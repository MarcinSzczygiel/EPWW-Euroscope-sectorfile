; Warszawa ACC ES by Marcin Dziadowiec
; All rights reserved
;Wykorzystanie plików zawieraj¹cych dane dla sektorów dla EPWW FIR publikowanych na tej stronie
; dla platform innych ni¿ VATSIM wymaga zgody Zarz¹du PL-VACC.
;Sector data files for EPWW FIR published here may not be used on network platforms
; other than VATSIM unless permission has been obtained from the Board of PL-VACC.

[INFO]
FIR Warszawa 1712 [09.11.2017]
EPWW_CTR
EPWA
N052.14.21.827
E019.23.31.961
60
37
-4
;-60.8
1

#define Color_1ACI        255
#define Color_2ACI      65535
#define Color_5ACI   16711680
#define Color_7ACI   16777215
#define Color_14ACI       153
#define Color_18ACI        76
#define Color_42ACI     39372
#define Color_44ACI     21346
#define Color_45ACI   5014937
#define Color_88ACI     19475
#define Color_92ACI     52224
#define Color_96ACI     32512
#define Color_186ACI  8323103
#define Color_250ACI  3355443
#define Color_251ACI  3618615
#define Color_252ACI  8684676
#define Color_253ACI 11382189

#define Color_16ACI       127
#define Color_46ACI     24447
#define Color_96ACI     32512
#define Color_196ACI  8323135
;#define Color_251ACI  5987163

#define gray 22878
#define red2 83
#define twy_epwa 4605761
#define epwa_grass 1456158
#define epwa_twy_edge 218254

#define stargray 2631720



;temp
#define pink 6560511

#define region_URBAN 1644825
#define vistula 1835008

;#define nonsch 3646192
#define nonsch 37887
;#define sch 4970129
#define sch 1113875
#define white 32896
#define maroon 128
#define teal 8421376
#define blue 5921280
#define PROHI 64
#define yellow 130
#define Blue 1058084
#define red 1058084
#define lime 65280
#define white 1058084
#define green 65025
#define ILSRED 130
#define build 81
#define olive 32896
#define blu 8672768
#define oranz 24767
#define ulica 24767
#define cctr  2309951
#define mrva  2043446
#define river  204344
#define grass 727571


;af2sct
#define runway 3355443
#define offset_threshold 255
#define apron 3618615
#define hold_short 125
#define ils_hold_short 125
#define wagrass 1456158

;regions
#define conc 2631720

[ARTCC LOW]
;EPSY
;A
EPSY_SEKTOR_A N053.43.02.000 E020.57.18.000 N053.41.44.000 E021.03.15.000
N053.41.44.000 E021.03.15.000 N053.40.49.000 E021.07.28.000
N053.40.49.000 E021.07.28.000 N053.36.21.000 E021.06.45.000
N053.36.21.000 E021.06.45.000 N053.29.21.000 E021.05.37.000
N053.29.21.000 E021.05.37.000 N053.25.49.000 E021.03.57.000
N053.25.49.000 E021.03.57.000 N053.25.31.000 E021.03.48.000
N053.25.31.000 E021.03.48.000 N053.17.57.000 E020.56.02.000
N053.17.57.000 E020.56.02.000 N053.13.42.000 E020.51.37.000
N053.13.42.000 E020.51.37.000 N053.17.21.000 E020.34.42.000
N053.17.21.000 E020.34.42.000 N053.23.36.000 E020.34.24.000
N053.23.36.000 E020.34.24.000 N053.33.07.000 E020.40.19.000
N053.33.07.000 E020.40.19.000 N053.41.53.000 E020.49.55.000
N053.41.53.000 E020.49.55.000 N053.43.02.000 E020.57.18.000

;B
EPSY_SEKTOR_B N053.40.40.000 E020.41.06.000 N053.43.55.000 E020.49.32.000
N053.43.55.000 E020.49.32.000 N053.47.10.000 E020.58.00.000
N053.47.10.000 E020.58.00.000 N053.47.37.000 E021.02.27.000
N053.47.37.000 E021.02.27.000 N053.46.54.000 E021.08.43.000
N053.46.54.000 E021.08.43.000 N053.45.16.000 E021.15.51.000
N053.45.16.000 E021.15.51.000 N053.43.54.000 E021.19.14.000
N053.43.54.000 E021.19.14.000 N053.41.19.000 E021.18.36.000
N053.41.19.000 E021.18.36.000 N053.38.42.000 E021.17.11.000
N053.38.42.000 E021.17.11.000 N053.36.21.000 E021.15.55.000
N053.36.21.000 E021.15.55.000 N053.25.31.000 E021.03.48.000
N053.25.31.000 E021.03.48.000 N053.17.57.000 E020.56.02.000
N053.17.57.000 E020.56.02.000 N053.13.42.000 E020.51.37.000
N053.13.42.000 E020.51.37.000 N053.17.21.000 E020.34.42.000
N053.17.21.000 E020.34.42.000 N053.18.55.000 E020.28.15.000
N053.18.55.000 E020.28.15.000 N053.23.33.000 E020.15.25.000
N053.23.33.000 E020.15.25.000 N053.37.08.000 E020.29.23.000
N053.37.08.000 E020.29.23.000 N053.40.40.000 E020.41.06.000

;C
EPSY_SEKTOR_C N053.23.33.000 E020.15.25.000 N053.30.12.000 E019.51.45.000
N053.30.12.000 E019.51.45.000 N053.38.49.000 E020.02.36.000
N053.38.49.000 E020.02.36.000 N053.40.49.000 E020.10.59.000
N053.40.49.000 E020.10.59.000 N053.37.08.000 E020.29.23.000
N053.37.08.000 E020.29.23.000 N053.23.33.000 E020.15.25.000

;D
EPSY_SEKTOR_D N053.40.45.000 E020.41.20.000 N053.40.40.000 E020.41.06.000
N053.40.40.000 E020.41.06.000 N053.45.44.000 E020.46.25.000
N053.45.44.000 E020.46.25.000 N053.50.48.000 E020.51.46.000
N053.50.48.000 E020.51.46.000 N053.51.26.000 E020.55.17.000
N053.51.26.000 E020.55.17.000 N053.52.17.000 E021.00.00.000
N053.52.17.000 E021.00.00.000 N053.52.16.000 E021.00.41.000
N053.52.16.000 E021.00.41.000 N053.52.07.000 E021.07.54.000
N053.52.07.000 E021.07.54.000 N053.50.44.000 E021.12.49.000
N053.50.44.000 E021.12.49.000 N053.49.32.000 E021.17.00.000
N053.49.32.000 E021.17.00.000 N053.46.04.000 E021.19.38.000
N053.46.04.000 E021.19.38.000 N053.43.54.000 E021.19.14.000
N053.43.54.000 E021.19.14.000 N053.45.16.000 E021.15.51.000
N053.45.16.000 E021.15.51.000 N053.46.54.000 E021.08.43.000
N053.46.54.000 E021.08.43.000 N053.47.37.000 E021.02.27.000
N053.47.37.000 E021.02.27.000 N053.47.10.000 E020.58.00.000
N053.47.10.000 E020.58.00.000 N053.47.02.000 E020.57.39.000
N053.47.02.000 E020.57.39.000 N053.40.45.000 E020.41.20.000

;EPLB
;A
EPLB_TMA_IN N051.16.13.000 E022.37.54.000 N051.19.58.000 E022.47.40.000
N051.19.58.000 E022.47.40.000 N051.22.07.000 E022.58.19.000
N051.22.07.000 E022.58.19.000 N051.20.44.000 E023.03.12.000
N051.20.44.000 E023.03.12.000 N051.17.38.000 E023.05.53.000
N051.17.38.000 E023.05.53.000 N051.12.06.000 E023.05.43.000
N051.12.06.000 E023.05.43.000 N051.10.55.000 E022.58.37.000
N051.10.55.000 E022.58.37.000 N051.08.25.000 E022.54.16.000
N051.08.25.000 E022.54.16.000 N051.07.18.000 E022.49.16.000
N051.07.18.000 E022.49.16.000 N051.04.14.000 E022.35.26.000
N051.04.14.000 E022.35.26.000 N051.06.05.000 E022.30.39.000
N051.06.05.000 E022.30.39.000 N051.07.22.000 E022.30.13.000
N051.07.22.000 E022.30.13.000 N051.09.22.000 E022.29.33.000
N051.09.22.000 E022.29.33.000 N051.14.11.000 E022.27.56.000
N051.14.11.000 E022.27.56.000 N051.15.40.000 E022.33.48.000
N051.15.40.000 E022.33.48.000 N051.16.13.000 E022.37.54.000

;B
N051.23.11.000 E023.01.05.000 N051.20.44.000 E023.03.12.000
N051.20.44.000 E023.03.12.000 N051.22.07.000 E022.58.19.000
N051.22.07.000 E022.58.19.000 N051.19.58.000 E022.47.40.000
N051.19.58.000 E022.47.40.000 N051.16.13.000 E022.37.54.000
N051.16.13.000 E022.37.54.000 N051.15.40.000 E022.33.48.000
N051.15.40.000 E022.33.48.000 N051.14.11.000 E022.27.56.000
N051.14.11.000 E022.27.56.000 N051.09.22.000 E022.29.33.000
N051.09.22.000 E022.29.33.000 N051.07.22.000 E022.30.13.000
N051.07.22.000 E022.30.13.000 N051.06.05.000 E022.30.39.000
N051.06.05.000 E022.30.39.000 N051.04.14.000 E022.35.26.000
N051.04.14.000 E022.35.26.000 N051.04.00.000 E022.28.18.000
N051.04.00.000 E022.28.18.000 N051.04.50.000 E022.24.54.000
N051.04.50.000 E022.24.54.000 N051.07.48.000 E022.19.13.000
N051.07.48.000 E022.19.13.000 N051.10.16.000 E022.19.13.000
N051.10.16.000 E022.19.13.000 N051.12.34.000 E022.19.12.000
N051.12.34.000 E022.19.12.000 N051.15.21.000 E022.19.35.000
N051.15.21.000 E022.19.35.000 N051.17.49.000 E022.21.45.000
N051.17.49.000 E022.21.45.000 N051.18.40.000 E022.22.53.000
N051.18.40.000 E022.22.53.000 N051.22.00.000 E022.27.20.000
N051.22.00.000 E022.27.20.000 N051.23.07.000 E022.50.44.000
N051.23.07.000 E022.50.44.000 N051.23.20.000 E022.55.59.000
N051.23.20.000 E022.55.59.000 N051.23.13.000 E022.59.49.000
N051.23.13.000 E022.59.49.000 N051.23.11.000 E023.01.05.000

;C
N051.07.18.000 E022.49.16.000 N051.08.25.000 E022.54.16.000
N051.08.25.000 E022.54.16.000 N051.10.55.000 E022.58.37.000
N051.10.55.000 E022.58.37.000 N051.12.06.000 E023.05.43.000
N051.12.06.000 E023.05.43.000 N051.07.28.000 E023.04.03.000
N051.07.28.000 E023.04.03.000 N051.04.34.000 E023.00.30.000
N051.04.34.000 E023.00.30.000 N051.02.22.000 E022.54.59.000
N051.02.22.000 E022.54.59.000 N051.01.50.000 E022.53.39.000
N051.01.50.000 E022.53.39.000 N051.07.18.000 E022.49.16.000

;D
N051.20.05.000 E022.18.09.000 N051.20.29.000 E022.20.04.000
N051.20.29.000 E022.20.04.000 N051.21.03.000 E022.22.44.000
N051.21.03.000 E022.22.44.000 N051.22.00.000 E022.27.20.000
N051.22.00.000 E022.27.20.000 N051.18.40.000 E022.22.53.000
N051.18.40.000 E022.22.53.000 N051.17.49.000 E022.21.45.000
N051.17.49.000 E022.21.45.000 N051.15.21.000 E022.19.35.000
N051.15.21.000 E022.19.35.000 N051.12.34.000 E022.19.12.000
N051.12.34.000 E022.19.12.000 N051.10.16.000 E022.19.13.000
N051.10.16.000 E022.19.13.000 N051.07.48.000 E022.19.13.000
N051.07.48.000 E022.19.13.000 N051.04.50.000 E022.24.54.000
N051.04.50.000 E022.24.54.000 N051.04.00.000 E022.28.18.000
N051.04.00.000 E022.28.18.000 N051.04.14.000 E022.35.26.000
N051.04.14.000 E022.35.26.000 N051.07.18.000 E022.49.16.000
N051.07.18.000 E022.49.16.000 N051.01.50.000 E022.53.39.000
N051.01.50.000 E022.53.39.000 N050.54.26.000 E022.36.42.000
N050.54.26.000 E022.36.42.000 N050.53.38.000 E022.33.59.000
N050.53.38.000 E022.33.59.000 N050.51.59.000 E022.23.53.000
N050.51.59.000 E022.23.53.000 N050.59.26.000 E022.16.51.000
N050.59.26.000 E022.16.51.000 N051.02.22.000 E022.14.04.000
N051.02.22.000 E022.14.04.000 N051.06.44.000 E022.10.34.000
N051.06.44.000 E022.10.34.000 N051.14.18.000 E022.12.00.000
N051.14.18.000 E022.12.00.000 N051.20.05.000 E022.18.09.000

;E
N050.51.59.000 E022.23.53.000 N050.53.05.000 E022.19.23.000
N050.53.05.000 E022.19.23.000 N050.54.34.000 E022.13.16.000
N050.54.34.000 E022.13.16.000 N051.02.57.000 E022.03.45.000
N051.02.57.000 E022.03.45.000 N051.06.19.000 E022.01.15.000
N051.06.19.000 E022.01.15.000 N051.07.00.000 E022.01.33.000
N051.07.00.000 E022.01.33.000 N051.17.28.000 E022.06.11.000
N051.17.28.000 E022.06.11.000 N051.19.18.000 E022.09.35.000
N051.19.18.000 E022.09.35.000 N051.20.05.000 E022.18.09.000
N051.20.05.000 E022.18.09.000 N051.14.18.000 E022.12.00.000
N051.14.18.000 E022.12.00.000 N051.06.44.000 E022.10.34.000
N051.06.44.000 E022.10.34.000 N051.02.22.000 E022.14.04.000
N051.02.22.000 E022.14.04.000 N050.59.26.000 E022.16.51.000
N050.59.26.000 E022.16.51.000 N050.51.59.000 E022.23.53.000

;F
N051.19.18.000 E022.09.35.000 N051.17.28.000 E022.06.11.000
N051.17.28.000 E022.06.11.000 N051.16.44.000 E022.04.50.000
N051.16.44.000 E022.04.50.000 N051.05.23.000 E021.50.08.000
N051.05.23.000 E021.50.08.000 N050.48.07.000 E022.06.23.000
N050.48.07.000 E022.06.23.000 N050.51.21.000 E022.20.58.000
N050.51.21.000 E022.20.58.000 N050.51.59.000 E022.23.53.000
N050.51.59.000 E022.23.53.000 N050.53.38.000 E022.33.59.000
N050.53.38.000 E022.33.59.000 N050.54.26.000 E022.36.42.000
N050.54.26.000 E022.36.42.000 N051.01.50.000 E022.53.39.000
N051.01.50.000 E022.53.39.000 N051.02.22.000 E022.54.59.000
N051.02.22.000 E022.54.59.000 N051.04.34.000 E023.00.30.000
N051.04.34.000 E023.00.30.000 N051.07.28.000 E023.04.03.000
N051.07.28.000 E023.04.03.000 N051.12.06.000 E023.05.43.000
N051.12.06.000 E023.05.43.000 N051.17.38.000 E023.05.53.000
N051.17.38.000 E023.05.53.000 N051.20.44.000 E023.03.12.000
N051.20.44.000 E023.03.12.000 N051.23.11.000 E023.01.05.000
N051.23.11.000 E023.01.05.000 N051.23.13.000 E022.59.49.000
N051.23.13.000 E022.59.49.000 N051.23.20.000 E022.55.59.000
N051.23.20.000 E022.55.59.000 N051.23.07.000 E022.50.44.000
N051.23.07.000 E022.50.44.000 N051.22.00.000 E022.27.20.000
N051.22.00.000 E022.27.20.000 N051.21.03.000 E022.22.44.000
N051.21.03.000 E022.22.44.000 N051.20.29.000 E022.20.04.000
N051.20.29.000 E022.20.04.000 N051.20.05.000 E022.18.09.000
N051.20.05.000 E022.18.09.000 N051.19.18.000 E022.09.35.000

;EPPO NORTH
;A
EPPO_TMA_IN N052.37.07.000 E016.20.39.000 N052.34.54.000 E016.57.46.000
N052.34.54.000 E016.57.46.000 N052.27.30.000 E017.16.09.000
N052.27.30.000 E017.16.09.000 N052.24.02.000 E017.24.42.000 
N052.24.02.000 E017.24.42.000 N052.21.39.000 E017.30.34.000
N052.21.39.000 E017.30.34.000 N052.04.28.000 E017.25.32.000
N052.04.28.000 E017.25.32.000 N052.08.37.000 E016.43.29.000
N052.08.37.000 E016.43.29.000 N052.17.11.000 E016.34.45.000
N052.17.11.000 E016.34.45.000 N052.23.20.000 E016.21.21.000
N052.23.20.000 E016.21.21.000 N052.35.36.000 E016.17.13.000
N052.35.36.000 E016.17.13.000 N052.37.07.000 E016.20.39.000

;B
N052.31.27.000 E016.07.51.000 N052.35.36.000 E016.17.13.000
N052.35.36.000 E016.17.13.000 N052.23.20.000 E016.21.22.000
N052.23.20.000 E016.21.22.000 N052.17.11.000 E016.34.45.000
N052.17.11.000 E016.34.45.000 N052.08.37.000 E016.43.29.000
N052.08.37.000 E016.43.29.000 N052.04.28.000 E017.25.32.000
N052.04.28.000 E017.25.32.000 N052.03.33.000 E017.25.16.000
N052.03.33.000 E017.25.16.000 N051.58.59.000 E017.15.46.000
N051.58.59.000 E017.15.46.000 N052.01.49.000 E016.39.00.000
N052.01.49.000 E016.39.00.000 N052.06.28.000 E016.29.47.000
N052.06.28.000 E016.29.47.000 N052.24.14.000 E016.11.09.000
N052.24.14.000 E016.11.09.000 N052.31.27.000 E016.07.51.000

;C
N052.32.54.000 E016.00.43.000 N052.19.48.000 E016.07.02.000
N052.19.48.000 E016.07.02.000 N052.19.28.000 E016.07.12.000
N052.19.28.000 E016.07.12.000 N052.10.57.000 E016.13.11.000
N052.10.57.000 E016.13.11.000 N052.10.01.000 E016.13.42.000
N052.10.01.000 E016.13.42.000 N052.07.05.000 E016.15.21.000
N052.07.05.000 E016.15.21.000 N051.54.43.000 E016.43.44.000
N051.54.43.000 E016.43.44.000 N051.55.02.000 E017.21.00.000
N051.55.02.000 E017.21.00.000 N052.00.17.000 E017.31.55.000
N052.00.17.000 E017.31.55.000 N052.18.32.000 E017.38.11.000
N052.18.32.000 E017.38.11.000 N052.21.39.000 E017.30.34.000
N052.21.39.000 E017.30.34.000 N052.24.44.000 E017.23.00.000
N052.24.44.000 E017.23.00.000 N052.32.19.000 E017.32.11.000
N052.32.19.000 E017.32.11.000 N052.38.41.000 E017.04.55.000
N052.38.41.000 E017.04.55.000 N052.38.41.000 E017.04.53.000
N052.38.41.000 E017.04.53.000 N052.41.32.000 E016.18.19.000
N052.41.32.000 E016.18.19.000 N052.32.54.000 E016.00.43.000

;D
EPPO_TMA_OUT N052.58.51.000 E015.33.30.000 N052.09.27.000 E015.30.04.000
N052.09.27.000 E015.30.04.000 N052.03.37.000 E015.32.00.000
N052.03.37.000 E015.32.00.000 N052.00.49.000 E015.36.34.000
N052.00.49.000 E015.36.34.000 N051.37.03.000 E016.00.00.000
N051.37.03.000 E016.00.00.000 N051.45.00.000 E017.40.42.000
N051.45.00.000 E017.40.42.000 N051.59.48.000 E018.00.00.000
N051.59.48.000 E018.00.00.000 N052.56.33.000 E018.00.00.000
N052.56.33.000 E018.00.00.000 N052.56.35.000 E017.53.57.000
N052.56.35.000 E017.53.57.000 N052.56.36.000 E017.48.15.000
N052.56.36.000 E017.48.15.000 N052.56.37.000 E017.39.17.000
N052.56.37.000 E017.39.17.000 N052.56.31.000 E017.21.42.000
N052.56.31.000 E017.21.42.000 N052.57.46.000 E017.18.33.000
N052.57.46.000 E017.18.33.000 N053.06.44.000 E017.15.57.000
N053.06.44.000 E017.15.57.000 N053.11.06.000 E017.16.17.000
N053.11.06.000 E017.16.17.000 N053.12.37.000 E017.17.24.000
N053.12.37.000 E017.17.24.000 N053.11.18.000 E016.34.37.000
N053.11.18.000 E016.34.37.000 N052.58.51.000 E015.33.30.000

;EPPO SOUTH
;A
EPPO_TMA_IN N051.20.00.000 E016.30.57.000 N051.21.15.000 E016.36.57.000
N051.21.15.000 E016.36.57.000 N051.09.34.000 E017.19.34.000
N051.09.34.000 E017.19.34.000 N051.09.40.000 E017.28.55.000
N051.09.40.000 E017.28.55.000 N051.05.36.000 E017.34.14.000
N051.05.36.000 E017.34.14.000 N051.01.15.000 E017.34.28.000
N051.01.15.000 E017.34.28.000 N050.49.17.000 E017.23.22.000
N050.49.17.000 E017.23.22.000 N050.48.05.000 E017.15.47.000
N050.48.05.000 E017.15.47.000 N050.50.15.000 E017.07.33.000
N050.50.15.000 E017.07.33.000 N051.02.18.000 E016.22.44.000
N051.02.18.000 E016.22.44.000 N051.06.22.000 E016.20.40.000
N051.06.22.000 E016.20.40.000 N051.20.00.000 E016.30.57.000

;B
N051.22.53.000 E016.24.24.000 N051.23.35.000 E016.47.44.000
N051.23.35.000 E016.47.44.000 N051.11.09.000 E017.34.13.000
N051.11.09.000 E017.34.13.000 N051.05.36.000 E017.34.14.000
N051.05.36.000 E017.34.14.000 N051.01.15.000 E017.34.28.000
N051.01.15.000 E017.34.28.000 N050.49.17.000 E017.23.22.000
N050.49.17.000 E017.23.22.000 N050.48.05.000 E017.15.47.000
N050.48.05.000 E017.15.47.000 N050.45.58.000 E017.02.25.000
N050.45.58.000 E017.02.25.000 N050.59.10.000 E016.12.25.000
N050.59.10.000 E016.12.25.000 N051.11.29.000 E016.14.10.000
N051.11.29.000 E016.14.10.000 N051.22.53.000 E016.24.24.000

;C
N051.22.53.000 E016.24.24.000 N051.28.11.000 E016.44.56.000
N051.28.11.000 E016.44.56.000 N051.29.44.000 E017.07.26.000
N051.29.44.000 E017.07.26.000 N051.28.17.000 E017.23.08.000
N051.28.17.000 E017.23.08.000 N051.19.59.000 E017.33.21.000
N051.19.59.000 E017.33.21.000 N051.18.55.000 E017.34.40.000
N051.18.55.000 E017.34.40.000 N051.10.13.000 E017.45.17.000
N051.10.13.000 E017.45.17.000 N051.00.05.000 E017.46.09.000
N051.00.05.000 E017.46.09.000 N050.54.41.000 E017.41.45.000
N050.54.41.000 E017.41.45.000 N050.44.15.000 E017.32.01.000
N050.44.15.000 E017.32.01.000 N050.42.17.000 E017.17.54.000
N050.42.17.000 E017.17.54.000 N050.45.58.000 E017.02.25.000
N050.45.58.000 E017.02.25.000 N050.48.05.000 E017.15.47.000
N050.48.05.000 E017.15.47.000 N050.49.17.000 E017.23.22.000
N050.49.17.000 E017.23.22.000 N051.01.15.000 E017.34.28.000
N051.01.15.000 E017.34.28.000 N051.05.41.000 E017.34.13.000
N051.05.41.000 E017.34.13.000 N051.11.09.000 E017.34.13.000
N051.11.09.000 E017.34.13.000 N051.23.35.000 E016.47.44.000
N051.23.35.000 E016.47.44.000 N051.22.53.000 E016.24.24.000

;D
N051.05.33.000 E017.08.42.000 N051.02.58.000 E017.13.08.000
N051.02.58.000 E017.13.08.000 N050.56.49.000 E017.08.42.000
N050.56.49.000 E017.08.42.000 N050.57.38.000 E017.02.40.000
N050.57.38.000 E017.02.40.000 N051.05.33.000 E017.08.42.000

;E
N051.14.03.000 E016.32.21.000 N051.15.10.000 E016.34.56.000
N051.15.10.000 E016.34.56.000 N051.14.11.000 E016.39.28.000
N051.14.11.000 E016.39.28.000 N051.06.01.000 E016.33.52.000
N051.06.01.000 E016.33.52.000 N051.07.22.000 E016.30.09.000
N051.07.22.000 E016.30.09.000 N051.09.22.000 E016.29.10.000
N051.09.22.000 E016.29.10.000 N051.14.03.000 E016.32.21.000

;F
EPPO_TMA_OUT N051.37.03.000 E016.00.00.000 N051.45.00.000 E017.40.42.000
N051.45.00.000 E017.40.42.000 N051.29.18.000 E018.00.29.000
N051.29.18.000 E018.00.29.000 N050.53.40.000 E018.44.18.000
N050.53.40.000 E018.44.18.000 N050.39.12.000 E018.24.42.000
N050.39.12.000 E018.24.42.000 N050.31.34.000 E018.14.51.000
N050.31.34.000 E018.14.51.000 N050.22.32.000 E018.06.31.000
N050.22.32.000 E018.06.31.000 N050.19.58.000 E017.55.26.000
N050.19.58.000 E017.55.26.000 N050.49.45.000 E016.07.17.000
N050.49.45.000 E016.07.17.000 N051.07.28.000 E016.00.36.000
N051.07.28.000 E016.00.36.000 N051.16.36.000 E015.58.32.000
N051.16.36.000 E015.58.32.000 N051.37.03.000 E016.00.00.000

;CTA5
;N051.37.03.000 E016.00.00.000 N051.16.36.000 E015.58.32.000
;N051.16.36.000 E015.58.32.000 N051.07.28.000 E016.00.36.000
;N051.07.28.000 E016.00.36.000 N050.49.45.000 E016.07.17.000
;N050.49.45.000 E016.07.17.000 N050.23.22.000 E017.43.29.000
N050.23.22.000 E017.43.29.000 N050.19.21.960 E017.42.43.400

;TMA EPZG
EPZG_TMA N052.12.22.000 E015.33.13.000 N052.18.07.000 E015.52.49.000
N052.18.07.000 E015.52.49.000 N052.19.47.000 E016.01.18.000
N052.19.47.000 E016.01.18.000 N052.19.48.000 E016.07.02.000
N052.19.48.000 E016.07.02.000 N052.19.28.000 E016.07.12.000
N052.19.28.000 E016.07.12.000 N052.10.57.000 E016.13.11.000
N052.10.57.000 E016.13.11.000 N052.10.01.000 E016.13.42.000
N052.10.01.000 E016.13.42.000 N052.04.07.000 E016.04.30.000
N052.04.07.000 E016.04.30.000 N052.02.20.000 E015.58.04.000
N052.02.20.000 E015.58.04.000 N052.01.58.000 E015.54.06.000
N052.01.58.000 E015.54.06.000 N052.00.49.000 E015.36.34.000
N052.00.49.000 E015.36.34.000 N052.03.37.000 E015.32.00.000
N052.03.37.000 E015.32.00.000 N052.09.27.000 E015.30.04.000
N052.09.27.000 E015.30.04.000 N052.12.22.000 E015.33.13.000

;TMA EPGD A
EPGD_TMA_IN N054.33.34.000 E018.00.31.000 N054.35.50.000 E018.18.27.000
N054.35.50.000 E018.18.27.000 N054.27.47.000 E018.24.44.000
N054.27.47.000 E018.24.44.000 N054.26.56.000 E018.32.40.000
N054.26.56.000 E018.32.40.000 N054.25.09.000 E018.47.50.000
N054.25.09.000 E018.47.50.000 N054.23.00.000 E019.00.00.000
N054.23.00.000 E019.00.00.000 N054.19.18.000 E019.04.57.000
N054.19.18.000 E019.04.57.000 N054.09.00.000 E019.00.00.000
N054.09.00.000 E019.00.00.000 N054.03.20.000 E018.51.59.000
N054.03.20.000 E018.51.59.000 N053.59.58.000 E018.31.28.000
N053.59.58.000 E018.31.28.000 N053.58.38.000 E018.23.30.000
N053.58.38.000 E018.23.30.000 N054.15.00.000 E017.50.00.000
N054.15.00.000 E017.50.00.000 N054.20.17.000 E017.50.00.000
N054.20.17.000 E017.50.00.000 N054.22.22.000 E017.55.13.000
N054.22.22.000 E017.55.13.000 N054.23.23.000 E018.03.00.000
N054.23.23.000 E018.03.00.000 N054.33.34.000 E018.00.31.000

;TMA EPGD B
N054.38.53.000 E017.56.35.000 N054.40.41.000 E018.14.38.000
N054.40.41.000 E018.14.38.000 N054.41.01.000 E018.36.16.000
N054.41.01.000 E018.36.16.000 N054.29.45.000 E018.55.23.000
N054.29.45.000 E018.55.23.000 N054.23.00.000 E019.00.00.000
N054.23.00.000 E019.00.00.000 N054.25.09.000 E018.47.50.000
N054.25.09.000 E018.47.50.000 N054.26.56.000 E018.32.40.000
N054.26.56.000 E018.32.40.000 N054.27.47.000 E018.24.44.000
N054.27.47.000 E018.24.44.000 N054.35.50.000 E018.18.27.000
N054.35.50.000 E018.18.27.000 N054.33.34.000 E018.00.31.000
N054.33.34.000 E018.00.31.000 N054.23.23.000 E018.03.00.000
N054.23.23.000 E018.03.00.000 N054.22.22.000 E017.55.13.000
N054.22.22.000 E017.55.13.000 N054.20.17.000 E017.50.00.000
N054.20.17.000 E017.50.00.000 N054.33.10.000 E017.50.00.000
N054.33.10.000 E017.50.00.000 N054.38.53.000 E017.56.35.000


;TMA EPGD C
N054.47.43.000 E017.49.36.000 N054.48.58.000 E018.23.09.000
N054.48.58.000 E018.23.09.000 N054.32.37.000 E019.06.25.000
N054.32.37.000 E019.06.25.000 N054.09.05.000 E019.15.59.000
N054.09.05.000 E019.15.59.000 N053.52.38.000 E019.07.04.000
N053.52.38.000 E019.07.04.000 N053.51.21.000 E018.51.23.000
N053.51.21.000 E018.51.23.000 N053.49.20.000 E018.31.32.000
N053.49.20.000 E018.31.32.000 N054.10.43.000 E017.49.37.000
N054.10.43.000 E017.49.37.000 N054.08.28.000 E017.30.16.000
N054.08.28.000 E017.30.16.000 N054.13.27.000 E017.26.56.000
N054.13.27.000 E017.26.56.000 N054.23.33.000 E017.24.19.000
N054.23.33.000 E017.24.19.000 N054.32.26.000 E017.30.51.000
N054.32.26.000 E017.30.51.000 N054.47.43.000 E017.49.36.000

;TMA EPGD D
EPGD_TMA_OUT N054.08.28.000 E017.30.16.000 N054.10.43.000 E017.49.37.000
N054.10.43.000 E017.49.37.000 N053.49.20.000 E018.31.32.000
N053.49.20.000 E018.31.32.000 N053.51.21.000 E018.51.23.000
N053.51.21.000 E018.51.23.000 N053.52.38.000 E019.07.04.000
N053.52.38.000 E019.07.04.000 N053.50.31.000 E019.05.56.000
N053.50.31.000 E019.05.56.000 N053.41.43.000 E018.26.19.000
N053.41.43.000 E018.26.19.000 N054.08.28.000 E017.30.16.000

;UTMA GDANSK

EPGD_TMA_OUT N055.08.07.000 E016.15.01.000 N055.17.24.660 E018.24.03.860
N055.17.24.660 E018.24.03.860 N054.27.29.998 E019.38.30.199
N054.27.29.998 E019.38.30.199 N054.25.18.000 E020.00.00.000
N054.25.18.000 E020.00.00.000 N053.33.51.000 E020.18.20.000
N053.33.51.000 E020.18.20.000 N053.26.21.000 E019.24.33.000
N053.26.21.000 E019.24.33.000 N053.19.05.000 E018.44.35.000
N053.19.05.000 E018.44.35.000 N053.11.34.000 E018.06.35.000
N053.11.34.000 E018.06.35.000 N052.44.05.000 E017.34.42.000
N052.44.05.000 E017.34.42.000 N053.11.18.000 E016.34.37.000
N053.11.18.000 E016.34.37.000 N053.37.29.000 E016.56.09.000
N053.37.29.000 E016.56.09.000 N054.31.54.000 E015.33.12.000
N054.31.54.000 E015.33.12.000 N054.41.06.000 E015.43.09.000
N054.41.06.000 E015.43.09.000 N054.55.00.000 E015.52.00.000
N054.55.00.000 E015.52.00.000 N055.08.07.000 E016.15.01.000

;TMA EPBY
EPBY_TMA_A N053.14.22.000 E018.07.18.000 N053.15.51.000 E018.16.50.000
N053.15.51.000 E018.16.50.000 N053.15.46.000 E018.20.16.000
N053.15.46.000 E018.20.16.000 N053.11.19.000 E018.26.49.000
N053.11.19.000 E018.26.49.000 N053.05.55.000 E018.27.28.000
N053.05.55.000 E018.27.28.000 N053.03.19.000 E018.25.56.000
N053.03.19.000 E018.25.56.000 N052.59.15.000 E018.21.39.000
N052.59.15.000 E018.21.39.000 N052.57.24.000 E018.17.03.000
N052.57.24.000 E018.17.03.000 N052.56.32.000 E018.05.01.000
N052.56.32.000 E018.05.01.000 N052.56.35.000 E017.53.57.000
N052.56.35.000 E017.53.57.000 N052.56.36.000 E017.48.15.000
N052.56.36.000 E017.48.15.000 N052.57.44.000 E017.44.10.000
N052.57.44.000 E017.44.10.000 N052.58.44.000 E017.41.30.000
N052.58.44.000 E017.41.30.000 N053.03.47.000 E017.39.38.000
N053.03.47.000 E017.39.38.000 N053.08.11.000 E017.40.03.000
N053.08.11.000 E017.40.03.000 N053.08.46.000 E017.40.46.000
N053.08.46.000 E017.40.46.000 N053.10.16.000 E017.42.37.000
N053.10.16.000 E017.42.37.000 N053.11.23.000 E017.50.49.000
N053.11.23.000 E017.50.49.000 N053.14.22.000 E018.07.18.000

EPBY_TMA_B N053.11.23.000 E017.50.49.000 N053.14.22.000 E018.07.18.000
N053.14.22.000 E018.07.18.000 N053.15.51.000 E018.16.50.000
N053.15.51.000 E018.16.50.000 N053.15.46.000 E018.20.16.000
N053.15.46.000 E018.20.16.000 N053.11.19.000 E018.26.49.000
N053.11.19.000 E018.26.49.000 N053.05.55.000 E018.27.28.000
N053.05.55.000 E018.27.28.000 N053.03.19.000 E018.25.56.000
N053.03.19.000 E018.25.56.000 N052.59.15.000 E018.21.39.000
N052.59.15.000 E018.21.39.000 N052.57.24.000 E018.17.03.000
N052.57.24.000 E018.17.03.000 N052.56.32.000 E018.05.01.000
N052.56.32.000 E018.05.01.000 N052.56.35.000 E017.53.57.000
N052.56.35.000 E017.53.57.000 N052.56.36.000 E017.48.15.000
N052.56.36.000 E017.48.15.000 N052.56.37.000 E017.39.17.000
N052.56.37.000 E017.39.17.000 N053.00.11.000 E017.34.19.000
N053.00.11.000 E017.34.19.000 N053.02.12.000 E017.32.10.000
N053.02.12.000 E017.32.10.000 N053.08.51.000 E017.32.19.000
N053.08.51.000 E017.32.19.000 N053.10.16.000 E017.42.37.000
N053.10.16.000 E017.42.37.000 N053.11.23.000 E017.50.49.000

EPBY_TMA_C N053.11.06.000 E017.16.17.000 N053.12.37.000 E017.17.24.000
N053.12.37.000 E017.17.24.000 N053.13.51.000 E017.20.54.000
N053.13.51.000 E017.20.54.000 N053.11.23.000 E017.50.49.000
N053.11.23.000 E017.50.49.000 N053.22.04.000 E018.17.02.000
N053.22.04.000 E018.17.02.000 N053.22.17.000 E018.29.29.000
N053.22.17.000 E018.29.29.000 N053.17.28.000 E018.39.46.000
N053.17.28.000 E018.39.46.000 N053.05.04.000 E018.43.10.000
N053.05.04.000 E018.43.10.000 N053.03.40.000 E018.28.52.000
N053.03.40.000 E018.28.52.000 N052.59.15.000 E018.21.39.000
N052.59.15.000 E018.21.39.000 N052.57.24.000 E018.17.03.000
N052.57.24.000 E018.17.03.000 N052.56.32.000 E018.05.01.000
N052.56.32.000 E018.05.01.000 N052.56.35.000 E017.53.57.000
N052.56.35.000 E017.53.57.000 N052.56.36.000 E017.48.15.000
N052.56.36.000 E017.48.15.000 N052.56.37.000 E017.39.17.000
N052.56.37.000 E017.39.17.000 N052.56.31.000 E017.21.42.000
N052.56.31.000 E017.21.42.000 N052.57.46.000 E017.18.33.000
N052.57.46.000 E017.18.33.000 N053.06.44.000 E017.15.57.000
N053.06.44.000 E017.15.57.000 N053.11.06.000 E017.16.17.000


; LTMA SEKTOR A EPKK
EPKK_TMA_IN N050.10.03.000 E019.22.11.000 N050.21.21.000 E020.02.11.000
N050.21.21.000 E020.02.11.000 N050.21.19.908 E020.02.31.739 ;arc beg
N050.21.19.908 E020.02.31.739 N050.21.14.112 E020.03.18.467
N050.21.14.112 E020.03.18.467 N050.21.07.235 E020.04.04.836
N050.21.07.235 E020.04.04.836 N050.20.59.352 E020.04.50.772
N050.20.59.352 E020.04.50.772 N050.20.50.424 E020.05.36.275
N050.20.50.424 E020.05.36.275 N050.20.40.488 E020.06.21.276
N050.20.40.488 E020.06.21.276 N050.20.29.544 E020.07.05.699
N050.20.29.544 E020.07.05.699 N050.20.17.628 E020.07.49.512
N050.20.17.628 E020.07.49.512 N050.20.04.740 E020.08.32.639
N050.20.04.740 E020.08.32.639 N050.19.50.880 E020.09.15.048
N050.19.50.880 E020.09.15.048 N050.19.36.083 E020.09.56.663
N050.19.36.083 E020.09.56.663 N050.19.20.351 E020.10.37.452
N050.19.20.351 E020.10.37.452 N050.19.03.755 E020.11.17.375
N050.19.03.755 E020.11.17.375 N050.18.46.259 E020.11.56.327
N050.18.46.259 E020.11.56.327 N050.18.27.899 E020.12.34.344
N050.18.27.899 E020.12.34.344 N050.18.08.676 E020.13.11.315
N050.18.08.676 E020.13.11.315 N050.17.48.659 E020.13.47.244
N050.17.48.659 E020.13.47.244 N050.17.27.851 E020.14.22.056
N050.17.27.851 E020.14.22.056 N050.17.06.288 E020.14.55.679
N050.17.06.288 E020.14.55.679 N050.16.43.968 E020.15.28.151
N050.16.43.968 E020.15.28.151 N050.16.20.928 E020.15.59.364
N050.16.20.928 E020.15.59.364 N050.15.57.203 E020.16.29.315
N050.15.57.203 E020.16.29.315 N050.15.32.832 E020.16.57.935
N050.15.32.832 E020.16.57.935 N050.15.07.848 E020.17.25.260
N050.15.07.848 E020.17.25.260 N050.14.42.251 E020.17.51.180
N050.14.42.251 E020.17.51.180 N050.14.16.116 E020.18.15.659
N050.14.16.116 E020.18.15.659 N050.13.49.403 E020.18.38.735
N050.13.49.403 E020.18.38.735 N050.13.22.223 E020.19.00.335
N050.13.22.223 E020.19.00.335 N050.12.54.575 E020.19.20.460
N050.12.54.575 E020.19.20.460 N050.12.26.496 E020.19.39.036
N050.12.26.496 E020.19.39.036 N050.11.57.984 E020.19.56.099
N050.11.57.984 E020.19.56.099 N050.11.29.147 E020.20.11.579
N050.11.29.147 E020.20.11.579 N050.10.59.952 E020.20.25.512
N050.10.59.952 E020.20.25.512 N050.10.30.503 E020.20.37.824
N050.10.30.503 E020.20.37.824 N050.10.00.767 E020.20.48.516
N050.10.00.767 E020.20.48.516 N050.09.30.816 E020.20.57.624
N050.09.30.816 E020.20.57.624 N050.09.00.684 E020.21.05.040
N050.09.00.684 E020.21.05.040 N050.08.30.372 E020.21.10.836
N050.08.30.372 E020.21.10.836 N050.07.59.988 E020.21.15.011
N050.07.59.988 E020.21.15.011 N050.07.24.000 E020.21.13.000 ;arc end
N050.07.24.000 E020.21.13.000 N050.03.25.000 E020.20.56.000
N050.03.25.000 E020.20.56.000 N050.01.55.000 E020.20.49.000
N050.01.55.000 E020.20.49.000 N049.58.24.000 E020.12.13.000
N049.58.24.000 E020.12.13.000 N049.51.39.000 E019.27.39.000
N049.51.39.000 E019.27.39.000 N049.54.13.000 E019.23.26.000
N049.54.13.000 E019.23.26.000 N050.03.53.000 E019.20.20.000
N050.03.53.000 E019.20.20.000 N050.10.03.000 E019.22.11.000

; LTMA SEKTOR A EPKT
N050.38.08.000 E018.38.20.000 N050.39.09.000 E019.12.31.000
N050.39.09.000 E019.12.31.000 N050.39.02.000 E019.20.14.000
N050.39.02.000 E019.20.14.000 N050.39.02.952 E019.21.12.960 ;arc beg
N050.39.02.952 E019.21.12.960 N050.39.01.404 E019.21.47.519
N050.39.01.404 E019.21.47.519 N050.38.59.099 E019.22.22.007
N050.38.59.099 E019.22.22.007 N050.38.56.039 E019.22.56.316
N050.38.56.039 E019.22.56.316 N050.38.52.224 E019.23.30.444
N050.38.52.224 E019.23.30.444 N050.38.47.616 E019.24.04.319
N050.38.47.616 E019.24.04.319 N050.38.42.288 E019.24.37.944
N050.38.42.288 E019.24.37.944 N050.38.36.203 E019.25.11.279
N050.38.36.203 E019.25.11.279 N050.38.29.400 E019.25.44.220
N050.38.29.400 E019.25.44.220 N050.38.21.840 E019.26.16.799
N050.38.21.840 E019.26.16.799 N050.38.13.595 E019.26.48.911
N050.38.13.595 E019.26.48.911 N050.38.04.631 E019.27.20.555
N050.38.04.631 E019.27.20.555 N050.37.54.947 E019.27.51.731
N050.37.54.947 E019.27.51.731 N050.37.44.616 E019.28.22.296
N050.37.44.616 E019.28.22.296 N050.37.33.564 E019.28.52.320
N050.37.33.564 E019.28.52.320 N050.37.21.900 E019.29.21.696
N050.37.21.900 E019.29.21.696 N050.37.09.552 E019.29.50.424
N050.37.09.552 E019.29.50.424 N050.36.56.592 E019.30.18.468
N050.36.56.592 E019.30.18.468 N050.36.43.020 E019.30.45.792
N050.36.43.020 E019.30.45.792 N050.36.28.836 E019.31.12.323
N050.36.28.836 E019.31.12.323 N050.36.14.075 E019.31.38.063
N050.36.14.075 E019.31.38.063 N050.35.58.776 E019.32.03.011
N050.35.58.776 E019.32.03.011 N050.35.42.900 E019.32.27.059
N050.35.42.900 E019.32.27.059 N050.35.26.519 E019.32.50.244
N050.35.26.519 E019.32.50.244 N050.35.09.636 E019.33.12.528
N050.35.09.636 E019.33.12.528 N050.34.52.248 E019.33.33.875
N050.34.52.248 E019.33.33.875 N050.34.34.391 E019.33.54.251
N050.34.34.391 E019.33.54.251 N050.34.16.103 E019.34.13.620
N050.34.16.103 E019.34.13.620 N050.33.57.420 E019.34.31.979
N050.33.57.420 E019.34.31.979 N050.33.38.303 E019.34.49.295
N050.33.38.303 E019.34.49.295 N050.33.18.863 E019.35.05.567
N050.33.18.863 E019.35.05.567 N050.32.59.027 E019.35.20.759
N050.32.59.027 E019.35.20.759 N050.32.38.868 E019.35.34.835
N050.32.38.868 E019.35.34.835 N050.32.18.419 E019.35.47.832
N050.32.18.419 E019.35.47.832 N050.31.57.719 E019.35.59.676
N050.31.57.719 E019.35.59.676 N050.31.36.732 E019.36.10.403
N050.31.36.732 E019.36.10.403 N050.31.15.528 E019.36.19.944
N050.31.15.528 E019.36.19.944 N050.30.54.143 E019.36.28.331
N050.30.54.143 E019.36.28.331 N050.30.32.580 E019.36.35.532
N050.30.32.580 E019.36.35.532 N050.30.10.836 E019.36.41.544
N050.30.10.836 E019.36.41.544 N050.29.49.019 E019.36.46.368
N050.29.49.019 E019.36.46.368 N050.29.27.095 E019.36.50.004
N050.29.27.095 E019.36.50.004 N050.29.05.064 E019.36.52.416
N050.29.05.064 E019.36.52.416 N050.28.43.031 E019.36.53.603
N050.28.43.031 E019.36.53.603 N050.28.20.999 E019.36.53.603
N050.28.20.999 E019.36.53.603 N050.27.58.931 E019.36.52.416
N050.27.58.931 E019.36.52.416 N050.27.36.935 E019.36.50.004
N050.27.36.935 E019.36.50.004 N050.27.15.011 E019.36.46.368
N050.27.15.011 E019.36.46.368 N050.26.53.195 E019.36.41.544
N050.26.53.195 E019.36.41.544 N050.26.31.452 E019.36.35.532
N050.26.31.452 E019.36.35.532 N050.26.09.887 E019.36.28.331
N050.26.09.887 E019.36.28.331 N050.25.48.504 E019.36.19.944
N050.25.48.504 E019.36.19.944 N050.25.27.300 E019.36.10.403
N050.25.27.300 E019.36.10.403 N050.25.06.311 E019.35.59.676
N050.25.06.311 E019.35.59.676 N050.24.45.611 E019.35.47.832
N050.24.45.611 E019.35.47.832 N050.24.25.164 E019.35.34.835
N050.24.25.164 E019.35.34.835 N050.24.05.003 E019.35.20.759
N050.24.05.003 E019.35.20.759 N050.23.45.167 E019.35.05.567
N050.23.45.167 E019.35.05.567 N050.23.25.727 E019.34.49.295
N050.23.25.727 E019.34.49.295 N050.23.06.612 E019.34.31.979
N050.23.06.612 E019.34.31.979 N050.22.47.928 E019.34.13.620
N050.22.47.928 E019.34.13.620 N050.22.29.639 E019.33.54.215
N050.22.29.639 E019.33.54.215 N050.22.11.783 E019.33.33.875
N050.22.11.783 E019.33.33.875 N050.21.54.396 E019.33.12.528
N050.21.54.396 E019.33.12.528 N050.21.37.511 E019.32.50.244
N050.21.37.511 E019.32.50.244 N050.21.21.132 E019.32.27.059
N050.21.21.132 E019.32.27.059 N050.21.05.256 E019.32.03.011
N050.21.05.256 E019.32.03.011 N050.20.49.955 E019.31.38.063
N050.20.49.955 E019.31.38.063 N050.20.35.196 E019.31.12.323
N050.20.35.196 E019.31.12.323 N050.20.21.012 E019.30.45.792
N050.20.21.012 E019.30.45.792 N050.20.07.439 E019.30.18.468
N050.20.07.439 E019.30.18.468 N050.19.54.480 E019.29.50.424
N050.19.54.480 E019.29.50.424 N050.19.42.131 E019.29.21.696
N050.19.42.131 E019.29.21.696 N050.19.30.468 E019.28.52.320
N050.19.30.468 E019.28.52.320 N050.19.19.416 E019.28.22.296
N050.19.19.416 E019.28.22.296 N050.19.09.083 E019.27.51.731
N050.19.09.083 E019.27.51.731 N050.18.59.399 E019.27.20.555
N050.18.59.399 E019.27.20.555 N050.18.50.436 E019.26.48.911
N050.18.50.436 E019.26.48.911 N050.18.42.192 E019.26.16.799
N050.18.42.192 E019.26.16.799 N050.18.34.632 E019.25.44.220
N050.18.34.632 E019.25.44.220 N050.18.27.827 E019.25.11.279
N050.18.27.827 E019.25.11.279 N050.18.21.744 E019.24.37.944
N050.18.21.744 E019.24.37.944 N050.18.16.416 E019.24.04.319
N050.18.16.416 E019.24.04.319 N050.18.11.808 E019.23.30.444
N050.18.11.808 E019.23.30.444 N050.18.07.991 E019.22.56.316
N050.18.07.991 E019.22.56.316 N050.18.04.931 E019.22.22.007
N050.18.04.931 E019.22.22.007 N050.18.02.628 E019.21.47.519
N050.18.02.628 E019.21.47.519 N050.18.01.080 E019.21.12.960
N050.18.01.080 E019.21.12.960 N050.18.00.323 E019.20.38.327
N050.18.00.323 E019.20.38.327 N050.18.00.323 E019.20.03.696
N050.18.00.323 E019.20.03.696 N050.18.01.080 E019.19.29.063
N050.18.01.080 E019.19.29.063 N050.18.02.628 E019.18.54.503
N050.18.02.628 E019.18.54.503 N050.18.04.931 E019.18.20.015
N050.18.04.931 E019.18.20.015 N050.18.08.000 E019.17.55.000 ;arc end
N050.18.08.000 E019.17.55.000 N050.18.49.000 E019.11.45.000
N050.18.49.000 E019.11.45.000 N050.23.48.000 E018.34.18.000
N050.23.48.000 E018.34.18.000 N050.26.36.000 E018.30.22.000
N050.26.36.000 E018.30.22.000 N050.38.08.000 E018.38.20.000



; LTMA EPKK B
N050.40.09.000 E018.30.56.000 N050.42.25.000 E019.41.42.000
N050.42.25.000 E019.41.42.000 N050.22.37.000 E020.15.22.000
N050.22.37.000 E020.15.22.000 N050.20.16.000 E020.19.19.000
N050.20.16.000 E020.19.19.000 N050.01.20.000 E020.30.25.000 
N050.01.20.000 E020.30.25.000 N049.51.56.000 E020.23.50.000
N049.51.56.000 E020.23.50.000 N049.44.39.000 E019.53.22.000
N049.44.39.000 E019.53.22.000 N049.52.00.000 E019.18.04.000
N049.52.00.000 E019.18.04.000 N050.31.16.000 E018.23.48.000
N050.31.16.000 E018.23.48.000 N050.40.09.000 E018.30.56.000

;responsibility boundary between EPKK & EPKT
;N050.49.33.000 E019.41.51.000 N050.42.25.000 E019.41.32.000
;N050.42.25.000 E019.41.32.000 N050.21.45.000 E019.40.00.000
;N050.21.45.000 E019.40.00.000 N050.08.00.000 E019.10.00.000
;N050.08.00.000 E019.10.00.000 N050.08.00.000 E018.56.13.000
;N050.08.00.000 E018.56.13.000 N050.07.58.000 E018.39.24.000

; LTMA EPKK C
N050.42.55.000 E018.29.41.000 N050.46.29.000 E019.06.46.000
N050.46.29.000 E019.06.46.000 N050.48.34.000 E019.30.31.000
N050.48.34.000 E019.30.31.000 N050.49.33.000 E019.41.51.000
N050.49.33.000 E019.41.51.000 N050.42.54.000 E020.06.26.000
N050.42.54.000 E020.06.26.000 N050.35.49.000 E020.10.04.000
N050.35.49.000 E020.10.04.000 N050.32.51.000 E020.20.39.000
N050.32.51.000 E020.20.39.000 N050.22.37.000 E020.15.22.000
N050.22.37.000 E020.15.22.000 N050.42.25.000 E019.41.42.000
N050.42.25.000 E019.41.42.000 N050.40.09.000 E018.30.56.000
N050.40.09.000 E018.30.56.000 N050.31.16.000 E018.23.48.000
N050.31.16.000 E018.23.48.000 N049.52.00.000 E019.18.04.000
N049.52.00.000 E019.18.04.000 N049.52.20.000 E019.00.56.000
N049.52.20.000 E019.00.56.000 N050.13.10.000 E018.32.10.000
N050.13.10.000 E018.32.10.000 N050.27.56.000 E018.11.29.000
N050.27.56.000 E018.11.29.000 N050.31.34.000 E018.14.51.000
N050.31.34.000 E018.14.51.000 N050.39.12.000 E018.24.42.000
N050.39.12.000 E018.24.42.000 N050.42.55.000 E018.29.41.000


; LTMA EPKK D
N049.52.00.000 E019.18.04.000 N049.44.39.000 E019.53.22.000
N049.44.39.000 E019.53.22.000 N049.51.56.000 E020.23.50.000
N049.51.56.000 E020.23.50.000 N050.01.20.000 E020.30.25.000
N050.01.20.000 E020.30.25.000 N050.20.16.000 E020.19.19.000
N050.20.16.000 E020.19.19.000 N050.22.37.000 E020.15.22.000
N050.22.37.000 E020.15.22.000 N050.32.51.000 E020.20.39.000
N050.32.51.000 E020.20.39.000 N050.30.42.000 E020.28.16.000
N050.30.42.000 E020.28.16.000 N050.06.31.000 E020.42.24.000
N050.06.31.000 E020.42.24.000 N049.50.41.000 E020.32.28.000
N049.50.41.000 E020.32.28.000 N049.40.39.000 E019.54.36.000
N049.40.39.000 E019.54.36.000 N049.43.41.000 E019.29.17.000
N049.43.41.000 E019.29.17.000 N049.52.00.000 E019.18.04.000

;uTMA EPKK
EPKK_TMA_OUT N050.02.52.000 E018.05.52.000 N050.22.32.000 E018.06.31.000
N050.22.32.000 E018.06.31.000 N050.27.56.000 E018.11.29.000
N050.27.56.000 E018.11.29.000 N050.31.34.000 E018.14.51.000
N050.31.34.000 E018.14.51.000 N050.39.12.000 E018.24.42.000
N050.39.12.000 E018.24.42.000 N050.42.55.000 E018.29.41.000
N050.42.55.000 E018.29.41.000 N050.53.40.000 E018.44.18.000
N050.53.40.000 E018.44.18.000 N050.56.43.000 E018.51.18.000
N050.56.43.000 E018.51.18.000 N051.00.56.000 E019.57.08.000
N051.00.56.000 E019.57.08.000 N050.42.54.000 E020.06.26.000
N050.42.54.000 E020.06.26.000 N050.35.49.000 E020.10.04.000
N050.35.49.000 E020.10.04.000 N050.32.51.000 E020.20.39.000
N050.32.51.000 E020.20.39.000 N050.30.42.000 E020.28.16.000
N050.30.42.000 E020.28.16.000 N050.10.21.000 E020.59.11.000
N050.10.21.000 E020.59.11.000 N049.50.49.000 E021.13.08.000
N049.50.49.000 E021.13.08.000 N049.43.46.000 E021.11.03.000
N049.43.46.000 E021.11.03.000 N049.29.21.000 E021.11.42.000
N049.29.21.000 E021.11.42.000 N049.24.10.000 E021.11.56.000

;CTA4
;N050.23.22.000 E017.43.29.000 N050.19.58.000 E017.55.26.000 PROHI
;N050.19.58.000 E017.55.26.000 N050.22.32.000 E018.06.31.000
N050.22.32.000 E018.06.31.000 N050.02.52.000 E018.05.52.000
;N050.02.52.000 E018.05.52.000 N050.02.45.420 E018.05.09.360 PROHI

;TMA
;a
EPWA_TMA N052.17.03.000 E020.03.13.000 N051.47.13.000 E021.04.14.000
N051.47.13.000 E021.04.14.000 N051.45.14.000 E021.23.53.000
N051.45.14.000 E021.23.53.000 N051.49.55.000 E021.30.48.000
N051.49.55.000 E021.30.48.000 N051.59.02.000 E021.37.53.000
N051.59.02.000 E021.37.53.000 N052.07.17.000 E021.37.21.000
N052.07.17.000 E021.37.21.000 N052.07.00.000 E021.32.41.000
N052.07.00.000 E021.32.41.000 N052.17.00.000 E021.26.15.000
N052.17.00.000 E021.26.15.000 N052.19.10.000 E021.18.33.000
N052.19.10.000 E021.18.33.000 N052.26.20.000 E021.09.25.000
N052.26.20.000 E021.09.25.000 N052.29.19.000 E021.15.49.000
N052.29.19.000 E021.15.49.000 N052.30.13.000 E021.17.46.000
N052.30.13.000 E021.17.46.000 N052.41.11.000 E021.12.44.000
N052.41.11.000 E021.12.44.000 N052.41.55.000 E020.59.26.000
N052.41.55.000 E020.59.26.000 N052.42.37.000 E020.46.02.000
N052.42.37.000 E020.46.02.000 N052.37.38.000 E020.39.38.000
N052.37.38.000 E020.39.38.000 N052.33.27.000 E020.15.42.000
N052.33.27.000 E020.15.42.000 N052.17.03.000 E020.03.13.000

;b
N051.43.34.000 E020.33.56.000 N051.37.17.000 E021.28.07.000
N051.37.17.000 E021.28.07.000 N051.48.09.000 E021.47.05.000
N051.48.09.000 E021.47.05.000 N052.05.40.000 E022.01.54.000
N052.05.40.000 E022.01.54.000 N052.25.59.000 E021.51.34.000
N052.25.59.000 E021.51.34.000 N052.26.17.000 E021.33.28.000
N052.26.17.000 E021.33.28.000 N052.26.11.000 E021.19.37.000
N052.26.11.000 E021.19.37.000 N052.30.13.000 E021.17.46.000
N052.30.13.000 E021.17.46.000 N052.26.20.000 E021.09.25.000
N052.26.20.000 E021.09.25.000 N052.19.10.000 E021.18.33.000
N052.19.10.000 E021.18.33.000 N052.17.00.000 E021.26.15.000
N052.17.00.000 E021.26.15.000 N052.07.00.000 E021.32.41.000
N052.07.00.000 E021.32.41.000 N052.07.17.000 E021.37.21.000
N052.07.17.000 E021.37.21.000 N051.59.02.000 E021.37.53.000
N051.59.02.000 E021.37.53.000 N051.49.55.000 E021.30.48.000
N051.49.55.000 E021.30.48.000 N051.45.14.000 E021.23.53.000
N051.45.14.000 E021.23.53.000 N051.47.13.000 E021.04.14.000
N051.47.13.000 E021.04.14.000 N052.17.03.000 E020.03.13.000
N052.17.03.000 E020.03.13.000 N052.33.27.000 E020.15.42.000
N052.33.27.000 E020.15.42.000 N052.37.38.000 E020.39.38.000
N052.37.38.000 E020.39.38.000 N052.42.37.000 E020.46.02.000
N052.42.37.000 E020.46.02.000 N052.46.13.000 E020.24.44.000
N052.46.13.000 E020.24.44.000 N052.41.53.000 E020.04.48.000
N052.41.53.000 E020.04.48.000 N052.35.10.000 E019.53.51.000
N052.35.10.000 E019.53.51.000 N052.26.12.000 E019.50.27.000
N052.26.12.000 E019.50.27.000 N052.17.15.000 E019.53.33.000
N052.17.15.000 E019.53.33.000 N052.08.02.000 E020.11.35.000
N052.08.02.000 E020.11.35.000 N051.43.34.000 E020.33.56.000

;c
N052.51.16.000 E020.15.26.000 N052.48.45.000 E019.54.40.000
N052.48.45.000 E019.54.40.000 N052.42.10.000 E019.37.04.000
N052.42.10.000 E019.37.04.000 N052.30.56.000 E019.30.50.000
N052.30.56.000 E019.30.50.000 N052.07.28.000 E019.38.17.000
N052.07.28.000 E019.38.17.000 N052.02.00.000 E019.40.57.000
N052.02.00.000 E019.40.57.000 N052.02.23.000 E019.43.19.000
N052.02.23.000 E019.43.19.000 N052.05.12.000 E019.54.55.000
N052.05.12.000 E019.54.55.000 N051.56.34.000 E019.59.05.000
N051.56.34.000 E019.59.05.000 N051.47.03.000 E020.03.38.000
N051.47.03.000 E020.03.38.000 N051.39.58.000 E019.57.37.000
N051.39.58.000 E019.57.37.000 N051.32.13.000 E019.57.41.000
N051.32.13.000 E019.57.41.000 N051.30.03.000 E020.03.36.000
N051.30.03.000 E020.03.36.000 N051.29.09.000 E020.17.19.000
N051.29.09.000 E020.17.19.000 N051.28.13.000 E020.31.01.000
N051.28.13.000 E020.31.01.000 N051.27.16.000 E020.44.43.000
N051.27.16.000 E020.44.43.000 N051.26.17.000 E020.58.24.000
N051.26.17.000 E020.58.24.000 N051.24.07.000 E020.59.34.000
N051.24.07.000 E020.59.34.000 N051.27.02.000 E021.06.13.000
N051.27.02.000 E021.06.13.000 N051.29.19.000 E021.11.30.000
N051.29.19.000 E021.11.30.000 N051.34.10.000 E021.22.40.000
N051.34.10.000 E021.22.40.000 N051.36.40.000 E021.27.02.000
N051.36.40.000 E021.27.02.000 N051.37.17.000 E021.28.07.000
N051.37.17.000 E021.28.07.000 N051.38.54.000 E021.14.36.000
N051.38.54.000 E021.14.36.000 N051.40.29.000 E021.01.03.000
N051.40.29.000 E021.01.03.000 N051.42.02.000 E020.47.30.000
N051.42.02.000 E020.47.30.000 N051.43.34.000 E020.33.56.000
N051.43.34.000 E020.33.56.000 N052.08.02.000 E020.11.35.000
N052.08.02.000 E020.11.35.000 N052.17.15.000 E019.53.33.000
N052.17.15.000 E019.53.33.000 N052.26.12.000 E019.50.27.000
N052.26.12.000 E019.50.27.000 N052.35.10.000 E019.53.51.000
N052.35.10.000 E019.53.51.000 N052.41.53.000 E020.04.48.000
N052.41.53.000 E020.04.48.000 N052.46.13.000 E020.24.44.000
N052.46.13.000 E020.24.44.000 N052.51.16.000 E020.15.26.000

;d
N052.11.00.000 E020.40.00.000 N052.06.04.000 E020.45.30.000
N052.06.04.000 E020.45.30.000 N051.58.40.000 E020.58.15.000
N051.58.40.000 E020.58.15.000 N051.58.38.000 E021.06.59.000
N051.58.38.000 E021.06.59.000 N052.00.20.000 E021.12.04.000
N052.00.20.000 E021.12.04.000 N052.02.25.000 E021.12.31.000
N052.02.25.000 E021.12.31.000 N052.05.34.000 E021.12.39.000
N052.05.34.000 E021.12.39.000 N052.07.57.000 E021.10.36.000
N052.07.57.000 E021.10.36.000 N052.02.23.000 E021.07.19.000
N052.02.23.000 E021.07.19.000 N052.00.43.000 E021.00.38.000
N052.00.43.000 E021.00.38.000 N052.08.52.000 E020.45.47.000
N052.08.52.000 E020.45.47.000 N052.12.28.000 E020.42.01.000
N052.12.28.000 E020.42.01.000 N052.11.00.000 E020.40.00.000

;e
N052.10.08.000 E021.07.31.000 N052.07.57.000 E021.10.36.000
N052.07.57.000 E021.10.36.000 N052.05.34.000 E021.12.39.000
N052.05.34.000 E021.12.39.000 N052.09.52.000 E021.12.26.000
N052.09.52.000 E021.12.26.000 N052.10.08.000 E021.07.31.000

;f
N052.11.00.000 E020.40.00.000 N052.12.28.000 E020.42.01.000
N052.12.28.000 E020.42.01.000 N052.15.32.000 E020.46.15.000
N052.15.32.000 E020.46.15.000 N052.15.47.000 E020.50.10.000
N052.15.47.000 E020.50.10.000 N052.15.48.000 E020.55.56.000
N052.15.48.000 E020.55.56.000 N052.15.38.000 E020.57.05.000
N052.15.38.000 E020.57.05.000 N052.16.47.000 E020.56.21.000
N052.16.47.000 E020.56.21.000 N052.16.55.000 E020.38.52.000
N052.16.55.000 E020.38.52.000 N052.15.46.000 E020.37.35.000
N052.15.46.000 E020.37.35.000 N052.11.00.000 E020.40.00.000

;g
N051.24.07.000 E020.59.34.000 N051.26.17.000 E020.58.24.000
N051.26.17.000 E020.58.24.000 N051.27.16.000 E020.44.43.000
N051.27.16.000 E020.44.43.000 N051.28.13.000 E020.31.01.000
N051.28.13.000 E020.31.01.000 N051.29.09.000 E020.17.19.000
N051.29.09.000 E020.17.19.000 N051.30.03.000 E020.03.36.000
N051.30.03.000 E020.03.36.000 N051.24.32.000 E020.18.21.000
N051.24.32.000 E020.18.21.000 N051.19.00.000 E020.33.02.000
N051.19.00.000 E020.33.02.000 N051.15.50.000 E020.47.08.000
N051.15.50.000 E020.47.08.000 N051.15.12.000 E020.49.58.000
N051.15.12.000 E020.49.58.000 N051.24.07.000 E020.59.34.000

;h
N052.35.18.000 E020.39.16.000 N052.34.22.000 E020.46.55.000
N052.34.22.000 E020.46.55.000 N052.37.37.000 E020.46.38.000
N052.37.37.000 E020.46.38.000 N052.38.11.000 E020.42.08.000
N052.38.11.000 E020.42.08.000 N052.35.18.000 E020.39.16.000

;CTA1

N051.47.03.000 E020.03.38.000 N051.56.34.000 E019.59.05.000
N051.56.34.000 E019.59.05.000 N052.05.12.000 E019.54.55.000
N052.05.12.000 E019.54.55.000 N052.02.23.000 E019.43.19.000
N052.02.23.000 E019.43.19.000 N052.02.00.000 E019.40.57.000
N052.02.00.000 E019.40.57.000 N052.07.28.000 E019.38.17.000
N052.07.28.000 E019.38.17.000 N052.30.56.000 E019.30.50.000
N052.30.56.000 E019.30.50.000 N052.42.10.000 E019.37.04.000
N052.42.10.000 E019.37.04.000 N052.31.36.000 E019.07.52.000
N052.31.36.000 E019.07.52.000 N052.21.32.000 E019.13.18.000
N052.21.32.000 E019.13.18.000 N052.11.27.000 E019.18.42.000
N052.11.27.000 E019.18.42.000 N052.01.22.000 E019.24.04.000
N052.01.22.000 E019.24.04.000 N051.51.17.000 E019.29.23.000
N051.51.17.000 E019.29.23.000 N051.41.12.000 E019.34.40.000
N051.41.12.000 E019.34.40.000 N051.31.06.000 E019.39.54.000
N051.31.06.000 E019.39.54.000 N051.21.00.000 E019.45.06.000
N051.21.00.000 E019.45.06.000 N051.19.46.000 E020.00.38.000
N051.19.46.000 E020.00.38.000 N051.18.29.000 E020.16.09.000
N051.18.29.000 E020.16.09.000 N051.17.11.000 E020.31.39.000
N051.17.11.000 E020.31.39.000 N051.15.50.000 E020.47.08.000
N051.15.50.000 E020.47.08.000 N051.19.00.000 E020.33.02.000
N051.19.00.000 E020.33.02.000 N051.23.17.000 E020.21.43.000
N051.23.17.000 E020.21.43.000 N051.27.46.000 E020.09.44.000
N051.27.46.000 E020.09.44.000 N051.30.03.000 E020.03.36.000
N051.30.03.000 E020.03.36.000 N051.32.13.000 E019.57.41.000
N051.32.13.000 E019.57.41.000 N051.39.58.000 E019.57.37.000
N051.39.58.000 E019.57.37.000 N051.47.03.000 E020.03.38.000

;CTA2
N052.51.16.000 E020.15.26.000 N052.48.45.000 E019.54.40.000
N052.48.45.000 E019.54.40.000 N052.42.10.000 E019.37.04.000
N052.42.10.000 E019.37.04.000 N052.30.56.000 E019.30.50.000
N052.30.56.000 E019.30.50.000 N052.07.28.000 E019.38.17.000
N052.07.28.000 E019.38.17.000 N052.02.00.000 E019.40.57.000
N052.02.00.000 E019.40.57.000 N052.02.23.000 E019.43.19.000
N052.02.23.000 E019.43.19.000 N052.05.12.000 E019.54.55.000
N052.05.12.000 E019.54.55.000 N051.56.34.000 E019.59.05.000
N051.56.34.000 E019.59.05.000 N051.47.03.000 E020.03.38.000
N051.47.03.000 E020.03.38.000 N051.39.58.000 E019.57.37.000
N051.39.58.000 E019.57.37.000 N051.32.13.000 E019.57.41.000
N051.32.13.000 E019.57.41.000 N051.30.03.000 E020.03.36.000
N051.30.03.000 E020.03.36.000 N051.27.46.000 E020.09.44.000
N051.27.46.000 E020.09.44.000 N051.23.17.000 E020.21.43.000
N051.23.17.000 E020.21.43.000 N051.19.00.000 E020.33.02.000
N051.19.00.000 E020.33.02.000 N051.15.50.000 E020.47.08.000
N051.15.50.000 E020.47.08.000 N051.15.12.000 E020.49.58.000
N051.15.12.000 E020.49.58.000 N051.24.07.000 E020.59.34.000
N051.24.07.000 E020.59.34.000 N051.27.02.000 E021.06.13.000
N051.27.02.000 E021.06.13.000 N051.29.19.000 E021.11.30.000
N051.29.19.000 E021.11.30.000 N051.34.10.000 E021.22.40.000
N051.34.10.000 E021.22.40.000 N051.36.40.000 E021.27.02.000
N051.36.40.000 E021.27.02.000 N051.37.17.000 E021.28.07.000
N051.37.17.000 E021.28.07.000 N051.48.09.000 E021.47.05.000
N051.48.09.000 E021.47.05.000 N051.56.55.000 E021.54.28.000
N051.56.55.000 E021.54.28.000 N052.05.40.000 E022.01.54.000
N052.05.40.000 E022.01.54.000 N052.15.50.000 E021.56.45.000
N052.15.50.000 E021.56.45.000 N052.25.59.000 E021.51.34.000
N052.25.59.000 E021.51.34.000 N052.26.17.000 E021.33.28.000
N052.26.17.000 E021.33.28.000 N052.26.11.000 E021.19.37.000
N052.26.11.000 E021.19.37.000 N052.41.11.000 E021.12.44.000
N052.41.11.000 E021.12.44.000 N052.41.55.000 E020.59.26.000
N052.41.55.000 E020.59.26.000 N052.42.37.000 E020.46.02.000
N052.42.37.000 E020.46.02.000 N052.46.13.000 E020.24.44.000
N052.46.13.000 E020.24.44.000 N052.51.16.000 E020.15.26.000 

;CTA3
N051.59.23.000 E019.25.06.000 N051.39.24.000 E019.35.36.000
N051.39.24.000 E019.35.36.000 N051.30.32.000 E019.40.12.000
N051.30.32.000 E019.40.12.000 N051.32.13.000 E019.57.41.000
N051.32.13.000 E019.57.41.000 N051.39.58.000 E019.57.37.000
N051.39.58.000 E019.57.37.000 N051.47.03.000 E020.03.38.000
N051.47.03.000 E020.03.38.000 N052.05.12.000 E019.54.55.000
N052.05.12.000 E019.54.55.000 N052.02.23.000 E019.43.19.000
N052.02.23.000 E019.43.19.000 N052.02.00.000 E019.40.57.000
N052.02.00.000 E019.40.57.000 N052.07.28.000 E019.38.17.000
N052.07.28.000 E019.38.17.000 N052.04.51.000 E019.22.13.000
N052.04.51.000 E019.22.13.000 N051.59.23.000 E019.25.06.000
 
;TMA EPLL
;A
EPLL_TMA N051.49.41.000 E019.03.58.000 N051.55.01.000 E019.33.29.000
N051.55.01.000 E019.33.29.000 N051.50.13.000 E019.36.07.000
N051.50.13.000 E019.36.07.000 N051.44.15.000 E019.39.23.000
N051.44.15.000 E019.39.23.000 N051.39.39.000 E019.23.52.000
N051.39.39.000 E019.23.52.000 N051.38.01.000 E019.17.21.000
N051.38.01.000 E019.17.21.000 N051.37.54.000 E019.15.47.000
N051.37.54.000 E019.15.47.000 N051.39.28.000 E019.09.31.000
N051.39.28.000 E019.09.31.000 N051.40.48.000 E019.04.15.000
N051.40.48.000 E019.04.15.000 N051.47.40.000 E019.00.53.000
N051.47.40.000 E019.00.53.000 N051.49.41.000 E019.03.58.000


;B
N051.55.01.000 E019.33.29.000 N051.56.53.000 E019.44.06.000
N051.56.53.000 E019.44.06.000 N051.56.41.000 E019.49.36.000
N051.56.41.000 E019.49.36.000 N051.55.49.000 E019.53.27.000
N051.55.49.000 E019.53.27.000 N051.54.16.000 E019.56.15.000
N051.54.16.000 E019.56.15.000 N051.50.53.000 E019.58.48.000
N051.50.53.000 E019.58.48.000 N051.48.30.000 E019.59.15.000
N051.48.30.000 E019.59.15.000 N051.45.48.000 E019.58.10.000
N051.45.48.000 E019.58.10.000 N051.43.42.000 E019.55.54.000
N051.43.42.000 E019.55.54.000 N051.42.13.000 E019.53.14.000
N051.42.13.000 E019.53.14.000 N051.40.21.000 E019.41.31.000
N051.40.21.000 E019.41.31.000 N051.44.15.000 E019.39.23.000
N051.44.15.000 E019.39.23.000 N051.50.13.000 E019.36.07.000
N051.50.13.000 E019.36.07.000 N051.55.01.000 E019.33.29.000


;C
N051.38.01.000 E019.17.21.000 N051.39.39.000 E019.23.52.000
N051.39.39.000 E019.23.52.000 N051.44.15.000 E019.39.23.000
N051.44.15.000 E019.39.23.000 N051.40.21.000 E019.41.31.000
N051.40.21.000 E019.41.31.000 N051.39.24.000 E019.35.36.000
N051.39.24.000 E019.35.36.000 N051.38.01.000 E019.17.21.000

;D
N051.40.48.000 E019.04.15.000 N051.39.28.000 E019.09.31.000
N051.39.28.000 E019.09.31.000 N051.37.54.000 E019.15.49.000
N051.37.54.000 E019.15.47.000 N051.37.06.000 E019.09.17.000
N051.37.06.000 E019.09.17.000 N051.38.10.000 E019.05.49.000
N051.38.10.000 E019.05.49.000 N051.40.48.000 E019.04.15.000

;E
N051.53.49.000 E018.52.03.000 N051.59.23.000 E019.25.06.000
N051.59.23.000 E019.25.06.000 N052.04.51.000 E019.22.13.000
N052.04.51.000 E019.22.13.000 N052.07.28.000 E019.38.17.000
N052.07.28.000 E019.38.17.000 N052.02.00.000 E019.40.57.000
N052.02.00.000 E019.40.57.000 N052.05.12.000 E019.54.55.000
N052.05.12.000 E019.54.55.000 N051.47.03.000 E020.03.38.000
N051.47.03.000 E020.03.38.000 N051.39.58.000 E019.57.37.000
N051.39.58.000 E019.57.37.000 N051.32.13.000 E019.57.41.000
N051.32.13.000 E019.57.41.000 N051.30.32.000 E019.40.12.000
N051.30.32.000 E019.40.12.000 N051.39.24.000 E019.35.36.000
N051.39.24.000 E019.35.36.000 N051.37.54.000 E019.15.47.000
N051.37.54.000 E019.15.47.000 N051.39.28.000 E019.09.31.000
N051.39.28.000 E019.09.31.000 N051.40.48.000 E019.04.15.000
N051.40.48.000 E019.04.15.000 N051.43.12.000 E018.54.25.000
N051.43.12.000 E018.54.25.000 N051.47.45.000 E018.51.48.000
N051.47.45.000 E018.51.48.000 N051.53.49.000 E018.52.03.000




;TMA EPRA
;A
EPRA_TMA N051.24.07.000 E020.59.34.000 N051.27.02.000 E021.06.13.000
N051.27.02.000 E021.06.13.000 N051.29.19.000 E021.11.30.000
N051.29.19.000 E021.11.30.000 N051.34.10.000 E021.22.40.000
N051.34.10.000 E021.22.40.000 N051.36.40.000 E021.27.02.000
N051.36.40.000 E021.27.02.000 N051.34.29.000 E021.30.04.000
N051.34.29.000 E021.30.04.000 N051.32.53.000 E021.32.15.000
N051.32.53.000 E021.32.15.000 N051.28.21.000 E021.39.44.000
N051.28.21.000 E021.39.44.000 N051.23.02.000 E021.41.17.000
N051.23.02.000 E021.41.17.000 N051.17.16.000 E021.36.52.000
N051.17.16.000 E021.36.52.000 N051.15.49.000 E021.28.57.000
N051.15.49.000 E021.28.57.000 N051.14.26.000 E021.21.23.000
N051.14.26.000 E021.21.23.000 N051.13.39.000 E021.03.39.000
N051.13.39.000 E021.03.39.000 N051.14.25.000 E021.03.22.000
N051.14.25.000 E021.03.22.000 N051.24.07.000 E020.59.34.000
N051.24.07.000 E020.59.34.000 N051.24.07.000 E020.59.34.000

B;
N051.23.24.000 E020.51.47.000 N051.24.07.000 E020.59.34.000
N051.24.07.000 E020.59.34.000 N051.14.25.000 E021.03.22.000
N051.14.25.000 E021.03.22.000 N051.13.39.000 E021.03.39.000
N051.13.39.000 E021.03.39.000 N051.13.27.000 E020.56.40.000
N051.13.27.000 E020.56.40.000 N051.19.26.000 E020.51.08.000
N051.19.26.000 E020.51.08.000 N051.23.24.000 E020.51.47.000
N051.23.24.000 E020.51.47.000 N051.23.24.000 E020.51.47.000

C;
N051.24.07.000 E020.59.34.000 N051.27.02.000 E021.06.13.000
N051.27.02.000 E021.06.13.000 N051.29.19.000 E021.11.30.000
N051.29.19.000 E021.11.30.000 N051.34.10.000 E021.22.40.000
N051.34.10.000 E021.22.40.000 N051.36.40.000 E021.27.02.000
N051.36.40.000 E021.27.02.000 N051.34.29.000 E021.30.04.000
N051.34.29.000 E021.30.04.000 N051.32.53.000 E021.32.15.000
N051.32.53.000 E021.32.15.000 N051.28.21.000 E021.39.44.000
N051.28.21.000 E021.39.44.000 N051.23.02.000 E021.41.17.000
N051.23.02.000 E021.41.17.000 N051.17.16.000 E021.36.52.000
N051.17.16.000 E021.36.52.000 N051.15.49.000 E021.28.57.000
N051.15.49.000 E021.28.57.000 N051.14.26.000 E021.21.23.000
N051.14.26.000 E021.21.23.000 N051.13.39.000 E021.03.39.000
N051.13.39.000 E021.03.39.000 N051.13.27.000 E020.56.40.000
N051.13.27.000 E020.56.40.000 N051.14.53.000 E020.51.11.000
N051.14.53.000 E020.51.11.000 N051.15.12.000 E020.49.58.000
N051.15.12.000 E020.49.58.000 N051.15.50.000 E020.47.08.000
N051.15.50.000 E020.47.08.000 N051.18.57.000 E020.44.48.000
N051.18.57.000 E020.44.48.000 N051.22.59.000 E020.47.16.000
N051.22.59.000 E020.47.16.000 N051.23.24.000 E020.51.47.000
N051.23.24.000 E020.51.47.000 N051.24.07.000 E020.59.34.000

;TMA EPRZ
;A
EPRZ_TMA N049.57.54.000 E021.44.07.000 N050.03.50.000 E021.34.45.000
N050.03.50.000 E021.34.45.000 N050.16.08.000 E021.34.37.000
N050.16.08.000 E021.34.37.000 N050.18.44.000 E021.38.53.000
N050.18.44.000 E021.38.53.000 N050.18.36.000 E021.46.49.000
N050.18.36.000 E021.46.49.000 N050.17.54.000 E022.21.41.000
N050.17.54.000 E022.21.41.000 N050.09.46.000 E022.27.33.000
N050.09.46.000 E022.27.33.000 N050.02.48.000 E022.27.14.000
N050.02.48.000 E022.27.14.000 N049.57.42.000 E022.22.00.000
N049.57.42.000 E022.22.00.000 N049.57.54.000 E021.44.07.000

;B
N050.02.50.000 E021.27.11.000 N050.11.10.000 E021.26.32.000
N050.11.10.000 E021.26.32.000 N050.18.44.000 E021.38.53.000
N050.18.44.000 E021.38.53.000 N050.18.36.000 E021.46.49.000
N050.18.36.000 E021.46.49.000 N050.17.54.000 E022.21.41.000
N050.17.54.000 E022.21.41.000 N050.17.39.000 E022.33.02.000
N050.17.39.000 E022.33.02.000 N050.12.19.000 E022.35.37.000
N050.12.19.000 E022.35.37.000 N050.03.05.000 E022.35.42.000
N050.03.05.000 E022.35.42.000 N049.57.37.000 E022.32.13.000
N049.57.37.000 E022.32.13.000 N049.57.42.000 E022.22.00.000
N049.57.42.000 E022.22.00.000 N049.57.54.000 E021.44.07.000
N049.57.54.000 E021.44.07.000 N049.55.23.000 E021.33.04.000
N049.55.23.000 E021.33.04.000 N050.02.50.000 E021.27.11.000

;C
N049.50.32.000 E021.25.44.000 N049.59.09.000 E021.18.09.000
N049.59.09.000 E021.18.09.000 N050.16.43.000 E021.16.31.000
N050.16.43.000 E021.16.31.000 N050.19.36.000 E021.23.15.000
N050.19.36.000 E021.23.15.000 N050.22.37.000 E021.45.13.000
N050.22.37.000 E021.45.13.000 N050.26.53.000 E022.14.25.000
N050.26.53.000 E022.14.25.000 N050.29.19.000 E022.31.04.000
N050.29.19.000 E022.31.04.000 N050.29.20.000 E022.31.14.000
N050.29.20.000 E022.31.14.000 N050.25.35.000 E022.41.27.000
N050.25.35.000 E022.41.27.000 N050.20.51.000 E022.47.55.000
N050.20.51.000 E022.47.55.000 N050.12.25.000 E022.46.30.000
N050.12.25.000 E022.46.30.000 N050.11.52.000 E022.46.18.000
N050.11.52.000 E022.46.18.000 N049.53.58.000 E022.40.06.000
N049.53.58.000 E022.40.06.000 N049.49.10.000 E022.31.36.000
N049.49.10.000 E022.31.36.000 N049.50.32.000 E021.25.44.000

;D
N050.10.21.000 E020.59.11.000 N050.18.26.000 E021.04.36.000
N050.18.26.000 E021.04.36.000 N050.26.27.000 E021.17.33.000
N050.26.27.000 E021.17.33.000 N050.22.37.000 E021.45.13.000
N050.22.37.000 E021.45.13.000 N050.29.19.000 E022.31.05.000
N050.29.19.000 E022.31.05.000 N050.29.20.000 E022.31.14.000
N050.29.20.000 E022.31.14.000 N050.25.35.000 E022.41.27.000
N050.25.35.000 E022.41.27.000 N050.20.51.000 E022.47.55.000
N050.20.51.000 E022.47.55.000 N049.57.57.000 E023.08.18.000
N049.57.57.000 E023.08.18.000 N049.48.32.000 E022.56.24.000
N049.48.32.000 E022.56.24.000 N049.49.10.000 E022.31.36.000
N049.49.10.000 E022.31.36.000 N049.50.32.000 E021.25.44.000
N049.50.32.000 E021.25.44.000 N049.50.49.000 E021.13.08.000
N049.50.49.000 E021.13.08.000 N050.10.21.000 E020.59.11.000

;E
N050.14.02.000 E022.17.04.000 N050.12.11.000 E022.22.33.000
N050.12.11.000 E022.22.33.000 N050.02.51.000 E022.21.56.000
N050.02.51.000 E022.21.56.000 N050.01.00.000 E022.17.00.000
N050.01.00.000 E022.17.00.000 N050.14.02.000 E022.17.04.000

;TMA EPSC
;A

EPSC_TMA N053.47.47.000 E014.40.45.000 N053.42.00.000 E014.37.03.000
N053.42.00.000 E014.37.03.000 N053.36.19.000 E014.36.16.000
N053.36.19.000 E014.36.16.000 N053.18.32.000 E014.57.59.000
N053.18.32.000 E014.57.59.000 N053.19.54.000 E015.12.10.000
N053.19.54.000 E015.12.10.000 N053.25.11.000 E015.27.09.000
N053.25.11.000 E015.27.09.000 N053.35.24.000 E015.24.25.000
N053.35.24.000 E015.24.25.000 N053.45.57.000 E014.54.46.000
N053.45.57.000 E014.54.46.000 N053.48.00.000 E014.45.42.000
N053.48.00.000 E014.45.42.000 N053.47.47.000 E014.40.45.000

;B
N053.47.47.000 E014.40.45.000 N053.42.00.000 E014.37.03.000
N053.42.00.000 E014.37.03.000 N053.36.19.000 E014.36.16.000
N053.36.19.000 E014.36.16.000 N053.18.32.000 E014.57.59.000
N053.18.32.000 E014.57.59.000 N053.15.39.000 E015.22.32.000
N053.15.39.000 E015.22.32.000 N053.18.01.000 E015.31.10.000
N053.18.01.000 E015.31.10.000 N053.28.07.000 E015.33.23.000
N053.28.07.000 E015.33.23.000 N053.43.14.000 E015.23.27.000
N053.43.14.000 E015.23.27.000 N053.45.57.000 E014.54.46.000
N053.45.57.000 E014.54.46.000 N053.48.00.000 E014.45.42.000
N053.48.00.000 E014.45.42.000 N053.47.47.000 E014.40.45.000

;C
N053.47.34.000 E014.35.43.000 N053.41.29.000 E014.33.33.000
N053.41.29.000 E014.33.33.000 N053.41.04.000 E014.16.43.000
N053.41.04.000 E014.16.43.000 N053.41.00.814 E014.16.10.697
N053.41.00.814 E014.16.10.697 N053.41.55.732 E014.16.10.697
N053.41.55.732 E014.16.10.697 N053.48.39.999 E014.15.20.600
N053.48.39.999 E014.15.20.600 N053.51.11.000 E014.13.40.000
N053.51.11.000 E014.13.40.000 N053.50.15.000 E014.19.27.000
N053.50.15.000 E014.19.27.000 N053.47.34.000 E014.35.43.000

;D
N053.41.04.000 E014.16.43.000 N053.41.29.000 E014.33.33.000
N053.41.29.000 E014.33.33.000 N053.47.34.000 E014.35.43.000
N053.47.34.000 E014.35.43.000 N053.47.47.000 E014.40.45.000
N053.47.47.000 E014.40.45.000 N053.47.11.000 E014.40.22.000
N053.47.11.000 E014.40.22.000 N053.42.00.000 E014.37.03.000
N053.42.00.000 E014.37.03.000 N053.36.19.000 E014.36.16.000
N053.36.19.000 E014.36.16.000 N053.18.32.000 E014.57.59.000
N053.18.32.000 E014.57.59.000 N053.10.40.000 E014.22.39.000
N053.10.40.000 E014.22.39.000 N053.10.35.916 E014.21.57.089
;granica FIR
N053.10.35.916 E014.21.57.089 N053.11.22.388 E014.22.28.771
N053.11.22.388 E014.22.28.771 N053.11.58.286 E014.23.52.202
N053.11.58.286 E014.23.52.202 N053.13.52.352 E014.25.23.024
N053.13.52.352 E014.25.23.024 N053.15.22.110 E014.26.23.219
N053.15.22.110 E014.26.23.219 N053.16.29.703 E014.24.36.556
N053.16.29.703 E014.24.36.556 N053.17.34.124 E014.24.29.164
N053.17.34.124 E014.24.29.164 N053.18.33.258 E014.23.40.584
N053.18.33.258 E014.23.40.584 N053.19.45.081 E014.24.09.097
N053.19.45.081 E014.24.09.097 N053.20.49.503 E014.23.20.520
N053.20.49.503 E014.23.20.520 N053.21.08.509 E014.23.06.787
N053.21.08.509 E014.23.06.787 N053.22.01.312 E014.23.09.956
N053.22.01.312 E014.23.09.956 N053.22.32.994 E014.23.02.564
N053.22.32.994 E014.23.02.564 N053.24.06.982 E014.22.20.322
N053.24.06.982 E014.22.20.322 N053.24.32.333 E014.21.49.694
N053.24.32.333 E014.21.49.694 N053.26.06.321 E014.22.06.592
N053.26.06.321 E014.22.06.592 N053.26.24.270 E014.21.40.191
N053.26.24.270 E014.21.40.191 N053.26.54.894 E014.21.15.901
N053.26.54.894 E014.21.15.901 N053.29.26.972 E014.20.48.445
N053.29.26.972 E014.20.48.445 N053.29.47.036 E014.19.46.135
N053.29.47.036 E014.19.46.135 N053.30.29.279 E014.18.53.329
N053.30.29.279 E014.18.53.329 N053.31.29.484 E014.18.39.603
N053.31.29.484 E014.18.39.603 N053.31.50.605 E014.18.08.975
N053.31.50.605 E014.18.08.975 N053.32.27.560 E014.18.12.144
N053.32.27.560 E014.18.12.144 N053.33.18.262 E014.18.54.390
N053.33.18.262 E014.18.54.390 N053.34.48.020 E014.18.41.714
N053.34.48.020 E014.18.41.714 N053.36.16.735 E014.18.46.995
N053.36.16.735 E014.18.46.995 N053.37.57.068 E014.16.51.882
N053.37.57.068 E014.16.51.882 N053.38.51.972 E014.17.01.389
N053.38.51.972 E014.17.01.389 N053.39.33.157 E014.16.30.761
N053.39.33.157 E014.16.30.761 N053.40.34.419 E014.16.42.375
N053.40.34.419 E014.16.42.375 N053.41.04.000 E014.16.43.000



;DELEGACJA CTR HERRINGSDORF
N053.55.18.710 E014.12.53.060 N053.54.03.710 E014.20.18.070
N053.54.03.710 E014.20.18.070 N053.48.18.710 E014.17.33.090
N053.48.18.710 E014.17.33.090 N053.48.38.710 E014.15.13.080

;DELEGACJA CTA DREWITZ
N052.04.09.000 E014.45.36.000 N052.04.35.000 E014.58.20.000
N052.04.35.000 E014.58.20.000 N051.50.33.000 E015.00.27.000
N051.50.33.000 E015.00.27.000 N051.45.31.000 E014.40.17.000

;DELEGACJA FIS DREWITZ
N051.55.57.000 E014.42.55.000 N051.53.08.000 E014.44.13.000
N051.53.08.000 E014.44.13.000 N051.50.07.000 E014.36.56.000


;BERLIN C
BERLIN N051.55.03.000 E013.00.06.000 N051.55.03.000 E013.17.28.000
N051.55.03.000 E013.17.28.000 N052.02.00.000 E013.47.00.000
N052.02.00.000 E013.47.00.000 N052.10.03.000 E014.15.11.000
N052.10.03.000 E014.15.11.000 N052.19.12.000 E014.23.31.000
N052.19.12.000 E014.23.31.000 N052.20.42.900 E014.23.54.203
N052.20.42.900 E014.23.54.203 N052.23.25.007 E014.24.05.795
N052.23.25.007 E014.24.05.795 N052.26.07.116 E014.23.54.203
N052.26.07.116 E014.23.54.203 N052.28.47.999 E014.23.19.499
N052.28.47.999 E014.23.19.499 N052.31.26.400 E014.22.21.935
N052.31.26.400 E014.22.21.935 N052.34.01.163 E014.21.01.980
N052.34.01.163 E014.21.01.980 N052.36.31.067 E014.19.20.244
N052.36.31.067 E014.19.20.244 N052.38.54.995 E014.17.17.448
N052.38.54.995 E014.17.17.448 N052.41.11.868 E014.14.54.599
N052.41.11.868 E014.14.54.599 N052.42.54.000 E014.12.55.000
N052.42.54.000 E014.12.55.000 N052.54.32.000 E013.53.48.000
N052.54.32.000 E013.53.48.000 N052.52.10.000 E012.40.51.000
N052.52.10.000 E012.40.51.000 N052.51.53.000 E012.33.36.000
N052.51.53.000 E012.33.36.000 N052.49.06.000 E012.24.26.000
N052.49.06.000 E012.24.26.000 N052.48.20.520 E012.23.52.368
N052.48.20.520 E012.23.52.368 N052.45.31.247 E012.21.57.024
N052.45.31.247 E012.21.57.024 N052.42.36.539 E012.20.26.411
N052.42.36.539 E012.20.26.411 N052.39.37.691 E012.19.21.215
N052.39.37.691 E012.19.21.215 N052.36.36.036 E012.18.41.867
N052.36.36.036 E012.18.41.867 N052.33.33.012 E012.18.28.728
N052.33.33.012 E012.18.28.728 N052.30.29.988 E012.18.41.867
N052.30.29.988 E012.18.41.867 N052.27.28.368 E012.19.21.215
N052.27.28.368 E012.19.21.215 N052.24.29.483 E012.20.26.411
N052.24.29.483 E012.20.26.411 N052.21.34.775 E012.21.57.024
N052.21.34.775 E012.21.57.024 N052.20.52.000 E012.22.36.000 
N052.20.52.000 E012.22.36.000 N052.09.00.000 E012.40.47.000
N052.09.00.000 E012.40.47.000 N051.55.03.000 E013.00.06.000


;PRAHA VII
PRAHA N050.28.29.080 E014.41.21.250 N050.29.13.776 E014.39.42.119
N050.29.13.776 E014.39.42.119 N050.29.59.747 E014.37.45.227
N050.29.59.747 E014.37.45.227 N050.30.41.688 E014.35.44.736
N050.30.41.688 E014.35.44.736 N050.31.19.560 E014.33.40.967
N050.31.19.560 E014.33.40.967 N050.31.53.219 E014.31.34.319
N050.31.53.219 E014.31.34.319 N050.32.22.596 E014.29.25.079
N050.32.22.596 E014.29.25.079 N050.32.47.580 E014.27.13.608
N050.32.47.580 E014.27.13.608 N050.33.08.100 E014.25.00.300
N050.33.08.100 E014.25.00.300 N050.33.24.119 E014.22.45.480
N050.33.24.119 E014.22.45.480 N050.33.35.604 E014.20.29.544
N050.33.35.604 E014.20.29.544 N050.33.42.516 E014.18.12.852
N050.33.42.516 E014.18.12.852 N050.33.44.567 E014.15.10.116
N050.33.44.567 E014.15.10.116 N050.33.40.715 E014.12.53.136
N050.33.40.715 E014.12.53.136 N050.33.32.292 E014.10.36.659
N050.33.32.292 E014.10.36.659 N050.33.19.296 E014.08.21.047
N050.33.19.296 E014.08.21.047 N050.33.01.764 E014.06.06.696
N050.33.01.764 E014.06.06.696 N050.32.39.732 E014.03.53.963
N050.32.39.732 E014.03.53.963 N050.32.13.271 E014.01.43.211
N050.32.13.271 E014.01.43.211 N050.31.42.491 E013.59.34.764
N050.31.42.491 E013.59.34.764 N050.31.07.392 E013.57.29.051
N050.31.07.392 E013.57.29.051 N050.30.28.152 E013.55.26.328
N050.30.28.152 E013.55.26.328 N050.29.44.843 E013.53.26.987
N050.29.44.843 E013.53.26.987 N050.28.57.576 E013.51.31.356
N050.28.57.576 E013.51.31.356 N050.28.06.527 E013.49.39.755
N050.28.06.527 E013.49.39.755 N050.27.11.772 E013.47.52.440
N050.27.11.772 E013.47.52.440 N050.26.13.488 E013.46.09.767
N050.26.13.488 E013.46.09.767 N050.25.11.820 E013.44.31.956
N050.25.11.820 E013.44.31.956 N050.24.06.984 E013.42.59.328
N050.24.06.984 E013.42.59.328 N050.22.59.124 E013.41.32.135
N050.22.59.124 E013.41.32.135 N050.21.48.420 E013.40.10.560
N050.21.48.420 E013.40.10.560 N050.20.35.088 E013.38.54.888
N050.20.35.088 E013.38.54.888 N050.19.19.307 E013.37.45.300
N050.19.19.307 E013.37.45.300 N050.18.09.620 E013.36.52.950
;PRAHA VI
N050.18.09.620 E013.36.52.950 N050.12.51.650 E013.15.49.680 
N050.12.51.650 E013.15.49.680 N050.05.22.060 E013.19.35.480
N050.05.22.060 E013.19.35.480 N049.58.43.860 E013.13.16.990
N049.58.43.860 E013.13.16.990 N049.43.12.460 E013.39.22.140
N049.43.12.460 E013.39.22.140 N049.51.39.910 E013.57.59.410
;PRAHA II
N049.51.39.910 E013.57.59.410 N049.47.53.900 E014.05.56.050
;PRAHA III
N049.47.53.900 E014.05.56.050 N049.46.49.290 E014.14.37.560
N049.46.49.290 E014.14.37.560 N049.41.46.520 E014.25.09.570
;PRAHA V
N049.41.46.520 E014.25.09.570 N049.39.23.600 E014.30.06.440
N049.39.23.600 E014.30.06.440 N049.29.54.690 E014.49.39.120
N049.29.54.690 E014.49.39.120 N049.30.31.356 E014.51.35.279
N049.30.31.356 E014.51.35.279 N049.31.46.092 E014.54.24.767
N049.31.46.092 E014.54.24.767 N049.33.06.408 E014.57.07.919
N049.33.06.408 E014.57.07.919 N049.34.32.088 E014.59.44.303
N049.34.32.088 E014.59.44.303 N049.36.02.879 E015.02.13.487
N049.36.02.879 E015.02.13.487 N049.37.38.603 E015.04.35.075
N049.37.38.603 E015.04.35.075 N049.39.18.935 E015.06.48.635
N049.39.18.935 E015.06.48.635 N049.41.03.588 E015.08.53.807
N049.41.03.588 E015.08.53.807 N049.42.52.308 E015.10.50.304
N049.42.52.308 E015.10.50.304 N049.44.35.180 E015.12.02.870
N049.44.35.180 E015.12.02.870 N049.49.40.040 E015.01.51.090
N049.49.40.040 E015.01.51.090 N049.55.03.850 E014.56.02.600
;MTMA KBELY + PRAHA VIII 
N049.55.03.850 E014.56.02.600 N049.56.10.211 E014.56.56.688
N049.56.10.211 E014.56.56.688 N049.57.33.623 E014.57.40.211
N049.57.33.623 E014.57.40.211 N049.58.58.368 E014.58.16.859
N049.58.58.368 E014.58.16.859 N050.00.24.264 E014.58.46.523
N050.00.24.264 E014.58.46.523 N050.01.50.988 E014.59.09.167
N050.01.50.988 E014.59.09.167 N050.03.18.395 E014.59.24.684
N050.03.18.395 E014.59.24.684 N050.04.46.163 E014.59.33.035
N050.04.46.163 E014.59.33.035 N050.06.14.112 E014.59.34.223
N050.06.14.112 E014.59.34.223 N050.07.41.987 E014.59.28.247
N050.07.41.987 E014.59.28.247 N050.09.09.540 E014.59.15.107
N050.09.09.540 E014.59.15.107 N050.10.36.551 E014.58.54.839
N050.10.36.551 E014.58.54.839 N050.12.02.736 E014.58.27.515
N050.12.02.736 E014.58.27.515 N050.13.27.875 E014.57.53.171
N050.13.27.875 E014.57.53.171 N050.14.51.755 E014.57.11.951
N050.14.51.755 E014.57.11.951 N050.16.14.160 E014.56.23.928
N050.16.14.160 E014.56.23.928 N050.17.34.799 E014.55.29.279
N050.17.34.799 E014.55.29.279 N050.18.53.531 E014.54.28.079
N050.18.53.531 E014.54.28.079 N050.20.10.067 E014.53.20.579
N050.20.10.067 E014.53.20.579 N050.21.24.264 E014.52.06.923
N050.21.24.264 E014.52.06.923 N050.22.35.867 E014.50.47.292
N050.22.35.867 E014.50.47.292 N050.23.44.699 E014.49.21.936
N050.23.44.699 E014.49.21.936 N050.24.50.580 E014.47.51.108
N050.24.50.580 E014.47.51.108 N050.25.53.291 E014.46.14.988
N050.25.53.291 E014.46.14.988 N050.26.52.728 E014.44.33.899
N050.26.52.728 E014.44.33.899 N050.27.48.672 E014.42.48.131
N050.27.48.672 E014.42.48.131 N050.28.29.080 E014.41.21.250

[ARTCC HIGH]
;EA11 EAGLE TALON
TALON N054.21.17.000 E015.19.00.000 N053.52.09.000 E015.17.42.000 PROHI
N053.52.09.000 E015.17.42.000 N054.00.00.000 E015.05.00.000 PROHI
N054.00.00.000 E015.05.00.000 N054.16.00.000 E015.00.00.000 PROHI
N054.16.00.000 E015.00.00.000 N054.21.17.000 E015.19.00.000 PROHI

;EA12 EAGLE TALON
N054.21.17.000 E015.19.00.000 N054.26.59.000 E015.51.53.000 PROHI
N054.26.59.000 E015.51.53.000 N054.27.57.000 E015.59.17.000 PROHI
N054.27.57.000 E015.59.17.000 N054.23.00.000 E016.15.00.000 PROHI
N054.23.00.000 E016.15.00.000 N054.18.00.000 E016.25.00.000 PROHI
N054.18.00.000 E016.25.00.000 N054.14.31.000 E016.32.27.000 PROHI
N054.14.31.000 E016.32.27.000 N054.09.35.000 E016.46.08.000 PROHI
N054.09.35.000 E016.46.08.000 N053.52.09.000 E015.17.42.000 PROHI
N053.52.09.000 E015.17.42.000 N054.21.17.000 E015.19.00.000 PROHI

;EA13 EAGLE TALON
N053.52.09.000 E015.17.42.000 N054.09.35.000 E016.46.08.000 PROHI
N054.09.35.000 E016.46.08.000 N053.38.00.000 E018.11.00.000 PROHI
N053.38.00.000 E018.11.00.000 N053.30.44.000 E018.17.57.000 PROHI
N053.30.44.000 E018.17.57.000 N052.58.59.000 E015.57.20.000 PROHI
N052.58.59.000 E015.57.20.000 N053.02.47.000 E015.53.11.000 PROHI
N053.02.47.000 E015.53.11.000 N053.28.07.000 E015.33.23.000 PROHI
N053.28.07.000 E015.33.23.000 N053.43.14.000 E015.23.27.000 PROHI
N053.43.14.000 E015.23.27.000 N053.52.09.000 E015.17.42.000 PROHI

;EA14 EAGLE TALON
N054.21.17.000 E015.19.00.000 N054.26.59.000 E015.51.53.000 PROHI
N054.26.59.000 E015.51.53.000 N054.27.57.000 E015.59.17.000 PROHI
N054.27.57.000 E015.59.17.000 N054.23.00.000 E016.15.00.000 PROHI
N054.23.00.000 E016.15.00.000 N054.18.00.000 E016.25.00.000 PROHI
N054.18.00.000 E016.25.00.000 N054.14.31.000 E016.32.27.000 PROHI
N054.14.31.000 E016.32.27.000 N054.09.35.000 E016.46.08.000 PROHI
N054.09.35.000 E016.46.08.000 N053.38.00.000 E018.11.00.000 PROHI
N053.38.00.000 E018.11.00.000 N053.30.44.000 E018.17.57.000 PROHI
N053.30.44.000 E018.17.57.000 N052.58.59.000 E015.57.20.000 PROHI
N052.58.59.000 E015.57.20.000 N053.02.47.000 E015.53.11.000 PROHI
N053.02.47.000 E015.53.11.000 N053.28.07.000 E015.33.23.000 PROHI
N053.28.07.000 E015.33.23.000 N053.43.14.000 E015.23.27.000 PROHI
N053.43.14.000 E015.23.27.000 N053.52.09.000 E015.17.42.000 PROHI
N053.52.09.000 E015.17.42.000 N054.21.17.000 E015.19.00.000 PROHI

;EA15 EAGLE TALON
N052.58.59.000 E015.57.20.000 N053.30.44.000 E018.17.57.000 PROHI
N053.30.44.000 E018.17.57.000 N053.20.19.000 E018.27.48.000 PROHI
N053.20.19.000 E018.27.48.000 N053.15.55.000 E018.12.18.000 PROHI
N053.15.55.000 E018.12.18.000 N053.07.15.000 E017.32.10.000 PROHI
N053.07.15.000 E017.32.10.000 N052.51.11.000 E016.27.11.000 PROHI
N052.51.11.000 E016.27.11.000 N052.58.59.000 E015.57.20.000 PROHI

;EA16 EAGLE TALON
N053.20.19.000 E018.27.48.000 N052.49.56.000 E018.57.37.000 PROHI
N052.49.56.000 E018.57.37.000 N052.57.24.000 E017.33.21.000 PROHI
N052.57.24.000 E017.33.21.000 N053.07.15.000 E017.32.10.000 PROHI
N053.07.15.000 E017.32.10.000 N053.15.55.000 E018.12.18.000 PROHI
N053.15.55.000 E018.12.18.000 N053.20.19.000 E018.27.48.000 PROHI

;EA17 EAGLE TALON
N052.51.11.000 E016.27.11.000 N053.07.15.000 E017.32.10.000 PROHI
N053.07.15.000 E017.32.10.000 N052.57.24.000 E017.33.21.000 PROHI
N052.57.24.000 E017.33.21.000 N052.49.56.000 E018.57.37.000 PROHI
N052.49.56.000 E018.57.37.000 N052.24.49.000 E018.53.41.000 PROHI
N052.24.49.000 E018.53.41.000 N052.18.32.000 E017.38.11.000 PROHI
N052.18.32.000 E017.38.11.000 N052.51.11.000 E016.27.11.000 PROHI
;LKAA
;granica z FIR poczatek
;T
LKAA N050.51.21.308 E014.49.18.230 N050.50.40.109 E014.49.24.568
N050.50.40.109 E014.49.24.568 N050.50.04.211 E014.49.52.023
N050.50.04.211 E014.49.52.023 N050.50.36.951 E014.51.31.295
N050.50.36.951 E014.51.31.295 N050.50.21.103 E014.52.43.108
N050.50.21.103 E014.52.43.108 N050.50.44.339 E014.54.08.650
N050.50.44.339 E014.54.08.650 N050.50.02.097 E014.57.33.532
N050.50.02.097 E014.57.33.532 N050.50.21.103 E014.59.01.182
N050.50.21.103 E014.59.01.182 N050.52.19.384 E014.59.50.820
N050.52.19.384 E014.59.50.820 N050.53.29.093 E014.59.04.351
N050.53.29.093 E014.59.04.351 N050.54.11.335 E015.00.00.323
N050.54.11.335 E015.00.00.323 N050.55.11.526 E015.00.49.960
N050.55.11.526 E015.00.49.960 N050.55.46.381 E015.00.33.062
N050.55.46.381 E015.00.33.062 N050.57.04.521 E015.00.53.129
N050.57.04.521 E015.00.53.129 N050.57.28.814 E015.00.00.323
N050.57.28.814 E015.00.00.323 N050.57.21.426 E014.58.36.895
N050.57.21.426 E014.58.36.895 N050.57.41.490 E014.58.18.940
N050.57.41.490 E014.58.18.940 N050.58.46.968 E014.59.09.631
N050.58.46.968 E014.59.09.631 N050.59.03.860 E015.00.00.323
N050.59.03.860 E015.00.00.323 N050.59.55.605 E015.01.29.034
N050.59.55.605 E015.01.29.034 N050.58.21.617 E015.02.30.286
N050.58.21.617 E015.02.30.286 N050.59.38.714 E015.04.08.500
N050.59.38.714 E015.04.08.500 N050.59.14.420 E015.04.27.514
N050.59.14.420 E015.04.27.514 N050.58.56.472 E015.06.17.346
N050.58.56.472 E015.06.17.346 N050.58.24.790 E015.05.50.941
N050.58.24.790 E015.05.50.941 N050.57.59.439 E015.06.03.613
N050.57.59.439 E015.06.03.613 N050.57.56.280 E015.06.36.352
N050.57.56.280 E015.06.36.352 N050.57.40.432 E015.08.06.118
N050.57.40.432 E015.08.06.118 N050.58.53.299 E015.08.34.634
N050.58.53.299 E015.08.34.634 N050.59.12.306 E015.09.10.542
N050.59.12.306 E015.09.10.542 N050.59.11.262 E015.10.04.399
N050.59.11.262 E015.10.04.399 N050.57.40.432 E015.10.27.635
N050.57.40.432 E015.10.27.635 N050.57.15.081 E015.11.08.820
N050.57.15.081 E015.11.08.820 N050.57.12.980 E015.11.42.617
N050.57.12.980 E015.11.42.617 N050.57.48.878 E015.12.29.082
N050.57.48.878 E015.12.29.082 N050.57.53.108 E015.13.27.166
N050.57.53.108 E015.13.27.166 N050.57.48.878 E015.14.13.631
N050.57.48.878 E015.14.13.631 N050.57.21.426 E015.14.31.587
N050.57.21.426 E015.14.31.587 N050.57.07.693 E015.15.46.568
N050.57.07.693 E015.15.46.568 N050.55.29.475 E015.17.33.232
N050.55.29.475 E015.17.33.232 N050.54.14.494 E015.16.11.912
N050.54.14.494 E015.16.11.912 N050.53.14.302 E015.15.58.186
N050.53.14.302 E015.15.58.186 N050.50.42.224 E015.17.05.773
N050.50.42.224 E015.17.05.773 N050.49.59.982 E015.17.57.522
N050.49.59.982 E015.17.57.522 N050.49.17.739 E015.20.58.110
N050.49.17.739 E015.20.58.110 N050.48.32.338 E015.21.49.859
N050.48.32.338 E015.21.49.859 N050.46.04.476 E015.21.47.747
N050.46.04.476 E015.21.47.747 N050.45.47.585 E015.22.18.372
N050.45.47.585 E015.22.18.372 N050.45.59.203 E015.22.23.652
N050.45.59.203 E015.22.23.652 N050.45.01.112 E015.22.21.541
N050.45.01.112 E015.22.21.541 N050.44.52.667 E015.23.01.672
N050.44.52.667 E015.23.01.672 N050.45.19.075 E015.24.11.373
N050.45.19.075 E015.24.11.373 N050.46.42.502 E015.25.37.969
N050.46.42.502 E015.25.37.969 N050.46.49.891 E015.26.20.212
N050.46.49.891 E015.26.20.212 N050.46.18.209 E015.27.45.757
N050.46.18.209 E015.27.45.757 N050.45.34.909 E015.28.33.280
N050.45.34.909 E015.28.33.280 N050.45.21.176 E015.29.01.793
N050.45.21.176 E015.29.01.793 N050.45.31.737 E015.30.16.775
N050.45.31.737 E015.30.16.775 N050.44.52.667 E015.30.40.007
N050.44.52.667 E015.30.40.007 N050.44.48.437 E015.31.12.747
N050.44.48.437 E015.31.12.747 N050.45.05.342 E015.32.27.728
N050.45.05.342 E015.32.27.728 N050.44.54.781 E015.33.54.328
N050.44.54.781 E015.33.54.328 N050.45.03.227 E015.34.33.402
N050.45.03.227 E015.34.33.402 N050.44.33.660 E015.36.46.467
N050.44.33.660 E015.36.46.467 N050.43.40.857 E015.38.40.525
N050.43.40.857 E015.38.40.525 N050.43.25.009 E015.40.28.243
N050.43.25.009 E015.40.28.243 N050.42.51.213 E015.40.46.195
N050.42.51.213 E015.40.46.195 N050.42.44.882 E015.41.35.833
N050.42.44.882 E015.41.35.833 N050.42.32.206 E015.43.12.990
N050.42.32.206 E015.43.12.990 N050.42.53.328 E015.45.21.832
N050.42.53.328 E015.45.21.832 N050.42.43.824 E015.46.08.301
N050.42.43.824 E015.46.08.301 N050.43.22.895 E015.48.23.477
N050.43.22.895 E015.48.23.477 N050.42.33.264 E015.49.13.111
N050.42.33.264 E015.49.13.111 N050.38.34.586 E015.51.56.804
N050.38.34.586 E015.51.56.804 N050.38.22.968 E015.52.40.101
N050.38.22.968 E015.52.40.101 N050.39.15.785 E015.55.32.243
N050.39.15.785 E015.55.32.243 N050.39.09.440 E015.56.02.867
N050.39.09.440 E015.56.02.867 N050.39.44.294 E015.57.52.699
N050.39.44.294 E015.57.52.699 N050.38.55.707 E015.59.45.701
N050.38.55.707 E015.59.45.701 N050.38.12.421 E016.00.00.488
N050.38.12.421 E016.00.00.488 N050.37.31.222 E016.00.14.214
N050.37.31.222 E016.00.14.214 N050.37.21.719 E016.00.13.156
N050.37.21.719 E016.00.13.156 N050.37.14.331 E016.00.11.048
N050.37.14.331 E016.00.11.048 N050.37.15.388 E016.00.00.488
N050.37.15.388 E016.00.00.488 N050.37.16.446 E015.59.59.430
N050.37.16.446 E015.59.59.430 N050.37.14.331 E015.59.56.265
N050.37.14.331 E015.59.56.265 N050.37.13.273 E015.59.56.265
N050.37.13.273 E015.59.56.265 N050.37.12.216 E015.59.53.096
N050.37.12.216 E015.59.53.096 N050.37.09.044 E015.59.53.096
N050.37.09.044 E015.59.53.096 N050.37.08.000 E015.59.50.981
N050.37.08.000 E015.59.50.981 N050.37.04.828 E015.59.48.869
N050.37.04.828 E015.59.48.869 N050.36.54.267 E015.59.43.593
N050.36.54.267 E015.59.43.593 N050.36.52.152 E015.59.43.593
N050.36.52.152 E015.59.43.593 N050.36.51.095 E015.59.42.532
N050.36.51.095 E015.59.42.532 N050.36.46.879 E015.59.42.532
N050.36.46.879 E015.59.42.532 N050.36.40.534 E015.59.42.532
N050.36.40.534 E015.59.42.532 N050.36.39.477 E015.59.43.593
N050.36.39.477 E015.59.43.593 N050.36.36.304 E015.59.43.593
N050.36.36.304 E015.59.43.593 N050.36.27.859 E015.59.47.815
N050.36.27.859 E015.59.47.815 N050.36.25.757 E015.59.50.981
N050.36.25.757 E015.59.50.981 N050.36.24.686 E015.59.50.981
N050.36.24.686 E015.59.50.981 N050.36.20.470 E016.00.00.488
N050.36.20.470 E016.00.00.488 N050.36.20.470 E016.00.00.488
N050.36.20.470 E016.00.00.488 N050.36.10.967 E016.00.24.774
N050.36.10.967 E016.00.24.774 N050.36.06.737 E016.00.43.787
N050.36.06.737 E016.00.43.787 N050.36.39.477 E016.03.36.980 
N050.36.39.477 E016.03.36.980 N050.39.24.230 E016.05.39.484 
N050.39.24.230 E016.05.39.484 N050.39.05.210 E016.09.15.984 
N050.39.05.210 E016.09.15.984 N050.37.22.776 E016.11.30.106 
N050.37.22.776 E016.11.30.106 N050.38.01.847 E016.13.26.273 
N050.38.01.847 E016.13.26.273 N050.39.43.237 E016.13.44.229 
N050.39.43.237 E016.13.44.229 N050.39.23.173 E016.17.33.397 
N050.39.23.173 E016.17.33.397 N050.39.27.403 E016.20.25.532 
N050.39.27.403 E016.20.25.532 N050.36.06.737 E016.25.50.803 
N050.36.06.737 E016.25.50.803 N050.34.13.743 E016.26.39.390 
N050.34.13.743 E016.26.39.390 N050.30.08.734 E016.22.21.705 
N050.30.08.734 E016.22.21.705 N050.30.08.734 E016.18.39.926 
N050.30.08.734 E016.18.39.926 N050.25.21.483 E016.11.56.508 
N050.25.21.483 E016.11.56.508 N050.24.19.177 E016.14.58.153 
N050.24.19.177 E016.14.58.153 N050.22.02.932 E016.16.22.638 
N050.22.02.932 E016.16.22.638 N050.22.56.793 E016.20.18.143 
N050.22.56.793 E016.20.18.143 N050.22.09.277 E016.22.14.310 
N050.22.09.277 E016.22.14.310 N050.20.31.059 E016.22.11.145 
N050.20.31.059 E016.22.11.145 N050.19.05.517 E016.26.14.039 
N050.19.05.517 E016.26.14.039 N050.13.40.239 E016.32.49.011 
N050.13.40.239 E016.32.49.011 N050.09.54.250 E016.33.22.808 
N050.09.54.250 E016.33.22.808 N050.07.14.770 E016.37.02.472 
N050.07.14.770 E016.37.02.472 N050.05.54.515 E016.41.30.717 
N050.05.54.515 E016.41.30.717 N050.06.12.464 E016.43.23.712 
N050.06.12.464 E016.43.23.712 N050.12.02.035 E016.49.55.518 
N050.12.02.035 E016.49.55.518 N050.11.45.130 E016.51.49.577 
N050.11.45.130 E016.51.49.577 N050.13.21.233 E016.53.38.349 
N050.13.21.233 E016.53.38.349 N050.13.20.175 E016.57.26.466 
N050.13.20.175 E016.57.26.466 N050.14.12.979 E016.57.41.250 
N050.14.12.979 E016.57.41.250 N050.13.11.730 E016.59.59.595
N050.13.11.730 E016.59.59.595 N050.13.20.175 E017.01.07.181 
N050.13.20.175 E017.01.07.181 N050.15.00.508 E017.00.11.213 
N050.15.00.508 E017.00.11.213 N050.16.26.050 E017.01.14.577 
N050.16.26.050 E017.01.14.577 N050.18.00.038 E016.59.59.595
N050.18.00.038 E016.59.59.595 N050.19.00.230 E016.56.29.433 
N050.19.00.230 E016.56.29.433 N050.24.06.501 E016.51.58.023 
N050.24.06.501 E016.51.58.023 N050.26.43.853 E016.54.08.973 
N050.26.43.853 E016.54.08.973 N050.25.29.929 E016.59.59.595 
N050.25.29.929 E016.59.59.595 N050.23.54.883 E017.04.14.107 
N050.23.54.883 E017.04.14.107 N050.24.14.947 E017.06.15.554 
N050.24.14.947 E017.06.15.554 N050.22.36.729 E017.08.44.460 
N050.22.36.729 E017.08.44.460 N050.23.06.296 E017.11.46.105 
N050.23.06.296 E017.11.46.105 N050.21.42.869 E017.11.03.863 
N050.21.42.869 E017.11.03.863 N050.18.52.841 E017.17.48.345 
N050.18.52.841 E017.17.48.345 N050.19.38.256 E017.20.30.977 
N050.19.38.256 E017.20.30.977 N050.18.59.186 E017.21.30.118 
N050.18.59.186 E017.21.30.118 N050.16.04.929 E017.20.30.977 
N050.16.04.929 E017.20.30.977 N050.15.43.808 E017.21.34.341 
N050.15.43.808 E017.21.34.341 N050.17.01.948 E017.24.23.310 
N050.17.01.948 E017.24.23.310 N050.15.08.954 E017.25.33.018 
N050.15.08.954 E017.25.33.018 N050.16.21.821 E017.29.41.193 
N050.16.21.821 E017.29.41.193 N050.15.52.254 E017.36.30.948 
N050.15.52.254 E017.36.30.948 N050.15.59.642 E017.38.38.733 
N050.15.59.642 E017.38.38.733 N050.17.35.745 E017.40.54.971 
N050.17.35.745 E017.40.54.971 N050.19.20.307 E017.41.01.308 
N050.19.20.307 E017.41.01.308 N050.19.21.960 E017.42.43.400
N050.19.21.960 E017.42.43.400 N050.18.12.714 E017.44.57.865
N050.18.12.714 E017.44.57.865 N050.15.38.521 E017.43.29.157 
N050.15.38.521 E017.43.29.157 N050.13.44.469 E017.45.32.719 
N050.13.44.469 E017.45.32.719 N050.12.29.487 E017.45.21.101 
N050.12.29.487 E017.45.21.101 N050.11.59.920 E017.42.40.577 
N050.11.59.920 E017.42.40.577 N050.10.58.658 E017.42.16.283 
N050.10.58.658 E017.42.16.283 N050.10.04.797 E017.36.06.662 
N050.10.04.797 E017.36.06.662 N050.09.24.670 E017.35.55.044 
N050.09.24.670 E017.35.55.044 N050.06.15.636 E017.40.13.779 
N050.06.15.636 E017.40.13.779 N050.06.49.433 E017.41.27.710 
N050.06.49.433 E017.41.27.710 N050.06.19.866 E017.43.59.781 
N050.06.19.866 E017.43.59.781 N050.05.37.624 E017.43.24.934 
N050.05.37.624 E017.43.24.934 N049.59.59.670 E017.48.17.466 
N049.59.59.670 E017.48.17.466 N049.59.44.894 E017.49.16.606 
N049.59.44.894 E017.49.16.606 N049.59.08.982 E017.50.30.531 
N049.59.08.982 E017.50.30.531 N049.58.38.358 E017.52.19.309 
N049.58.38.358 E017.52.19.309 N049.58.26.740 E017.53.25.838 
N049.58.26.740 E017.53.25.838 N049.58.28.855 E017.54.17.584 
N049.58.28.855 E017.54.17.584 N049.58.49.976 E017.55.49.464 
N049.58.49.976 E017.55.49.464 N049.59.23.773 E017.56.32.764 
N049.59.23.773 E017.56.32.764 N049.59.59.670 E017.58.06.752 
N049.59.59.670 E017.58.06.752 N049.59.59.670 E017.58.06.752 
N049.59.59.670 E017.58.06.752 N050.00.21.849 E017.58.32.103 
N050.00.21.849 E017.58.32.103 N050.00.50.359 E017.59.11.180 
N050.00.50.359 E017.59.11.180 N050.00.58.818 E017.59.43.912 
N050.00.58.818 E017.59.43.912 N050.00.55.646 E017.59.59.753 
N050.00.55.646 E017.59.59.753 N050.00.22.906 E018.03.21.469 
N050.00.22.906 E018.03.21.469 N050.02.46.539 E018.00.16.651 
N050.02.46.539 E018.00.16.651 N050.03.23.494 E018.03.40.475
N050.03.23.494 E018.03.40.475 N050.02.52.000 E018.05.52.000

;J
N050.02.52.000 E018.05.52.000 N049.59.59.670 E018.06.41.063 
N049.59.59.670 E018.06.41.063 N049.59.53.340 E018.07.11.687 
N049.59.53.340 E018.07.11.687 N049.59.57.556 E018.07.38.096 
N049.59.57.556 E018.07.38.096 N049.59.54.397 E018.08.04.497 
N049.59.54.397 E018.08.04.497 N049.59.17.428 E018.08.57.293 
N049.59.17.428 E018.08.57.293 N049.59.11.097 E018.09.26.867 
N049.59.11.097 E018.09.26.867 N049.59.17.428 E018.09.42.708 
N049.59.17.428 E018.09.42.708 N049.59.59.670 E018.10.33.403 
N049.59.59.670 E018.10.33.403 N049.59.59.670 E018.12.50.691
N049.59.59.670 E018.12.50.691 N049.58.06.676 E018.13.46.666 
N049.58.06.676 E018.13.46.666 N049.57.46.612 E018.16.34.579 
N049.57.46.612 E018.16.34.579 N049.56.09.452 E018.17.21.051 
N049.56.09.452 E018.17.21.051 N049.56.42.191 E018.19.35.166 
N049.56.42.191 E018.19.35.166 N049.55.30.368 E018.20.30.084 
N049.55.30.368 E018.20.30.084 N049.56.15.783 E018.23.58.131 
N049.56.15.783 E018.23.58.131 N049.54.22.788 E018.29.22.344 
N049.54.22.788 E018.29.22.344 N049.54.50.240 E018.34.29.666 
N049.54.50.240 E018.34.29.666 N049.51.33.805 E018.34.29.666 
N049.51.33.805 E018.34.29.666 N049.50.27.283 E018.35.50.979 
N049.50.27.283 E018.35.50.979 N049.49.03.855 E018.34.48.673 
N049.49.03.855 E018.34.48.673 N049.42.55.278 E018.38.11.439 
N049.42.55.278 E018.38.11.439 N049.40.16.869 E018.48.44.025 
N049.40.16.869 E018.48.44.025 N049.32.52.266 E018.51.35.116 
N049.32.52.266 E018.51.35.116 N049.31.27.781 E018.50.49.702 


;granica z fir koniec
N049.31.27.781 E018.50.49.702  N049.30.00.000 E018.40.00.200
N049.30.00.000 E018.40.00.200 N049.30.00.000 E018.36.00.195
N049.30.00.000 E018.36.00.195 N049.29.44.998 E018.34.00.199
N049.29.44.998 E018.34.00.199 N049.28.59.998 E018.32.44.998
N049.28.59.998 E018.32.44.998 N049.27.00.019 E018.32.30.200
N049.27.00.019 E018.32.30.200 N049.22.59.998 E018.26.59.999
N049.22.59.998 E018.26.59.999 N049.19.59.998 E018.22.00.199
N049.19.59.998 E018.22.00.199 N049.18.14.999 E018.16.49.999
N049.18.14.999 E018.16.49.999 N049.16.59.998 E018.11.59.999
N049.16.59.998 E018.11.59.999 N049.14.44.998 E018.10.14.998
N049.14.44.998 E018.10.14.998 N049.07.29.999 E018.06.45.536
N049.07.29.999 E018.06.45.536 N049.02.39.998 E018.04.14.998
N049.02.39.998 E018.04.14.998 N048.59.14.999 E017.55.00.200
N048.59.14.999 E017.55.00.200 N048.55.59.998 E017.51.10.000
N048.55.59.998 E017.51.10.000 N048.51.50.000 E017.42.34.999
N048.51.50.000 E017.42.34.999 N048.49.14.998 E017.32.15.142
N048.49.14.998 E017.32.15.142 N048.49.42.999 E017.24.18.014
N048.49.42.999 E017.24.18.014 N048.52.19.999 E017.11.25.999
N048.52.19.999 E017.11.25.999 N048.46.35.000 E017.03.29.998
N048.46.35.000 E017.03.29.998 N048.37.00.199 E016.56.59.999
N048.37.00.199 E016.56.59.999 N048.43.00.200 E016.54.20.600
N048.43.00.200 E016.54.20.600 N048.43.45.199 E016.52.40.999
N048.43.45.199 E016.52.40.999 N048.43.00.200 E016.50.30.200
N048.43.00.200 E016.50.30.200 N048.44.14.999 E016.43.14.998
N048.44.14.999 E016.43.14.998 N048.47.09.999 E016.37.29.999
N048.47.09.999 E016.37.29.999 N048.48.39.999 E016.28.00.200
N048.48.39.999 E016.28.00.200 N048.43.59.998 E016.22.00.199
N048.43.59.998 E016.22.00.199 N048.44.00.999 E016.19.19.999
N048.44.00.999 E016.19.19.999 N048.44.09.999 E016.16.09.998
N048.44.09.999 E016.16.09.998 N048.44.49.999 E016.06.00.095
N048.44.49.999 E016.06.00.095 N048.46.59.998 E016.01.00.200
N048.46.59.998 E016.01.00.200 N048.51.50.000 E015.50.15.145
N048.51.50.000 E015.50.15.145 N048.51.29.998 E015.41.14.999
N048.51.29.998 E015.41.14.999 N048.53.20.999 E015.36.50.000
N048.53.20.999 E015.36.50.000 N048.58.59.998 E015.20.59.999
N048.58.59.998 E015.20.59.999 N049.00.00.000 E015.09.29.998
N049.00.00.000 E015.09.29.998 N049.00.00.000 E015.00.14.999
N049.00.00.000 E015.00.14.999 N048.47.49.999 E014.57.50.000
N048.47.49.999 E014.57.50.000 N048.46.59.998 E014.49.59.998
N048.46.59.998 E014.49.59.998 N048.43.30.087 E014.46.30.094
N048.43.30.087 E014.46.30.094 N048.38.59.999 E014.43.00.199
N048.38.59.999 E014.43.00.199 N048.34.30.028 E014.43.00.199
N048.34.30.028 E014.43.00.199 N048.37.59.998 E014.37.00.199
N048.37.59.998 E014.37.00.199 N048.37.45.200 E014.30.00.000
N048.37.45.200 E014.30.00.000 N048.35.30.200 E014.22.59.998
N048.35.30.200 E014.22.59.998 N048.34.59.998 E014.16.30.293
N048.34.59.998 E014.16.30.293 N048.35.49.999 E014.10.59.998
N048.35.49.999 E014.10.59.998 N048.40.00.199 E014.03.00.547
N048.40.00.199 E014.03.00.547 N048.42.39.999 E014.00.29.998
N048.42.39.999 E014.00.29.998 N048.45.00.000 E013.55.00.200
N048.45.00.000 E013.55.00.200 N048.46.59.998 E013.49.00.200
N048.46.59.998 E013.49.00.200 N048.52.59.998 E013.45.00.000
N048.52.59.998 E013.45.00.000 N048.52.59.998 E013.40.59.998
N048.52.59.998 E013.40.59.998 N048.58.00.200 E013.35.59.999
N048.58.00.200 E013.35.59.999 N048.58.30.087 E013.30.29.998
N048.58.30.087 E013.30.29.998 N049.00.00.000 E013.24.00.199
N049.00.00.000 E013.24.00.199 N049.02.59.999 E013.24.00.199
N049.02.59.999 E013.24.00.199 N049.07.00.199 E013.16.59.998
N049.07.00.199 E013.16.59.998 N049.07.00.199 E013.13.59.998
N049.07.00.199 E013.13.59.998 N049.19.59.998 E012.58.00.199
N049.19.59.998 E012.58.00.199 N049.20.14.999 E012.48.00.398
N049.20.14.999 E012.48.00.398 N049.25.59.998 E012.40.59.998
N049.25.59.998 E012.40.59.998 N049.31.54.199 E012.36.29.998
N049.31.54.199 E012.36.29.998 N049.40.45.199 E012.31.14.998
N049.40.45.199 E012.31.14.998 N049.41.49.999 E012.26.59.999
N049.41.49.999 E012.26.59.999 N049.46.59.998 E012.28.59.998
N049.46.59.998 E012.28.59.998 N049.55.00.199 E012.34.00.200
N049.55.00.199 E012.34.00.200 N049.58.00.200 E012.30.00.000
N049.58.00.200 E012.30.00.000 N050.06.29.998 E012.12.29.998
N050.06.29.998 E012.12.29.998 N050.10.00.199 E012.12.29.998
N050.10.00.199 E012.12.29.998 N050.12.34.999 E012.10.45.199
N050.12.34.999 E012.10.45.199 N050.18.29.998 E012.07.14.998
N050.18.29.998 E012.07.14.998 N050.19.19.999 E012.05.44.998
N050.19.19.999 E012.05.44.998 N050.19.00.200 E012.10.59.998
N050.19.00.200 E012.10.59.998 N050.12.29.998 E012.18.15.199
N050.12.29.998 E012.18.15.199 N050.17.12.998 E012.22.27.199
N050.17.12.998 E012.22.27.199 N050.23.59.999 E012.31.59.998
N050.23.59.999 E012.31.59.998 N050.27.00.019 E012.49.59.998
N050.27.00.019 E012.49.59.998 N050.25.00.199 E012.56.59.999
N050.25.00.199 E012.56.59.999 N050.27.00.019 E013.01.59.998
N050.27.00.019 E013.01.59.998 N050.28.59.998 E013.03.00.547
N050.28.59.998 E013.03.00.547 N050.31.00.199 E013.10.00.200
N050.31.00.199 E013.10.00.200 N050.37.59.998 E013.24.00.199
N050.37.59.998 E013.24.00.199 N050.36.00.195 E013.28.00.199
N050.36.00.195 E013.28.00.199 N050.43.00.200 E013.35.59.999
N050.43.00.200 E013.35.59.999 N050.44.03.199 E013.47.54.999
N050.44.03.199 E013.47.54.999 N050.46.00.199 E013.53.30.200
N050.46.00.199 E013.53.30.200 N050.47.59.999 E013.56.59.999
N050.47.59.999 E013.56.59.999 N050.52.00.199 E014.19.00.200
N050.52.00.199 E014.19.00.200 N050.55.59.998 E014.22.30.237
N050.55.59.998 E014.22.30.237 N050.58.59.998 E014.14.30.199
N050.58.59.998 E014.14.30.199 N051.02.59.999 E014.19.00.200
N051.02.59.999 E014.19.00.200 N051.02.59.999 E014.24.00.199
N051.02.59.999 E014.24.00.199 N051.00.00.000 E014.34.41.998
N051.00.00.000 E014.34.41.998 N050.55.00.199 E014.37.00.199
N050.55.00.199 E014.37.00.199 N050.49.59.998 E014.37.00.199
N050.49.59.998 E014.37.00.199 N050.49.00.200 E014.41.59.999
N050.49.00.200 E014.41.59.999 N050.49.00.200 E014.48.00.398
N050.49.00.200 E014.48.00.398 N050.51.21.308 E014.49.18.230


;LZBB 
;granica z FIR poczatek 
;J
LZBB N049.31.27.781 E018.50.49.702 N049.30.38.136 E018.57.54.248 
N049.30.38.136 E018.57.54.248 N049.25.37.152 E018.59.20.841 
N049.25.37.152 E018.59.20.841 N049.24.02.107 E018.58.22.757 
N049.24.02.107 E018.58.22.757 N049.24.02.107 E018.59.59.918 
N049.24.02.107 E018.59.59.918 N049.23.39.928 E019.01.58.199 
N049.23.39.928 E019.01.58.199 N049.25.14.987 E019.04.34.493 
N049.25.14.987 E019.04.34.493 N049.24.16.897 E019.08.05.712 
N049.24.16.897 E019.08.05.712 N049.24.48.579 E019.11.30.594 
N049.24.48.579 E019.11.30.594 N049.26.40.516 E019.11.49.600 
N049.26.40.516 E019.11.49.600 N049.27.31.218 E019.14.03.723 
N049.27.31.218 E019.14.03.723 N049.31.24.608 E019.15.20.812 
N049.31.24.608 E019.15.20.812 N049.32.19.526 E019.22.15.855 
N049.32.19.526 E019.22.15.855 N049.34.16.750 E019.23.14.996 
N049.34.16.750 E019.23.14.996 N049.35.56.012 E019.27.37.961 
N049.35.56.012 E019.27.37.961 N049.34.09.348 E019.31.51.415 
N049.34.09.348 E019.31.51.415 N049.30.05.397 E019.33.11.677 
N049.30.05.397 E019.33.11.677 N049.26.44.745 E019.36.27.048 
N049.26.44.745 E019.36.27.048 N049.26.46.860 E019.38.33.783 
N049.26.46.860 E019.38.33.783 N049.24.03.164 E019.38.28.502 
N049.24.03.164 E019.38.28.502 N049.23.12.476 E019.43.54.824 
N049.23.12.476 E019.43.54.824 N049.24.13.725 E019.45.38.322 
N049.24.13.725 E019.45.38.322 N049.24.16.897 E019.47.33.438 
N049.24.16.897 E019.47.33.438 N049.17.35.580 E019.47.43.992 
N049.17.35.580 E019.47.43.992 N049.16.22.713 E019.49.22.209 
N049.16.22.713 E019.49.22.209 N049.13.55.922 E019.46.02.608 
N049.13.55.922 E019.46.02.608 N049.12.18.762 E019.46.15.284 
N049.12.18.762 E019.46.15.284 N049.11.33.347 E019.47.19.705 
N049.11.33.347 E019.47.19.705 N049.11.51.310 E019.48.34.687 
N049.11.51.310 E019.48.34.687 N049.11.25.959 E019.52.37.587 
N049.11.25.959 E019.52.37.587 N049.13.49.591 E019.55.35.003 
N049.13.49.591 E019.55.35.003 N049.13.30.571 E020.00.00.082 
N049.13.30.571 E020.00.00.082 N049.12.22.992 E020.00.51.828 
N049.12.22.992 E020.00.51.828 N049.10.41.602 E020.05.38.029 
N049.10.41.602 E020.05.38.029 N049.17.10.243 E020.08.01.654 
N049.17.10.243 E020.08.01.654 N049.18.38.958 E020.08.37.559 
N049.18.38.958 E020.08.37.559 N049.18.15.721 E020.09.56.764 
N049.18.15.721 E020.09.56.764 N049.20.49.901 E020.13.35.371 
N049.20.49.901 E020.13.35.371 N049.20.52.016 E020.17.31.934 
N049.20.52.016 E020.17.31.934 N049.20.22.449 E020.18.59.584 
N049.20.22.449 E020.18.59.584 N049.23.12.476 E020.18.53.253 
N049.23.12.476 E020.18.53.253 N049.23.57.891 E020.19.17.540 
N049.23.57.891 E020.19.17.540 N049.23.57.891 E020.21.57.007 
N049.23.57.891 E020.21.57.007 N049.22.54.513 E020.23.10.931 
N049.22.54.513 E020.23.10.931 N049.24.23.228 E020.25.58.850 
N049.24.23.228 E020.25.58.850 N049.24.46.464 E020.26.54.819 
N049.24.46.464 E020.26.54.819 N049.24.38.018 E020.29.15.279 
N049.24.38.018 E020.29.15.279 N049.22.57.686 E020.32.39.103 
N049.22.57.686 E020.32.39.103 N049.22.49.240 E020.35.13.289 
N049.22.49.240 E020.35.13.289 N049.24.58.082 E020.37.01.010 
N049.24.58.082 E020.37.01.010 N049.24.01.049 E020.39.28.858 
N049.24.01.049 E020.39.28.858 N049.24.55.967 E020.42.00.930 
N049.24.55.967 E020.42.00.930 N049.24.49.636 E020.43.44.428 
N049.24.49.636 E020.43.44.428 N049.19.58.155 E020.49.22.374 
N049.19.58.155 E020.49.22.374 N049.20.21.391 E020.51.51.280 
N049.20.21.391 E020.51.51.280 N049.19.45.480 E020.52.41.968 
N049.19.45.480 E020.52.41.968 N049.19.05.352 E020.52.32.465 
N049.19.05.352 E020.52.32.465 N049.19.07.467 E020.54.31.804 
N049.19.07.467 E020.54.31.804 N049.17.41.925 E020.56.26.913 
N049.17.41.925 E020.56.26.913 N049.18.18.880 E020.59.27.501 
N049.18.18.880 E020.59.27.501 N049.19.38.091 E021.00.00.240
N049.19.38.091 E021.00.00.240 N049.21.45.876 E021.03.29.344 
N049.21.45.876 E021.03.29.344 N049.22.00.667 E021.06.00.365 
N049.22.00.667 E021.06.00.365 N049.25.08.643 E021.04.02.084 
N049.25.08.643 E021.04.02.084 N049.25.51.942 E021.08.36.666 
N049.25.51.942 E021.08.36.666 N049.24.10.000 E021.11.56.000
;R
N049.24.10.000 E021.11.56.000 N049.27.09.039 E021.17.13.086  
N049.27.09.039 E021.17.13.086 N049.25.48.770 E021.23.22.714 
N049.25.48.770 E021.23.22.714 N049.25.58.273 E021.24.29.243 
N049.25.58.273 E021.24.29.243 N049.24.49.636 E021.27.27.723 
N049.24.49.636 E021.27.27.723 N049.26.37.357 E021.33.57.415 
N049.26.37.357 E021.33.57.415 N049.26.04.618 E021.35.27.180 
N049.26.04.618 E021.35.27.180 N049.26.41.573 E021.38.18.264 
N049.26.41.573 E021.38.18.264 N049.25.08.643 E021.39.58.590 
N049.25.08.643 E021.39.58.590 N049.24.45.406 E021.43.38.255 
N049.24.45.406 E021.43.38.255 N049.21.09.965 E021.46.54.684 
N049.21.09.965 E021.46.54.684 N049.23.23.036 E021.50.48.074 
N049.23.23.036 E021.50.48.074 N049.21.15.252 E021.54.03.452 
N049.21.15.252 E021.54.03.452 N049.20.33.009 E021.56.20.740 
N049.20.33.009 E021.56.20.740 N049.20.43.570 E021.58.23.245 
N049.20.43.570 E021.58.23.245 N049.18.17.836 E022.00.00.405
N049.18.17.836 E022.00.00.405 N049.14.43.452 E022.02.30.368 
N049.14.43.452 E022.02.30.368 N049.13.01.004 E022.03.06.273 
N049.13.01.004 E022.03.06.273 N049.12.03.972 E022.08.41.047 
N049.12.03.972 E022.08.41.047 N049.10.41.602 E022.11.34.247 
N049.10.41.602 E022.11.34.247 N049.11.04.838 E022.14.13.713 
N049.11.04.838 E022.14.13.713 N049.09.10.786 E022.14.07.375 
N049.09.10.786 E022.14.07.375 N049.08.11.638 E022.19.08.360 
N049.08.11.638 E022.19.08.360 N049.08.54.938 E022.22.20.565 
N049.08.54.938 E022.22.20.565 N049.06.17.586 E022.24.57.917 
N049.06.17.586 E022.24.57.917 N049.05.16.338 E022.34.12.363


;granica z FIR koniec

N049.05.16.338 E022.34.12.363 N049.02.30.199 E022.33.15.199
N049.02.30.199 E022.33.15.199 N048.59.39.998 E022.32.09.999
N048.59.39.998 E022.32.09.999 N048.57.15.199 E022.27.44.999
N048.57.15.199 E022.27.44.999 N048.53.30.199 E022.25.30.490
N048.53.30.199 E022.25.30.490 N048.49.54.998 E022.22.30.237
N048.49.54.998 E022.22.30.237 N048.48.29.998 E022.23.14.999
N048.48.29.998 E022.23.14.999 N048.43.59.998 E022.21.00.195
N048.43.59.998 E022.21.00.195 N048.41.01.971 E022.19.35.999
N048.41.01.971 E022.19.35.999 N048.40.12.040 E022.17.54.960
N048.40.12.040 E022.17.54.960 N048.37.17.968 E022.13.57.961
N048.37.17.968 E022.13.57.961 N048.34.58.940 E022.09.43.000
N048.34.58.940 E022.09.43.000 N048.33.24.879 E022.09.32.039
N048.33.24.879 E022.09.32.039 N048.29.53.840 E022.09.30.120
N048.29.53.840 E022.09.30.120 N048.25.19.199 E022.09.12.920
N048.25.19.199 E022.09.12.920 N048.24.38.458 E022.09.11.960
N048.24.38.458 E022.09.11.960 N048.22.44.000 E022.07.32.998
N048.22.44.000 E022.07.32.998 N048.23.24.953 E022.04.47.999
N048.23.24.953 E022.04.47.999 N048.21.54.240 E021.51.15.200
N048.21.54.240 E021.51.15.200 N048.20.30.001 E021.49.59.998
N048.20.30.001 E021.49.59.998 N048.21.15.199 E021.43.59.998
N048.21.15.199 E021.43.59.998 N048.23.59.999 E021.40.54.998
N048.23.59.999 E021.40.54.998 N048.27.29.998 E021.37.29.999
N048.27.29.998 E021.37.29.999 N048.30.33.199 E021.36.48.999
N048.30.33.199 E021.36.48.999 N048.34.30.028 E021.26.30.199
N048.34.30.028 E021.26.30.199 N048.34.35.999 E021.25.50.599
N048.34.35.999 E021.25.50.599 N048.32.59.999 E021.19.19.999
N048.32.59.999 E021.19.19.999 N048.31.29.999 E021.18.29.998
N048.31.29.999 E021.18.29.998 N048.31.29.999 E021.17.30.200
N048.31.29.999 E021.17.30.200 N048.30.29.998 E021.09.29.998
N048.30.29.998 E021.09.29.998 N048.29.30.199 E021.06.47.998
N048.29.30.199 E021.06.47.998 N048.31.14.998 E020.58.00.200
N048.31.14.998 E020.58.00.200 N048.33.15.199 E020.52.29.999
N048.33.15.199 E020.52.29.999 N048.34.59.998 E020.50.30.200
N048.34.59.998 E020.50.30.200 N048.34.14.998 E020.44.45.999
N048.34.14.998 E020.44.45.999 N048.32.15.142 E020.30.00.000
N048.32.15.142 E020.30.00.000 N048.30.55.000 E020.30.37.999
N048.30.55.000 E020.30.37.999 N048.16.59.998 E020.19.59.998
N048.16.59.998 E020.19.59.998 N048.16.00.199 E020.17.09.999
N048.16.00.199 E020.17.09.999 N048.17.20.999 E020.15.00.000
N048.17.20.999 E020.15.00.000 N048.07.59.998 E019.55.59.998
N048.07.59.998 E019.55.59.998 N048.14.30.199 E019.38.59.999
N048.14.30.199 E019.38.59.999 N048.12.29.998 E019.31.59.998
N048.12.29.998 E019.31.59.998 N048.06.00.095 E019.29.44.998
N048.06.00.095 E019.29.44.998 N048.05.23.841 E019.23.34.411
N048.05.23.841 E019.23.34.411 N048.04.00.200 E019.07.01.999
N048.04.00.200 E019.07.01.999 N048.04.30.023 E018.58.59.998
N048.04.30.023 E018.58.59.998 N048.02.30.199 E018.49.00.199
N048.02.30.199 E018.49.00.199 N047.56.30.200 E018.46.24.999
N047.56.30.200 E018.46.24.999 N047.52.59.998 E018.46.59.998
N047.52.59.998 E018.46.59.998 N047.49.00.200 E018.52.29.999
N047.49.00.200 E018.52.29.999 N047.49.00.200 E018.46.00.200
N047.49.00.200 E018.46.00.200 N047.45.00.000 E018.40.30.692
N047.45.00.000 E018.40.30.692 N047.45.52.999 E018.34.14.998
N047.45.52.999 E018.34.14.998 N047.45.51.200 E018.27.53.999
N047.45.51.200 E018.27.53.999 N047.43.59.998 E018.22.00.199
N047.43.59.998 E018.22.00.199 N047.45.20.599 E018.03.50.999
N047.45.20.599 E018.03.50.999 N047.45.00.000 E017.43.59.998
N047.45.00.000 E017.43.59.998 N047.49.08.590 E017.36.42.919
N047.49.08.590 E017.36.42.919 N048.01.19.999 E017.15.10.999
N048.01.19.999 E017.15.10.999 N048.01.00.199 E017.10.00.200
N048.01.00.199 E017.10.00.200 N048.01.59.998 E017.04.59.998
N048.01.59.998 E017.04.59.998 N048.07.59.998 E017.04.00.199
N048.07.59.998 E017.04.00.199 N048.10.00.199 E016.58.59.998
N048.10.00.199 E016.58.59.998 N048.19.32.998 E016.54.32.999
N048.19.32.998 E016.54.32.999 N048.22.59.998 E016.49.59.998
N048.22.59.998 E016.49.59.998 N048.31.00.199 E016.55.59.998
N048.31.00.199 E016.55.59.998 N048.37.00.199 E016.56.59.999
N048.37.00.199 E016.56.59.999 N048.46.35.000 E017.03.29.998
N048.46.35.000 E017.03.29.998 N048.52.19.999 E017.11.25.999
N048.52.19.999 E017.11.25.999 N048.49.42.999 E017.24.18.014
N048.49.42.999 E017.24.18.014 N048.49.14.998 E017.32.15.142
N048.49.14.998 E017.32.15.142 N048.51.50.000 E017.42.34.999
N048.51.50.000 E017.42.34.999 N048.55.59.998 E017.51.10.000
N048.55.59.998 E017.51.10.000 N048.59.14.999 E017.55.00.200
N048.59.14.999 E017.55.00.200 N049.02.39.998 E018.04.14.998
N049.02.39.998 E018.04.14.998 N049.07.29.999 E018.06.45.536
N049.07.29.999 E018.06.45.536 N049.14.44.998 E018.10.14.998
N049.14.44.998 E018.10.14.998 N049.16.59.998 E018.11.59.999
N049.16.59.998 E018.11.59.999 N049.18.14.999 E018.16.49.999
N049.18.14.999 E018.16.49.999 N049.19.59.998 E018.22.00.199
N049.19.59.998 E018.22.00.199 N049.22.59.998 E018.26.59.999
N049.22.59.998 E018.26.59.999 N049.27.00.019 E018.32.30.200
N049.27.00.019 E018.32.30.200 N049.28.59.998 E018.32.44.998
N049.28.59.998 E018.32.44.998 N049.29.44.998 E018.34.00.199
N049.29.44.998 E018.34.00.199 N049.30.00.000 E018.36.00.195
N049.30.00.000 E018.36.00.195 N049.30.00.000 E018.40.00.200
N049.30.00.000 E018.40.00.200 N049.31.27.781 E018.50.49.702


;UKLV
;poczatek granicy z UMMV
UKLV N051.27.54.770 E023.40.28.487 N051.30.38.249 E023.40.20.370
N051.30.38.249 E023.40.20.370 N051.31.50.440 E023.40.47.179
N051.31.50.440 E023.40.47.179 N051.36.10.339 E023.39.12.301
N051.36.10.339 E023.39.12.301 N051.37.08.090 E023.39.28.800
N051.37.08.090 E023.39.28.800 N051.37.59.660 E023.40.22.429
N051.37.59.660 E023.40.22.429 N051.38.30.598 E023.41.36.690
N051.38.30.598 E023.41.36.690 N051.38.49.160 E023.43.42.509
N051.38.49.160 E023.43.42.509 N051.38.36.779 E023.45.25.639
N051.38.36.779 E023.45.25.639 N051.37.41.160 E023.47.43.839
N051.37.41.160 E023.47.43.839 N051.35.00.211 E023.51.16.289
N051.35.00.211 E023.51.16.289 N051.34.16.888 E023.53.15.928
N051.34.16.888 E023.53.15.928 N051.33.52.138 E023.55.46.498
N051.33.52.138 E023.55.46.498 N051.33.37.699 E024.00.24.958
N051.33.37.699 E024.00.24.958 N051.33.48.599 E024.03.16.149
N051.33.48.599 E024.03.16.149 N051.37.20.470 E024.09.00.619
N051.37.20.470 E024.09.00.619 N051.39.38.660 E024.14.16.198
N051.39.38.660 E024.14.16.198 N051.41.17.671 E024.17.28.839
N051.41.17.671 E024.17.28.839 N051.43.00.800 E024.19.46.228
N051.43.00.800 E024.19.46.228 N051.44.37.748 E024.21.19.039
N051.44.37.748 E024.21.19.039 N051.45.45.810 E024.22.06.481
N051.45.45.810 E024.22.06.481 N051.47.26.890 E024.22.47.740
N051.47.26.890 E024.22.47.740 N051.48.49.388 E024.23.39.299
N051.48.49.388 E024.23.39.299 N051.52.19.779 E024.25.28.621
N051.52.19.779 E024.25.28.621 N051.53.09.279 E024.26.57.321
N051.53.09.279 E024.26.57.321 N051.54.23.540 E024.30.35.960
N051.54.23.540 E024.30.35.960 N051.55.08.918 E024.34.35.230
N051.55.08.918 E024.34.35.230 N051.55.27.480 E024.36.57.549
N051.55.27.480 E024.36.57.549 N051.55.10.981 E024.43.43.888
N051.55.10.981 E024.43.43.888 N051.53.38.158 E024.56.04.380
N051.53.38.158 E024.56.04.380 N051.53.35.811 E024.59.10.291
N051.53.35.811 E024.59.10.291 N051.54.17.348 E025.03.01.039
N051.54.17.348 E025.03.01.039 N051.56.31.419 E025.06.06.670
N051.56.31.419 E025.06.06.670 N051.57.12.679 E025.07.33.301
N051.57.12.679 E025.07.33.301 N051.57.45.680 E025.12.48.891
N051.57.45.680 E025.12.48.891 N051.57.43.740 E025.16.48.118
N051.57.43.740 E025.16.48.118 N051.57.27.118 E025.18.56.120
N051.57.27.118 E025.18.56.120 N051.55.31.609 E025.22.20.240
N051.55.31.609 E025.22.20.240 N051.54.50.349 E025.24.42.570
N051.54.50.349 E025.24.42.570 N051.54.31.791 E025.27.27.579
N051.54.31.791 E025.27.27.579 N051.54.13.229 E025.33.55.360
N051.54.13.229 E025.33.55.360 N051.53.29.911 E025.38.21.440
N051.53.29.911 E025.38.21.440 N051.54.13.229 E025.41.22.948
N051.54.13.229 E025.41.22.948 N051.54.56.541 E025.43.43.208
N051.54.56.541 E025.43.43.208 N051.55.17.169 E025.46.32.350
N051.55.17.169 E025.46.32.350 N051.54.24.541 E025.51.56.908
N051.54.24.541 E025.51.56.908 N051.53.38.158 E025.58.13.648
N051.53.38.158 E025.58.13.648 N051.54.23.540 E026.02.50.960
N051.54.23.540 E026.02.50.960 N051.54.25.599 E026.04.29.960
N051.54.25.599 E026.04.29.960 N051.54.09.100 E026.06.22.499
N051.54.09.100 E026.06.22.499 N051.52.23.908 E026.08.26.250
N051.52.23.908 E026.08.26.250 N051.51.32.338 E026.09.59.960
N051.51.32.338 E026.09.59.960 N051.50.46.960 E026.15.37.349
N051.50.46.960 E026.15.37.349 N051.50.28.399 E026.20.01.370
N051.50.28.399 E026.20.01.370 N051.49.34.769 E026.25.37.581
N051.49.34.769 E026.25.37.581 N051.48.49.388 E026.28.26.720
N051.48.49.388 E026.28.26.720 N051.48.08.139 E026.30.16.160
N051.48.08.139 E026.30.16.160 N051.48.18.449 E026.37.10.628
N051.48.18.449 E026.37.10.628 N051.47.26.890 E026.43.09.530
N051.47.26.890 E026.43.09.530 N051.45.19.999 E026.51.10.130
N051.45.19.999 E026.51.10.130 N051.44.50.121 E026.54.07.520
N051.44.50.121 E026.54.07.520 N051.45.04.561 E026.59.41.668
N051.45.04.561 E026.59.41.668 N051.45.58.190 E027.05.38.500
N051.45.58.190 E027.05.38.500 N051.45.31.381 E027.08.02.889
N051.45.31.381 E027.08.02.889 N051.44.19.179 E027.09.46.880
N051.44.19.179 E027.09.46.880 N051.43.09.880 E027.10.04.580
N051.43.09.880 E027.10.04.580 N051.41.34.169 E027.09.25.390
N051.41.34.169 E027.09.25.390 N051.39.34.538 E027.10.19.999
N051.39.34.538 E027.10.19.999 N051.38.12.999 E027.12.04.219
N051.38.12.999 E027.12.04.219 N051.37.47.280 E027.13.34.978
N051.37.47.280 E027.13.34.978 N051.37.06.119 E027.14.47.169
N051.37.06.119 E027.14.47.169 N051.36.10.339 E027.14.34.789
N051.36.10.339 E027.14.34.789 N051.35.35.271 E027.14.01.791
N051.35.35.271 E027.14.01.791 N051.35.06.399 E027.14.40.981
N051.35.06.399 E027.14.40.981 N051.34.33.391 E027.16.28.239
N051.34.33.391 E027.16.28.239 N051.35.14.640 E027.20.11.000
N051.35.14.640 E027.20.11.000 N051.35.14.640 E027.30.11.228
N051.35.14.640 E027.30.11.228 N051.36.12.398 E027.30.58.669
N051.36.12.398 E027.30.58.669 N051.36.57.780 E027.32.17.919
N051.36.57.780 E027.32.17.919 N051.36.53.650 E027.34.22.879
N051.36.53.650 E027.34.22.879 N051.35.14.640 E027.40.50.649
N051.35.14.640 E027.40.50.649 N051.34.29.269 E027.42.54.410
N051.34.29.269 E027.42.54.410 N051.33.37.699 E027.43.31.540
N051.33.37.699 E027.43.31.540 N051.30.29.998 E027.42.35.848
N051.30.29.998 E027.42.35.848 N051.28.59.239 E027.43.06.790
N051.28.59.239 E027.43.06.790 N051.28.09.739 E027.44.41.668

;koniec granicy z UMMV


N051.28.09.739 E027.44.41.668 N051.22.59.998 E027.45.00.000
N051.22.59.998 E027.45.00.000 N050.51.00.195 E027.25.59.998
N050.51.00.195 E027.25.59.998 N050.10.54.199 E027.02.35.998
N050.10.54.199 E027.02.35.998 N049.45.42.200 E027.51.00.195
N049.45.42.200 E027.51.00.195 N048.26.42.663 E027.50.17.998
N048.26.42.663 E027.50.17.998 N048.24.37.101 E027.50.11.669
N048.24.37.101 E027.50.11.669 N048.26.23.960 E027.47.09.329
N048.26.23.960 E027.47.09.329 N048.27.14.839 E027.42.11.879
N048.27.14.839 E027.42.11.879 N048.26.57.519 E027.37.51.200
N048.26.57.519 E027.37.51.200 N048.27.53.211 E027.35.10.320
N048.27.53.211 E027.35.10.320 N048.27.53.211 E027.33.51.940
N048.27.53.211 E027.33.51.940 N048.25.22.918 E027.29.20.979
N048.25.22.918 E027.29.20.979 N048.24.53.758 E027.25.51.340
N048.24.53.758 E027.25.51.340 N048.25.57.709 E027.22.47.758
N048.25.57.709 E027.22.47.758 N048.25.41.199 E027.19.52.438
N048.25.41.199 E027.19.52.438 N048.23.06.500 E027.16.15.859
N048.23.06.500 E027.16.15.859 N048.23.53.941 E027.13.18.469
N048.23.53.941 E027.13.18.469 N048.23.00.319 E027.08.29.698
N048.23.00.319 E027.08.29.698 N048.23.10.629 E027.07.09.260
N048.23.10.629 E027.07.09.260 N048.25.22.641 E027.04.40.749
N048.25.22.641 E027.04.40.749 N048.25.45.328 E027.03.03.808
N048.25.45.328 E027.03.03.808 N048.25.18.508 E027.02.03.991
N048.25.18.508 E027.02.03.991 N048.23.37.449 E027.02.08.109
N048.23.37.449 E027.02.08.109 N048.22.52.160 E027.01.10.358
N048.22.52.160 E027.01.10.358 N048.22.12.601 E026.58.24.870
N048.22.12.601 E026.58.24.870 N048.22.43.820 E026.55.48.579
N048.22.43.820 E026.55.48.579 N048.25.16.449 E026.52.47.120
N048.25.16.449 E026.52.47.120 N048.25.51.520 E026.50.06.190
N048.25.51.520 E026.50.06.190 N048.25.45.328 E026.46.06.920
N048.25.45.328 E026.46.06.920 N048.25.26.760 E026.44.09.351
N048.25.26.760 E026.44.09.351 N048.25.02.000 E026.43.11.589
N048.25.02.000 E026.43.11.589 N048.24.14.569 E026.42.46.839
N048.24.14.569 E026.42.46.839 N048.21.23.371 E026.43.44.590
N048.21.23.371 E026.43.44.590 N048.19.58.799 E026.42.15.901
N048.19.58.799 E026.42.15.901 N048.18.40.420 E026.39.59.770
N048.18.40.420 E026.39.59.770 N048.17.22.160 E026.38.24.889
N048.17.22.160 E026.38.24.889 N048.14.24.291 E026.36.08.161
N048.14.24.291 E026.36.08.161 N048.12.27.919 E026.31.46.999
N048.12.27.919 E026.31.46.999 N048.12.41.939 E026.30.57.880
N048.12.41.939 E026.30.57.880 N048.12.57.380 E026.27.57.628
N048.12.57.380 E026.27.57.628 N048.11.11.759 E026.18.58.381
N048.11.11.759 E026.18.58.381 N048.10.00.919 E026.19.20.938
N048.10.00.919 E026.19.20.938 N048.06.32.749 E026.17.24.129
N048.06.32.749 E026.17.24.129 N048.04.46.120 E026.16.27.880
N048.04.46.120 E026.16.27.880 N048.01.37.970 E026.12.49.920
N048.01.37.970 E026.12.49.920 N047.59.43.900 E026.11.00.959
N047.59.43.900 E026.11.00.959 N047.58.56.960 E026.06.04.960
N047.58.56.960 E026.06.04.960 N047.58.53.990 E026.01.15.988
N047.58.53.990 E026.01.15.988 N047.58.30.889 E025.56.23.920
N047.58.30.889 E025.56.23.920 N047.58.23.840 E025.55.04.079
N047.58.23.840 E025.55.04.079 N047.57.45.921 E025.52.08.968
N047.57.45.921 E025.52.08.968 N047.56.25.920 E025.47.30.929
N047.56.25.920 E025.47.30.929 N047.56.08.980 E025.45.39.959
N047.56.08.980 E025.45.39.959 N047.56.02.990 E025.31.09.929
N047.56.02.990 E025.31.09.929 N047.55.19.960 E025.26.26.109
N047.55.19.960 E025.26.26.109 N047.54.59.080 E025.21.41.079
N047.54.59.080 E025.21.41.079 N047.54.38.800 E025.18.47.998
N047.54.38.800 E025.18.47.998 N047.53.08.080 E025.14.15.939
N047.53.08.080 E025.14.15.939 N047.52.15.079 E025.13.07.919
N047.52.15.079 E025.13.07.919 N047.51.47.960 E025.13.06.600
N047.51.47.960 E025.13.06.600 N047.50.13.999 E025.11.21.019
N047.50.13.999 E025.11.21.019 N047.46.26.900 E025.08.10.119
N047.46.26.900 E025.08.10.119 N047.44.27.000 E025.04.16.939
N047.44.27.000 E025.04.16.939 N047.43.24.970 E024.59.32.089
N047.43.24.970 E024.59.32.089 N047.42.43.920 E024.54.46.999
N047.42.43.920 E024.54.46.999 N047.42.57.949 E024.53.50.931
N047.42.57.949 E024.53.50.931 N047.43.59.998 E024.52.59.599
N047.43.59.998 E024.52.59.599 N047.48.46.951 E024.48.59.879
N047.48.46.951 E024.48.59.879 N047.50.05.949 E024.44.11.940
N047.50.05.949 E024.44.11.940 N047.51.55.889 E024.40.13.918
N047.51.55.889 E024.40.13.918 N047.52.21.040 E024.40.05.120
N047.52.21.040 E024.40.05.120 N047.53.34.920 E024.40.26.960
N047.53.34.920 E024.40.26.960 N047.55.57.079 E024.37.01.959
N047.55.57.079 E024.37.01.959 N047.56.58.879 E024.34.25.989
N047.56.58.879 E024.34.25.989 N047.57.22.701 E024.29.54.459
N047.57.22.701 E024.29.54.459 N047.57.33.771 E024.25.41.311
N047.57.33.771 E024.25.41.311 N047.57.10.960 E024.24.13.960
N047.57.10.960 E024.24.13.960 N047.55.44.839 E024.19.36.940
N047.55.44.839 E024.19.36.940 N047.54.14.911 E024.14.58.898
N047.54.14.911 E024.14.58.898 N047.54.42.958 E024.07.31.918
N047.54.42.958 E024.07.31.918 N047.56.17.019 E024.05.21.980
N047.56.17.019 E024.05.21.980 N047.57.23.489 E024.01.43.399
N047.57.23.489 E024.01.43.399 N047.58.02.959 E023.48.51.749
N047.58.02.959 E023.48.51.749 N047.59.57.739 E023.34.04.940
N047.59.57.739 E023.34.04.940 N047.59.23.159 E023.30.49.150
N047.59.23.159 E023.30.49.150 N047.59.09.919 E023.30.44.040
N047.59.09.919 E023.30.44.040 N047.58.38.931 E023.29.32.839
N047.58.38.931 E023.29.32.839 N047.59.04.919 E023.27.48.949
N047.59.04.919 E023.27.48.949 N048.02.47.968 E023.17.45.661
N048.02.47.968 E023.17.45.661 N048.04.38.539 E023.16.37.959
N048.04.38.539 E023.16.37.959 N048.05.28.528 E023.15.31.129
N048.05.28.528 E023.15.31.129 N048.06.29.689 E023.10.33.000
N048.06.29.689 E023.10.33.000 N048.06.14.990 E023.08.54.578
N048.06.14.990 E023.08.54.578 N048.05.12.649 E023.07.22.259
N048.05.12.649 E023.07.22.259 N048.02.37.978 E023.06.23.338
N048.02.37.978 E023.06.23.338 N048.00.49.168 E023.05.19.150
N048.00.49.168 E023.05.19.150 N047.59.27.279 E023.01.57.291
N047.59.27.279 E023.01.57.291 N047.57.13.949 E022.53.46.100
N047.57.13.949 E022.53.46.100 N047.59.43.900 E022.51.47.908
N047.59.43.900 E022.51.47.908 N048.02.25.000 E022.53.09.999
N048.02.25.000 E022.53.09.999 N048.05.10.208 E022.50.30.818
N048.05.10.208 E022.50.30.818 N048.07.04.920 E022.47.17.079
N048.07.04.920 E022.47.17.079 N048.06.51.901 E022.44.15.979
N048.06.51.901 E022.44.15.979 N048.05.42.291 E022.40.57.248
N048.05.42.291 E022.40.57.248 N048.06.05.911 E022.37.13.969
N048.06.05.911 E022.37.13.969 N048.07.43.060 E022.36.06.930
N048.07.43.060 E022.36.06.930 N048.09.03.088 E022.35.44.039
N048.09.03.088 E022.35.44.039 N048.10.24.970 E022.34.31.879
N048.10.24.970 E022.34.31.879 N048.10.59.998 E022.34.14.998
N048.10.59.998 E022.34.14.998 N048.11.27.059 E022.34.34.939
N048.11.27.059 E022.34.34.939 N048.11.40.959 E022.34.31.879
N048.11.40.959 E022.34.31.879 N048.12.58.119 E022.31.54.159
N048.12.58.119 E022.31.54.159 N048.15.01.990 E022.29.04.909
N048.15.01.990 E022.29.04.909 N048.14.41.978 E022.26.38.079
N048.14.41.978 E022.26.38.079 N048.15.47.991 E022.21.52.988
N048.15.47.991 E022.21.52.988 N048.17.06.169 E022.20.53.408
N048.17.06.169 E022.20.53.408 N048.17.58.999 E022.20.14.839
N048.17.58.999 E022.20.14.839 N048.18.46.789 E022.19.36.631
N048.18.46.789 E022.19.36.631 N048.19.43.949 E022.18.52.919
N048.19.43.949 E022.18.52.919 N048.21.41.939 E022.19.10.880
N048.21.41.939 E022.19.10.880 N048.23.00.931 E022.15.16.959
N048.23.00.931 E022.15.16.959 N048.23.34.969 E022.15.41.918
N048.23.34.969 E022.15.41.918 N048.23.48.991 E022.16.09.969
N048.23.48.991 E022.16.09.969 N048.24.14.990 E022.16.16.989
N048.24.14.990 E022.16.16.989 N048.24.25.920 E022.16.07.910
N048.24.25.920 E022.16.07.910 N048.24.45.928 E022.11.09.120
N048.24.45.928 E022.11.09.120 N048.24.38.458 E022.09.11.960

;poczatek wspolnej z LZBB
N049.05.16.338 E022.34.12.363 N049.02.30.199 E022.33.15.199
N049.02.30.199 E022.33.15.199 N048.59.39.998 E022.32.09.999
N048.59.39.998 E022.32.09.999 N048.57.15.199 E022.27.44.999
N048.57.15.199 E022.27.44.999 N048.53.30.199 E022.25.30.490
N048.53.30.199 E022.25.30.490 N048.49.54.998 E022.22.30.237
N048.49.54.998 E022.22.30.237 N048.48.29.998 E022.23.14.999
N048.48.29.998 E022.23.14.999 N048.43.59.998 E022.21.00.195
N048.43.59.998 E022.21.00.195 N048.41.01.971 E022.19.35.999
N048.41.01.971 E022.19.35.999 N048.40.12.040 E022.17.54.960
N048.40.12.040 E022.17.54.960 N048.37.17.968 E022.13.57.961
N048.37.17.968 E022.13.57.961 N048.34.58.940 E022.09.43.000
N048.34.58.940 E022.09.43.000 N048.33.24.879 E022.09.32.039
N048.33.24.879 E022.09.32.039 N048.29.53.840 E022.09.30.120
N048.29.53.840 E022.09.30.120 N048.25.19.199 E022.09.12.920
N048.25.19.199 E022.09.12.920 N048.24.38.458 E022.09.11.960
;koniec wspolnej z LZBB

;poczatek granicy z FIR
;R
N049.05.16.338 E022.34.12.363 N049.05.29.013 E022.36.51.829
N049.05.29.013 E022.36.51.829 N049.02.30.526 E022.41.35.915
N049.02.30.526 E022.41.35.915 N049.03.27.559 E022.46.41.115
N049.03.27.559 E022.46.41.115 N049.02.21.023 E022.48.26.728
N049.02.21.023 E022.48.26.728 N049.05.34.286 E022.54.08.898
N049.05.34.286 E022.54.08.898 N049.07.08.275 E022.50.11.277
N049.07.08.275 E022.50.11.277 N049.09.35.066 E022.47.41.314
N049.09.35.066 E022.47.41.314 N049.09.51.971 E022.45.02.905
N049.09.51.971 E022.45.02.905 N049.10.58.507 E022.45.25.083
N049.10.58.507 E022.45.25.083 N049.10.29.984 E022.43.44.751
N049.10.29.984 E022.43.44.751 N049.10.25.768 E022.42.47.725
N049.10.25.768 E022.42.47.725 N049.11.23.844 E022.43.12.011
N049.11.23.844 E022.43.12.011 N049.13.08.406 E022.45.05.013
N049.13.08.406 E022.45.05.013 N049.13.50.649 E022.43.58.483
N049.13.50.649 E022.43.58.483 N049.16.30.102 E022.47.21.250
N049.16.30.102 E022.47.21.250 N049.19.35.977 E022.48.47.850
N049.19.35.977 E022.48.47.850 N049.26.59.536 E022.41.46.476
N049.26.59.536 E022.41.46.476 N049.28.33.524 E022.42.07.597
N049.28.33.524 E022.42.07.597 N049.31.36.227 E022.40.00.863
N049.31.36.227 E022.40.00.863 N049.32.41.691 E022.40.10.366
N049.32.41.691 E022.40.10.366 N049.41.21.290 E022.48.04.550
N049.41.21.290 E022.48.04.550 N049.43.01.609 E022.51.12.526
N049.43.01.609 E022.51.12.526 N049.51.07.410 E022.59.59.512
N049.51.07.410 E022.59.59.512 N049.52.26.622 E023.02.05.182
N049.52.26.622 E023.02.05.182 N049.53.10.965 E023.02.35.814
N049.53.10.965 E023.02.35.814 N049.53.48.992 E023.03.13.833
N049.53.48.992 E023.03.13.833 N049.56.01.006 E023.05.55.408
N049.56.01.006 E023.05.55.408 N049.56.41.134 E023.06.22.867
N049.56.41.134 E023.06.22.867 N049.57.18.089 E023.07.04.052
N049.57.18.089 E023.07.04.052 N049.57.39.210 E023.07.46.294
N049.57.39.210 E023.07.46.294 N049.58.11.949 E023.08.19.033
N049.58.11.949 E023.08.19.033 N049.58.32.013 E023.08.54.945
N049.58.32.013 E023.08.54.945 N049.59.59.670 E023.10.39.494
N049.59.59.670 E023.10.39.494 N050.01.03.034 E023.12.05.036
N050.01.03.034 E023.12.05.036 N050.03.36.170 E023.14.10.706
N050.03.36.170 E023.14.10.706 N050.04.04.679 E023.15.44.701
N050.04.04.679 E023.15.44.701 N050.05.49.228 E023.17.37.695
N050.05.49.228 E023.17.37.695 N050.08.16.033 E023.21.38.481
N050.08.16.033 E023.21.38.481 N050.10.45.996 E023.25.54.057
N050.10.45.996 E023.25.54.057 N050.12.21.042 E023.27.25.937
N050.12.21.042 E023.27.25.937 N050.16.38.726 E023.35.53.904
N050.16.38.726 E023.35.53.904 N050.18.12.714 E023.36.50.930
N050.18.12.714 E023.36.50.930 N050.19.46.702 E023.40.12.646
N050.19.46.702 E023.40.12.646 N050.20.40.562 E023.41.23.405
N050.20.40.562 E023.41.23.405 N050.23.44.323 E023.43.24.852
N050.23.44.323 E023.43.24.852 N050.24.20.220 E023.45.04.120
N050.24.20.220 E023.45.04.120 N050.25.10.922 E023.47.14.019
N050.25.10.922 E023.47.14.019 N050.24.50.858 E023.54.41.795
N050.24.50.858 E023.54.41.795 N050.25.25.699 E023.59.59.670
N050.25.25.699 E023.59.59.670 N050.27.10.247 E024.02.58.150
N050.27.10.247 E024.02.58.150 N050.38.18.752 E024.05.59.795
N050.38.18.752 E024.05.59.795 N050.41.15.110 E024.03.57.291
N050.41.15.110 E024.03.57.291 N050.42.58.615 E024.04.50.094
N050.42.58.615 E024.04.50.094 N050.46.25.597 E023.59.59.670
N050.46.25.597 E023.59.59.670 N050.47.00.451 E023.58.13.014
N050.47.00.451 E023.58.13.014 N050.48.56.618 E023.58.04.561
N050.48.56.618 E023.58.04.561 N050.50.27.448 E023.59.59.670
N050.50.27.448 E023.59.59.670 N050.50.14.772 E024.06.40.980
N050.50.14.772 E024.06.40.980 N050.51.49.818 E024.08.56.160
N050.51.49.818 E024.08.56.160 N050.56.29.680 E023.59.59.670
N050.56.29.680 E023.59.59.670 N050.56.56.075 E023.59.14.263
N050.56.56.075 E023.59.14.263 N050.57.16.139 E023.58.49.976
N050.57.16.139 E023.58.49.976 N050.58.43.796 E023.58.24.632
N050.58.43.796 E023.58.24.632 N050.58.58.586 E023.58.09.841
N050.58.58.586 E023.58.09.841 N050.59.59.835 E023.56.21.063
N050.59.59.835 E023.56.21.063 N051.00.09.338 E023.55.45.158
N051.00.09.338 E023.55.45.158 N051.02.18.181 E023.56.03.114
N051.02.18.181 E023.56.03.114 N051.04.08.016 E023.55.18.757
N051.04.08.016 E023.55.18.757 N051.07.19.165 E023.51.34.869
N051.07.19.165 E023.51.34.869 N051.08.56.325 E023.52.42.463
N051.08.56.325 E023.52.42.463 N051.13.01.334 E023.44.37.718
N051.13.01.334 E023.44.37.718 N051.16.11.425 E023.43.22.737
N051.16.11.425 E023.43.22.737 N051.17.30.636 E023.39.15.620
N051.17.30.636 E023.39.15.620 N051.18.51.949 E023.38.44.989
N051.18.51.949 E023.38.44.989 N051.20.01.657 E023.39.06.110
N051.20.01.657 E023.39.06.110 N051.24.39.405 E023.42.29.934
N051.24.39.405 E023.42.29.934 N051.26.46.119 E023.39.31.454
N051.26.46.119 E023.39.31.454 N051.27.54.770 E023.40.28.487
;koniec granicy z FIR


UMMV N054.00.00.330 E023.28.52.530 N053.54.32.489 E023.37.06.481
N053.54.32.489 E023.37.06.481 N053.53.59.999 E023.48.00.398
N053.53.59.999 E023.48.00.398 N053.55.44.691 E023.55.38.251
N053.55.44.691 E023.55.38.251 N053.56.21.811 E024.11.45.628
N053.56.21.811 E024.11.45.628 N053.54.11.869 E024.17.21.840
N053.54.11.869 E024.17.21.840 N053.53.28.550 E024.24.41.180
N053.53.28.550 E024.24.41.180 N054.00.47.998 E024.40.03.667
N054.00.47.998 E024.40.03.667 N054.00.05.000 E024.41.35.599
N054.00.05.000 E024.41.35.599 N053.56.52.760 E024.44.47.828
N053.56.52.760 E024.44.47.828 N053.58.17.320 E024.48.12.120
N053.58.17.320 E024.48.12.120 N054.03.57.661 E024.48.24.411
N054.03.57.661 E024.48.24.411 N054.06.10.000 E024.47.39.998
N054.06.10.000 E024.47.39.998 N054.08.30.199 E024.50.09.999
N054.08.30.199 E024.50.09.999 N054.09.29.998 E024.58.19.999
N054.09.29.998 E024.58.19.999 N054.08.44.998 E025.00.00.000
N054.08.44.998 E025.00.00.000 N054.07.59.998 E025.03.00.547
N054.07.59.998 E025.03.00.547 N054.10.44.999 E025.10.32.761
N054.10.44.999 E025.10.32.761 N054.12.16.819 E025.13.52.831
N054.12.16.819 E025.13.52.831 N054.16.27.998 E025.16.06.999
N054.16.27.998 E025.16.06.999 N054.15.59.590 E025.27.23.450
N054.15.59.590 E025.27.23.450 N054.15.12.149 E025.32.34.918
N054.15.12.149 E025.32.34.918 N054.12.46.299 E025.34.00.559
N054.12.46.299 E025.34.00.559 N054.10.52.251 E025.35.07.551
N054.10.52.251 E025.35.07.551 N054.09.19.429 E025.34.18.079
N054.09.19.429 E025.34.18.079 N054.08.09.301 E025.42.55.771
N054.08.09.301 E025.42.55.771 N054.10.00.199 E025.46.59.998
N054.10.00.199 E025.46.59.998 N054.14.43.270 E025.46.44.720
N054.14.43.270 E025.46.44.720 N054.16.59.998 E025.43.00.200
N054.16.59.998 E025.43.00.200 N054.18.17.780 E025.35.42.619
N054.18.17.780 E025.35.42.619 N054.19.44.410 E025.35.05.488
N054.19.44.410 E025.35.05.488 N054.28.00.200 E025.37.00.199
N054.28.00.200 E025.37.00.199 N054.33.21.229 E025.43.43.208
N054.33.21.229 E025.43.43.208 N054.35.18.380 E025.44.00.430
N054.35.18.380 E025.44.00.430 N054.38.05.539 E025.44.24.169
N054.38.05.539 E025.44.24.169 N054.47.11.130 E025.46.14.401
N054.47.11.130 E025.46.14.401 N054.52.41.998 E025.49.00.199
N054.52.41.998 E025.49.00.199 N054.57.54.878 E026.08.37.769
N054.57.54.878 E026.08.37.769 N055.00.00.000 E026.13.00.200
N055.00.00.000 E026.13.00.200 N055.02.42.730 E026.14.29.281
N055.02.42.730 E026.14.29.281 N055.05.33.928 E026.14.06.590
N055.05.33.928 E026.14.06.590 N055.08.16.879 E026.16.20.668
N055.08.16.879 E026.16.20.668 N055.07.56.251 E026.19.57.241
N055.07.56.251 E026.19.57.241 N055.06.04.870 E026.27.04.208
N055.06.04.870 E026.27.04.208 N055.07.25.309 E026.30.32.540
N055.07.25.309 E026.30.32.540 N055.08.33.381 E026.40.08.840
N055.08.33.381 E026.40.08.840 N055.12.01.699 E026.43.15.718
N055.12.01.699 E026.43.15.718 N055.15.52.718 E026.51.22.499
N055.15.52.718 E026.51.22.499 N055.17.46.168 E026.51.06.199
N055.17.46.168 E026.51.06.199 N055.18.06.789 E026.48.35.431
N055.18.06.789 E026.48.35.431 N055.17.58.538 E026.31.50.919
N055.17.58.538 E026.31.50.919 N055.19.06.610 E026.27.31.120
N055.19.06.610 E026.27.31.120 N055.21.26.870 E026.27.47.530
N055.21.26.870 E026.27.47.530 N055.22.34.939 E026.30.26.348
N055.22.34.939 E026.30.26.348 N055.26.58.959 E026.33.17.549
N055.26.58.959 E026.33.17.549 N055.36.24.119 E026.38.49.639
N055.36.24.119 E026.38.49.639 N055.40.50.600 E026.37.50.599
;koniec granicy z EYVL
N055.40.50.600 E026.37.50.599 N055.42.34.999 E026.39.45.037
N055.42.34.999 E026.39.45.037 N055.41.14.999 E026.45.15.199
N055.41.14.999 E026.45.15.199 N055.42.44.999 E026.51.20.600
N055.42.44.999 E026.51.20.600 N055.44.30.199 E026.52.59.998
N055.44.30.199 E026.52.59.998 N055.46.45.200 E026.53.59.999
N055.46.45.200 E026.53.59.999 N055.49.59.998 E026.59.35.599
N055.49.59.998 E026.59.35.599 N055.50.44.998 E027.08.59.999
N055.50.44.998 E027.08.59.999 N055.49.24.999 E027.12.44.999
N055.49.24.999 E027.12.44.999 N055.48.20.600 E027.20.30.001
N055.48.20.600 E027.20.30.001 N055.47.15.142 E027.31.59.998
N055.47.15.142 E027.31.59.998 N055.47.30.199 E027.35.54.999
N055.47.30.199 E027.35.54.999 N055.51.00.195 E027.38.09.999
N055.51.00.195 E027.38.09.999 N055.51.44.999 E027.37.50.599
N055.51.44.999 E027.37.50.599 N055.54.45.037 E027.38.35.600
N055.54.45.037 E027.38.35.600 N055.55.35.000 E027.38.59.999
N055.55.35.000 E027.38.59.999 N056.00.29.998 E027.48.50.999
N056.00.29.998 E027.48.50.999 N056.04.09.998 E027.53.49.999
N056.04.09.998 E027.53.49.999 N056.07.00.199 E027.55.59.998
N056.07.00.199 E027.55.59.998 N056.10.23.998 E028.08.48.200
N056.10.23.998 E028.08.48.200 N056.08.59.999 E028.10.00.200
N056.08.59.999 E028.10.00.200 N056.02.59.999 E028.19.59.998
N056.02.59.999 E028.19.59.998 N056.06.00.095 E028.23.30.200
N056.06.00.095 E028.23.30.200 N056.06.00.095 E028.38.59.999
N056.06.00.095 E028.38.59.999 N056.01.29.999 E028.42.50.000
N056.01.29.999 E028.42.50.000 N055.57.29.998 E028.43.40.000
N055.57.29.998 E028.43.40.000 N055.56.30.200 E028.51.00.195
N055.56.30.200 E028.51.00.195 N055.58.59.998 E028.51.29.998
N055.58.59.998 E028.51.29.998 N056.01.59.998 E029.04.00.199
N056.01.59.998 E029.04.00.199 N055.57.00.039 E029.25.00.200
N055.57.00.039 E029.25.00.200 N055.54.39.999 E029.28.00.200
N055.54.39.999 E029.28.00.200 N055.53.59.999 E029.24.29.998
N055.53.59.999 E029.24.29.998 N055.47.59.999 E029.20.49.999
N055.47.59.999 E029.20.49.999 N055.41.30.200 E029.30.00.000
N055.41.30.200 E029.30.00.000 N055.46.29.999 E029.37.59.998
N055.46.29.999 E029.37.59.998 N055.51.29.998 E029.58.00.200
N055.51.29.998 E029.58.00.200 N055.51.20.600 E030.15.29.998
N055.51.20.600 E030.15.29.998 N055.47.59.999 E030.28.59.998
N055.47.59.999 E030.28.59.998 N055.43.40.000 E030.36.20.600
N055.43.40.000 E030.36.20.600 N055.38.59.999 E030.40.00.200
N055.38.59.999 E030.40.00.200 N055.35.20.000 E030.46.00.200
N055.35.20.000 E030.46.00.200 N055.37.29.999 E030.51.39.999
N055.37.29.999 E030.51.39.999 N055.37.18.200 E030.55.54.200
N055.37.18.200 E030.55.54.200 N055.23.59.999 E030.55.59.998
N055.23.59.999 E030.55.59.998 N055.17.59.999 E030.48.39.999
N055.17.59.999 E030.48.39.999 N055.11.39.998 E030.56.59.999
N055.11.39.998 E030.56.59.999 N055.02.30.199 E031.01.35.000
N055.02.30.199 E031.01.35.000 N054.57.44.999 E030.55.50.599
N054.57.44.999 E030.55.50.599 N054.57.00.039 E030.51.15.200
N054.57.00.039 E030.51.15.200 N054.47.39.998 E030.46.29.999
N054.47.39.998 E030.46.29.999 N054.45.45.023 E030.53.30.200
N054.45.45.023 E030.53.30.200 N054.38.59.999 E031.06.45.536
N054.38.59.999 E031.06.45.536 N054.34.40.000 E031.08.20.999
N054.34.40.000 E031.08.20.999 N054.30.00.000 E031.04.40.999
N054.30.00.000 E031.04.40.999 N054.27.20.600 E031.14.30.199
N054.27.20.600 E031.14.30.199 N054.19.59.998 E031.19.00.199
N054.19.59.998 E031.19.00.199 N054.14.20.000 E031.19.59.998
N054.14.20.000 E031.19.59.998 N054.09.45.137 E031.31.00.200
N054.09.45.137 E031.31.00.200 N054.06.39.999 E031.40.59.998
N054.06.39.999 E031.40.59.998 N054.06.29.998 E031.45.29.998
N054.06.29.998 E031.45.29.998 N054.04.00.200 E031.51.00.195
N054.04.00.200 E031.51.00.195 N054.00.00.000 E031.52.29.999
N054.00.00.000 E031.52.29.999 N053.51.20.600 E031.48.00.398
N053.51.20.600 E031.48.00.398 N053.47.59.999 E031.45.44.999
N053.47.59.999 E031.45.44.999 N053.46.29.999 E031.54.29.998
N053.46.29.999 E031.54.29.998 N053.49.00.200 E032.07.00.199
N053.49.00.200 E032.07.00.199 N053.43.59.998 E032.27.00.019
N053.43.59.998 E032.27.00.019 N053.40.59.998 E032.31.29.999
N053.40.59.998 E032.31.29.999 N053.38.30.199 E032.25.00.199
N053.38.30.199 E032.25.00.199 N053.33.44.999 E032.27.00.019
N053.33.44.999 E032.27.00.019 N053.30.29.998 E032.37.00.199
N053.30.29.998 E032.37.00.199 N053.28.00.200 E032.45.00.000
N053.28.00.200 E032.45.00.000 N053.21.20.600 E032.42.29.998
N053.21.20.600 E032.42.29.998 N053.07.59.998 E032.19.30.028
N053.07.59.998 E032.19.30.028 N053.04.59.998 E032.09.39.999
N053.04.59.998 E032.09.39.999 N053.05.49.999 E031.55.00.200
N053.05.49.999 E031.55.00.200 N053.07.29.999 E031.48.20.599
N053.07.29.999 E031.48.20.599 N053.11.44.998 E031.46.00.200
N053.11.44.998 E031.46.00.200 N053.13.00.200 E031.36.00.195
N053.13.00.200 E031.36.00.195 N053.13.00.200 E031.25.00.200
N053.13.00.200 E031.25.00.200 N053.07.29.999 E031.22.30.237
N053.07.29.999 E031.22.30.237 N053.06.29.998 E031.24.15.200
N053.06.29.998 E031.24.15.200 N053.01.45.200 E031.16.00.200
N053.01.45.200 E031.16.00.200 N052.52.45.200 E031.25.45.199
N052.52.45.200 E031.25.45.199 N052.51.00.195 E031.33.00.398
N052.51.00.195 E031.33.00.398 N052.43.59.998 E031.35.30.200
N052.43.59.998 E031.35.30.200 N052.40.00.199 E031.31.00.200
N052.40.00.199 E031.31.00.200 N052.34.59.998 E031.36.00.195
N052.34.59.998 E031.36.00.195 N052.22.00.199 E031.37.29.999
N052.22.00.199 E031.37.29.999 N052.19.00.200 E031.34.29.999
N052.19.00.200 E031.34.29.999 N052.09.45.137 E031.47.30.200
N052.09.45.137 E031.47.30.200 N052.06.54.140 E031.47.35.998
N052.06.54.140 E031.47.35.998 N052.05.48.811 E031.46.39.921
N052.05.48.811 E031.46.39.921 N052.05.59.931 E031.38.01.489
N052.05.59.931 E031.38.01.489 N052.06.15.209 E031.33.25.289
N052.06.15.209 E031.33.25.289 N052.06.22.161 E031.28.26.450
N052.06.22.161 E031.28.26.450 N052.06.02.710 E031.23.29.871
N052.06.02.710 E031.23.29.871 N052.05.19.640 E031.21.14.039
N052.05.19.640 E031.21.14.039 N052.03.54.899 E031.19.20.841
N052.03.54.899 E031.19.20.841 N052.02.30.159 E031.18.12.920
N052.02.30.159 E031.18.12.920 N052.01.47.999 E031.17.16.321
N052.01.47.999 E031.17.16.321 N052.01.47.999 E031.14.55.960
N052.01.47.999 E031.14.55.960 N052.02.24.608 E031.09.59.389
N052.02.24.608 E031.09.59.389 N052.02.56.558 E031.08.15.248
N052.02.56.558 E031.08.15.248 N052.03.00.730 E031.06.01.670
N052.03.00.730 E031.06.01.670 N052.03.41.119 E031.02.53.768
N052.03.41.119 E031.02.53.768 N052.03.52.120 E030.59.09.639
N052.03.52.120 E030.59.09.639 N052.03.17.119 E030.57.56.761
N052.03.17.119 E030.57.56.761 N051.57.04.831 E030.50.26.368
N051.57.04.831 E030.50.26.368 N051.53.16.418 E030.46.34.370
N051.53.16.418 E030.46.34.370 N051.49.35.230 E030.41.06.809
N051.49.35.230 E030.41.06.809 N051.48.12.430 E030.39.44.640
N051.48.12.430 E030.39.44.640 N051.47.05.910 E030.39.29.408
N051.47.05.910 E030.39.29.408 N051.45.41.821 E030.38.53.181
N051.45.41.821 E030.38.53.181 N051.44.30.130 E030.37.30.878
N051.44.30.130 E030.37.30.878 N051.43.06.571 E030.37.44.378
N051.43.06.571 E030.37.44.378 N051.42.03.769 E030.37.23.160
N051.42.03.769 E030.37.23.160 N051.41.47.500 E030.36.40.910
N051.41.47.500 E030.36.40.910 N051.41.32.110 E030.35.12.400
N051.41.32.110 E030.35.12.400 N051.41.03.231 E030.34.31.148
N051.41.03.231 E030.34.31.148 N051.40.00.850 E030.33.57.470
N051.40.00.850 E030.33.57.470 N051.38.53.289 E030.32.48.920
N051.38.53.289 E030.32.48.920 N051.37.15.848 E030.33.20.559
N051.37.15.848 E030.33.20.559 N051.35.58.171 E030.32.20.248
N051.35.58.171 E030.32.20.248 N051.34.35.159 E030.31.59.970
N051.34.35.159 E030.31.59.970 N051.33.27.119 E030.32.22.970
N051.33.27.119 E030.32.22.970 N051.29.02.601 E030.34.45.919
N051.29.02.601 E030.34.45.919 N051.26.51.360 E030.36.12.218
N051.26.51.360 E030.36.12.218 N051.24.47.559 E030.37.52.730
N051.24.47.559 E030.37.52.730 N051.22.32.811 E030.38.29.320
N051.22.32.811 E030.38.29.320 N051.21.13.880 E030.38.05.668
N051.21.13.880 E030.38.05.668 N051.19.27.890 E030.37.03.788
N051.19.27.890 E030.37.03.788 N051.19.06.999 E030.36.24.200
N051.19.06.999 E030.36.24.200 N051.18.03.319 E030.35.18.589
N051.18.03.319 E030.35.18.589 N051.16.41.519 E030.34.57.471
N051.16.41.519 E030.34.57.471 N051.15.21.110 E030.33.57.481
N051.15.21.110 E030.33.57.481 N051.15.38.689 E030.30.49.460
N051.15.38.689 E030.30.49.460 N051.16.34.330 E030.27.41.439
N051.16.34.330 E030.27.41.439 N051.18.27.111 E030.24.40.460
N051.18.27.111 E030.24.40.460 N051.19.50.509 E030.22.53.810
N051.19.50.509 E030.22.53.810 N051.21.06.868 E030.21.48.960
N051.21.06.868 E030.21.48.960 N051.25.55.671 E030.18.19.648
N051.25.55.671 E030.18.19.648 N051.26.54.830 E030.16.24.358
N051.26.54.830 E030.16.24.358 N051.28.12.860 E030.10.56.161
N051.28.12.860 E030.10.56.161 N051.28.32.430 E030.06.38.339
N051.28.32.430 E030.06.38.339 N051.28.26.920 E030.01.14.991
N051.28.26.920 E030.01.14.991 N051.27.56.739 E029.57.52.869
N051.27.56.739 E029.57.52.869 N051.27.09.878 E029.54.47.188
N051.27.09.878 E029.54.47.188 N051.27.08.729 E029.51.27.120
N051.27.08.729 E029.51.27.120 N051.27.53.809 E029.47.20.641
N051.27.53.809 E029.47.20.641 N051.28.56.780 E029.44.50.218
N051.28.56.780 E029.44.50.218 N051.29.43.141 E029.41.08.271
N051.29.43.141 E029.41.08.271 N051.29.31.919 E029.38.29.468
N051.29.31.919 E029.38.29.468 N051.28.17.569 E029.36.01.198
N051.28.17.569 E029.36.01.198 N051.25.28.851 E029.32.05.380
N051.25.28.851 E029.32.05.380 N051.23.30.901 E029.32.04.200
N051.23.30.901 E029.32.04.200 N051.22.38.308 E029.30.13.258
N051.22.38.308 E029.30.13.258 N051.22.42.420 E029.23.02.511
N051.22.42.420 E029.23.02.511 N051.23.33.079 E029.20.09.848
N051.23.33.079 E029.20.09.848 N051.24.32.920 E029.18.55.360
N051.24.32.920 E029.18.55.360 N051.35.29.960 E029.14.04.560
N051.35.29.960 E029.14.04.560 N051.37.00.109 E029.10.12.939
N051.37.00.109 E029.10.12.939 N051.37.16.039 E029.08.12.519
N051.37.16.039 E029.08.12.519 N051.36.55.119 E029.06.16.419
N051.36.55.119 E029.06.16.419 N051.34.19.318 E029.03.20.300
N051.34.19.318 E029.03.20.300 N051.33.33.411 E029.00.36.550
N051.33.33.411 E029.00.36.550 N051.33.07.039 E028.54.54.871
N051.33.07.039 E028.54.54.871 N051.32.42.410 E028.52.41.210
N051.32.42.410 E028.52.41.210 N051.31.44.259 E028.49.56.578
N051.31.44.259 E028.49.56.578 N051.30.05.248 E028.48.36.129
N051.30.05.248 E028.48.36.129 N051.27.56.869 E028.48.30.128
N051.27.56.869 E028.48.30.128 N051.25.57.730 E028.48.11.379
N051.25.57.730 E028.48.11.379 N051.25.02.880 E028.47.09.499
N051.25.02.880 E028.47.09.499 N051.25.00.079 E028.44.43.389
N051.25.00.079 E028.44.43.389 N051.25.37.419 E028.41.49.599
N051.25.37.419 E028.41.49.599 N051.26.22.228 E028.40.16.939
N051.26.22.228 E028.40.16.939 N051.27.52.898 E028.39.44.039
N051.27.52.898 E028.39.44.039 N051.31.11.000 E028.40.42.031
N051.31.11.000 E028.40.42.031 N051.32.15.190 E028.40.08.720
N051.32.15.190 E028.40.08.720 N051.32.37.888 E028.38.13.210
N051.32.37.888 E028.38.13.210 N051.32.42.080 E028.34.13.951
N051.32.42.080 E028.34.13.951 N051.32.25.439 E028.30.18.270
N051.32.25.439 E028.30.18.270 N051.32.11.389 E028.28.08.461
N051.32.11.389 E028.28.08.461 N051.32.25.990 E028.25.02.071
N051.32.25.990 E028.25.02.071 N051.32.54.110 E028.22.57.190
N051.32.54.110 E028.22.57.190 N051.33.59.378 E028.21.13.500
N051.33.59.378 E028.21.13.500 N051.35.08.901 E028.19.18.400
N051.35.08.901 E028.19.18.400 N051.35.49.581 E028.17.34.861
N051.35.49.581 E028.17.34.861 N051.36.47.858 E028.16.44.079
N051.36.47.858 E028.16.44.079 N051.38.25.000 E028.17.19.240
N051.38.25.000 E028.17.19.240 N051.39.12.358 E028.16.36.260
N051.39.12.358 E028.16.36.260 N051.39.15.000 E028.14.43.760
N051.39.15.000 E028.14.43.760 N051.38.46.679 E028.13.22.400
N051.38.46.679 E028.13.22.400 N051.37.35.828 E028.12.23.281
N051.37.35.828 E028.12.23.281 N051.35.54.560 E028.10.16.910
N051.35.54.560 E028.10.16.910 N051.34.59.790 E028.06.50.209
N051.34.59.790 E028.06.50.209 N051.33.36.860 E028.02.25.040
N051.33.36.860 E028.02.25.040 N051.33.17.071 E027.58.26.731
N051.33.17.071 E027.58.26.731 N051.34.05.210 E027.56.49.840
N051.34.05.210 E027.56.49.840 N051.35.53.840 E027.55.21.000
N051.35.53.840 E027.55.21.000 N051.36.10.429 E027.53.28.230
N051.36.10.429 E027.53.28.230 N051.35.47.760 E027.52.05.278
N051.35.47.760 E027.52.05.278 N051.34.47.830 E027.50.46.759
N051.34.47.830 E027.50.46.759 N051.31.39.421 E027.49.56.549
N051.31.39.421 E027.49.56.549 N051.30.13.831 E027.49.21.190
N051.30.13.831 E027.49.21.190 N051.28.34.489 E027.48.01.749
N051.28.34.489 E027.48.01.749 N051.27.59.428 E027.46.22.738
N051.27.59.428 E027.46.22.738 N051.28.04.508 E027.45.36.539
N051.28.04.508 E027.45.36.539 N051.28.09.739 E027.44.41.668



N051.28.09.739 E027.44.41.668 N051.28.59.239 E027.43.06.790
N051.28.59.239 E027.43.06.790 N051.30.29.998 E027.42.35.848
N051.30.29.998 E027.42.35.848 N051.33.37.699 E027.43.31.540
N051.33.37.699 E027.43.31.540 N051.34.29.269 E027.42.54.410
N051.34.29.269 E027.42.54.410 N051.35.14.640 E027.40.50.649
N051.35.14.640 E027.40.50.649 N051.36.53.650 E027.34.22.879
N051.36.53.650 E027.34.22.879 N051.36.57.780 E027.32.17.919
N051.36.57.780 E027.32.17.919 N051.36.12.398 E027.30.58.669
N051.36.12.398 E027.30.58.669 N051.35.14.640 E027.30.11.228
N051.35.14.640 E027.30.11.228 N051.35.14.640 E027.20.11.000
N051.35.14.640 E027.20.11.000 N051.34.33.391 E027.16.28.239
N051.34.33.391 E027.16.28.239 N051.35.06.399 E027.14.40.981
N051.35.06.399 E027.14.40.981 N051.35.35.271 E027.14.01.791
N051.35.35.271 E027.14.01.791 N051.36.10.339 E027.14.34.789
N051.36.10.339 E027.14.34.789 N051.37.06.119 E027.14.47.169
N051.37.06.119 E027.14.47.169 N051.37.47.280 E027.13.34.978
N051.37.47.280 E027.13.34.978 N051.38.12.999 E027.12.04.219
N051.38.12.999 E027.12.04.219 N051.39.34.538 E027.10.19.999
N051.39.34.538 E027.10.19.999 N051.41.34.169 E027.09.25.390
N051.41.34.169 E027.09.25.390 N051.43.09.880 E027.10.04.580
N051.43.09.880 E027.10.04.580 N051.44.19.179 E027.09.46.880
N051.44.19.179 E027.09.46.880 N051.45.31.381 E027.08.02.889
N051.45.31.381 E027.08.02.889 N051.45.58.190 E027.05.38.500
N051.45.58.190 E027.05.38.500 N051.45.04.561 E026.59.41.668
N051.45.04.561 E026.59.41.668 N051.44.50.121 E026.54.07.520
N051.44.50.121 E026.54.07.520 N051.45.19.999 E026.51.10.130
N051.45.19.999 E026.51.10.130 N051.47.26.890 E026.43.09.530
N051.47.26.890 E026.43.09.530 N051.48.18.449 E026.37.10.628
N051.48.18.449 E026.37.10.628 N051.48.08.139 E026.30.16.160
N051.48.08.139 E026.30.16.160 N051.48.53.110 E026.28.14.588
N051.48.53.110 E026.28.14.588 N051.49.34.769 E026.25.37.581
N051.49.34.769 E026.25.37.581 N051.50.28.399 E026.20.01.370
N051.50.28.399 E026.20.01.370 N051.50.46.960 E026.15.37.349
N051.50.46.960 E026.15.37.349 N051.51.32.338 E026.09.59.960
N051.51.32.338 E026.09.59.960 N051.52.23.908 E026.08.26.250
N051.52.23.908 E026.08.26.250 N051.54.09.100 E026.06.22.499
N051.54.09.100 E026.06.22.499 N051.54.25.599 E026.04.29.960
N051.54.25.599 E026.04.29.960 N051.54.23.540 E026.02.50.960
N051.54.23.540 E026.02.50.960 N051.53.38.158 E025.58.13.648
N051.53.38.158 E025.58.13.648 N051.54.24.541 E025.51.56.908
N051.54.24.541 E025.51.56.908 N051.55.17.169 E025.46.32.350
N051.55.17.169 E025.46.32.350 N051.54.56.541 E025.43.43.208
N051.54.56.541 E025.43.43.208 N051.54.13.229 E025.41.22.948
N051.54.13.229 E025.41.22.948 N051.53.29.911 E025.38.21.440
N051.53.29.911 E025.38.21.440 N051.54.13.229 E025.33.55.360
N051.54.13.229 E025.33.55.360 N051.54.31.791 E025.27.27.579
N051.54.31.791 E025.27.27.579 N051.54.50.349 E025.24.42.570
N051.54.50.349 E025.24.42.570 N051.55.31.609 E025.22.20.240
N051.55.31.609 E025.22.20.240 N051.57.27.118 E025.18.56.120
N051.57.27.118 E025.18.56.120 N051.57.43.740 E025.16.48.118
N051.57.43.740 E025.16.48.118 N051.57.45.680 E025.12.48.891
N051.57.45.680 E025.12.48.891 N051.57.12.679 E025.07.33.301
N051.57.12.679 E025.07.33.301 N051.56.31.419 E025.06.06.670
N051.56.31.419 E025.06.06.670 N051.54.17.348 E025.03.01.039
N051.54.17.348 E025.03.01.039 N051.53.35.811 E024.59.10.291
N051.53.35.811 E024.59.10.291 N051.53.38.158 E024.56.04.380
N051.53.38.158 E024.56.04.380 N051.55.10.981 E024.43.43.888
N051.55.10.981 E024.43.43.888 N051.55.27.480 E024.36.57.549
N051.55.27.480 E024.36.57.549 N051.54.23.540 E024.30.35.960
N051.54.23.540 E024.30.35.960 N051.53.09.279 E024.26.57.321
N051.53.09.279 E024.26.57.321 N051.52.19.779 E024.25.28.621
N051.52.19.779 E024.25.28.621 N051.47.26.890 E024.22.47.740
N051.47.26.890 E024.22.47.740 N051.45.45.810 E024.22.06.481
N051.45.45.810 E024.22.06.481 N051.43.00.800 E024.19.46.228
N051.43.00.800 E024.19.46.228 N051.41.17.671 E024.17.28.839
N051.41.17.671 E024.17.28.839 N051.39.38.660 E024.14.16.198
N051.39.38.660 E024.14.16.198 N051.37.20.470 E024.09.00.619
N051.37.20.470 E024.09.00.619 N051.33.48.599 E024.03.16.149
N051.33.48.599 E024.03.16.149 N051.33.37.699 E024.00.24.958
N051.33.37.699 E024.00.24.958 N051.33.52.138 E023.55.46.498
N051.33.52.138 E023.55.46.498 N051.34.16.888 E023.53.15.928
N051.34.16.888 E023.53.15.928 N051.35.00.211 E023.51.16.289
N051.35.00.211 E023.51.16.289 N051.37.41.160 E023.47.43.839
N051.37.41.160 E023.47.43.839 N051.38.36.779 E023.45.25.639
N051.38.36.779 E023.45.25.639 N051.38.49.160 E023.43.42.509
N051.38.49.160 E023.43.42.509 N051.38.30.598 E023.41.36.690
N051.38.30.598 E023.41.36.690 N051.37.59.660 E023.40.22.429
N051.37.59.660 E023.40.22.429 N051.37.08.090 E023.39.28.800
N051.37.08.090 E023.39.28.800 N051.36.10.339 E023.39.12.301
N051.36.10.339 E023.39.12.301 N051.31.50.440 E023.40.47.179
N051.31.50.440 E023.40.47.179 N051.30.38.249 E023.40.20.370
N051.30.38.249 E023.40.20.370 N051.27.54.770 E023.40.28.487 
;granica FIR poczatek
;R
N051.27.54.770 E023.40.28.487 N051.32.05.066 E023.34.22.024
N051.32.05.066 E023.34.22.024 N051.33.42.226 E023.34.46.317
N051.33.42.226 E023.34.46.317 N051.37.09.208 E023.32.36.418
N051.37.09.208 E023.32.36.418 N051.39.29.669 E023.32.42.756
N051.39.29.669 E023.32.42.756 N051.39.47.631 E023.33.28.163
N051.39.47.631 E023.33.28.163 N051.42.57.708 E023.33.29.228
N051.42.57.708 E023.33.29.228 N051.43.30.448 E023.32.27.972
N051.43.30.448 E023.32.27.972 N051.44.46.487 E023.32.31.138
N051.44.46.487 E023.32.31.138 N051.47.52.362 E023.38.44.989
N051.47.52.362 E023.38.44.989 N051.51.04.568 E023.36.42.484
N051.51.04.568 E023.36.42.484 N051.51.46.810 E023.37.18.396
N051.51.46.810 E023.37.18.396 N051.53.03.907 E023.36.49.879
N051.53.03.907 E023.36.49.879 N051.53.34.531 E023.38.14.364
N051.53.34.531 E023.38.14.364 N051.54.49.513 E023.37.03.605
N051.54.49.513 E023.37.03.605 N051.55.41.258 E023.37.24.727
N051.55.41.258 E023.37.24.727 N052.00.00.000 E023.41.37.131
N052.00.00.000 E023.41.37.131 N052.01.26.600 E023.39.37.792
N052.01.26.600 E023.39.37.792 N052.05.07.315 E023.38.53.441
N052.05.07.315 E023.38.53.441 N052.06.51.864 E023.36.25.586
N052.06.51.864 E023.36.25.586 N052.06.52.921 E023.33.04.934
N052.06.52.921 E023.33.04.934 N052.09.09.152 E023.29.55.894
N052.09.09.152 E023.29.55.894 N052.10.37.866 E023.30.05.397
N052.10.37.866 E023.30.05.397 N052.10.32.593 E023.26.07.783
N052.10.32.593 E023.26.07.783 N052.11.17.000 E023.24.16.000
;E
N052.11.17.000 E023.24.16.000 N052.12.23.472 E023.22.18.615
N052.12.23.472 E023.22.18.615 N052.13.59.575 E023.12.06.093
N052.13.59.575 E023.12.06.093 N052.14.48.162 E023.11.51.303
N052.14.48.162 E023.11.51.303 N052.15.29.347 E023.12.36.718
N052.15.29.347 E023.12.36.718 N052.16.36.927 E023.12.06.093
N052.16.36.927 E023.12.06.093 N052.17.06.508 E023.10.18.372
N052.17.06.508 E023.10.18.372 N052.21.47.414 E023.14.29.719
N052.21.47.414 E023.14.29.719 N052.27.50.705 E023.18.28.390
N052.27.50.705 E023.18.28.390 N052.33.23.371 E023.25.09.700
N052.33.23.371 E023.25.09.700 N052.36.39.806 E023.33.58.795
N052.36.39.806 E023.33.58.795 N052.40.01.515 E023.54.54.470
N052.40.01.515 E023.54.54.470 N052.56.26.838 E023.56.20.013
N052.56.26.838 E023.56.20.013 N052.57.34.417 E023.57.04.370
N052.57.34.417 E023.57.04.370 N052.58.14.559 E023.56.34.796
N052.58.14.559 E023.56.34.796 N053.00.00.165 E023.56.49.579
N053.00.00.165 E023.56.49.579 N053.04.08.332 E023.53.25.756
N053.04.08.332 E023.53.25.756 N053.09.07.202 E023.55.16.642
N053.09.07.202 E023.55.16.642 N053.11.48.783 E023.52.05.494
N053.11.48.783 E023.52.05.494 N053.13.43.906 E023.52.15.004
N053.13.43.906 E023.52.15.004 N053.18.04.749 E023.46.38.108
N053.18.04.749 E023.46.38.108 N053.22.52.000 E023.44.23.000
;S
N053.22.52.000 E023.44.23.000 N053.35.23.932 E023.38.10.141
N053.35.23.932 E023.38.10.141 N053.36.03.002 E023.37.01.497
N053.36.03.002 E023.37.01.497 N053.40.13.298 E023.36.11.860
N053.40.13.298 E023.36.11.860 N053.44.15.135 E023.36.29.809
N053.44.15.135 E023.36.29.809 N053.46.54.601 E023.33.39.781
N053.46.54.601 E023.33.39.781 N053.50.41.661 E023.33.36.616
N053.50.41.661 E023.33.36.616 N054.00.00.330 E023.28.52.530
;granica FIR koniec

;;;;;;;UMKK
;umkk/esaa pocz
UMKK N055.51.00.195 E017.33.00.398 N056.05.41.999 E018.01.05.998
;umkk/esaa koniec
N056.05.41.999 E018.01.05.998 N055.22.23.998 E020.38.35.998
N055.22.23.998 E020.38.35.998 N055.16.54.199 E020.57.24.199
N055.16.54.199 E020.57.24.199 N055.14.44.519 E021.16.35.360
N055.14.44.519 E021.16.35.360 N055.17.05.190 E021.21.15.379
N055.17.05.190 E021.21.15.379 N055.17.26.451 E021.23.19.100
N055.17.26.451 E021.23.19.100 N055.15.10.119 E021.26.03.039
N055.15.10.119 E021.26.03.039 N055.13.51.639 E021.26.44.879
N055.13.51.639 E021.26.44.879 N055.12.35.470 E021.28.58.999
N055.12.35.470 E021.28.58.999 N055.11.40.160 E021.30.07.491
N055.11.40.160 E021.30.07.491 N055.11.21.260 E021.31.17.770
N055.11.21.260 E021.31.17.770 N055.11.55.388 E021.34.31.350
N055.11.55.388 E021.34.31.350 N055.11.16.400 E021.37.38.499
N055.11.16.400 E021.37.38.499 N055.07.40.598 E021.44.55.129
N055.07.40.598 E021.44.55.129 N055.07.12.039 E021.49.17.641
N055.07.12.039 E021.49.17.641 N055.05.55.230 E021.50.59.971
N055.05.55.230 E021.50.59.971 N055.04.32.318 E021.57.07.430
N055.04.32.318 E021.57.07.430 N055.05.07.879 E022.02.04.340
N055.05.07.879 E022.02.04.340 N055.03.42.000 E022.02.13.559
N055.03.42.000 E022.02.13.559 N055.01.34.280 E022.04.15.758
N055.01.34.280 E022.04.15.758 N055.02.13.808 E022.07.52.730
N055.02.13.808 E022.07.52.730 N055.03.01.828 E022.08.30.159
N055.03.01.828 E022.08.30.159 N055.03.48.830 E022.13.56.359
N055.03.48.830 E022.13.56.359 N055.03.23.979 E022.25.10.160
N055.03.23.979 E022.25.10.160 N055.02.52.360 E022.28.08.648
N055.02.52.360 E022.28.08.648 N055.04.18.530 E022.34.51.229
N055.04.18.530 E022.34.51.229 N054.56.58.261 E022.41.55.928
N054.56.58.261 E022.41.55.928 N054.55.17.191 E022.46.52.950
N054.55.17.191 E022.46.52.950 N054.52.58.231 E022.50.28.629
N054.52.58.231 E022.50.28.629 N054.51.34.430 E022.51.33.469
N054.51.34.430 E022.51.33.469 N054.47.20.720 E022.50.15.999
N054.47.20.720 E022.50.15.999 N054.41.42.449 E022.42.55.749
N054.41.42.449 E022.42.55.749 N054.30.21.780 E022.40.41.671
N054.30.21.780 E022.40.41.671 N054.23.56.159 E022.45.18.840
N054.23.56.159 E022.45.18.840 N054.22.02.534 E022.47.14.912
granica FIR poczatek
;S
N054.22.02.534 E022.47.14.912 N054.21.29.795 E022.43.04.623
N054.21.29.795 E022.43.04.623 N054.20.02.138 E022.00.00.405
N054.20.02.138 E022.00.00.405 N054.19.50.520 E021.53.00.089
N054.19.50.520 E021.53.00.089 N054.19.53.692 E021.33.56.357
N054.19.53.692 E021.33.56.357 N054.19.12.507 E021.27.26.665
N054.19.12.507 E021.27.26.665 N054.21.12.890 E021.00.00.240
N054.21.12.890 E021.00.00.240 N054.22.04.635 E020.38.20.214
N054.22.04.635 E020.38.20.214 N054.22.54.000 E020.30.00.000
N054.22.54.000 E020.30.00.000 N054.24.27.210 E020.15.35.760
N054.24.27.210 E020.15.35.760 N054.24.30.383 E020.11.12.803
N054.24.30.383 E020.11.12.803 N054.25.11.568 E020.05.30.634
N054.25.11.568 E020.05.30.634 N054.25.17.899 E020.00.00.000

;G
N054.25.17.899 E020.00.00.000 N054.25.34.804 E019.58.27.145
N054.25.34.804 E019.58.27.145 N054.25.52.753 E019.54.30.589
N054.25.52.753 E019.54.30.589 N054.26.09.644 E019.52.46.033
N054.26.09.644 E019.52.46.033 N054.26.11.759 E019.51.27.879
N054.26.11.759 E019.51.27.879 N054.26.27.607 E019.49.06.368
N054.26.27.607 E019.49.06.368 N054.26.31.837 E019.48.14.623
N054.26.31.837 E019.48.14.623 N054.27.29.998 E019.38.30.200
N054.27.29.998 E019.38.30.200 N054.36.11.998 E019.24.24.199
N054.36.11.998 E019.24.24.199 N055.17.24.000 E018.23.03.000
;granica FIR koneic

;LOA3
N055.17.24.000 E018.23.03.000 N055.51.00.195 E017.33.00.398
 

;;;;;;;;;;;;EYVL

;poczatek granicy z UMKK
;umkk/esaa pocz
EYVL N056.20.43.000 E018.30.23.999 N056.05.41.999 E018.01.05.998
;umkk/essa koni

N056.05.41.999 E018.01.05.998 N055.22.23.998 E020.38.35.998
N055.22.23.998 E020.38.35.998 N055.16.54.199 E020.57.24.199
N055.16.54.199 E020.57.24.199 N055.14.44.519 E021.16.35.360
N055.14.44.519 E021.16.35.360 N055.17.05.190 E021.21.15.379
N055.17.05.190 E021.21.15.379 N055.17.26.451 E021.23.19.100
N055.17.26.451 E021.23.19.100 N055.15.10.119 E021.26.03.039
N055.15.10.119 E021.26.03.039 N055.13.51.639 E021.26.44.879
N055.13.51.639 E021.26.44.879 N055.12.35.470 E021.28.58.999
N055.12.35.470 E021.28.58.999 N055.11.40.160 E021.30.07.491
N055.11.40.160 E021.30.07.491 N055.11.21.260 E021.31.17.770
N055.11.21.260 E021.31.17.770 N055.11.55.388 E021.34.31.350
N055.11.55.388 E021.34.31.350 N055.11.16.400 E021.37.38.499
N055.11.16.400 E021.37.38.499 N055.07.40.598 E021.44.55.129
N055.07.40.598 E021.44.55.129 N055.07.12.039 E021.49.17.641
N055.07.12.039 E021.49.17.641 N055.05.55.230 E021.50.59.971
N055.05.55.230 E021.50.59.971 N055.04.32.318 E021.57.07.430
N055.04.32.318 E021.57.07.430 N055.05.07.879 E022.02.04.340
N055.05.07.879 E022.02.04.340 N055.03.42.000 E022.02.13.559
N055.03.42.000 E022.02.13.559 N055.01.34.280 E022.04.15.758
N055.01.34.280 E022.04.15.758 N055.02.13.808 E022.07.52.730
N055.02.13.808 E022.07.52.730 N055.03.01.828 E022.08.30.159
N055.03.01.828 E022.08.30.159 N055.03.48.830 E022.13.56.359
N055.03.48.830 E022.13.56.359 N055.03.23.979 E022.25.10.160
N055.03.23.979 E022.25.10.160 N055.02.52.360 E022.28.08.648
N055.02.52.360 E022.28.08.648 N055.04.18.530 E022.34.51.229
N055.04.18.530 E022.34.51.229 N054.56.58.261 E022.41.55.928
N054.56.58.261 E022.41.55.928 N054.55.17.191 E022.46.52.950
N054.55.17.191 E022.46.52.950 N054.52.58.231 E022.50.28.629
N054.52.58.231 E022.50.28.629 N054.51.34.430 E022.51.33.469
N054.51.34.430 E022.51.33.469 N054.47.20.720 E022.50.15.999
N054.47.20.720 E022.50.15.999 N054.41.42.449 E022.42.55.749
N054.41.42.449 E022.42.55.749 N054.30.21.780 E022.40.41.671
N054.30.21.780 E022.40.41.671 N054.23.56.159 E022.45.18.840
N054.23.56.159 E022.45.18.840 N054.22.02.534 E022.47.14.912
;koniec granicy z UMKK


N056.20.43.000 E018.30.23.999 N056.17.52.000 E018.53.56.000
N056.17.52.000 E018.53.56.000 N056.08.45.999 E020.04.55.999
N056.08.45.999 E020.04.55.999 N056.04.00.200 E020.40.00.200
N056.04.00.200 E020.40.00.200 N056.04.01.999 E020.44.52.000
N056.04.01.999 E020.44.52.000 N056.04.09.200 E021.03.51.998
N056.04.09.200 E021.03.51.998 N056.04.26.000 E021.05.36.999
N056.04.26.000 E021.05.36.999 N056.10.46.999 E021.16.45.200
N056.10.46.999 E021.16.45.200 N056.12.21.999 E021.18.43.999
N056.12.21.999 E021.18.43.999 N056.17.39.200 E021.32.07.000
N056.17.39.200 E021.32.07.000 N056.25.35.489 E022.08.31.509
N056.25.35.489 E022.08.31.509 N056.24.13.600 E022.19.19.120
N056.24.13.600 E022.19.19.120 N056.23.59.819 E022.33.49.089
N056.23.59.819 E022.33.49.089 N056.21.28.609 E022.41.03.919
N056.21.28.609 E022.41.03.919 N056.25.07.251 E022.56.14.139
N056.25.07.251 E022.56.14.139 N056.18.21.999 E023.05.31.999
N056.18.21.999 E023.05.31.999 N056.20.47.788 E023.10.36.960
N056.20.47.788 E023.10.36.960 N056.22.15.999 E023.12.21.999
N056.22.15.999 E023.12.21.999 N056.22.19.999 E023.15.37.999
N056.22.19.999 E023.15.37.999 N056.18.48.999 E023.30.26.319
N056.18.48.999 E023.30.26.319 N056.22.17.000 E023.45.20.599
N056.22.17.000 E023.45.20.599 N056.16.42.999 E024.03.55.999
N056.16.42.999 E024.03.55.999 N056.15.44.211 E024.28.07.140
N056.15.44.211 E024.28.07.140 N056.22.08.000 E024.37.49.000
N056.22.08.000 E024.37.49.000 N056.26.45.589 E024.53.15.889
N056.26.45.589 E024.53.15.889 N056.10.24.330 E025.08.18.999
N056.10.24.330 E025.08.18.999 N055.59.08.600 E025.56.51.570
N055.59.08.600 E025.56.51.570 N055.40.50.600 E026.37.50.599


;poczatek granicy z UMMV
N055.40.50.600 E026.37.50.599 N055.36.24.119 E026.38.49.639
N055.36.24.119 E026.38.49.639 N055.26.58.959 E026.33.17.549
N055.26.58.959 E026.33.17.549 N055.22.34.939 E026.30.26.348
N055.22.34.939 E026.30.26.348 N055.21.26.870 E026.27.47.530
N055.21.26.870 E026.27.47.530 N055.19.06.610 E026.27.31.120
N055.19.06.610 E026.27.31.120 N055.17.58.538 E026.31.50.919
N055.17.58.538 E026.31.50.919 N055.18.06.789 E026.48.35.431
N055.18.06.789 E026.48.35.431 N055.17.46.168 E026.51.06.199
N055.17.46.168 E026.51.06.199 N055.15.52.718 E026.51.22.499
N055.15.52.718 E026.51.22.499 N055.12.01.699 E026.43.15.718
N055.12.01.699 E026.43.15.718 N055.08.33.381 E026.40.08.840
N055.08.33.381 E026.40.08.840 N055.07.25.309 E026.30.32.540
N055.07.25.309 E026.30.32.540 N055.06.04.870 E026.27.04.208
N055.06.04.870 E026.27.04.208 N055.07.56.251 E026.19.57.241
N055.07.56.251 E026.19.57.241 N055.08.16.879 E026.16.20.668
N055.08.16.879 E026.16.20.668 N055.05.33.928 E026.14.06.590
N055.05.33.928 E026.14.06.590 N055.02.42.730 E026.14.29.281
N055.02.42.730 E026.14.29.281 N055.00.00.000 E026.13.00.200
N055.00.00.000 E026.13.00.200 N054.57.54.878 E026.08.37.769
N054.57.54.878 E026.08.37.769 N054.52.41.998 E025.49.00.199
N054.52.41.998 E025.49.00.199 N054.47.11.130 E025.46.14.401
N054.47.11.130 E025.46.14.401 N054.38.05.539 E025.44.24.169
N054.38.05.539 E025.44.24.169 N054.33.21.229 E025.43.43.208
N054.33.21.229 E025.43.43.208 N054.28.00.200 E025.37.00.199
N054.28.00.200 E025.37.00.199 N054.19.44.410 E025.35.05.488
N054.19.44.410 E025.35.05.488 N054.18.17.780 E025.35.42.619
N054.18.17.780 E025.35.42.619 N054.16.59.998 E025.43.00.200
N054.16.59.998 E025.43.00.200 N054.14.43.270 E025.46.44.720
N054.14.43.270 E025.46.44.720 N054.10.00.199 E025.46.59.998
N054.10.00.199 E025.46.59.998 N054.08.09.301 E025.42.55.771
N054.08.09.301 E025.42.55.771 N054.09.19.429 E025.34.18.079
N054.09.19.429 E025.34.18.079 N054.10.52.251 E025.35.07.551
N054.10.52.251 E025.35.07.551 N054.15.12.149 E025.32.34.918
N054.15.12.149 E025.32.34.918 N054.15.59.590 E025.27.23.450
N054.15.59.590 E025.27.23.450 N054.16.27.998 E025.16.06.999
N054.16.27.998 E025.16.06.999 N054.12.16.819 E025.13.52.831
N054.12.16.819 E025.13.52.831 N054.10.44.999 E025.10.32.761
N054.10.44.999 E025.10.32.761 N054.07.59.998 E025.03.00.547
N054.07.59.998 E025.03.00.547 N054.08.44.998 E025.00.00.000
N054.08.44.998 E025.00.00.000 N054.09.29.998 E024.58.19.999
N054.09.29.998 E024.58.19.999 N054.08.30.199 E024.50.09.999
N054.08.30.199 E024.50.09.999 N054.06.10.000 E024.47.39.998
N054.06.10.000 E024.47.39.998 N054.03.57.661 E024.48.24.411
N054.03.57.661 E024.48.24.411 N053.58.17.320 E024.48.12.120
N053.58.17.320 E024.48.12.120 N053.56.52.760 E024.44.47.828
N053.56.52.760 E024.44.47.828 N054.00.05.000 E024.41.35.599
N054.00.05.000 E024.41.35.599 N054.00.47.998 E024.40.03.667
N054.00.47.998 E024.40.03.667 N053.53.28.550 E024.24.41.180
N053.53.28.550 E024.24.41.180 N053.54.11.869 E024.17.21.840
N053.54.11.869 E024.17.21.840 N053.56.21.811 E024.11.45.628
N053.56.21.811 E024.11.45.628 N053.55.44.691 E023.55.38.251
N053.55.44.691 E023.55.38.251 N053.53.59.999 E023.48.00.398
N053.53.59.999 E023.48.00.398 N053.54.32.489 E023.37.06.481
N053.54.32.489 E023.37.06.481 N054.00.00.330 E023.28.52.530

;granica z FIR
;s
N054.00.00.330 E023.28.52.530 N054.00.23.552 E023.29.02.033
N054.00.23.552 E023.29.02.033 N054.01.00.521 E023.29.46.391
N054.01.00.521 E023.29.46.391 N054.01.32.203 E023.30.47.646
N054.01.32.203 E023.30.47.646 N054.07.50.270 E023.30.05.397
N054.07.50.270 E023.30.05.397 N054.13.37.726 E023.21.52.214
N054.13.37.726 E023.21.52.214 N054.18.53.487 E023.02.54.820
N054.18.53.487 E023.02.54.820 N054.20.44.380 E023.03.30.725
N054.20.44.380 E023.03.30.725 N054.22.19.426 E022.59.59.512
N054.22.19.426 E022.59.59.512 N054.25.43.250 E022.51.27.316
N054.25.43.250 E022.51.27.316 N054.24.31.440 E022.48.24.613
N054.24.31.440 E022.48.24.613 N054.22.02.534 E022.47.14.912
;granica z FIR koniec






;;ESAA EPWW LOA
EPWW N055.07.59.000 E016.15.21.150 N055.17.24.000 E018.23.03.000

;;;;;;ESAA
ESAA N054.55.00.199 E014.21.26.999 N054.55.00.199 E012.50.59.999
N054.55.00.199 E012.50.59.999 N055.20.12.199 E012.38.26.998
N055.20.12.199 E012.38.26.998 N055.25.08.479 E012.36.24.811
N055.25.08.479 E012.36.24.811 N055.29.44.728 E012.42.53.150
N055.29.44.728 E012.42.53.150 N055.32.57.109 E012.44.28.449
N055.32.57.109 E012.44.28.449 N055.36.17.629 E012.52.47.200
N055.36.17.629 E012.52.47.200 N055.38.27.999 E012.53.56.000
N055.38.27.999 E012.53.56.000 N055.49.49.709 E012.42.31.420
N055.49.49.709 E012.42.31.420 N055.52.11.589 E012.41.41.949
N055.52.11.589 E012.41.41.949 N055.53.29.999 E012.40.41.998
N055.53.29.999 E012.40.41.998 N055.55.52.568 E012.38.28.111
N055.55.52.568 E012.38.28.111 N055.58.51.999 E012.39.06.998
N055.58.51.999 E012.39.06.998 N056.01.58.000 E012.39.24.998
N056.01.58.000 E012.39.24.998 N056.03.30.999 E012.38.26.600
N056.03.30.999 E012.38.26.600 N056.09.51.199 E012.26.23.999
N056.09.51.199 E012.26.23.999 N056.12.52.999 E012.22.05.599
N056.12.52.999 E012.22.05.599 N058.30.00.000 E010.30.00.000
N058.30.00.000 E010.30.00.000 N058.45.39.999 E010.35.31.999
N058.45.39.999 E010.35.31.999 N058.53.31.999 E010.38.20.000
N058.53.31.999 E010.38.20.000 N058.58.59.998 E011.07.00.199
N058.58.59.998 E011.07.00.199 N059.01.26.101 E011.09.13.309
N059.01.26.101 E011.09.13.309 N059.04.59.998 E011.19.59.998
N059.04.59.998 E011.19.59.998 N059.01.22.339 E011.23.05.229
N059.01.22.339 E011.23.05.229 N058.53.59.999 E011.25.59.998
N058.53.59.999 E011.25.59.998 N058.52.00.199 E011.31.59.998
N058.52.00.199 E011.31.59.998 N058.56.48.069 E011.43.48.040
N058.56.48.069 E011.43.48.040 N059.13.37.549 E011.50.35.858
N059.13.37.549 E011.50.35.858 N059.37.49.389 E011.40.33.870
N059.37.49.389 E011.40.33.870 N059.41.06.910 E011.56.44.829
N059.41.06.910 E011.56.44.829 N059.44.44.199 E011.58.41.339
N059.44.44.199 E011.58.41.339 N059.47.02.461 E011.55.27.159
N059.47.02.461 E011.55.27.159 N059.50.29.979 E011.50.56.839
N059.50.29.979 E011.50.56.839 N059.53.26.599 E011.56.39.998
N059.53.26.599 E011.56.39.998 N059.54.14.461 E011.58.24.358
N059.54.14.461 E011.58.24.358 N059.53.36.380 E012.10.23.610
N059.53.36.380 E012.10.23.610 N059.58.58.450 E012.23.55.840
N059.58.58.450 E012.23.55.840 N060.08.58.480 E012.32.55.120
N060.08.58.480 E012.32.55.120 N060.16.58.490 E012.31.54.998
N060.16.58.490 E012.31.54.998 N060.23.58.520 E012.36.55.000
N060.23.58.520 E012.36.55.000 N060.27.58.528 E012.37.54.991
N060.27.58.528 E012.37.54.991 N061.00.58.590 E012.15.54.860
N061.00.58.590 E012.15.54.860 N061.02.58.610 E012.40.54.901
N061.02.58.610 E012.40.54.901 N061.11.58.639 E012.46.54.890
N061.11.58.639 E012.46.54.890 N061.21.58.658 E012.51.54.871
N061.21.58.658 E012.51.54.871 N061.33.58.679 E012.33.54.788
N061.33.58.679 E012.33.54.788 N061.33.58.679 E012.24.54.770
N061.33.58.679 E012.24.54.770 N061.42.58.690 E012.08.54.711
N061.42.58.690 E012.08.54.711 N062.15.58.770 E012.18.54.640
N062.15.58.770 E012.18.54.640 N062.36.28.810 E012.03.54.539
N062.36.28.810 E012.03.54.539 N062.44.58.840 E012.09.54.529
N062.44.58.840 E012.09.54.529 N062.53.58.858 E012.05.54.488
N062.53.58.858 E012.05.54.488 N062.59.58.880 E012.14.54.488
N062.59.58.880 E012.14.54.488 N063.15.58.910 E012.00.54.410
N063.15.58.910 E012.00.54.410 N063.27.58.949 E012.13.54.400
N063.27.58.949 E012.13.54.400 N063.34.58.958 E012.09.54.370
N063.34.58.958 E012.09.54.370 N063.58.59.119 E012.44.54.369
N063.58.59.119 E012.44.54.369 N064.04.59.080 E013.09.54.399
N064.04.59.080 E013.09.54.399 N064.00.59.101 E013.57.54.529
N064.00.59.101 E013.57.54.529 N064.10.59.131 E014.11.54.531
N064.10.59.131 E014.11.54.531 N064.27.59.169 E014.09.54.460
N064.27.59.169 E014.09.54.460 N064.35.59.168 E013.39.54.370
N064.35.59.168 E013.39.54.370 N065.17.59.308 E014.29.54.340
N065.17.59.308 E014.29.54.340 N065.44.59.380 E014.34.54.249
N065.44.59.380 E014.34.54.249 N065.48.59.400 E014.36.54.259
N065.48.59.400 E014.36.54.259 N066.07.59.440 E014.31.54.159
N066.07.59.440 E014.31.54.159 N066.08.59.460 E014.59.54.229
N066.08.59.460 E014.59.54.229 N066.16.59.498 E015.29.54.268
N066.16.59.498 E015.29.54.268 N066.28.59.530 E015.22.54.209
N066.28.59.530 E015.22.54.209 N066.35.59.560 E015.39.54.219
N066.35.59.560 E015.39.54.219 N066.52.59.609 E016.01.54.210
N066.52.59.609 E016.01.54.210 N067.01.59.649 E016.24.54.241
N067.01.59.649 E016.24.54.241 N067.11.59.679 E016.24.54.201
N067.11.59.679 E016.24.54.201 N067.25.59.700 E016.04.54.120
N067.25.59.700 E016.04.54.120 N067.30.59.720 E016.09.54.920
N067.30.59.720 E016.09.54.920 N067.31.59.728 E016.24.54.118
N067.31.59.728 E016.24.54.118 N067.54.59.799 E016.44.54.160
N067.54.59.799 E016.44.54.160 N068.06.59.849 E017.16.54.120
N068.06.59.849 E017.16.54.120 N067.56.59.848 E017.56.54.268
N067.56.59.848 E017.56.54.268 N068.12.59.900 E018.11.54.239
N068.12.59.900 E018.11.54.239 N068.31.59.948 E018.09.54.158
N068.31.59.948 E018.09.54.158 N068.33.59.968 E018.24.55.191
N068.33.59.968 E018.24.55.191 N068.30.30.661 E018.37.18.339
N068.30.30.661 E018.37.18.339 N068.31.59.980 E018.59.54.301
N068.31.59.980 E018.59.54.301 N068.21.20.998 E019.55.15.999
N068.21.20.998 E019.55.15.999 N068.29.13.621 E020.14.04.801
N068.29.13.621 E020.14.04.801 N068.32.44.131 E019.59.21.310
N068.32.44.131 E019.59.21.310 N068.47.19.658 E020.20.00.830
N068.47.19.658 E020.20.00.830 N068.58.00.040 E020.20.54.510
N068.58.00.040 E020.20.54.510 N069.03.18.799 E020.04.19.040
N069.03.18.799 E020.04.19.040 N069.03.36.178 E020.32.54.999
N069.03.36.178 E020.32.54.999 N068.57.24.811 E020.55.14.789
N068.57.24.811 E020.55.14.789 N068.53.57.368 E020.53.27.531
N068.53.57.368 E020.53.27.531 N068.32.03.199 E021.59.42.765
N068.32.03.199 E021.59.42.765 N068.22.45.390 E022.49.39.880
N068.22.45.390 E022.49.39.880 N068.14.21.591 E023.08.52.999
N068.14.21.591 E023.08.52.999 N068.07.21.748 E023.09.32.220
N068.07.21.748 E023.09.32.220 N068.08.50.661 E023.18.15.120
N068.08.50.661 E023.18.15.120 N067.56.44.588 E023.39.15.321
N067.56.44.588 E023.39.15.321 N067.52.03.039 E023.29.52.231
N067.52.03.039 E023.29.52.231 N067.28.05.728 E023.26.31.138
N067.28.05.728 E023.26.31.138 N067.25.27.670 E023.45.57.520
N067.25.27.670 E023.45.57.520 N067.17.28.561 E023.45.03.898
N067.17.28.561 E023.45.03.898 N067.10.04.960 E023.35.13.999
N067.10.04.960 E023.35.13.999 N066.48.34.891 E024.00.28.951
N066.48.34.891 E024.00.28.951 N066.26.11.410 E023.38.21.688
N066.26.11.410 E023.38.21.688 N066.11.47.080 E023.45.17.308
N066.11.47.080 E023.45.17.308 N066.09.33.688 E023.54.26.978
N066.09.33.688 E023.54.26.978 N066.05.25.999 E023.56.08.998
N066.05.25.999 E023.56.08.998 N065.31.48.907 E024.08.24.053
N065.31.48.907 E024.08.24.053 N064.40.59.998 E022.55.00.200
N064.40.59.998 E022.55.00.200 N063.37.00.199 E021.30.00.000
N063.37.00.199 E021.30.00.000 N063.28.30.087 E020.40.00.200
N063.28.30.087 E020.40.00.200 N063.10.00.199 E020.10.00.200
N063.10.00.199 E020.10.00.200 N061.40.00.199 E019.30.00.000
N061.40.00.199 E019.30.00.000 N061.00.00.000 E019.19.05.599
N061.00.00.000 E019.19.05.599 N060.18.02.998 E019.07.55.999
N060.18.02.998 E019.07.55.999 N060.11.30.200 E019.05.12.199
N060.11.30.200 E019.05.12.199 N059.33.46.000 E019.58.59.600
N059.33.46.000 E019.58.59.600 N059.15.24.200 E020.32.39.200
N059.15.24.200 E020.32.39.200 N059.00.00.000 E021.00.00.000
N059.00.00.000 E021.00.00.000 N057.34.09.998 E020.08.59.999
N057.34.09.998 E020.08.59.999 N057.00.00.000 E019.49.59.998
N057.00.00.000 E019.49.59.998 N056.20.43.000 E018.30.23.999

;eyvl/umkk/esaa
N056.20.43.000 E018.30.23.999 N056.05.41.999 E018.01.05.998
N056.05.41.999 E018.01.05.998 N055.51.00.195 E017.33.00.398
;eyvl/umkk/esaa


;LOA_1
N055.51.00.195 E017.33.00.398 N055.07.59.000 E016.15.21.150

;EPWW_ESAA_G
N055.07.59.000 E016.15.21.150 N054.57.13.000 E015.55.53.000

;epww_esaa_b
N054.57.13.000 E015.55.53.000 N054.54.58.840 E015.51.52.920




RONNE N054.55.00.199 E014.21.26.999 N054.52.23.405 E014.25.06.863
N054.52.23.405 E014.25.06.863 N054.50.36.270 E014.28.56.663
N054.50.36.270 E014.28.56.663 N054.49.14.010 E014.33.15.339
N054.49.14.010 E014.33.15.339 N054.48.18.721 E014.37.55.097
N054.48.18.721 E014.37.55.097 N054.47.52.294 E014.42.47.239
N054.47.52.294 E014.42.47.239 N054.47.54.904 E014.47.43.765
N054.47.54.904 E014.47.43.765 N054.48.27.100 E014.52.33.585
N054.48.27.100 E014.52.33.585 N054.49.27.693 E014.57.09.905
N054.49.27.693 E014.57.09.905 N054.50.54.840 E015.01.23.653
N054.50.54.840 E015.01.23.653 N054.52.45.895 E015.05.07.118
N054.52.45.895 E015.05.07.118 N054.55.00.199 E015.08.07.999
N054.55.00.199 E015.08.07.999 N054.54.58.840 E015.51.52.920
N054.54.58.840 E015.51.52.920 N054.41.06.000 E015.43.09.000
N054.41.06.000 E015.43.09.000 N054.23.06.000 E015.23.46.000
N054.23.06.000 E015.23.46.000 N054.15.45.000 E015.03.21.000
N054.15.45.000 E015.03.21.000 N054.19.59.434 E014.16.56.190
N054.19.59.434 E014.16.56.190 N054.55.00.199 E014.21.26.999

RONNE_EXCLUDE N054.45.34.000 E014.20.12.000 N054.46.00.000 E014.35.30.000
N054.46.00.000 E014.35.30.000 N054.35.00.000 E014.39.45.000
N054.35.00.000 E014.39.45.000 N054.35.00.000 E015.14.00.000
N054.35.00.000 E015.14.00.000 N054.35.09.000 E015.26.54.000
N054.35.09.000 E015.26.54.000 N054.31.54.000 E015.33.12.000
N054.31.54.000 E015.33.12.000 N054.23.06.000 E015.23.46.000
N054.23.06.000 E015.23.46.000 N054.15.45.000 E015.03.21.000
N054.15.45.000 E015.03.21.000 N054.19.59.434 E014.16.56.190
N054.19.59.434 E014.16.56.190 N054.45.34.000 E014.20.12.000


;COORD:N054.19.59.434:E014.16.56.190


;EPWW_ESAA_B
ESAA N054.54.58.840 E015.51.52.920 N054.55.00.199 E015.08.07.999
N054.55.00.199 E015.08.07.999 N054.52.45.895 E015.05.07.118
N054.52.45.895 E015.05.07.118 N054.50.54.840 E015.01.23.653
N054.50.54.840 E015.01.23.653 N054.49.27.693 E014.57.09.905
N054.49.27.693 E014.57.09.905 N054.48.27.100 E014.52.33.585
N054.48.27.100 E014.52.33.585 N054.47.54.904 E014.47.43.765
N054.47.54.904 E014.47.43.765 N054.47.52.294 E014.42.47.239
N054.47.52.294 E014.42.47.239 N054.48.18.721 E014.37.55.097
N054.48.18.721 E014.37.55.097 N054.49.14.010 E014.33.15.339
N054.49.14.010 E014.33.15.339 N054.50.36.270 E014.28.56.663
N054.50.36.270 E014.28.56.663 N054.52.23.405 E014.25.06.863
N054.52.23.405 E014.25.06.863 N054.55.00.199 E014.21.26.999






EDWW  N051.50.27.999 E011.12.29.998 N051.54.23.999 E011.07.48.806
N051.54.23.999 E011.07.48.806 N052.22.24.999 E011.04.13.000
N052.22.24.999 E011.04.13.000 N054.07.59.998 E011.15.29.998
N054.07.59.998 E011.15.29.998 N054.27.00.019 E012.00.00.000
N054.27.00.019 E012.00.00.000 N054.43.59.998 E012.31.00.199
N054.43.59.998 E012.31.00.199 N054.55.00.199 E012.50.59.999

;granica essa eddw poczatek
N054.55.00.199 E012.50.59.999 N054.55.00.199 E014.10.00.200
N054.55.00.199 E014.10.00.200 N054.55.00.199 E014.21.26.999

;;granica essa edww koniec

;granica z FIRem
;B
N054.55.00.199 E014.21.26.999 N054.07.40.999 E014.15.20.998
N054.07.40.999 E014.15.20.998 N054.07.33.999 E014.12.05.000
N054.07.33.999 E014.12.05.000 N053.59.16.999 E014.14.31.999
N053.59.16.999 E014.14.31.999 N053.57.44.999 E014.13.59.998
N053.57.44.999 E014.13.59.998 N053.55.59.998 E014.13.59.998
N053.55.59.998 E014.13.59.998 N053.55.45.998 E014.13.41.998
N053.55.45.998 E014.13.41.998 N053.55.40.000 E014.13.33.999
N053.55.40.000 E014.13.33.999 N053.55.19.999 E014.13.00.199
N053.55.19.999 E014.13.00.199 N053.48.39.999 E014.15.20.600
N053.48.39.999 E014.15.20.600 N053.41.55.732 E014.16.10.697
N053.41.55.732 E014.16.10.697 N053.41.00.814 E014.16.10.697 
N053.41.00.814 E014.16.10.697 N053.40.34.419 E014.16.42.375 
N053.40.34.419 E014.16.42.375 N053.39.33.157 E014.16.30.761 
N053.39.33.157 E014.16.30.761 N053.38.51.972 E014.17.01.389 
N053.38.51.972 E014.17.01.389 N053.37.57.068 E014.16.51.882 
N053.37.57.068 E014.16.51.882 N053.36.16.735 E014.18.46.995 
N053.36.16.735 E014.18.46.995 N053.34.48.020 E014.18.41.714 
N053.34.48.020 E014.18.41.714 N053.33.18.262 E014.18.54.390 
N053.33.18.262 E014.18.54.390 N053.32.27.560 E014.18.12.144 
N053.32.27.560 E014.18.12.144 N053.31.50.605 E014.18.08.975 
N053.31.50.605 E014.18.08.975 N053.31.29.484 E014.18.39.603 
N053.31.29.484 E014.18.39.603 N053.30.29.279 E014.18.53.329 
N053.30.29.279 E014.18.53.329 N053.29.47.036 E014.19.46.135 
N053.29.47.036 E014.19.46.135 N053.29.26.972 E014.20.48.445 
N053.29.26.972 E014.20.48.445 N053.26.54.894 E014.21.15.901 
N053.26.54.894 E014.21.15.901 N053.26.24.270 E014.21.40.191 
N053.26.24.270 E014.21.40.191 N053.26.06.321 E014.22.06.592 
N053.26.06.321 E014.22.06.592 N053.24.32.333 E014.21.49.694 
N053.24.32.333 E014.21.49.694 N053.24.06.982 E014.22.20.322 
N053.24.06.982 E014.22.20.322 N053.22.32.994 E014.23.02.564 
N053.22.32.994 E014.23.02.564 N053.22.01.312 E014.23.09.956 
N053.22.01.312 E014.23.09.956 N053.21.08.509 E014.23.06.787 
N053.21.08.509 E014.23.06.787 N053.20.49.503 E014.23.20.520 
N053.20.49.503 E014.23.20.520 N053.19.45.081 E014.24.09.097 
N053.19.45.081 E014.24.09.097 N053.18.33.258 E014.23.40.584 
N053.18.33.258 E014.23.40.584 N053.17.34.124 E014.24.29.164 
N053.17.34.124 E014.24.29.164 N053.16.29.703 E014.24.36.556 
N053.16.29.703 E014.24.36.556 N053.15.22.110 E014.26.23.219 
N053.15.22.110 E014.26.23.219 N053.13.52.352 E014.25.23.024 
N053.13.52.352 E014.25.23.024 N053.11.58.286 E014.23.52.202 
N053.11.58.286 E014.23.52.202 N053.11.22.388 E014.22.28.771 
N053.11.22.388 E014.22.28.771 N053.10.35.916 E014.21.57.089
N053.10.35.916 E014.21.57.089 N053.10.00.000 E014.21.57.089
N053.10.00.000 E014.21.57.089 N053.09.45.228 E014.21.56.035
;D
N053.09.45.228 E014.21.56.035 N053.07.51.176 E014.22.55.172
N053.07.51.176 E014.22.55.172 N053.03.26.090 E014.21.18.016
N053.03.26.090 E014.21.18.016 N053.02.07.950 E014.19.52.470
N053.02.07.950 E014.19.52.470 N053.00.00.165 E014.15.51.684
N053.00.00.165 E014.15.51.684 N052.58.55.744 E014.14.11.361
N052.58.55.744 E014.14.11.361 N052.58.30.393 E014.11.53.013
N052.58.30.393 E014.11.53.013 N052.57.04.850 E014.08.35.527
N052.57.04.850 E014.08.35.527 N052.56.51.118 E014.08.23.909
N052.56.51.118 E014.08.23.909 N052.55.46.696 E014.08.24.966
N052.55.46.696 E014.08.24.966 N052.54.19.053 E014.08.57.702
N052.54.19.053 E014.08.57.702 N052.52.03.866 E014.09.17.769
N052.52.03.866 E014.09.17.769 N052.50.29.878 E014.07.44.835
N052.50.29.878 E014.07.44.835 N052.49.23.342 E014.07.17.379
N052.49.23.342 E014.07.17.379 N052.48.40.042 E014.08.09.125
N052.48.40.042 E014.08.09.125 N052.48.53.775 E014.10.21.133
N052.48.53.775 E014.10.21.133 N052.48.24.208 E014.12.54.265
N052.48.24.208 E014.12.54.265 N052.46.50.220 E014.15.28.451
N052.46.50.220 E014.15.28.451 N052.45.34.181 E014.16.52.939
N052.45.34.181 E014.16.52.939 N052.43.54.906 E014.21.40.191
N052.43.54.906 E014.21.40.191 N052.42.18.803 E014.23.19.463
N052.42.18.803 E014.23.19.463 N052.41.22.828 E014.24.48.170
N052.41.22.828 E014.24.48.170 N052.39.46.725 E014.26.17.939
N052.39.46.725 E014.26.17.939 N052.39.35.107 E014.27.28.694
N052.39.35.107 E014.27.28.694 N052.38.56.037 E014.27.48.761
N052.38.56.037 E014.27.48.761 N052.38.34.915 E014.28.43.676
N052.38.34.915 E014.28.43.676 N052.35.29.041 E014.36.17.792
N052.35.29.041 E014.36.17.792 N052.33.49.779 E014.38.11.848
N052.33.49.779 E014.38.11.848 N052.33.01.192 E014.38.07.625
N052.33.01.192 E014.38.07.625 N052.32.25.294 E014.37.20.099
N052.32.25.294 E014.37.20.099 N052.30.34.401 E014.36.25.181
N052.30.34.401 E014.36.25.181 N052.29.55.331 E014.36.55.808
N052.29.55.331 E014.36.55.808 N052.29.24.706 E014.38.07.625
N052.29.24.706 E014.38.07.625 N052.27.58.107 E014.38.04.456
N052.27.58.107 E014.38.04.456 N052.27.20.080 E014.36.50.528
N052.27.20.080 E014.36.50.528 N052.26.54.743 E014.36.43.136
N052.26.54.743 E014.36.43.136 N052.25.54.538 E014.35.24.986
N052.25.54.538 E014.35.24.986 N052.25.23.914 E014.33.24.596
N052.25.23.914 E014.33.24.596 N052.24.48.016 E014.32.31.790
N052.24.48.016 E014.32.31.790 N052.23.42.537 E014.32.36.013
N052.23.42.537 E014.32.36.013 N052.22.53.950 E014.32.19.118
N052.22.53.950 E014.32.19.118 N052.22.20.154 E014.32.48.688
N052.22.20.154 E014.32.48.688 N052.22.00.090 E014.33.14.032
N052.22.00.090 E014.33.14.032 N052.21.52.701 E014.33.22.481
N052.21.52.701 E014.33.22.481 N052.20.39.835 E014.33.18.255
N052.20.39.835 E014.33.18.255 N052.18.33.107 E014.34.00.501
N052.18.33.107 E014.34.00.501 N052.17.39.247 E014.35.03.865
N052.17.39.247 E014.35.03.865 N052.17.04.393 E014.35.13.368
N052.17.04.393 E014.35.13.368 N052.16.51.717 E014.34.58.584
N052.16.51.717 E014.34.58.584 N052.16.21.093 E014.34.30.071
N052.16.21.093 E014.34.30.071 N052.16.01.029 E014.34.56.469
N052.16.01.029 E014.34.56.469 N052.15.30.405 E014.35.28.155
N052.15.30.405 E014.35.28.155 N052.13.56.403 E014.42.03.127
N052.13.56.403 E014.42.03.127 N052.13.07.830 E014.42.40.089
N052.13.07.830 E014.42.40.089 N052.11.39.115 E014.42.37.978
N052.11.39.115 E014.42.37.978 N052.11.06.376 E014.41.32.499
N052.11.06.376 E014.41.32.499 N052.10.22.032 E014.41.12.435
N052.10.22.032 E014.41.12.435 N052.09.42.948 E014.42.10.519
N052.09.42.948 E014.42.10.519 N052.09.00.706 E014.42.34.809
N052.09.00.706 E014.42.34.809 N052.08.14.234 E014.41.31.445
N052.08.14.234 E014.41.31.445 N052.07.07.711 E014.40.50.257
N052.07.07.711 E014.40.50.257 N052.05.42.169 E014.40.56.594
N052.05.42.169 E014.40.56.594 N052.04.48.309 E014.41.30.391
N052.04.48.309 E014.41.30.391 N052.03.57.621 E014.44.24.641
N052.03.57.621 E014.44.24.641 N052.03.26.982 E014.44.58.434
N052.03.26.982 E014.44.58.434 N052.02.24.676 E014.45.01.603
N052.02.24.676 E014.45.01.603 N052.01.54.052 E014.44.24.641
N052.01.54.052 E014.44.24.641 N052.00.44.357 E014.44.20.418
N052.00.44.357 E014.44.20.418 N052.00.00.000 E014.43.54.017
N052.00.00.000 E014.43.54.017 N051.59.20.916 E014.42.48.538
N051.59.20.916 E014.42.48.538 N051.57.50.100 E014.43.04.379
N051.57.50.100 E014.43.04.379 N051.57.21.591 E014.42.34.809
N051.57.21.591 E014.42.34.809 N051.56.16.112 E014.42.39.035
N051.56.16.112 E014.42.39.035 N051.55.14.864 E014.43.07.548
N051.55.14.864 E014.43.07.548 N051.54.09.385 E014.41.59.962
N051.54.09.385 E014.41.59.962 N051.52.26.938 E014.41.20.881
N051.52.26.938 E014.41.20.881 N051.51.59.485 E014.40.46.034
N051.51.59.485 E014.40.46.034 N051.52.11.104 E014.39.54.285
N051.52.11.104 E014.39.54.285 N051.50.00.146 E014.37.57.061
N051.50.00.146 E014.37.57.061 N051.49.48.528 E014.36.36.799
N051.49.48.528 E014.36.36.799 N051.48.38.834 E014.35.34.489
N051.48.38.834 E014.35.34.489 N051.47.43.916 E014.35.32.378
N051.47.43.916 E014.35.32.378 N051.47.00.616 E014.36.05.117
N051.47.00.616 E014.36.05.117 N051.46.04.641 E014.38.12.902
N051.46.04.641 E014.38.12.902 N051.44.54.946 E014.39.15.211
N051.44.54.946 E014.39.15.211 N051.43.29.404 E014.39.02.539
N051.43.29.404 E014.39.02.539 N051.42.00.689 E014.40.06.960
;granica FIR koniec
;granica z edmm
N051.42.00.689 E014.40.06.960 N051.30.29.998 E013.45.00.000
N051.30.29.998 E013.45.00.000 N051.30.29.998 E013.05.59.999
N051.30.29.998 E013.05.59.999 N051.37.29.999 E012.38.25.000
N051.37.29.999 E012.38.25.000 N051.52.35.000 E012.12.06.200
N051.52.35.000 E012.12.06.200 N051.54.24.199 E012.00.00.000
N051.54.24.199 E012.00.00.000 N051.50.27.999 E011.12.29.998
;gr z eddm koniec





EDMM N049.06.39.999 E010.28.45.200 N049.10.42.999 E010.35.16.000
N049.10.42.999 E010.35.16.000 N049.26.30.200 E010.58.00.199
N049.26.30.200 E010.58.00.199 N049.59.58.999 E010.39.38.998
N049.59.58.999 E010.39.38.998 N050.13.36.998 E010.17.20.999
N050.13.36.998 E010.17.20.999 N050.30.00.000 E010.31.18.200
N050.30.00.000 E010.31.18.200 N050.32.13.999 E010.33.51.199
N050.32.13.999 E010.33.51.199 N050.39.26.999 E010.42.10.000
N050.39.26.999 E010.42.10.000 N051.19.59.998 E010.29.34.999
N051.19.59.998 E010.29.34.999 N051.20.02.999 E010.23.14.999
N051.20.02.999 E010.23.14.999 N051.34.00.200 E010.41.59.999
N051.34.00.200 E010.41.59.999 N051.50.27.999 E011.12.29.998
;edww/edmm poczatek
N051.50.27.999 E011.12.29.998 N051.54.24.199 E012.00.00.000
N051.54.24.199 E012.00.00.000 N051.52.35.000 E012.12.06.200
N051.52.35.000 E012.12.06.200 N051.37.29.999 E012.38.25.000
N051.37.29.999 E012.38.25.000 N051.30.29.998 E013.05.59.999
N051.30.29.998 E013.05.59.999 N051.30.29.998 E013.45.00.000
N051.30.29.998 E013.45.00.000 N051.42.00.689 E014.40.06.960
;edww/edmm koniec

;****
; GRANICA Z FIR WARSZAWA POCZATEK
;D
N051.42.00.689 E014.40.06.960 N051.38.29.477 E014.45.14.279
N051.38.29.477 E014.45.14.279 N051.37.43.005 E014.45.13.218
N051.37.43.005 E014.45.13.218 N051.37.02.878 E014.45.43.849
N051.37.02.878 E014.45.43.849 N051.35.51.054 E014.45.23.782
N051.35.51.054 E014.45.23.782 N051.35.23.602 E014.45.31.174
N051.35.23.602 E014.45.31.174 N051.35.02.481 E014.45.50.183
N051.35.02.481 E014.45.50.183 N051.32.33.575 E014.43.18.109
N051.32.33.575 E014.43.18.109 N051.31.54.505 E014.42.54.876
N051.31.54.505 E014.42.54.876 N051.31.37.600 E014.42.59.099
N051.31.37.600 E014.42.59.099 N051.31.34.441 E014.43.10.714
N051.31.34.441 E014.43.10.714 N051.31.23.867 E014.43.52.956
N051.31.23.867 E014.43.52.956 N051.30.55.357 E014.44.04.574
N051.30.55.357 E014.44.04.574 N051.30.42.000 E014.43.50.848
;T
N051.30.42.000 E014.43.50.848 N051.30.31.078 E014.43.50.848
N051.30.31.078 E014.43.50.848 N051.30.01.497 E014.44.23.587
N051.30.01.497 E014.44.23.587 N051.29.39.318 E014.47.47.408
N051.29.39.318 E014.47.47.408 N051.28.59.191 E014.49.00.278
N051.28.59.191 E014.49.00.278 N051.26.22.896 E014.57.26.136
N051.26.22.896 E014.57.26.136 N051.24.54.182 E014.58.25.277
N051.24.54.182 E014.58.25.277 N051.24.16.169 E014.57.32.471
N051.24.16.169 E014.57.32.471 N051.23.45.545 E014.57.49.369
N051.23.45.545 E014.57.49.369 N051.23.11.748 E014.57.35.643
N051.23.11.748 E014.57.35.643 N051.22.07.327 E014.57.51.484
N051.22.07.327 E014.57.51.484 N051.21.05.021 E014.58.44.287
N051.21.05.021 E014.58.44.287 N051.20.29.109 E014.58.49.567
N051.20.29.109 E014.58.49.567 N051.19.47.924 E014.58.22.108
N051.19.47.924 E014.58.22.108 N051.19.03.567 E014.58.28.446
N051.19.03.567 E014.58.28.446 N051.17.34.852 E014.59.52.934
N051.17.34.852 E014.59.52.934 N051.16.56.840 E015.00.00.323
N051.16.56.840 E015.00.00.323 N051.15.50.304 E015.01.33.257
N051.15.50.304 E015.01.33.257 N051.14.14.201 E015.01.56.493
N051.14.14.201 E015.01.56.493 N051.08.35.204 E015.00.00.323
N051.08.35.204 E015.00.00.323 N051.07.34.999 E014.59.29.698
N051.07.34.999 E014.59.29.698 N051.06.25.304 E014.59.38.148
N051.06.25.304 E014.59.38.148 N051.03.50.067 E014.58.31.612
N051.03.50.067 E014.58.31.612 N051.03.02.538 E014.58.31.612
N051.03.02.538 E014.58.31.612 N051.02.27.684 E014.58.05.210
N051.02.27.684 E014.58.05.210 N051.01.58.117 E014.58.08.382
N051.01.58.117 E014.58.08.382 N051.00.51.581 E014.56.55.512
N051.00.51.581 E014.56.55.512 N050.59.59.835 E014.56.58.678
N050.59.59.835 E014.56.58.678 N050.59.02.802 E014.56.05.874
N050.59.02.802 E014.56.05.874 N050.58.25.847 E014.56.02.706
N050.58.25.847 E014.56.02.706 N050.58.00.496 E014.55.23.632
N050.58.00.496 E014.55.23.632 N050.56.53.960 E014.55.08.845
N050.56.53.960 E014.55.08.845 N050.56.08.559 E014.54.00.201
N050.56.08.559 E014.54.00.201 N050.55.34.763 E014.53.50.698
N050.55.34.763 E014.53.50.698 N050.54.29.284 E014.54.00.201
N050.54.29.284 E014.54.00.201 N050.51.21.308 E014.49.18.230

; GRANICA Z FIR WARSZAWA KONIEC


N050.51.21.308 E014.49.18.230 N050.49.00.200 E014.48.00.398
N050.49.00.200 E014.48.00.398 N050.49.00.200 E014.41.59.999
N050.49.00.200 E014.41.59.999 N050.49.59.998 E014.37.00.199
N050.49.59.998 E014.37.00.199 N050.55.00.199 E014.37.00.199
N050.55.00.199 E014.37.00.199 N051.00.00.000 E014.34.41.998
N051.00.00.000 E014.34.41.998 N051.02.59.999 E014.24.00.199
N051.02.59.999 E014.24.00.199 N051.02.59.999 E014.19.00.200
N051.02.59.999 E014.19.00.200 N050.58.59.998 E014.14.30.199
N050.58.59.998 E014.14.30.199 N050.55.59.998 E014.22.30.237
N050.55.59.998 E014.22.30.237 N050.52.00.199 E014.19.00.200
N050.52.00.199 E014.19.00.200 N050.47.59.999 E013.56.59.999
N050.47.59.999 E013.56.59.999 N050.46.00.199 E013.53.30.200
N050.46.00.199 E013.53.30.200 N050.44.03.199 E013.47.54.999
N050.44.03.199 E013.47.54.999 N050.43.00.200 E013.35.59.999
N050.43.00.200 E013.35.59.999 N050.36.00.195 E013.28.00.199
N050.36.00.195 E013.28.00.199 N050.37.59.998 E013.24.00.199
N050.37.59.998 E013.24.00.199 N050.31.00.199 E013.10.00.200
N050.31.00.199 E013.10.00.200 N050.28.59.998 E013.03.00.547
N050.28.59.998 E013.03.00.547 N050.27.00.019 E013.01.59.998
N050.27.00.019 E013.01.59.998 N050.25.00.199 E012.56.59.999
N050.25.00.199 E012.56.59.999 N050.27.00.019 E012.49.59.998
N050.27.00.019 E012.49.59.998 N050.23.59.999 E012.31.59.998
N050.23.59.999 E012.31.59.998 N050.17.12.998 E012.22.27.199
N050.17.12.998 E012.22.27.199 N050.12.29.998 E012.18.15.199
N050.12.29.998 E012.18.15.199 N050.19.00.200 E012.10.59.998
N050.19.00.200 E012.10.59.998 N050.19.19.999 E012.05.44.998
N050.19.19.999 E012.05.44.998 N050.18.29.998 E012.07.14.998
N050.18.29.998 E012.07.14.998 N050.12.34.999 E012.10.45.199
N050.12.34.999 E012.10.45.199 N050.10.00.199 E012.12.29.998
N050.10.00.199 E012.12.29.998 N050.06.29.998 E012.12.29.998
N050.06.29.998 E012.12.29.998 N049.58.00.200 E012.30.00.000
N049.58.00.200 E012.30.00.000 N049.55.00.199 E012.34.00.200
N049.55.00.199 E012.34.00.200 N049.46.59.998 E012.28.59.998
N049.46.59.998 E012.28.59.998 N049.41.49.999 E012.26.59.999
N049.41.49.999 E012.26.59.999 N049.40.45.199 E012.31.14.998
N049.40.45.199 E012.31.14.998 N049.31.54.199 E012.36.29.998
N049.31.54.199 E012.36.29.998 N049.25.59.998 E012.40.59.998
N049.25.59.998 E012.40.59.998 N049.20.14.999 E012.48.00.398
N049.20.14.999 E012.48.00.398 N049.19.59.998 E012.58.00.199
N049.19.59.998 E012.58.00.199 N049.07.00.199 E013.13.59.998
N049.07.00.199 E013.13.59.998 N049.07.00.199 E013.16.59.998
N049.07.00.199 E013.16.59.998 N049.02.59.999 E013.24.00.199
N049.02.59.999 E013.24.00.199 N049.00.00.000 E013.24.00.199
N049.00.00.000 E013.24.00.199 N048.58.30.087 E013.30.29.998
N048.58.30.087 E013.30.29.998 N048.58.00.200 E013.35.59.999
N048.58.00.200 E013.35.59.999 N048.52.59.998 E013.40.59.998
N048.52.59.998 E013.40.59.998 N048.52.59.998 E013.45.00.000
N048.52.59.998 E013.45.00.000 N048.46.59.998 E013.49.00.200
N048.46.59.998 E013.49.00.200 N048.37.59.998 E013.48.00.398
N048.37.59.998 E013.48.00.398 N048.31.59.998 E013.43.00.199
N048.31.59.998 E013.43.00.199 N048.34.59.998 E013.30.00.000
N048.34.59.998 E013.30.00.000 N048.32.59.999 E013.26.59.999
N048.32.59.999 E013.26.59.999 N048.22.00.199 E013.25.00.200
N048.22.00.199 E013.25.00.200 N048.17.59.999 E013.15.00.000
N048.17.59.999 E013.15.00.000 N048.16.59.998 E013.04.00.200
N048.16.59.998 E013.04.00.200 N048.13.00.200 E012.56.59.999
N048.13.00.200 E012.56.59.999 N048.13.00.200 E012.49.59.998
N048.13.00.200 E012.49.59.998 N048.06.00.095 E012.45.00.000
N048.06.00.095 E012.45.00.000 N047.57.29.998 E012.54.00.199
N047.57.29.998 E012.54.00.199 N047.52.59.998 E012.58.59.998
N047.52.59.998 E012.58.59.998 N047.45.00.000 E012.55.00.200
N047.45.00.000 E012.55.00.200 N047.43.30.087 E013.00.39.999
N047.43.30.087 E013.00.39.999 N047.38.59.999 E013.05.59.999
N047.38.59.999 E013.05.59.999 N047.28.59.998 E013.01.00.199
N047.28.59.998 E013.01.00.199 N047.28.00.200 E012.55.00.200
N047.28.00.200 E012.55.00.200 N047.32.59.999 E012.48.00.398
N047.32.59.999 E012.48.00.398 N047.37.00.199 E012.49.00.200
N047.37.00.199 E012.49.00.200 N047.40.50.600 E012.44.54.999
N047.40.50.600 E012.44.54.999 N047.37.29.999 E012.30.44.999
N047.37.29.999 E012.30.44.999 N047.40.59.998 E012.26.59.999
N047.40.59.998 E012.26.59.999 N047.40.59.998 E012.15.00.000
N047.40.59.998 E012.15.00.000 N047.42.00.039 E012.11.59.999
N047.42.00.039 E012.11.59.999 N047.37.00.199 E012.13.00.199
N047.37.00.199 E012.13.00.199 N047.35.30.200 E011.44.20.000
N047.35.30.200 E011.44.20.000 N047.27.00.019 E011.19.59.998
N047.27.00.019 E011.19.59.998 N047.23.59.999 E011.19.00.200
N047.23.59.999 E011.19.00.200 N047.22.59.998 E011.15.00.000
N047.22.59.998 E011.15.00.000 N047.25.00.199 E011.16.00.199
N047.25.00.199 E011.16.00.199 N047.25.59.998 E011.13.59.998
N047.25.59.998 E011.13.59.998 N047.25.00.199 E011.05.59.999
N047.25.00.199 E011.05.59.999 N047.25.00.199 E010.55.00.200
N047.25.00.199 E010.55.00.200 N047.28.00.200 E010.55.59.998
N047.28.00.200 E010.55.59.998 N047.28.00.200 E010.52.00.199
N047.28.00.200 E010.52.00.199 N047.31.00.199 E010.55.00.200
N047.31.00.199 E010.55.00.200 N047.31.00.199 E010.46.00.199
N047.31.00.199 E010.46.00.199 N047.33.34.999 E010.43.59.998
N047.33.34.999 E010.43.59.998 N047.34.00.200 E010.34.59.998
N047.34.00.200 E010.34.59.998 N047.31.59.998 E010.33.00.398
N047.31.59.998 E010.33.00.398 N047.31.59.998 E010.28.59.998
N047.31.59.998 E010.28.59.998 N047.34.59.998 E010.28.00.199
N047.34.59.998 E010.28.00.199 N047.34.00.200 E010.25.59.998
N047.34.00.200 E010.25.59.998 N047.25.59.998 E010.28.00.199
N047.25.59.998 E010.28.00.199 N047.19.00.200 E010.19.00.200
N047.19.00.200 E010.19.00.200 N047.16.00.199 E010.10.59.998
N047.16.00.199 E010.10.59.998 N047.22.59.998 E010.13.59.998
N047.22.59.998 E010.13.59.998 N047.22.00.199 E010.07.00.199
N047.22.00.199 E010.07.00.199 N047.25.00.199 E010.04.59.998
N047.25.00.199 E010.04.59.998 N047.25.59.998 E010.05.59.999
N047.25.59.998 E010.05.59.999 N047.31.51.999 E009.55.15.999
N047.31.51.999 E009.55.15.999 N047.32.59.999 E009.50.59.999
N047.32.59.999 E009.50.59.999 N047.36.00.195 E009.48.00.398
N047.36.00.195 E009.48.00.398 N047.34.00.200 E009.45.00.000
N047.34.00.200 E009.45.00.000 N047.32.59.999 E009.43.59.998
N047.32.59.999 E009.43.59.998 N047.31.59.998 E009.34.00.200
N047.31.59.998 E009.34.00.200 N047.35.09.999 E009.26.59.999
N047.35.09.999 E009.26.59.999 N047.37.29.999 E009.21.20.600
N047.37.29.999 E009.21.20.600 N047.38.59.999 E009.19.00.200
N047.38.59.999 E009.19.00.200 N047.40.00.199 E009.13.59.998
N047.40.00.199 E009.13.59.998 N047.46.59.998 E009.13.59.998
N047.46.59.998 E009.13.59.998 N047.47.30.199 E009.13.59.998
N047.47.30.199 E009.13.59.998 N047.47.59.999 E009.33.00.398
N047.47.59.999 E009.33.00.398 N048.31.40.999 E009.33.00.398
N048.31.40.999 E009.33.00.398 N048.37.17.000 E009.37.27.998
N048.37.17.000 E009.37.27.998 N048.48.38.599 E009.46.35.999
N048.48.38.599 E009.46.35.999 N048.56.54.999 E010.05.48.998
N048.56.54.999 E010.05.48.998 N049.06.39.999 E010.28.45.200



;EPWW D
;;;GRANICA PANSTWA

EPWW N053.10.00.000 E014.21.57.089 N53.09.45.228 E014.21.56.035
N053.09.45.228 E014.21.56.035 N53.07.51.176 E014.22.55.172
N053.07.51.176 E014.22.55.172 N53.03.26.090 E014.21.18.016
N053.03.26.090 E014.21.18.016 N53.02.07.950 E014.19.52.470
N053.02.07.950 E014.19.52.470 N53.00.00.165 E014.15.51.684
N053.00.00.165 E014.15.51.684 N52.58.55.744 E014.14.11.361
N052.58.55.744 E014.14.11.361 N52.58.30.393 E014.11.53.013
N052.58.30.393 E014.11.53.013 N52.57.04.850 E014.08.35.527
N052.57.04.850 E014.08.35.527 N52.56.51.118 E014.08.23.909
N052.56.51.118 E014.08.23.909 N52.55.46.696 E014.08.24.966
N052.55.46.696 E014.08.24.966 N52.54.19.053 E014.08.57.702
N052.54.19.053 E014.08.57.702 N52.52.03.866 E014.09.17.769
N052.52.03.866 E014.09.17.769 N52.50.29.878 E014.07.44.835
N052.50.29.878 E014.07.44.835 N52.49.23.342 E014.07.17.379
N052.49.23.342 E014.07.17.379 N52.48.40.042 E014.08.09.125
N052.48.40.042 E014.08.09.125 N52.48.53.775 E014.10.21.133
N052.48.53.775 E014.10.21.133 N52.48.24.208 E014.12.54.265
N052.48.24.208 E014.12.54.265 N52.46.50.220 E014.15.28.451
N052.46.50.220 E014.15.28.451 N52.45.34.181 E014.16.52.939
N052.45.34.181 E014.16.52.939 N52.43.54.906 E014.21.40.191
N052.43.54.906 E014.21.40.191 N52.43.43.000 E014.21.40.191
N052.43.43.000 E014.21.40.191 N52.43.54.906 E014.21.40.191
N052.43.54.906 E014.21.40.191 N52.42.18.803 E014.23.19.463
N052.42.18.803 E014.23.19.463 N52.41.22.828 E014.24.48.170
N052.41.22.828 E014.24.48.170 N52.39.46.725 E014.26.17.939
N052.39.46.725 E014.26.17.939 N52.39.35.107 E014.27.28.694
N052.39.35.107 E014.27.28.694 N52.38.56.037 E014.27.48.761
N052.38.56.037 E014.27.48.761 N52.38.34.915 E014.28.43.676
N052.38.34.915 E014.28.43.676 N52.35.29.041 E014.36.17.792
N052.35.29.041 E014.36.17.792 N52.33.49.779 E014.38.11.848
N052.33.49.779 E014.38.11.848 N52.33.01.192 E014.38.07.625
N052.33.01.192 E014.38.07.625 N52.32.25.294 E014.37.20.099
N052.32.25.294 E014.37.20.099 N52.30.34.401 E014.36.25.181
N052.30.34.401 E014.36.25.181 N52.29.55.331 E014.36.55.808
N052.29.55.331 E014.36.55.808 N52.29.24.706 E014.38.07.625
N052.29.24.706 E014.38.07.625 N52.27.58.107 E014.38.04.456
N052.27.58.107 E014.38.04.456 N52.27.20.080 E014.36.50.528
N052.27.20.080 E014.36.50.528 N52.26.54.743 E014.36.43.136
N052.26.54.743 E014.36.43.136 N52.25.54.538 E014.35.24.986
N052.25.54.538 E014.35.24.986 N52.25.23.914 E014.33.24.596
N052.25.23.914 E014.33.24.596 N52.24.48.016 E014.32.31.790
N052.24.48.016 E014.32.31.790 N52.23.42.537 E014.32.36.013
N052.23.42.537 E014.32.36.013 N52.22.53.950 E014.32.19.118
N052.22.53.950 E014.32.19.118 N52.22.20.154 E014.32.48.688
N052.22.20.154 E014.32.48.688 N52.22.00.090 E014.33.14.032
N052.22.00.090 E014.33.14.032 N52.21.52.701 E014.33.22.481
N052.21.52.701 E014.33.22.481 N52.20.39.835 E014.33.18.255
N052.20.39.835 E014.33.18.255 N52.18.33.107 E014.34.00.501
N052.18.33.107 E014.34.00.501 N52.17.39.247 E014.35.03.865
N052.17.39.247 E014.35.03.865 N52.17.04.393 E014.35.13.368
N052.17.04.393 E014.35.13.368 N52.16.51.717 E014.34.58.584
N052.16.51.717 E014.34.58.584 N52.16.21.093 E014.34.30.071
N052.16.21.093 E014.34.30.071 N52.16.01.029 E014.34.56.469
N052.16.01.029 E014.34.56.469 N52.15.30.405 E014.35.28.155
N052.15.30.405 E014.35.28.155 N52.13.56.403 E014.42.03.127
N052.13.56.403 E014.42.03.127 N52.13.07.830 E014.42.40.089
N052.13.07.830 E014.42.40.089 N52.11.39.115 E014.42.37.978
N052.11.39.115 E014.42.37.978 N52.11.06.376 E014.41.32.499
N052.11.06.376 E014.41.32.499 N52.10.22.032 E014.41.12.435
N052.10.22.032 E014.41.12.435 N52.09.42.948 E014.42.10.519
N052.09.42.948 E014.42.10.519 N52.09.00.706 E014.42.34.809
N052.09.00.706 E014.42.34.809 N52.08.14.234 E014.41.31.445
N052.08.14.234 E014.41.31.445 N52.07.07.711 E014.40.50.257
N052.07.07.711 E014.40.50.257 N52.05.42.169 E014.40.56.594
N052.05.42.169 E014.40.56.594 N52.04.48.309 E014.41.30.391
N052.04.48.309 E014.41.30.391 N52.03.57.621 E014.44.24.641
N052.03.57.621 E014.44.24.641 N52.03.26.982 E014.44.58.434
N052.03.26.982 E014.44.58.434 N52.02.24.676 E014.45.01.603
N052.02.24.676 E014.45.01.603 N52.01.54.052 E014.44.24.641
N052.01.54.052 E014.44.24.641 N52.00.44.357 E014.44.20.418
N052.00.44.357 E014.44.20.418 N52.00.00.000 E014.43.54.017
N052.00.00.000 E014.43.54.017 N51.59.20.916 E014.42.48.538
N051.59.20.916 E014.42.48.538 N51.57.50.100 E014.43.04.379
N051.57.50.100 E014.43.04.379 N51.57.21.591 E014.42.34.809
N051.57.21.591 E014.42.34.809 N51.56.16.112 E014.42.39.035
N051.56.16.112 E014.42.39.035 N51.55.14.864 E014.43.07.548
N051.55.14.864 E014.43.07.548 N51.54.09.385 E014.41.59.962
N051.54.09.385 E014.41.59.962 N51.52.26.938 E014.41.20.881
N051.52.26.938 E014.41.20.881 N51.51.59.485 E014.40.46.034
N051.51.59.485 E014.40.46.034 N51.52.11.104 E014.39.54.285
N051.52.11.104 E014.39.54.285 N51.50.00.146 E014.37.57.061
N051.50.00.146 E014.37.57.061 N51.49.48.528 E014.36.36.799
N051.49.48.528 E014.36.36.799 N51.48.38.834 E014.35.34.489
N051.48.38.834 E014.35.34.489 N51.47.43.916 E014.35.32.378
N051.47.43.916 E014.35.32.378 N51.47.00.616 E014.36.05.117
N051.47.00.616 E014.36.05.117 N51.46.04.641 E014.38.12.902
N051.46.04.641 E014.38.12.902 N51.44.54.946 E014.39.15.211
N051.44.54.946 E014.39.15.211 N51.43.29.404 E014.39.02.539
N051.43.29.404 E014.39.02.539 N51.42.00.689 E014.40.06.960
N051.42.00.689 E014.40.06.960 N51.38.29.477 E014.45.14.279
N051.38.29.477 E014.45.14.279 N51.37.43.005 E014.45.13.218
N051.37.43.005 E014.45.13.218 N51.37.02.878 E014.45.43.849
N051.37.02.878 E014.45.43.849 N51.35.51.054 E014.45.23.782
N051.35.51.054 E014.45.23.782 N51.35.23.602 E014.45.31.174
N051.35.23.602 E014.45.31.174 N51.35.02.481 E014.45.50.183
N051.35.02.481 E014.45.50.183 N51.32.33.575 E014.43.18.109
N051.32.33.575 E014.43.18.109 N51.31.54.505 E014.42.54.876
N051.31.54.505 E014.42.54.876 N51.31.37.600 E014.42.59.099
N051.31.37.600 E014.42.59.099 N51.31.34.441 E014.43.10.714
N051.31.34.441 E014.43.10.714 N51.31.23.867 E014.43.52.956
N051.31.23.867 E014.43.52.956 N51.30.55.357 E014.44.04.574
N051.30.55.357 E014.44.04.574 N51.30.42.000 E014.43.50.848


;SEKTOR D
N051.30.42.000 E014.43.50.848 N051.37.04.000 E016.00.14.000
N051.37.04.000 E016.00.14.000 N051.38.52.000 E016.20.21.000
N051.38.52.000 E016.20.21.000 N051.42.00.000 E016.59.51.000
N051.42.00.000 E016.59.51.000 N051.43.48.000 E017.23.56.000
N051.43.48.000 E017.23.56.000 N051.45.00.000 E017.40.42.000
N051.45.00.000 E017.40.42.000 N052.42.48.000 E017.37.28.000
N052.42.48.000 E017.37.28.000 N053.11.18.000 E016.34.37.000
N053.11.18.000 E016.34.37.000 N052.43.43.000 E014.21.40.191


;EPWW_C
N051.45.00.000 E017.40.42.000 N051.29.18.000 E018.00.29.000
N051.29.18.000 E018.00.29.000 N050.53.40.000 E018.44.18.000
N050.53.40.000 E018.44.18.000 N051.08.57.000 E019.06.43.000
N051.08.57.000 E019.06.43.000 N051.29.45.000 E020.13.47.000
N051.29.45.000 E020.13.47.000 N052.06.24.000 E020.19.13.000
N052.06.24.000 E020.19.13.000 N052.27.07.000 E019.48.33.000
N052.27.07.000 E019.48.33.000 N052.42.48.000 E017.37.28.000
N052.42.48.000 E017.37.28.000 N051.45.00.000 E017.40.42.000

;EPWW_T
N051.30.42.000 E014.43.50.848 N051.30.31.078 E014.43.50.848
N051.30.31.078 E014.43.50.848 N051.30.01.497 E014.44.23.587
N051.30.01.497 E014.44.23.587 N051.29.39.318 E014.47.47.408
N051.29.39.318 E014.47.47.408 N051.28.59.191 E014.49.00.278
N051.28.59.191 E014.49.00.278 N051.26.22.896 E014.57.26.136
N051.26.22.896 E014.57.26.136 N051.24.54.182 E014.58.25.277
N051.24.54.182 E014.58.25.277 N051.24.16.169 E014.57.32.471
N051.24.16.169 E014.57.32.471 N051.23.45.545 E014.57.49.369
N051.23.45.545 E014.57.49.369 N051.23.11.748 E014.57.35.643
N051.23.11.748 E014.57.35.643 N051.22.07.327 E014.57.51.484
N051.22.07.327 E014.57.51.484 N051.21.05.021 E014.58.44.287
N051.21.05.021 E014.58.44.287 N051.20.29.109 E014.58.49.567
N051.20.29.109 E014.58.49.567 N051.19.47.924 E014.58.22.108
N051.19.47.924 E014.58.22.108 N051.19.03.567 E014.58.28.446
N051.19.03.567 E014.58.28.446 N051.17.34.852 E014.59.52.934
N051.17.34.852 E014.59.52.934 N051.16.56.840 E015.00.00.323
N051.16.56.840 E015.00.00.323 N051.15.50.304 E015.01.33.257
N051.15.50.304 E015.01.33.257 N051.14.14.201 E015.01.56.493
N051.14.14.201 E015.01.56.493 N051.08.35.204 E015.00.00.323
N051.08.35.204 E015.00.00.323 N051.07.34.999 E014.59.29.698
N051.07.34.999 E014.59.29.698 N051.06.25.304 E014.59.38.148
N051.06.25.304 E014.59.38.148 N051.03.50.067 E014.58.31.612
N051.03.50.067 E014.58.31.612 N051.03.02.538 E014.58.31.612
N051.03.02.538 E014.58.31.612 N051.02.27.684 E014.58.05.210
N051.02.27.684 E014.58.05.210 N051.01.58.117 E014.58.08.382
N051.01.58.117 E014.58.08.382 N051.00.51.581 E014.56.55.512
N051.00.51.581 E014.56.55.512 N050.59.59.835 E014.56.58.678
N050.59.59.835 E014.56.58.678 N050.59.02.802 E014.56.05.874
N050.59.02.802 E014.56.05.874 N050.58.25.847 E014.56.02.706
N050.58.25.847 E014.56.02.706 N050.58.00.496 E014.55.23.632
N050.58.00.496 E014.55.23.632 N050.56.53.960 E014.55.08.845
N050.56.53.960 E014.55.08.845 N050.56.08.559 E014.54.00.201
N050.56.08.559 E014.54.00.201 N050.55.34.763 E014.53.50.698
N050.55.34.763 E014.53.50.698 N050.54.29.284 E014.54.00.201
N050.54.29.284 E014.54.00.201 N050.51.21.308 E014.49.18.230
N050.51.21.308 E014.49.18.230 N050.50.40.109 E014.49.24.568
N050.50.40.109 E014.49.24.568 N050.50.04.211 E014.49.52.023
N050.50.04.211 E014.49.52.023 N050.50.36.951 E014.51.31.295
N050.50.36.951 E014.51.31.295 N050.50.21.103 E014.52.43.108
N050.50.21.103 E014.52.43.108 N050.50.44.339 E014.54.08.650
N050.50.44.339 E014.54.08.650 N050.50.02.097 E014.57.33.532
N050.50.02.097 E014.57.33.532 N050.50.21.103 E014.59.01.182
N050.50.21.103 E014.59.01.182 N050.52.19.384 E014.59.50.820
N050.52.19.384 E014.59.50.820 N050.53.29.093 E014.59.04.351
N050.53.29.093 E014.59.04.351 N050.54.11.335 E015.00.00.323
N050.54.11.335 E015.00.00.323 N050.55.11.526 E015.00.49.960
N050.55.11.526 E015.00.49.960 N050.55.46.381 E015.00.33.062
N050.55.46.381 E015.00.33.062 N050.57.04.521 E015.00.53.129
N050.57.04.521 E015.00.53.129 N050.57.28.814 E015.00.00.323
N050.57.28.814 E015.00.00.323 N050.57.21.426 E014.58.36.895
N050.57.21.426 E014.58.36.895 N050.57.41.490 E014.58.18.940
N050.57.41.490 E014.58.18.940 N050.58.46.968 E014.59.09.631
N050.58.46.968 E014.59.09.631 N050.59.03.860 E015.00.00.323
N050.59.03.860 E015.00.00.323 N050.59.55.605 E015.01.29.034
N050.59.55.605 E015.01.29.034 N050.58.21.617 E015.02.30.286
N050.58.21.617 E015.02.30.286 N050.59.38.714 E015.04.08.500
N050.59.38.714 E015.04.08.500 N050.59.14.420 E015.04.27.514
N050.59.14.420 E015.04.27.514 N050.58.56.472 E015.06.17.346
N050.58.56.472 E015.06.17.346 N050.58.24.790 E015.05.50.941
N050.58.24.790 E015.05.50.941 N050.57.59.439 E015.06.03.613
N050.57.59.439 E015.06.03.613 N050.57.56.280 E015.06.36.352
N050.57.56.280 E015.06.36.352 N050.57.40.432 E015.08.06.118
N050.57.40.432 E015.08.06.118 N050.58.53.299 E015.08.34.634
N050.58.53.299 E015.08.34.634 N050.59.12.306 E015.09.10.542
N050.59.12.306 E015.09.10.542 N050.59.11.262 E015.10.04.399
N050.59.11.262 E015.10.04.399 N050.57.40.432 E015.10.27.635
N050.57.40.432 E015.10.27.635 N050.57.15.081 E015.11.08.820
N050.57.15.081 E015.11.08.820 N050.57.12.980 E015.11.42.617
N050.57.12.980 E015.11.42.617 N050.57.48.878 E015.12.29.082
N050.57.48.878 E015.12.29.082 N050.57.53.108 E015.13.27.166
N050.57.53.108 E015.13.27.166 N050.57.48.878 E015.14.13.631
N050.57.48.878 E015.14.13.631 N050.57.21.426 E015.14.31.587
N050.57.21.426 E015.14.31.587 N050.57.07.693 E015.15.46.568
N050.57.07.693 E015.15.46.568 N050.55.29.475 E015.17.33.232
N050.55.29.475 E015.17.33.232 N050.54.14.494 E015.16.11.912
N050.54.14.494 E015.16.11.912 N050.53.14.302 E015.15.58.186
N050.53.14.302 E015.15.58.186 N050.50.42.224 E015.17.05.773
N050.50.42.224 E015.17.05.773 N050.49.59.982 E015.17.57.522
N050.49.59.982 E015.17.57.522 N050.49.17.739 E015.20.58.110
N050.49.17.739 E015.20.58.110 N050.48.32.338 E015.21.49.859
N050.48.32.338 E015.21.49.859 N050.46.04.476 E015.21.47.747
N050.46.04.476 E015.21.47.747 N050.45.47.585 E015.22.18.372
N050.45.47.585 E015.22.18.372 N050.45.59.203 E015.22.23.652
N050.45.59.203 E015.22.23.652 N050.45.01.112 E015.22.21.541
N050.45.01.112 E015.22.21.541 N050.44.52.667 E015.23.01.672
N050.44.52.667 E015.23.01.672 N050.45.19.075 E015.24.11.373
N050.45.19.075 E015.24.11.373 N050.46.42.502 E015.25.37.969
N050.46.42.502 E015.25.37.969 N050.46.49.891 E015.26.20.212
N050.46.49.891 E015.26.20.212 N050.46.18.209 E015.27.45.757
N050.46.18.209 E015.27.45.757 N050.45.34.909 E015.28.33.280
N050.45.34.909 E015.28.33.280 N050.45.21.176 E015.29.01.793
N050.45.21.176 E015.29.01.793 N050.45.31.737 E015.30.16.775
N050.45.31.737 E015.30.16.775 N050.44.52.667 E015.30.40.007
N050.44.52.667 E015.30.40.007 N050.44.48.437 E015.31.12.747
N050.44.48.437 E015.31.12.747 N050.45.05.342 E015.32.27.728
N050.45.05.342 E015.32.27.728 N050.44.54.781 E015.33.54.328
N050.44.54.781 E015.33.54.328 N050.45.03.227 E015.34.33.402
N050.45.03.227 E015.34.33.402 N050.44.33.660 E015.36.46.467
N050.44.33.660 E015.36.46.467 N050.43.40.857 E015.38.40.525
N050.43.40.857 E015.38.40.525 N050.43.25.009 E015.40.28.243
N050.43.25.009 E015.40.28.243 N050.42.51.213 E015.40.46.195
N050.42.51.213 E015.40.46.195 N050.42.44.882 E015.41.35.833
N050.42.44.882 E015.41.35.833 N050.42.32.206 E015.43.12.990
N050.42.32.206 E015.43.12.990 N050.42.53.328 E015.45.21.832
N050.42.53.328 E015.45.21.832 N050.42.43.824 E015.46.08.301
N050.42.43.824 E015.46.08.301 N050.43.22.895 E015.48.23.477
N050.43.22.895 E015.48.23.477 N050.42.33.264 E015.49.13.111
N050.42.33.264 E015.49.13.111 N050.38.34.586 E015.51.56.804
N050.38.34.586 E015.51.56.804 N050.38.22.968 E015.52.40.101
N050.38.22.968 E015.52.40.101 N050.39.15.785 E015.55.32.243
N050.39.15.785 E015.55.32.243 N050.39.09.440 E015.56.02.867
N050.39.09.440 E015.56.02.867 N050.39.44.294 E015.57.52.699
N050.39.44.294 E015.57.52.699 N050.38.55.707 E015.59.45.701
N050.38.55.707 E015.59.45.701 N050.38.12.421 E016.00.00.488
N050.38.12.421 E016.00.00.488 N050.37.31.222 E016.00.14.214
N050.37.31.222 E016.00.14.214 N050.37.21.719 E016.00.13.156
N050.37.21.719 E016.00.13.156 N050.37.14.331 E016.00.11.048
N050.37.14.331 E016.00.11.048 N050.37.15.388 E016.00.00.488
N050.37.15.388 E016.00.00.488 N050.37.16.446 E015.59.59.430
N050.37.16.446 E015.59.59.430 N050.37.14.331 E015.59.56.265
N050.37.14.331 E015.59.56.265 N050.37.13.273 E015.59.56.265
N050.37.13.273 E015.59.56.265 N050.37.12.216 E015.59.53.096
N050.37.12.216 E015.59.53.096 N050.37.09.044 E015.59.53.096
N050.37.09.044 E015.59.53.096 N050.37.08.000 E015.59.50.981
N050.37.08.000 E015.59.50.981 N050.37.04.828 E015.59.48.869
N050.37.04.828 E015.59.48.869 N050.36.54.267 E015.59.43.593
N050.36.54.267 E015.59.43.593 N050.36.52.152 E015.59.43.593
N050.36.52.152 E015.59.43.593 N050.36.51.095 E015.59.42.532
N050.36.51.095 E015.59.42.532 N050.36.46.879 E015.59.42.532
N050.36.46.879 E015.59.42.532 N050.36.40.534 E015.59.42.532
N050.36.40.534 E015.59.42.532 N050.36.39.477 E015.59.43.593
N050.36.39.477 E015.59.43.593 N050.36.36.304 E015.59.43.593
N050.36.36.304 E015.59.43.593 N050.36.27.859 E015.59.47.815
N050.36.27.859 E015.59.47.815 N050.36.25.757 E015.59.50.981
N050.36.25.757 E015.59.50.981 N050.36.24.686 E015.59.50.981
N050.36.24.686 E015.59.50.981 N050.36.20.470 E016.00.00.488
N050.36.20.470 E016.00.00.488 N050.36.20.470 E016.00.00.488
N050.36.20.470 E016.00.00.488 N050.36.10.967 E016.00.24.774
N050.36.10.967 E016.00.24.774 N050.36.06.737 E016.00.43.787
N050.36.06.737 E016.00.43.787 N050.36.39.477 E016.03.36.980
N050.36.39.477 E016.03.36.980 N050.39.24.230 E016.05.39.484
N050.39.24.230 E016.05.39.484 N050.39.05.210 E016.09.15.984
N050.39.05.210 E016.09.15.984 N050.37.22.776 E016.11.30.106
N050.37.22.776 E016.11.30.106 N050.38.01.847 E016.13.26.273
N050.38.01.847 E016.13.26.273 N050.39.43.237 E016.13.44.229
N050.39.43.237 E016.13.44.229 N050.39.23.173 E016.17.33.397
N050.39.23.173 E016.17.33.397 N050.39.27.403 E016.20.25.532
N050.39.27.403 E016.20.25.532 N050.36.06.737 E016.25.50.803
N050.36.06.737 E016.25.50.803 N050.34.13.743 E016.26.39.390
N050.34.13.743 E016.26.39.390 N050.30.08.734 E016.22.21.705
N050.30.08.734 E016.22.21.705 N050.30.08.734 E016.18.39.926
N050.30.08.734 E016.18.39.926 N050.25.21.483 E016.11.56.508
N050.25.21.483 E016.11.56.508 N050.24.19.177 E016.14.58.153
N050.24.19.177 E016.14.58.153 N050.22.02.932 E016.16.22.638
N050.22.02.932 E016.16.22.638 N050.22.56.793 E016.20.18.143
N050.22.56.793 E016.20.18.143 N050.22.09.277 E016.22.14.310
N050.22.09.277 E016.22.14.310 N050.20.31.059 E016.22.11.145
N050.20.31.059 E016.22.11.145 N050.19.05.517 E016.26.14.039
N050.19.05.517 E016.26.14.039 N050.13.40.239 E016.32.49.011
N050.13.40.239 E016.32.49.011 N050.09.54.250 E016.33.22.808
N050.09.54.250 E016.33.22.808 N050.07.14.770 E016.37.02.472
N050.07.14.770 E016.37.02.472 N050.05.54.515 E016.41.30.717
N050.05.54.515 E016.41.30.717 N050.06.12.464 E016.43.23.712
N050.06.12.464 E016.43.23.712 N050.12.02.035 E016.49.55.518
N050.12.02.035 E016.49.55.518 N050.11.45.130 E016.51.49.577
N050.11.45.130 E016.51.49.577 N050.13.21.233 E016.53.38.349
N050.13.21.233 E016.53.38.349 N050.13.20.175 E016.57.26.466
N050.13.20.175 E016.57.26.466 N050.14.12.979 E016.57.41.250
N050.14.12.979 E016.57.41.250 N050.13.11.730 E016.59.59.595
N050.13.11.730 E016.59.59.595 N050.13.20.175 E017.01.07.181
N050.13.20.175 E017.01.07.181 N050.15.00.508 E017.00.11.213
N050.15.00.508 E017.00.11.213 N050.16.26.050 E017.01.14.577
N050.16.26.050 E017.01.14.577 N050.18.00.038 E016.59.59.595
N050.18.00.038 E016.59.59.595 N050.19.00.230 E016.56.29.433
N050.19.00.230 E016.56.29.433 N050.24.06.501 E016.51.58.023
N050.24.06.501 E016.51.58.023 N050.26.43.853 E016.54.08.973
N050.26.43.853 E016.54.08.973 N050.25.29.929 E016.59.59.595
N050.25.29.929 E016.59.59.595 N050.23.54.883 E017.04.14.107
N050.23.54.883 E017.04.14.107 N050.24.14.947 E017.06.15.554
N050.24.14.947 E017.06.15.554 N050.22.36.729 E017.08.44.460
N050.22.36.729 E017.08.44.460 N050.23.06.296 E017.11.46.105
N050.23.06.296 E017.11.46.105 N050.21.42.869 E017.11.03.863
N050.21.42.869 E017.11.03.863 N050.18.52.841 E017.17.48.345
N050.18.52.841 E017.17.48.345 N050.19.38.256 E017.20.30.977
N050.19.38.256 E017.20.30.977 N050.18.59.186 E017.21.30.118
N050.18.59.186 E017.21.30.118 N050.16.04.929 E017.20.30.977
N050.16.04.929 E017.20.30.977 N050.15.43.808 E017.21.34.341
N050.15.43.808 E017.21.34.341 N050.17.01.948 E017.24.23.310
N050.17.01.948 E017.24.23.310 N050.15.08.954 E017.25.33.018
N050.15.08.954 E017.25.33.018 N050.16.21.821 E017.29.41.193
N050.16.21.821 E017.29.41.193 N050.15.52.254 E017.36.30.948
N050.15.52.254 E017.36.30.948 N050.15.59.642 E017.38.38.733
N050.15.59.642 E017.38.38.733 N050.17.35.745 E017.40.54.971
N050.17.35.745 E017.40.54.971 N050.19.20.307 E017.41.01.308
N050.19.20.307 E017.41.01.308 N050.19.21.960 E017.42.43.400
N050.19.21.960 E017.42.43.400 N050.18.12.714 E017.44.57.865
N050.18.12.714 E017.44.57.865 N050.15.38.521 E017.43.29.157
N050.15.38.521 E017.43.29.157 N050.13.44.469 E017.45.32.719
N050.13.44.469 E017.45.32.719 N050.12.29.487 E017.45.21.101
N050.12.29.487 E017.45.21.101 N050.11.59.920 E017.42.40.577
N050.11.59.920 E017.42.40.577 N050.10.58.658 E017.42.16.283
N050.10.58.658 E017.42.16.283 N050.10.04.797 E017.36.06.662
N050.10.04.797 E017.36.06.662 N050.09.24.670 E017.35.55.044
N050.09.24.670 E017.35.55.044 N050.06.15.636 E017.40.13.779
N050.06.15.636 E017.40.13.779 N050.06.49.433 E017.41.27.710
N050.06.49.433 E017.41.27.710 N050.06.19.866 E017.43.59.781
N050.06.19.866 E017.43.59.781 N050.05.37.624 E017.43.24.934
N050.05.37.624 E017.43.24.934 N049.59.59.670 E017.48.17.466
N049.59.59.670 E017.48.17.466 N049.59.44.894 E017.49.16.606
N049.59.44.894 E017.49.16.606 N049.59.08.982 E017.50.30.531
N049.59.08.982 E017.50.30.531 N049.58.38.358 E017.52.19.309
N049.58.38.358 E017.52.19.309 N049.58.26.740 E017.53.25.838
N049.58.26.740 E017.53.25.838 N049.58.28.855 E017.54.17.584
N049.58.28.855 E017.54.17.584 N049.58.49.976 E017.55.49.464
N049.58.49.976 E017.55.49.464 N049.59.23.773 E017.56.32.764
N049.59.23.773 E017.56.32.764 N049.59.59.670 E017.58.06.752
N049.59.59.670 E017.58.06.752 N049.59.59.670 E017.58.06.752
N049.59.59.670 E017.58.06.752 N050.00.21.849 E017.58.32.103
N050.00.21.849 E017.58.32.103 N050.00.50.359 E017.59.11.180
N050.00.50.359 E017.59.11.180 N050.00.58.818 E017.59.43.912
N050.00.58.818 E017.59.43.912 N050.00.55.646 E017.59.59.753
N050.00.55.646 E017.59.59.753 N050.00.22.906 E018.03.21.469
N050.00.22.906 E018.03.21.469 N050.02.46.539 E018.00.16.651
N050.02.46.539 E018.00.16.651 N050.03.23.494 E018.03.40.475 
N050.03.23.494 E018.03.40.475 N050.02.52.000 E018.05.52.000 ; granica panstwa - EPWW T
N050.02.52.000 E018.05.52.000 N050.22.32.000 E018.06.31.000 ; // - NUMBA
N050.22.32.000 E018.06.31.000 N050.27.56.000 E018.11.29.000
N050.27.56.000 E018.11.29.000 N050.31.34.000 E018.14.51.000 ; // - MAPIK
N050.31.34.000 E018.14.51.000 N050.39.12.000 E018.24.42.000 ; MAPIK - SUDOL
N050.39.12.000 E018.24.42.000 N050.42.55.000 E018.29.41.000 ; SUDOL - //
N050.42.55.000 E018.29.41.000 N050.53.40.000 E018.44.18.000 ; // - barex

;EPWW_J
N051.29.45.000 E020.13.47.000 N051.12.56.000 E021.22.18.000
N051.12.56.000 E021.22.18.000 N050.11.58.000 E021.20.57.000
N050.11.58.000 E021.20.57.000 N049.55.48.000 E021.10.31.000
N049.55.48.000 E021.10.31.000 N049.24.10.000 E021.11.56.000
;granica FIR J
N050.02.52.000 E018.05.52.000 N049.59.59.670 E018.06.41.063 
N049.59.59.670 E018.06.41.063 N049.59.53.340 E018.07.11.687 
N049.59.53.340 E018.07.11.687 N049.59.57.556 E018.07.38.096 
N049.59.57.556 E018.07.38.096 N049.59.54.397 E018.08.04.497 
N049.59.54.397 E018.08.04.497 N049.59.17.428 E018.08.57.293 
N049.59.17.428 E018.08.57.293 N049.59.11.097 E018.09.26.867 
N049.59.11.097 E018.09.26.867 N049.59.17.428 E018.09.42.708 
N049.59.17.428 E018.09.42.708 N049.59.59.670 E018.10.33.403 
N049.59.59.670 E018.10.33.403 N049.59.59.670 E018.12.50.691
N049.59.59.670 E018.12.50.691 N049.58.06.676 E018.13.46.666 
N049.58.06.676 E018.13.46.666 N049.57.46.612 E018.16.34.579 
N049.57.46.612 E018.16.34.579 N049.56.09.452 E018.17.21.051 
N049.56.09.452 E018.17.21.051 N049.56.42.191 E018.19.35.166 
N049.56.42.191 E018.19.35.166 N049.55.30.368 E018.20.30.084 
N049.55.30.368 E018.20.30.084 N049.56.15.783 E018.23.58.131 
N049.56.15.783 E018.23.58.131 N049.54.22.788 E018.29.22.344 
N049.54.22.788 E018.29.22.344 N049.54.50.240 E018.34.29.666 
N049.54.50.240 E018.34.29.666 N049.51.33.805 E018.34.29.666 
N049.51.33.805 E018.34.29.666 N049.50.27.283 E018.35.50.979 
N049.50.27.283 E018.35.50.979 N049.49.03.855 E018.34.48.673 
N049.49.03.855 E018.34.48.673 N049.42.55.278 E018.38.11.439 
N049.42.55.278 E018.38.11.439 N049.40.16.869 E018.48.44.025 
N049.40.16.869 E018.48.44.025 N049.32.52.266 E018.51.35.116 
N049.32.52.266 E018.51.35.116 N049.31.27.781 E018.50.49.702 
N049.31.27.781 E018.50.49.702 N049.30.38.136 E018.57.54.248 
N049.30.38.136 E018.57.54.248 N049.25.37.152 E018.59.20.841 
N049.25.37.152 E018.59.20.841 N049.24.02.107 E018.58.22.757 
N049.24.02.107 E018.58.22.757 N049.24.02.107 E018.59.59.918 
N049.24.02.107 E018.59.59.918 N049.23.39.928 E019.01.58.199 
N049.23.39.928 E019.01.58.199 N049.25.14.987 E019.04.34.493 
N049.25.14.987 E019.04.34.493 N049.24.16.897 E019.08.05.712 
N049.24.16.897 E019.08.05.712 N049.24.48.579 E019.11.30.594 
N049.24.48.579 E019.11.30.594 N049.26.40.516 E019.11.49.600 
N049.26.40.516 E019.11.49.600 N049.27.31.218 E019.14.03.723 
N049.27.31.218 E019.14.03.723 N049.31.24.608 E019.15.20.812 
N049.31.24.608 E019.15.20.812 N049.32.19.526 E019.22.15.855 
N049.32.19.526 E019.22.15.855 N049.34.16.750 E019.23.14.996 
N049.34.16.750 E019.23.14.996 N049.35.56.012 E019.27.37.961 
N049.35.56.012 E019.27.37.961 N049.34.09.348 E019.31.51.415 
N049.34.09.348 E019.31.51.415 N049.30.05.397 E019.33.11.677 
N049.30.05.397 E019.33.11.677 N049.26.44.745 E019.36.27.048 
N049.26.44.745 E019.36.27.048 N049.26.46.860 E019.38.33.783 
N049.26.46.860 E019.38.33.783 N049.24.03.164 E019.38.28.502 
N049.24.03.164 E019.38.28.502 N049.23.12.476 E019.43.54.824 
N049.23.12.476 E019.43.54.824 N049.24.13.725 E019.45.38.322 
N049.24.13.725 E019.45.38.322 N049.24.16.897 E019.47.33.438 
N049.24.16.897 E019.47.33.438 N049.17.35.580 E019.47.43.992 
N049.17.35.580 E019.47.43.992 N049.16.22.713 E019.49.22.209 
N049.16.22.713 E019.49.22.209 N049.13.55.922 E019.46.02.608 
N049.13.55.922 E019.46.02.608 N049.12.18.762 E019.46.15.284 
N049.12.18.762 E019.46.15.284 N049.11.33.347 E019.47.19.705 
N049.11.33.347 E019.47.19.705 N049.11.51.310 E019.48.34.687 
N049.11.51.310 E019.48.34.687 N049.11.25.959 E019.52.37.587 
N049.11.25.959 E019.52.37.587 N049.13.49.591 E019.55.35.003 
N049.13.49.591 E019.55.35.003 N049.13.30.571 E020.00.00.082 
N049.13.30.571 E020.00.00.082 N049.12.22.992 E020.00.51.828 
N049.12.22.992 E020.00.51.828 N049.10.41.602 E020.05.38.029 
N049.10.41.602 E020.05.38.029 N049.17.10.243 E020.08.01.654 
N049.17.10.243 E020.08.01.654 N049.18.38.958 E020.08.37.559 
N049.18.38.958 E020.08.37.559 N049.18.15.721 E020.09.56.764 
N049.18.15.721 E020.09.56.764 N049.20.49.901 E020.13.35.371 
N049.20.49.901 E020.13.35.371 N049.20.52.016 E020.17.31.934 
N049.20.52.016 E020.17.31.934 N049.20.22.449 E020.18.59.584 
N049.20.22.449 E020.18.59.584 N049.23.12.476 E020.18.53.253 
N049.23.12.476 E020.18.53.253 N049.23.57.891 E020.19.17.540 
N049.23.57.891 E020.19.17.540 N049.23.57.891 E020.21.57.007 
N049.23.57.891 E020.21.57.007 N049.22.54.513 E020.23.10.931 
N049.22.54.513 E020.23.10.931 N049.24.23.228 E020.25.58.850 
N049.24.23.228 E020.25.58.850 N049.24.46.464 E020.26.54.819 
N049.24.46.464 E020.26.54.819 N049.24.38.018 E020.29.15.279 
N049.24.38.018 E020.29.15.279 N049.22.57.686 E020.32.39.103 
N049.22.57.686 E020.32.39.103 N049.22.49.240 E020.35.13.289 
N049.22.49.240 E020.35.13.289 N049.24.58.082 E020.37.01.010 
N049.24.58.082 E020.37.01.010 N049.24.01.049 E020.39.28.858 
N049.24.01.049 E020.39.28.858 N049.24.55.967 E020.42.00.930 
N049.24.55.967 E020.42.00.930 N049.24.49.636 E020.43.44.428 
N049.24.49.636 E020.43.44.428 N049.19.58.155 E020.49.22.374 
N049.19.58.155 E020.49.22.374 N049.20.21.391 E020.51.51.280 
N049.20.21.391 E020.51.51.280 N049.19.45.480 E020.52.41.968 
N049.19.45.480 E020.52.41.968 N049.19.05.352 E020.52.32.465 
N049.19.05.352 E020.52.32.465 N049.19.07.467 E020.54.31.804 
N049.19.07.467 E020.54.31.804 N049.17.41.925 E020.56.26.913 
N049.17.41.925 E020.56.26.913 N049.18.18.880 E020.59.27.501 
N049.18.18.880 E020.59.27.501 N049.19.38.091 E021.00.00.240
N049.19.38.091 E021.00.00.240 N049.21.45.876 E021.03.29.344 
N049.21.45.876 E021.03.29.344 N049.22.00.667 E021.06.00.365 
N049.22.00.667 E021.06.00.365 N049.25.08.643 E021.04.02.084 
N049.25.08.643 E021.04.02.084 N049.25.51.942 E021.08.36.666 
N049.25.51.942 E021.08.36.666 N049.24.10.000 E021.11.56.000


;EPWW_R
EPWW N051.29.45.000 E020.13.47.000 N051.48.33.000 E020.16.33.000
N051.48.33.000 E020.16.33.000 N051.48.33.000 E022.05.57.000
N051.48.33.000 E022.05.57.000 N052.11.17.000 E023.24.16.000 


;GRANICA FIR
N049.24.10.000 E021.11.56.000 N049.27.09.039 E021.17.13.086 
N049.27.09.039 E021.17.13.086 N049.25.48.770 E021.23.22.714
N049.25.48.770 E021.23.22.714 N049.25.58.273 E021.24.29.243
N049.25.58.273 E021.24.29.243 N049.24.49.636 E021.27.27.723
N049.24.49.636 E021.27.27.723 N049.26.37.357 E021.33.57.415
N049.26.37.357 E021.33.57.415 N049.26.04.618 E021.35.27.180
N049.26.04.618 E021.35.27.180 N049.26.41.573 E021.38.18.264
N049.26.41.573 E021.38.18.264 N049.25.08.643 E021.39.58.590
N049.25.08.643 E021.39.58.590 N049.24.45.406 E021.43.38.255
N049.24.45.406 E021.43.38.255 N049.21.09.965 E021.46.54.684
N049.21.09.965 E021.46.54.684 N049.23.23.036 E021.50.48.074
N049.23.23.036 E021.50.48.074 N049.21.15.252 E021.54.03.452
N049.21.15.252 E021.54.03.452 N049.20.33.009 E021.56.20.740
N049.20.33.009 E021.56.20.740 N049.20.43.570 E021.58.23.245
N049.20.43.570 E021.58.23.245 N049.18.17.836 E022.00.00.405
N049.18.17.836 E022.00.00.405 N049.14.43.452 E022.02.30.368
N049.14.43.452 E022.02.30.368 N049.13.01.004 E022.03.06.273
N049.13.01.004 E022.03.06.273 N049.12.03.972 E022.08.41.047
N049.12.03.972 E022.08.41.047 N049.10.41.602 E022.11.34.247
N049.10.41.602 E022.11.34.247 N049.11.04.838 E022.14.13.713
N049.11.04.838 E022.14.13.713 N049.09.10.786 E022.14.07.375
N049.09.10.786 E022.14.07.375 N049.08.11.638 E022.19.08.360
N049.08.11.638 E022.19.08.360 N049.08.54.938 E022.22.20.565
N049.08.54.938 E022.22.20.565 N049.06.17.586 E022.24.57.917
N049.06.17.586 E022.24.57.917 N049.05.16.338 E022.34.12.363
N049.05.16.338 E022.34.12.363 N049.05.29.013 E022.36.51.829
N049.05.29.013 E022.36.51.829 N049.02.30.526 E022.41.35.915
N049.02.30.526 E022.41.35.915 N049.03.27.559 E022.46.41.115
N049.03.27.559 E022.46.41.115 N049.02.21.023 E022.48.26.728
N049.02.21.023 E022.48.26.728 N049.05.34.286 E022.54.08.898
N049.05.34.286 E022.54.08.898 N049.07.08.275 E022.50.11.277
N049.07.08.275 E022.50.11.277 N049.09.35.066 E022.47.41.314
N049.09.35.066 E022.47.41.314 N049.09.51.971 E022.45.02.905
N049.09.51.971 E022.45.02.905 N049.10.58.507 E022.45.25.083
N049.10.58.507 E022.45.25.083 N049.10.29.984 E022.43.44.751
N049.10.29.984 E022.43.44.751 N049.10.25.768 E022.42.47.725
N049.10.25.768 E022.42.47.725 N049.11.23.844 E022.43.12.011
N049.11.23.844 E022.43.12.011 N049.13.08.406 E022.45.05.013
N049.13.08.406 E022.45.05.013 N049.13.50.649 E022.43.58.483
N049.13.50.649 E022.43.58.483 N049.16.30.102 E022.47.21.250
N049.16.30.102 E022.47.21.250 N049.19.35.977 E022.48.47.850
N049.19.35.977 E022.48.47.850 N049.26.59.536 E022.41.46.476
N049.26.59.536 E022.41.46.476 N049.28.33.524 E022.42.07.597
N049.28.33.524 E022.42.07.597 N049.31.36.227 E022.40.00.863
N049.31.36.227 E022.40.00.863 N049.32.41.691 E022.40.10.366
N049.32.41.691 E022.40.10.366 N049.41.21.290 E022.48.04.550
N049.41.21.290 E022.48.04.550 N049.43.01.609 E022.51.12.526
N049.43.01.609 E022.51.12.526 N049.51.07.410 E022.59.59.512
N049.51.07.410 E022.59.59.512 N049.52.26.622 E023.02.05.182
N049.52.26.622 E023.02.05.182 N049.53.10.965 E023.02.35.814
N049.53.10.965 E023.02.35.814 N049.53.48.992 E023.03.13.833
N049.53.48.992 E023.03.13.833 N049.56.01.006 E023.05.55.408
N049.56.01.006 E023.05.55.408 N049.56.41.134 E023.06.22.867
N049.56.41.134 E023.06.22.867 N049.57.18.089 E023.07.04.052
N049.57.18.089 E023.07.04.052 N049.57.39.210 E023.07.46.294
N049.57.39.210 E023.07.46.294 N049.58.11.949 E023.08.19.033
N049.58.11.949 E023.08.19.033 N049.58.32.013 E023.08.54.945
N049.58.32.013 E023.08.54.945 N049.59.59.670 E023.10.39.494
N049.59.59.670 E023.10.39.494 N050.01.03.034 E023.12.05.036
N050.01.03.034 E023.12.05.036 N050.03.36.170 E023.14.10.706
N050.03.36.170 E023.14.10.706 N050.04.04.679 E023.15.44.701
N050.04.04.679 E023.15.44.701 N050.05.49.228 E023.17.37.695
N050.05.49.228 E023.17.37.695 N050.08.16.033 E023.21.38.481
N050.08.16.033 E023.21.38.481 N050.10.45.996 E023.25.54.057
N050.10.45.996 E023.25.54.057 N050.12.21.042 E023.27.25.937
N050.12.21.042 E023.27.25.937 N050.16.38.726 E023.35.53.904
N050.16.38.726 E023.35.53.904 N050.18.12.714 E023.36.50.930
N050.18.12.714 E023.36.50.930 N050.19.46.702 E023.40.12.646
N050.19.46.702 E023.40.12.646 N050.20.40.562 E023.41.23.405
N050.20.40.562 E023.41.23.405 N050.23.44.323 E023.43.24.852
N050.23.44.323 E023.43.24.852 N050.24.20.220 E023.45.04.120
N050.24.20.220 E023.45.04.120 N050.25.10.922 E023.47.14.019
N050.25.10.922 E023.47.14.019 N050.24.50.858 E023.54.41.795
N050.24.50.858 E023.54.41.795 N050.25.25.699 E023.59.59.670
N050.25.25.699 E023.59.59.670 N050.27.10.247 E024.02.58.150
N050.27.10.247 E024.02.58.150 N050.38.18.752 E024.05.59.795
N050.38.18.752 E024.05.59.795 N050.41.15.110 E024.03.57.291
N050.41.15.110 E024.03.57.291 N050.42.58.615 E024.04.50.094
N050.42.58.615 E024.04.50.094 N050.46.25.597 E023.59.59.670
N050.46.25.597 E023.59.59.670 N050.47.00.451 E023.58.13.014
N050.47.00.451 E023.58.13.014 N050.48.56.618 E023.58.04.561
N050.48.56.618 E023.58.04.561 N050.50.27.448 E023.59.59.670
N050.50.27.448 E023.59.59.670 N050.50.14.772 E024.06.40.980
N050.50.14.772 E024.06.40.980 N050.51.49.818 E024.08.56.160
N050.51.49.818 E024.08.56.160 N050.56.29.680 E023.59.59.670
N050.56.29.680 E023.59.59.670 N050.56.56.075 E023.59.14.263
N050.56.56.075 E023.59.14.263 N050.57.16.139 E023.58.49.976
N050.57.16.139 E023.58.49.976 N050.58.43.796 E023.58.24.632
N050.58.43.796 E023.58.24.632 N050.58.58.586 E023.58.09.841
N050.58.58.586 E023.58.09.841 N050.59.59.835 E023.56.21.063
N050.59.59.835 E023.56.21.063 N051.00.09.338 E023.55.45.158
N051.00.09.338 E023.55.45.158 N051.02.18.181 E023.56.03.114
N051.02.18.181 E023.56.03.114 N051.04.08.016 E023.55.18.757
N051.04.08.016 E023.55.18.757 N051.07.19.165 E023.51.34.869
N051.07.19.165 E023.51.34.869 N051.08.56.325 E023.52.42.463
N051.08.56.325 E023.52.42.463 N051.13.01.334 E023.44.37.718
N051.13.01.334 E023.44.37.718 N051.16.11.425 E023.43.22.737
N051.16.11.425 E023.43.22.737 N051.17.30.636 E023.39.15.620
N051.17.30.636 E023.39.15.620 N051.18.51.949 E023.38.44.989
N051.18.51.949 E023.38.44.989 N051.20.01.657 E023.39.06.110
N051.20.01.657 E023.39.06.110 N051.24.39.405 E023.42.29.934
N051.24.39.405 E023.42.29.934 N051.26.46.119 E023.39.31.454
N051.26.46.119 E023.39.31.454 N051.27.54.770 E023.40.28.487
N051.27.54.770 E023.40.28.487 N051.32.05.066 E023.34.22.024
N051.32.05.066 E023.34.22.024 N051.33.42.226 E023.34.46.317
N051.33.42.226 E023.34.46.317 N051.37.09.208 E023.32.36.418
N051.37.09.208 E023.32.36.418 N051.39.29.669 E023.32.42.756
N051.39.29.669 E023.32.42.756 N051.39.47.631 E023.33.28.163
N051.39.47.631 E023.33.28.163 N051.42.57.708 E023.33.29.228
N051.42.57.708 E023.33.29.228 N051.43.30.448 E023.32.27.972
N051.43.30.448 E023.32.27.972 N051.44.46.487 E023.32.31.138
N051.44.46.487 E023.32.31.138 N051.47.52.362 E023.38.44.989
N051.47.52.362 E023.38.44.989 N051.51.04.568 E023.36.42.484
N051.51.04.568 E023.36.42.484 N051.51.46.810 E023.37.18.396
N051.51.46.810 E023.37.18.396 N051.53.03.907 E023.36.49.879
N051.53.03.907 E023.36.49.879 N051.53.34.531 E023.38.14.364
N051.53.34.531 E023.38.14.364 N051.54.49.513 E023.37.03.605
N051.54.49.513 E023.37.03.605 N051.55.41.258 E023.37.24.727
N051.55.41.258 E023.37.24.727 N052.00.00.000 E023.41.37.131
N052.00.00.000 E023.41.37.131 N052.01.26.600 E023.39.37.792
N052.01.26.600 E023.39.37.792 N052.05.07.315 E023.38.53.441
N052.05.07.315 E023.38.53.441 N052.06.51.864 E023.36.25.586
N052.06.51.864 E023.36.25.586 N052.06.52.921 E023.33.04.934
N052.06.52.921 E023.33.04.934 N052.09.09.152 E023.29.55.894
N052.09.09.152 E023.29.55.894 N052.10.37.866 E023.30.05.397
N052.10.37.866 E023.30.05.397 N052.10.32.593 E023.26.07.783
N052.10.32.593 E023.26.07.783 N052.11.17.000 E023.24.16.000

;EPWW_E
N052.27.07.000 E019.48.33.000 N052.36.02.000 E020.00.15.000
N052.36.02.000 E020.00.15.000 N052.42.16.000 E020.19.42.000
N052.42.16.000 E020.19.42.000 N053.00.00.000 E020.30.00.000
N053.00.00.000 E020.30.00.000 N053.17.39.000 E022.55.45.000
N053.17.39.000 E022.55.45.000 N053.22.52.000 E023.44.23.000

;GRANICA FIR E
N052.11.17.000 E023.24.16.000 N052.12.23.472 E023.22.18.615
N052.12.23.472 E023.22.18.615 N052.13.59.575 E023.12.06.093
N052.13.59.575 E023.12.06.093 N052.14.48.162 E023.11.51.303
N052.14.48.162 E023.11.51.303 N052.15.29.347 E023.12.36.718
N052.15.29.347 E023.12.36.718 N052.16.36.927 E023.12.06.093
N052.16.36.927 E023.12.06.093 N052.17.06.508 E023.10.18.372
N052.17.06.508 E023.10.18.372 N052.21.47.414 E023.14.29.719
N052.21.47.414 E023.14.29.719 N052.27.50.705 E023.18.28.390
N052.27.50.705 E023.18.28.390 N052.33.23.371 E023.25.09.700
N052.33.23.371 E023.25.09.700 N052.36.39.806 E023.33.58.795
N052.36.39.806 E023.33.58.795 N052.40.01.515 E023.54.54.470
N052.40.01.515 E023.54.54.470 N052.56.26.838 E023.56.20.013
N052.56.26.838 E023.56.20.013 N052.57.34.417 E023.57.04.370
N052.57.34.417 E023.57.04.370 N052.58.14.559 E023.56.34.796
N052.58.14.559 E023.56.34.796 N053.00.00.165 E023.56.49.579
N053.00.00.165 E023.56.49.579 N053.04.08.332 E023.53.25.756
N053.04.08.332 E023.53.25.756 N053.09.07.202 E023.55.16.642
N053.09.07.202 E023.55.16.642 N053.11.48.783 E023.52.05.494
N053.11.48.783 E023.52.05.494 N053.13.43.906 E023.52.15.004
N053.13.43.906 E023.52.15.004 N053.18.04.749 E023.46.38.108
N053.18.04.749 E023.46.38.108 N053.22.52.000 E023.44.23.000

;EPWW_G
N053.00.00.000 E020.30.00.000 N052.42.16.000 E020.19.42.000
N052.42.16.000 E020.19.42.000 N052.35.51.000 E019.59.44.000
N052.35.51.000 E019.59.44.000 N052.27.07.000 E019.48.33.000
N052.27.07.000 E019.48.33.000 N052.42.48.000 E017.37.28.000
N052.42.48.000 E017.37.28.000 N053.11.18.000 E016.34.37.000
N053.11.18.000 E016.34.37.000 N053.42.22.000 E017.00.13.000
N053.42.22.000 E017.00.13.000 N054.13.51.000 E017.24.49.000
N054.13.51.000 E017.24.49.000 N054.57.13.000 E015.55.53.000


;granica FIR pocz
N055.17.24.000 E018.23.03.000 N054.36.11.998 E019.24.24.199
N054.36.11.998 E019.24.24.199 N054.27.29.998 E019.38.30.200
N054.27.29.998 E019.38.30.200 N054.26.31.837 E019.48.14.623
N054.26.31.837 E019.48.14.623 N054.26.27.607 E019.49.06.368
N054.26.27.607 E019.49.06.368 N054.26.11.759 E019.51.27.879
N054.26.11.759 E019.51.27.879 N054.26.09.644 E019.52.46.033
N054.26.09.644 E019.52.46.033 N054.25.52.753 E019.54.30.589
N054.25.52.753 E019.54.30.589 N054.25.34.804 E019.58.27.145
N054.25.34.804 E019.58.27.145 N054.25.17.899 E020.00.00.082
N054.25.17.899 E020.00.00.082 N054.25.11.568 E020.05.30.634
N054.25.11.568 E020.05.30.634 N054.24.30.383 E020.11.12.803
N054.24.30.383 E020.11.12.803 N054.24.27.210 E020.15.35.760
N054.24.27.210 E020.15.35.760 N054.22.54.000 E020.30.00.000
;granica FIR koniec
N054.36.11.998 E019.24.24.199 N054.27.29.998 E019.38.30.200


;G/S
N054.25.17.899 E020.00.00.000 N053.00.00.000 E020.30.00.000


;EPWW_B
;B
N054.54.58.840 E015.51.52.920 N054.55.00.199 E015.08.07.999
N054.55.00.199 E015.08.07.999 N054.52.45.895 E015.05.07.118
N054.52.45.895 E015.05.07.118 N054.50.54.840 E015.01.23.653
N054.50.54.840 E015.01.23.653 N054.49.27.693 E014.57.09.905
N054.49.27.693 E014.57.09.905 N054.48.27.100 E014.52.33.585
N054.48.27.100 E014.52.33.585 N054.47.54.904 E014.47.43.765
N054.47.54.904 E014.47.43.765 N054.47.52.294 E014.42.47.239
N054.47.52.294 E014.42.47.239 N054.48.18.721 E014.37.55.097
N054.48.18.721 E014.37.55.097 N054.49.14.010 E014.33.15.339
N054.49.14.010 E014.33.15.339 N054.50.36.270 E014.28.56.663
N054.50.36.270 E014.28.56.663 N054.52.23.405 E014.25.06.863
N054.52.23.405 E014.25.06.863 N054.55.00.199 E014.21.26.999

N054.55.00.199 E014.21.26.999 N054.07.40.999 E014.15.20.998
N054.07.40.999 E014.15.20.998 N054.07.33.999 E014.12.05.000
N054.07.33.999 E014.12.05.000 N053.59.16.999 E014.14.31.999
N053.59.16.999 E014.14.31.999 N053.57.44.999 E014.13.59.998
N053.57.44.999 E014.13.59.998 N053.55.59.998 E014.13.59.998
N053.55.59.998 E014.13.59.998 N053.55.45.998 E014.13.41.998
N053.55.45.998 E014.13.41.998 N053.55.40.000 E014.13.33.999
N053.55.40.000 E014.13.33.999 N053.55.19.999 E014.13.00.199
N053.55.19.999 E014.13.00.199 N053.48.39.999 E014.15.20.600
N053.48.39.999 E014.15.20.600 N053.41.55.732 E014.16.10.697
N053.41.55.732 E014.16.10.697 N053.41.00.814 E014.16.10.697 
N053.41.00.814 E014.16.10.697 N053.40.34.419 E014.16.42.375 
N053.40.34.419 E014.16.42.375 N053.39.33.157 E014.16.30.761 
N053.39.33.157 E014.16.30.761 N053.38.51.972 E014.17.01.389 
N053.38.51.972 E014.17.01.389 N053.37.57.068 E014.16.51.882 
N053.37.57.068 E014.16.51.882 N053.36.16.735 E014.18.46.995 
N053.36.16.735 E014.18.46.995 N053.34.48.020 E014.18.41.714 
N053.34.48.020 E014.18.41.714 N053.33.18.262 E014.18.54.390 
N053.33.18.262 E014.18.54.390 N053.32.27.560 E014.18.12.144 
N053.32.27.560 E014.18.12.144 N053.31.50.605 E014.18.08.975 
N053.31.50.605 E014.18.08.975 N053.31.29.484 E014.18.39.603 
N053.31.29.484 E014.18.39.603 N053.30.29.279 E014.18.53.329 
N053.30.29.279 E014.18.53.329 N053.29.47.036 E014.19.46.135 
N053.29.47.036 E014.19.46.135 N053.29.26.972 E014.20.48.445 
N053.29.26.972 E014.20.48.445 N053.26.54.894 E014.21.15.901 
N053.26.54.894 E014.21.15.901 N053.26.24.270 E014.21.40.191 
N053.26.24.270 E014.21.40.191 N053.26.06.321 E014.22.06.592 
N053.26.06.321 E014.22.06.592 N053.24.32.333 E014.21.49.694 
N053.24.32.333 E014.21.49.694 N053.24.06.982 E014.22.20.322 
N053.24.06.982 E014.22.20.322 N053.22.32.994 E014.23.02.564 
N053.22.32.994 E014.23.02.564 N053.22.01.312 E014.23.09.956 
N053.22.01.312 E014.23.09.956 N053.21.08.509 E014.23.06.787 
N053.21.08.509 E014.23.06.787 N053.20.49.503 E014.23.20.520 
N053.20.49.503 E014.23.20.520 N053.19.45.081 E014.24.09.097 
N053.19.45.081 E014.24.09.097 N053.18.33.258 E014.23.40.584 
N053.18.33.258 E014.23.40.584 N053.17.34.124 E014.24.29.164 
N053.17.34.124 E014.24.29.164 N053.16.29.703 E014.24.36.556 
N053.16.29.703 E014.24.36.556 N053.15.22.110 E014.26.23.219 
N053.15.22.110 E014.26.23.219 N053.13.52.352 E014.25.23.024 
N053.13.52.352 E014.25.23.024 N053.11.58.286 E014.23.52.202 
N053.11.58.286 E014.23.52.202 N053.11.22.388 E014.22.28.771 
N053.11.22.388 E014.22.28.771 N053.10.35.916 E014.21.57.089
N053.10.35.916 E014.21.57.089 N053.10.00.000 E014.21.57.089
N053.10.00.000 E014.21.57.089 N053.09.45.228 E014.21.56.035



;EPWW_S


;GRANICA FIR S
N053.22.52.000 E023.44.23.000 N053.35.23.932 E023.38.10.141
N053.35.23.932 E023.38.10.141 N053.36.03.002 E023.37.01.497
N053.36.03.002 E023.37.01.497 N053.40.13.298 E023.36.11.860
N053.40.13.298 E023.36.11.860 N053.44.15.135 E023.36.29.809
N053.44.15.135 E023.36.29.809 N053.46.54.601 E023.33.39.781
N053.46.54.601 E023.33.39.781 N053.50.41.661 E023.33.36.616
N053.50.41.661 E023.33.36.616 N054.00.00.330 E023.28.52.530
N054.00.00.330 E023.28.52.530 N054.00.23.552 E023.29.02.033
N054.00.23.552 E023.29.02.033 N054.01.00.521 E023.29.46.391
N054.01.00.521 E023.29.46.391 N054.01.32.203 E023.30.47.646
N054.01.32.203 E023.30.47.646 N054.07.50.270 E023.30.05.397
N054.07.50.270 E023.30.05.397 N054.13.37.726 E023.21.52.214
N054.13.37.726 E023.21.52.214 N054.18.53.487 E023.02.54.820
N054.18.53.487 E023.02.54.820 N054.20.44.380 E023.03.30.725
N054.20.44.380 E023.03.30.725 N054.22.19.426 E022.59.59.512
N054.22.19.426 E022.59.59.512 N054.25.43.250 E022.51.27.316
N054.25.43.250 E022.51.27.316 N054.24.31.440 E022.48.24.613
N054.24.31.440 E022.48.24.613 N054.22.02.534 E022.47.14.912
N054.22.02.534 E022.47.14.912 N054.21.29.795 E022.43.04.623
N054.21.29.795 E022.43.04.623 N054.20.02.138 E022.00.00.405
N054.20.02.138 E022.00.00.405 N054.19.50.520 E021.53.00.089
N054.19.50.520 E021.53.00.089 N054.19.53.692 E021.33.56.357
N054.19.53.692 E021.33.56.357 N054.19.12.507 E021.27.26.665
N054.19.12.507 E021.27.26.665 N054.21.12.890 E021.00.00.240
N054.21.12.890 E021.00.00.240 N054.22.04.635 E020.38.20.214
N054.22.04.635 E020.38.20.214 N054.22.54.000 E020.30.00.000

[ARTCC]

;B
POLAND N053.41.55.732 E014.16.10.697 N053.41.00.814 E014.16.10.697 
N053.41.00.814 E014.16.10.697 N053.40.34.419 E014.16.42.375 
N053.40.34.419 E014.16.42.375 N053.39.33.157 E014.16.30.761 
N053.39.33.157 E014.16.30.761 N053.38.51.972 E014.17.01.389 
N053.38.51.972 E014.17.01.389 N053.37.57.068 E014.16.51.882 
N053.37.57.068 E014.16.51.882 N053.36.16.735 E014.18.46.995 
N053.36.16.735 E014.18.46.995 N053.34.48.020 E014.18.41.714 
N053.34.48.020 E014.18.41.714 N053.33.18.262 E014.18.54.390 
N053.33.18.262 E014.18.54.390 N053.32.27.560 E014.18.12.144 
N053.32.27.560 E014.18.12.144 N053.31.50.605 E014.18.08.975 
N053.31.50.605 E014.18.08.975 N053.31.29.484 E014.18.39.603 
N053.31.29.484 E014.18.39.603 N053.30.29.279 E014.18.53.329 
N053.30.29.279 E014.18.53.329 N053.29.47.036 E014.19.46.135 
N053.29.47.036 E014.19.46.135 N053.29.26.972 E014.20.48.445 
N053.29.26.972 E014.20.48.445 N053.26.54.894 E014.21.15.901 
N053.26.54.894 E014.21.15.901 N053.26.24.270 E014.21.40.191 
N053.26.24.270 E014.21.40.191 N053.26.06.321 E014.22.06.592 
N053.26.06.321 E014.22.06.592 N053.24.32.333 E014.21.49.694 
N053.24.32.333 E014.21.49.694 N053.24.06.982 E014.22.20.322 
N053.24.06.982 E014.22.20.322 N053.22.32.994 E014.23.02.564 
N053.22.32.994 E014.23.02.564 N053.22.01.312 E014.23.09.956 
N053.22.01.312 E014.23.09.956 N053.21.08.509 E014.23.06.787 
N053.21.08.509 E014.23.06.787 N053.20.49.503 E014.23.20.520 
N053.20.49.503 E014.23.20.520 N053.19.45.081 E014.24.09.097 
N053.19.45.081 E014.24.09.097 N053.18.33.258 E014.23.40.584 
N053.18.33.258 E014.23.40.584 N053.17.34.124 E014.24.29.164 
N053.17.34.124 E014.24.29.164 N053.16.29.703 E014.24.36.556 
N053.16.29.703 E014.24.36.556 N053.15.22.110 E014.26.23.219 
N053.15.22.110 E014.26.23.219 N053.13.52.352 E014.25.23.024 
N053.13.52.352 E014.25.23.024 N053.11.58.286 E014.23.52.202 
N053.11.58.286 E014.23.52.202 N053.11.22.388 E014.22.28.771 
N053.11.22.388 E014.22.28.771 N053.10.35.916 E014.21.57.089
N053.10.35.916 E014.21.57.089 N053.10.00.000 E014.21.57.089
N053.10.00.000 E014.21.57.089 N053.09.45.228 E014.21.56.035


;D
N053.09.45.228 E014.21.56.035 N053.07.51.176 E014.22.55.172
N053.07.51.176 E014.22.55.172 N053.03.26.090 E014.21.18.016
N053.03.26.090 E014.21.18.016 N053.02.07.950 E014.19.52.470
N053.02.07.950 E014.19.52.470 N053.00.00.165 E014.15.51.684
N053.00.00.165 E014.15.51.684 N052.58.55.744 E014.14.11.361
N052.58.55.744 E014.14.11.361 N052.58.30.393 E014.11.53.013
N052.58.30.393 E014.11.53.013 N052.57.04.850 E014.08.35.527
N052.57.04.850 E014.08.35.527 N052.56.51.118 E014.08.23.909
N052.56.51.118 E014.08.23.909 N052.55.46.696 E014.08.24.966
N052.55.46.696 E014.08.24.966 N052.54.19.053 E014.08.57.702
N052.54.19.053 E014.08.57.702 N052.52.03.866 E014.09.17.769
N052.52.03.866 E014.09.17.769 N052.50.29.878 E014.07.44.835
N052.50.29.878 E014.07.44.835 N052.49.23.342 E014.07.17.379
N052.49.23.342 E014.07.17.379 N052.48.40.042 E014.08.09.125
N052.48.40.042 E014.08.09.125 N052.48.53.775 E014.10.21.133
N052.48.53.775 E014.10.21.133 N052.48.24.208 E014.12.54.265
N052.48.24.208 E014.12.54.265 N052.46.50.220 E014.15.28.451
N052.46.50.220 E014.15.28.451 N052.45.34.181 E014.16.52.939
N052.45.34.181 E014.16.52.939 N052.43.54.906 E014.21.40.191
N052.43.54.906 E014.21.40.191 N052.42.18.803 E014.23.19.463
N052.42.18.803 E014.23.19.463 N052.41.22.828 E014.24.48.170
N052.41.22.828 E014.24.48.170 N052.39.46.725 E014.26.17.939
N052.39.46.725 E014.26.17.939 N052.39.35.107 E014.27.28.694
N052.39.35.107 E014.27.28.694 N052.38.56.037 E014.27.48.761
N052.38.56.037 E014.27.48.761 N052.38.34.915 E014.28.43.676
N052.38.34.915 E014.28.43.676 N052.35.29.041 E014.36.17.792
N052.35.29.041 E014.36.17.792 N052.33.49.779 E014.38.11.848
N052.33.49.779 E014.38.11.848 N052.33.01.192 E014.38.07.625
N052.33.01.192 E014.38.07.625 N052.32.25.294 E014.37.20.099
N052.32.25.294 E014.37.20.099 N052.30.34.401 E014.36.25.181
N052.30.34.401 E014.36.25.181 N052.29.55.331 E014.36.55.808
N052.29.55.331 E014.36.55.808 N052.29.24.706 E014.38.07.625
N052.29.24.706 E014.38.07.625 N052.27.58.107 E014.38.04.456
N052.27.58.107 E014.38.04.456 N052.27.20.080 E014.36.50.528
N052.27.20.080 E014.36.50.528 N052.26.54.743 E014.36.43.136
N052.26.54.743 E014.36.43.136 N052.25.54.538 E014.35.24.986
N052.25.54.538 E014.35.24.986 N052.25.23.914 E014.33.24.596
N052.25.23.914 E014.33.24.596 N052.24.48.016 E014.32.31.790
N052.24.48.016 E014.32.31.790 N052.23.42.537 E014.32.36.013
N052.23.42.537 E014.32.36.013 N052.22.53.950 E014.32.19.118
N052.22.53.950 E014.32.19.118 N052.22.20.154 E014.32.48.688
N052.22.20.154 E014.32.48.688 N052.22.00.090 E014.33.14.032
N052.22.00.090 E014.33.14.032 N052.21.52.701 E014.33.22.481
N052.21.52.701 E014.33.22.481 N052.20.39.835 E014.33.18.255
N052.20.39.835 E014.33.18.255 N052.18.33.107 E014.34.00.501
N052.18.33.107 E014.34.00.501 N052.17.39.247 E014.35.03.865
N052.17.39.247 E014.35.03.865 N052.17.04.393 E014.35.13.368
N052.17.04.393 E014.35.13.368 N052.16.51.717 E014.34.58.584
N052.16.51.717 E014.34.58.584 N052.16.21.093 E014.34.30.071
N052.16.21.093 E014.34.30.071 N052.16.01.029 E014.34.56.469
N052.16.01.029 E014.34.56.469 N052.15.30.405 E014.35.28.155
N052.15.30.405 E014.35.28.155 N052.13.56.403 E014.42.03.127
N052.13.56.403 E014.42.03.127 N052.13.07.830 E014.42.40.089
N052.13.07.830 E014.42.40.089 N052.11.39.115 E014.42.37.978
N052.11.39.115 E014.42.37.978 N052.11.06.376 E014.41.32.499
N052.11.06.376 E014.41.32.499 N052.10.22.032 E014.41.12.435
N052.10.22.032 E014.41.12.435 N052.09.42.948 E014.42.10.519
N052.09.42.948 E014.42.10.519 N052.09.00.706 E014.42.34.809
N052.09.00.706 E014.42.34.809 N052.08.14.234 E014.41.31.445
N052.08.14.234 E014.41.31.445 N052.07.07.711 E014.40.50.257
N052.07.07.711 E014.40.50.257 N052.05.42.169 E014.40.56.594
N052.05.42.169 E014.40.56.594 N052.04.48.309 E014.41.30.391
N052.04.48.309 E014.41.30.391 N052.03.57.621 E014.44.24.641
N052.03.57.621 E014.44.24.641 N052.03.26.982 E014.44.58.434
N052.03.26.982 E014.44.58.434 N052.02.24.676 E014.45.01.603
N052.02.24.676 E014.45.01.603 N052.01.54.052 E014.44.24.641
N052.01.54.052 E014.44.24.641 N052.00.44.357 E014.44.20.418
N052.00.44.357 E014.44.20.418 N052.00.00.000 E014.43.54.017
N052.00.00.000 E014.43.54.017 N051.59.20.916 E014.42.48.538
N051.59.20.916 E014.42.48.538 N051.57.50.100 E014.43.04.379
N051.57.50.100 E014.43.04.379 N051.57.21.591 E014.42.34.809
N051.57.21.591 E014.42.34.809 N051.56.16.112 E014.42.39.035
N051.56.16.112 E014.42.39.035 N051.55.14.864 E014.43.07.548
N051.55.14.864 E014.43.07.548 N051.54.09.385 E014.41.59.962
N051.54.09.385 E014.41.59.962 N051.52.26.938 E014.41.20.881
N051.52.26.938 E014.41.20.881 N051.51.59.485 E014.40.46.034
N051.51.59.485 E014.40.46.034 N051.52.11.104 E014.39.54.285
N051.52.11.104 E014.39.54.285 N051.50.00.146 E014.37.57.061
N051.50.00.146 E014.37.57.061 N051.49.48.528 E014.36.36.799
N051.49.48.528 E014.36.36.799 N051.48.38.834 E014.35.34.489
N051.48.38.834 E014.35.34.489 N051.47.43.916 E014.35.32.378
N051.47.43.916 E014.35.32.378 N051.47.00.616 E014.36.05.117
N051.47.00.616 E014.36.05.117 N051.46.04.641 E014.38.12.902
N051.46.04.641 E014.38.12.902 N051.44.54.946 E014.39.15.211
N051.44.54.946 E014.39.15.211 N051.43.29.404 E014.39.02.539
N051.43.29.404 E014.39.02.539 N051.42.00.689 E014.40.06.960
N051.42.00.689 E014.40.06.960 N051.38.29.477 E014.45.14.279
N051.38.29.477 E014.45.14.279 N051.37.43.005 E014.45.13.218
N051.37.43.005 E014.45.13.218 N051.37.02.878 E014.45.43.849
N051.37.02.878 E014.45.43.849 N051.35.51.054 E014.45.23.782
N051.35.51.054 E014.45.23.782 N051.35.23.602 E014.45.31.174
N051.35.23.602 E014.45.31.174 N051.35.02.481 E014.45.50.183
N051.35.02.481 E014.45.50.183 N051.32.33.575 E014.43.18.109
N051.32.33.575 E014.43.18.109 N051.31.54.505 E014.42.54.876
N051.31.54.505 E014.42.54.876 N051.31.37.600 E014.42.59.099
N051.31.37.600 E014.42.59.099 N051.31.34.441 E014.43.10.714
N051.31.34.441 E014.43.10.714 N051.31.23.867 E014.43.52.956
N051.31.23.867 E014.43.52.956 N051.30.55.357 E014.44.04.574
N051.30.55.357 E014.44.04.574 N051.30.42.000 E014.43.50.848

;- NOAA object 46
;T
N051.30.42.000 E014.43.50.848 N051.30.31.078 E014.43.50.848
N051.30.31.078 E014.43.50.848 N051.30.01.497 E014.44.23.587
N051.30.01.497 E014.44.23.587 N051.29.39.318 E014.47.47.408
N051.29.39.318 E014.47.47.408 N051.28.59.191 E014.49.00.278
N051.28.59.191 E014.49.00.278 N051.26.22.896 E014.57.26.136
N051.26.22.896 E014.57.26.136 N051.24.54.182 E014.58.25.277
N051.24.54.182 E014.58.25.277 N051.24.16.169 E014.57.32.471
N051.24.16.169 E014.57.32.471 N051.23.45.545 E014.57.49.369
N051.23.45.545 E014.57.49.369 N051.23.11.748 E014.57.35.643
N051.23.11.748 E014.57.35.643 N051.22.07.327 E014.57.51.484
N051.22.07.327 E014.57.51.484 N051.21.05.021 E014.58.44.287
N051.21.05.021 E014.58.44.287 N051.20.29.109 E014.58.49.567
N051.20.29.109 E014.58.49.567 N051.19.47.924 E014.58.22.108
N051.19.47.924 E014.58.22.108 N051.19.03.567 E014.58.28.446
N051.19.03.567 E014.58.28.446 N051.17.34.852 E014.59.52.934
N051.17.34.852 E014.59.52.934 N051.16.56.840 E015.00.00.323
N051.16.56.840 E015.00.00.323 N051.15.50.304 E015.01.33.257
N051.15.50.304 E015.01.33.257 N051.14.14.201 E015.01.56.493
N051.14.14.201 E015.01.56.493 N051.08.35.204 E015.00.00.323
N051.08.35.204 E015.00.00.323 N051.07.34.999 E014.59.29.698
N051.07.34.999 E014.59.29.698 N051.06.25.304 E014.59.38.148
N051.06.25.304 E014.59.38.148 N051.03.50.067 E014.58.31.612
N051.03.50.067 E014.58.31.612 N051.03.02.538 E014.58.31.612
N051.03.02.538 E014.58.31.612 N051.02.27.684 E014.58.05.210
N051.02.27.684 E014.58.05.210 N051.01.58.117 E014.58.08.382
N051.01.58.117 E014.58.08.382 N051.00.51.581 E014.56.55.512
N051.00.51.581 E014.56.55.512 N050.59.59.835 E014.56.58.678
N050.59.59.835 E014.56.58.678 N050.59.02.802 E014.56.05.874
N050.59.02.802 E014.56.05.874 N050.58.25.847 E014.56.02.706
N050.58.25.847 E014.56.02.706 N050.58.00.496 E014.55.23.632
N050.58.00.496 E014.55.23.632 N050.56.53.960 E014.55.08.845
N050.56.53.960 E014.55.08.845 N050.56.08.559 E014.54.00.201
N050.56.08.559 E014.54.00.201 N050.55.34.763 E014.53.50.698
N050.55.34.763 E014.53.50.698 N050.54.29.284 E014.54.00.201
N050.54.29.284 E014.54.00.201 N050.51.21.308 E014.49.18.230
N050.51.21.308 E014.49.18.230 N050.50.40.109 E014.49.24.568
N050.50.40.109 E014.49.24.568 N050.50.04.211 E014.49.52.023
N050.50.04.211 E014.49.52.023 N050.50.36.951 E014.51.31.295
N050.50.36.951 E014.51.31.295 N050.50.21.103 E014.52.43.108
N050.50.21.103 E014.52.43.108 N050.50.44.339 E014.54.08.650
N050.50.44.339 E014.54.08.650 N050.50.02.097 E014.57.33.532
N050.50.02.097 E014.57.33.532 N050.50.21.103 E014.59.01.182
N050.50.21.103 E014.59.01.182 N050.52.19.384 E014.59.50.820
N050.52.19.384 E014.59.50.820 N050.53.29.093 E014.59.04.351
N050.53.29.093 E014.59.04.351 N050.54.11.335 E015.00.00.323
N050.54.11.335 E015.00.00.323 N050.55.11.526 E015.00.49.960
N050.55.11.526 E015.00.49.960 N050.55.46.381 E015.00.33.062
N050.55.46.381 E015.00.33.062 N050.57.04.521 E015.00.53.129
N050.57.04.521 E015.00.53.129 N050.57.28.814 E015.00.00.323
N050.57.28.814 E015.00.00.323 N050.57.21.426 E014.58.36.895
N050.57.21.426 E014.58.36.895 N050.57.41.490 E014.58.18.940
N050.57.41.490 E014.58.18.940 N050.58.46.968 E014.59.09.631
N050.58.46.968 E014.59.09.631 N050.59.03.860 E015.00.00.323
N050.59.03.860 E015.00.00.323 N050.59.55.605 E015.01.29.034
N050.59.55.605 E015.01.29.034 N050.58.21.617 E015.02.30.286
N050.58.21.617 E015.02.30.286 N050.59.38.714 E015.04.08.500
N050.59.38.714 E015.04.08.500 N050.59.14.420 E015.04.27.514
N050.59.14.420 E015.04.27.514 N050.58.56.472 E015.06.17.346
N050.58.56.472 E015.06.17.346 N050.58.24.790 E015.05.50.941
N050.58.24.790 E015.05.50.941 N050.57.59.439 E015.06.03.613
N050.57.59.439 E015.06.03.613 N050.57.56.280 E015.06.36.352
N050.57.56.280 E015.06.36.352 N050.57.40.432 E015.08.06.118
N050.57.40.432 E015.08.06.118 N050.58.53.299 E015.08.34.634
N050.58.53.299 E015.08.34.634 N050.59.12.306 E015.09.10.542
N050.59.12.306 E015.09.10.542 N050.59.11.262 E015.10.04.399
N050.59.11.262 E015.10.04.399 N050.57.40.432 E015.10.27.635
N050.57.40.432 E015.10.27.635 N050.57.15.081 E015.11.08.820
N050.57.15.081 E015.11.08.820 N050.57.12.980 E015.11.42.617
N050.57.12.980 E015.11.42.617 N050.57.48.878 E015.12.29.082
N050.57.48.878 E015.12.29.082 N050.57.53.108 E015.13.27.166
N050.57.53.108 E015.13.27.166 N050.57.48.878 E015.14.13.631
N050.57.48.878 E015.14.13.631 N050.57.21.426 E015.14.31.587
N050.57.21.426 E015.14.31.587 N050.57.07.693 E015.15.46.568
N050.57.07.693 E015.15.46.568 N050.55.29.475 E015.17.33.232
N050.55.29.475 E015.17.33.232 N050.54.14.494 E015.16.11.912
N050.54.14.494 E015.16.11.912 N050.53.14.302 E015.15.58.186
N050.53.14.302 E015.15.58.186 N050.50.42.224 E015.17.05.773
N050.50.42.224 E015.17.05.773 N050.49.59.982 E015.17.57.522
N050.49.59.982 E015.17.57.522 N050.49.17.739 E015.20.58.110
N050.49.17.739 E015.20.58.110 N050.48.32.338 E015.21.49.859
N050.48.32.338 E015.21.49.859 N050.46.04.476 E015.21.47.747
N050.46.04.476 E015.21.47.747 N050.45.47.585 E015.22.18.372
N050.45.47.585 E015.22.18.372 N050.45.59.203 E015.22.23.652
N050.45.59.203 E015.22.23.652 N050.45.01.112 E015.22.21.541
N050.45.01.112 E015.22.21.541 N050.44.52.667 E015.23.01.672
N050.44.52.667 E015.23.01.672 N050.45.19.075 E015.24.11.373
N050.45.19.075 E015.24.11.373 N050.46.42.502 E015.25.37.969
N050.46.42.502 E015.25.37.969 N050.46.49.891 E015.26.20.212
N050.46.49.891 E015.26.20.212 N050.46.18.209 E015.27.45.757
N050.46.18.209 E015.27.45.757 N050.45.34.909 E015.28.33.280
N050.45.34.909 E015.28.33.280 N050.45.21.176 E015.29.01.793
N050.45.21.176 E015.29.01.793 N050.45.31.737 E015.30.16.775
N050.45.31.737 E015.30.16.775 N050.44.52.667 E015.30.40.007
N050.44.52.667 E015.30.40.007 N050.44.48.437 E015.31.12.747
N050.44.48.437 E015.31.12.747 N050.45.05.342 E015.32.27.728
N050.45.05.342 E015.32.27.728 N050.44.54.781 E015.33.54.328
N050.44.54.781 E015.33.54.328 N050.45.03.227 E015.34.33.402
N050.45.03.227 E015.34.33.402 N050.44.33.660 E015.36.46.467
N050.44.33.660 E015.36.46.467 N050.43.40.857 E015.38.40.525
N050.43.40.857 E015.38.40.525 N050.43.25.009 E015.40.28.243
N050.43.25.009 E015.40.28.243 N050.42.51.213 E015.40.46.195
N050.42.51.213 E015.40.46.195 N050.42.44.882 E015.41.35.833
N050.42.44.882 E015.41.35.833 N050.42.32.206 E015.43.12.990
N050.42.32.206 E015.43.12.990 N050.42.53.328 E015.45.21.832
N050.42.53.328 E015.45.21.832 N050.42.43.824 E015.46.08.301
N050.42.43.824 E015.46.08.301 N050.43.22.895 E015.48.23.477
N050.43.22.895 E015.48.23.477 N050.42.33.264 E015.49.13.111
N050.42.33.264 E015.49.13.111 N050.38.34.586 E015.51.56.804
N050.38.34.586 E015.51.56.804 N050.38.22.968 E015.52.40.101
N050.38.22.968 E015.52.40.101 N050.39.15.785 E015.55.32.243
N050.39.15.785 E015.55.32.243 N050.39.09.440 E015.56.02.867
N050.39.09.440 E015.56.02.867 N050.39.44.294 E015.57.52.699
N050.39.44.294 E015.57.52.699 N050.38.55.707 E015.59.45.701
N050.38.55.707 E015.59.45.701 N050.38.12.421 E016.00.00.488
N050.38.12.421 E016.00.00.488 N050.37.31.222 E016.00.14.214
N050.37.31.222 E016.00.14.214 N050.37.21.719 E016.00.13.156
N050.37.21.719 E016.00.13.156 N050.37.14.331 E016.00.11.048
N050.37.14.331 E016.00.11.048 N050.37.15.388 E016.00.00.488
N050.37.15.388 E016.00.00.488 N050.37.16.446 E015.59.59.430
N050.37.16.446 E015.59.59.430 N050.37.14.331 E015.59.56.265
N050.37.14.331 E015.59.56.265 N050.37.13.273 E015.59.56.265
N050.37.13.273 E015.59.56.265 N050.37.12.216 E015.59.53.096
N050.37.12.216 E015.59.53.096 N050.37.09.044 E015.59.53.096
N050.37.09.044 E015.59.53.096 N050.37.08.000 E015.59.50.981
N050.37.08.000 E015.59.50.981 N050.37.04.828 E015.59.48.869
N050.37.04.828 E015.59.48.869 N050.36.54.267 E015.59.43.593
N050.36.54.267 E015.59.43.593 N050.36.52.152 E015.59.43.593
N050.36.52.152 E015.59.43.593 N050.36.51.095 E015.59.42.532
N050.36.51.095 E015.59.42.532 N050.36.46.879 E015.59.42.532
N050.36.46.879 E015.59.42.532 N050.36.40.534 E015.59.42.532
N050.36.40.534 E015.59.42.532 N050.36.39.477 E015.59.43.593
N050.36.39.477 E015.59.43.593 N050.36.36.304 E015.59.43.593
N050.36.36.304 E015.59.43.593 N050.36.27.859 E015.59.47.815
N050.36.27.859 E015.59.47.815 N050.36.25.757 E015.59.50.981
N050.36.25.757 E015.59.50.981 N050.36.24.686 E015.59.50.981
N050.36.24.686 E015.59.50.981 N050.36.20.470 E016.00.00.488
N050.36.20.470 E016.00.00.488 N050.36.20.470 E016.00.00.488
N050.36.20.470 E016.00.00.488 N050.36.10.967 E016.00.24.774
N050.36.10.967 E016.00.24.774 N050.36.06.737 E016.00.43.787
N050.36.06.737 E016.00.43.787 N050.36.39.477 E016.03.36.980 
N050.36.39.477 E016.03.36.980 N050.39.24.230 E016.05.39.484 
N050.39.24.230 E016.05.39.484 N050.39.05.210 E016.09.15.984 
N050.39.05.210 E016.09.15.984 N050.37.22.776 E016.11.30.106 
N050.37.22.776 E016.11.30.106 N050.38.01.847 E016.13.26.273 
N050.38.01.847 E016.13.26.273 N050.39.43.237 E016.13.44.229 
N050.39.43.237 E016.13.44.229 N050.39.23.173 E016.17.33.397 
N050.39.23.173 E016.17.33.397 N050.39.27.403 E016.20.25.532 
N050.39.27.403 E016.20.25.532 N050.36.06.737 E016.25.50.803 
N050.36.06.737 E016.25.50.803 N050.34.13.743 E016.26.39.390 
N050.34.13.743 E016.26.39.390 N050.30.08.734 E016.22.21.705 
N050.30.08.734 E016.22.21.705 N050.30.08.734 E016.18.39.926 
N050.30.08.734 E016.18.39.926 N050.25.21.483 E016.11.56.508 
N050.25.21.483 E016.11.56.508 N050.24.19.177 E016.14.58.153 
N050.24.19.177 E016.14.58.153 N050.22.02.932 E016.16.22.638 
N050.22.02.932 E016.16.22.638 N050.22.56.793 E016.20.18.143 
N050.22.56.793 E016.20.18.143 N050.22.09.277 E016.22.14.310 
N050.22.09.277 E016.22.14.310 N050.20.31.059 E016.22.11.145 
N050.20.31.059 E016.22.11.145 N050.19.05.517 E016.26.14.039 
N050.19.05.517 E016.26.14.039 N050.13.40.239 E016.32.49.011 
N050.13.40.239 E016.32.49.011 N050.09.54.250 E016.33.22.808 
N050.09.54.250 E016.33.22.808 N050.07.14.770 E016.37.02.472 
N050.07.14.770 E016.37.02.472 N050.05.54.515 E016.41.30.717 
N050.05.54.515 E016.41.30.717 N050.06.12.464 E016.43.23.712 
N050.06.12.464 E016.43.23.712 N050.12.02.035 E016.49.55.518 
N050.12.02.035 E016.49.55.518 N050.11.45.130 E016.51.49.577 
N050.11.45.130 E016.51.49.577 N050.13.21.233 E016.53.38.349 
N050.13.21.233 E016.53.38.349 N050.13.20.175 E016.57.26.466 
N050.13.20.175 E016.57.26.466 N050.14.12.979 E016.57.41.250 
N050.14.12.979 E016.57.41.250 N050.13.11.730 E016.59.59.595
N050.13.11.730 E016.59.59.595 N050.13.20.175 E017.01.07.181 
N050.13.20.175 E017.01.07.181 N050.15.00.508 E017.00.11.213 
N050.15.00.508 E017.00.11.213 N050.16.26.050 E017.01.14.577 
N050.16.26.050 E017.01.14.577 N050.18.00.038 E016.59.59.595
N050.18.00.038 E016.59.59.595 N050.19.00.230 E016.56.29.433 
N050.19.00.230 E016.56.29.433 N050.24.06.501 E016.51.58.023 
N050.24.06.501 E016.51.58.023 N050.26.43.853 E016.54.08.973 
N050.26.43.853 E016.54.08.973 N050.25.29.929 E016.59.59.595 
N050.25.29.929 E016.59.59.595 N050.23.54.883 E017.04.14.107 
N050.23.54.883 E017.04.14.107 N050.24.14.947 E017.06.15.554 
N050.24.14.947 E017.06.15.554 N050.22.36.729 E017.08.44.460 
N050.22.36.729 E017.08.44.460 N050.23.06.296 E017.11.46.105 
N050.23.06.296 E017.11.46.105 N050.21.42.869 E017.11.03.863 
N050.21.42.869 E017.11.03.863 N050.18.52.841 E017.17.48.345 
N050.18.52.841 E017.17.48.345 N050.19.38.256 E017.20.30.977 
N050.19.38.256 E017.20.30.977 N050.18.59.186 E017.21.30.118 
N050.18.59.186 E017.21.30.118 N050.16.04.929 E017.20.30.977 
N050.16.04.929 E017.20.30.977 N050.15.43.808 E017.21.34.341 
N050.15.43.808 E017.21.34.341 N050.17.01.948 E017.24.23.310 
N050.17.01.948 E017.24.23.310 N050.15.08.954 E017.25.33.018 
N050.15.08.954 E017.25.33.018 N050.16.21.821 E017.29.41.193 
N050.16.21.821 E017.29.41.193 N050.15.52.254 E017.36.30.948 
N050.15.52.254 E017.36.30.948 N050.15.59.642 E017.38.38.733 
N050.15.59.642 E017.38.38.733 N050.17.35.745 E017.40.54.971 
N050.17.35.745 E017.40.54.971 N050.19.20.307 E017.41.01.308 
N050.19.20.307 E017.41.01.308 N050.19.21.960 E017.42.43.400
N050.19.21.960 E017.42.43.400 N050.18.12.714 E017.44.57.865
N050.18.12.714 E017.44.57.865 N050.15.38.521 E017.43.29.157 
N050.15.38.521 E017.43.29.157 N050.13.44.469 E017.45.32.719 
N050.13.44.469 E017.45.32.719 N050.12.29.487 E017.45.21.101 
N050.12.29.487 E017.45.21.101 N050.11.59.920 E017.42.40.577 
N050.11.59.920 E017.42.40.577 N050.10.58.658 E017.42.16.283 
N050.10.58.658 E017.42.16.283 N050.10.04.797 E017.36.06.662 
N050.10.04.797 E017.36.06.662 N050.09.24.670 E017.35.55.044 
N050.09.24.670 E017.35.55.044 N050.06.15.636 E017.40.13.779 
N050.06.15.636 E017.40.13.779 N050.06.49.433 E017.41.27.710 
N050.06.49.433 E017.41.27.710 N050.06.19.866 E017.43.59.781 
N050.06.19.866 E017.43.59.781 N050.05.37.624 E017.43.24.934 
N050.05.37.624 E017.43.24.934 N049.59.59.670 E017.48.17.466 
N049.59.59.670 E017.48.17.466 N049.59.44.894 E017.49.16.606 
N049.59.44.894 E017.49.16.606 N049.59.08.982 E017.50.30.531 
N049.59.08.982 E017.50.30.531 N049.58.38.358 E017.52.19.309 
N049.58.38.358 E017.52.19.309 N049.58.26.740 E017.53.25.838 
N049.58.26.740 E017.53.25.838 N049.58.28.855 E017.54.17.584 
N049.58.28.855 E017.54.17.584 N049.58.49.976 E017.55.49.464 
N049.58.49.976 E017.55.49.464 N049.59.23.773 E017.56.32.764 
N049.59.23.773 E017.56.32.764 N049.59.59.670 E017.58.06.752 
N049.59.59.670 E017.58.06.752 N049.59.59.670 E017.58.06.752 
N049.59.59.670 E017.58.06.752 N050.00.21.849 E017.58.32.103 
N050.00.21.849 E017.58.32.103 N050.00.50.359 E017.59.11.180 
N050.00.50.359 E017.59.11.180 N050.00.58.818 E017.59.43.912 
N050.00.58.818 E017.59.43.912 N050.00.55.646 E017.59.59.753 
N050.00.55.646 E017.59.59.753 N050.00.22.906 E018.03.21.469 
N050.00.22.906 E018.03.21.469 N050.02.46.539 E018.00.16.651 
N050.02.46.539 E018.00.16.651 N050.03.23.494 E018.03.40.475
N050.03.23.494 E018.03.40.475 N050.02.52.000 E018.05.52.000




;J
N050.02.52.000 E018.05.52.000 N049.59.59.670 E018.06.41.063 
N049.59.59.670 E018.06.41.063 N049.59.53.340 E018.07.11.687 
N049.59.53.340 E018.07.11.687 N049.59.57.556 E018.07.38.096 
N049.59.57.556 E018.07.38.096 N049.59.54.397 E018.08.04.497 
N049.59.54.397 E018.08.04.497 N049.59.17.428 E018.08.57.293 
N049.59.17.428 E018.08.57.293 N049.59.11.097 E018.09.26.867 
N049.59.11.097 E018.09.26.867 N049.59.17.428 E018.09.42.708 
N049.59.17.428 E018.09.42.708 N049.59.59.670 E018.10.33.403
N049.59.59.670 E018.10.33.403 N049.59.59.670 E018.12.50.691
N049.59.59.670 E018.12.50.691 N049.58.06.676 E018.13.46.666 
N049.58.06.676 E018.13.46.666 N049.57.46.612 E018.16.34.579 
N049.57.46.612 E018.16.34.579 N049.56.09.452 E018.17.21.051 
N049.56.09.452 E018.17.21.051 N049.56.42.191 E018.19.35.166 
N049.56.42.191 E018.19.35.166 N049.55.30.368 E018.20.30.084 
N049.55.30.368 E018.20.30.084 N049.56.15.783 E018.23.58.131 
N049.56.15.783 E018.23.58.131 N049.54.22.788 E018.29.22.344 
N049.54.22.788 E018.29.22.344 N049.54.50.240 E018.34.29.666 
N049.54.50.240 E018.34.29.666 N049.51.33.805 E018.34.29.666 
N049.51.33.805 E018.34.29.666 N049.50.27.283 E018.35.50.979 
N049.50.27.283 E018.35.50.979 N049.49.03.855 E018.34.48.673 
N049.49.03.855 E018.34.48.673 N049.42.55.278 E018.38.11.439 
N049.42.55.278 E018.38.11.439 N049.40.16.869 E018.48.44.025 
N049.40.16.869 E018.48.44.025 N049.32.52.266 E018.51.35.116 
N049.32.52.266 E018.51.35.116 N049.31.27.781 E018.50.49.702 
N049.31.27.781 E018.50.49.702 N049.30.38.136 E018.57.54.248 
N049.30.38.136 E018.57.54.248 N049.25.37.152 E018.59.20.841 
N049.25.37.152 E018.59.20.841 N049.24.02.107 E018.58.22.757 
N049.24.02.107 E018.58.22.757 N049.24.02.107 E018.59.59.918 
N049.24.02.107 E018.59.59.918 N049.23.39.928 E019.01.58.199 
N049.23.39.928 E019.01.58.199 N049.25.14.987 E019.04.34.493 
N049.25.14.987 E019.04.34.493 N049.24.16.897 E019.08.05.712 
N049.24.16.897 E019.08.05.712 N049.24.48.579 E019.11.30.594 
N049.24.48.579 E019.11.30.594 N049.26.40.516 E019.11.49.600 
N049.26.40.516 E019.11.49.600 N049.27.31.218 E019.14.03.723 
N049.27.31.218 E019.14.03.723 N049.31.24.608 E019.15.20.812 
N049.31.24.608 E019.15.20.812 N049.32.19.526 E019.22.15.855 
N049.32.19.526 E019.22.15.855 N049.34.16.750 E019.23.14.996 
N049.34.16.750 E019.23.14.996 N049.35.56.012 E019.27.37.961 
N049.35.56.012 E019.27.37.961 N049.34.09.348 E019.31.51.415 
N049.34.09.348 E019.31.51.415 N049.30.05.397 E019.33.11.677 
N049.30.05.397 E019.33.11.677 N049.26.44.745 E019.36.27.048 
N049.26.44.745 E019.36.27.048 N049.26.46.860 E019.38.33.783 
N049.26.46.860 E019.38.33.783 N049.24.03.164 E019.38.28.502 
N049.24.03.164 E019.38.28.502 N049.23.12.476 E019.43.54.824 
N049.23.12.476 E019.43.54.824 N049.24.13.725 E019.45.38.322 
N049.24.13.725 E019.45.38.322 N049.24.16.897 E019.47.33.438 
N049.24.16.897 E019.47.33.438 N049.17.35.580 E019.47.43.992 
N049.17.35.580 E019.47.43.992 N049.16.22.713 E019.49.22.209 
N049.16.22.713 E019.49.22.209 N049.13.55.922 E019.46.02.608 
N049.13.55.922 E019.46.02.608 N049.12.18.762 E019.46.15.284 
N049.12.18.762 E019.46.15.284 N049.11.33.347 E019.47.19.705 
N049.11.33.347 E019.47.19.705 N049.11.51.310 E019.48.34.687 
N049.11.51.310 E019.48.34.687 N049.11.25.959 E019.52.37.587 
N049.11.25.959 E019.52.37.587 N049.13.49.591 E019.55.35.003 
N049.13.49.591 E019.55.35.003 N049.13.30.571 E020.00.00.082 
N049.13.30.571 E020.00.00.082 N049.12.22.992 E020.00.51.828 
N049.12.22.992 E020.00.51.828 N049.10.41.602 E020.05.38.029 
N049.10.41.602 E020.05.38.029 N049.17.10.243 E020.08.01.654 
N049.17.10.243 E020.08.01.654 N049.18.38.958 E020.08.37.559 
N049.18.38.958 E020.08.37.559 N049.18.15.721 E020.09.56.764 
N049.18.15.721 E020.09.56.764 N049.20.49.901 E020.13.35.371 
N049.20.49.901 E020.13.35.371 N049.20.52.016 E020.17.31.934 
N049.20.52.016 E020.17.31.934 N049.20.22.449 E020.18.59.584 
N049.20.22.449 E020.18.59.584 N049.23.12.476 E020.18.53.253 
N049.23.12.476 E020.18.53.253 N049.23.57.891 E020.19.17.540 
N049.23.57.891 E020.19.17.540 N049.23.57.891 E020.21.57.007 
N049.23.57.891 E020.21.57.007 N049.22.54.513 E020.23.10.931 
N049.22.54.513 E020.23.10.931 N049.24.23.228 E020.25.58.850 
N049.24.23.228 E020.25.58.850 N049.24.46.464 E020.26.54.819 
N049.24.46.464 E020.26.54.819 N049.24.38.018 E020.29.15.279 
N049.24.38.018 E020.29.15.279 N049.22.57.686 E020.32.39.103 
N049.22.57.686 E020.32.39.103 N049.22.49.240 E020.35.13.289 
N049.22.49.240 E020.35.13.289 N049.24.58.082 E020.37.01.010 
N049.24.58.082 E020.37.01.010 N049.24.01.049 E020.39.28.858 
N049.24.01.049 E020.39.28.858 N049.24.55.967 E020.42.00.930 
N049.24.55.967 E020.42.00.930 N049.24.49.636 E020.43.44.428 
N049.24.49.636 E020.43.44.428 N049.19.58.155 E020.49.22.374 
N049.19.58.155 E020.49.22.374 N049.20.21.391 E020.51.51.280 
N049.20.21.391 E020.51.51.280 N049.19.45.480 E020.52.41.968 
N049.19.45.480 E020.52.41.968 N049.19.05.352 E020.52.32.465 
N049.19.05.352 E020.52.32.465 N049.19.07.467 E020.54.31.804 
N049.19.07.467 E020.54.31.804 N049.17.41.925 E020.56.26.913 
N049.17.41.925 E020.56.26.913 N049.18.18.880 E020.59.27.501 
N049.18.18.880 E020.59.27.501 N049.19.38.091 E021.00.00.240
N049.19.38.091 E021.00.00.240 N049.21.45.876 E021.03.29.344 
N049.21.45.876 E021.03.29.344 N049.22.00.667 E021.06.00.365 
N049.22.00.667 E021.06.00.365 N049.25.08.643 E021.04.02.084 
N049.25.08.643 E021.04.02.084 N049.25.51.942 E021.08.36.666 
N049.25.51.942 E021.08.36.666 N049.24.10.000 E021.11.56.000


;R
N049.24.10.000 E021.11.56.000 N049.27.09.039 E021.17.13.086  
N049.27.09.039 E021.17.13.086 N049.25.48.770 E021.23.22.714 
N049.25.48.770 E021.23.22.714 N049.25.58.273 E021.24.29.243 
N049.25.58.273 E021.24.29.243 N049.24.49.636 E021.27.27.723 
N049.24.49.636 E021.27.27.723 N049.26.37.357 E021.33.57.415 
N049.26.37.357 E021.33.57.415 N049.26.04.618 E021.35.27.180 
N049.26.04.618 E021.35.27.180 N049.26.41.573 E021.38.18.264 
N049.26.41.573 E021.38.18.264 N049.25.08.643 E021.39.58.590 
N049.25.08.643 E021.39.58.590 N049.24.45.406 E021.43.38.255 
N049.24.45.406 E021.43.38.255 N049.21.09.965 E021.46.54.684 
N049.21.09.965 E021.46.54.684 N049.23.23.036 E021.50.48.074 
N049.23.23.036 E021.50.48.074 N049.21.15.252 E021.54.03.452 
N049.21.15.252 E021.54.03.452 N049.20.33.009 E021.56.20.740 
N049.20.33.009 E021.56.20.740 N049.20.43.570 E021.58.23.245 
N049.20.43.570 E021.58.23.245 N049.18.17.836 E022.00.00.405
N049.18.17.836 E022.00.00.405 N049.14.43.452 E022.02.30.368 
N049.14.43.452 E022.02.30.368 N049.13.01.004 E022.03.06.273 
N049.13.01.004 E022.03.06.273 N049.12.03.972 E022.08.41.047 
N049.12.03.972 E022.08.41.047 N049.10.41.602 E022.11.34.247 
N049.10.41.602 E022.11.34.247 N049.11.04.838 E022.14.13.713 
N049.11.04.838 E022.14.13.713 N049.09.10.786 E022.14.07.375 
N049.09.10.786 E022.14.07.375 N049.08.11.638 E022.19.08.360 
N049.08.11.638 E022.19.08.360 N049.08.54.938 E022.22.20.565 
N049.08.54.938 E022.22.20.565 N049.06.17.586 E022.24.57.917 
N049.06.17.586 E022.24.57.917 N049.05.16.338 E022.34.12.363
N049.05.16.338 E022.34.12.363 N049.05.29.013 E022.36.51.829
N049.05.29.013 E022.36.51.829 N049.02.30.526 E022.41.35.915
N049.02.30.526 E022.41.35.915 N049.03.27.559 E022.46.41.115
N049.03.27.559 E022.46.41.115 N049.02.21.023 E022.48.26.728
N049.02.21.023 E022.48.26.728 N049.05.34.286 E022.54.08.898
N049.05.34.286 E022.54.08.898 N049.07.08.275 E022.50.11.277
N049.07.08.275 E022.50.11.277 N049.09.35.066 E022.47.41.314
N049.09.35.066 E022.47.41.314 N049.09.51.971 E022.45.02.905
N049.09.51.971 E022.45.02.905 N049.10.58.507 E022.45.25.083
N049.10.58.507 E022.45.25.083 N049.10.29.984 E022.43.44.751
N049.10.29.984 E022.43.44.751 N049.10.25.768 E022.42.47.725
N049.10.25.768 E022.42.47.725 N049.11.23.844 E022.43.12.011
N049.11.23.844 E022.43.12.011 N049.13.08.406 E022.45.05.013
N049.13.08.406 E022.45.05.013 N049.13.50.649 E022.43.58.483
N049.13.50.649 E022.43.58.483 N049.16.30.102 E022.47.21.250
N049.16.30.102 E022.47.21.250 N049.19.35.977 E022.48.47.850
N049.19.35.977 E022.48.47.850 N049.26.59.536 E022.41.46.476
N049.26.59.536 E022.41.46.476 N049.28.33.524 E022.42.07.597
N049.28.33.524 E022.42.07.597 N049.31.36.227 E022.40.00.863
N049.31.36.227 E022.40.00.863 N049.32.41.691 E022.40.10.366
N049.32.41.691 E022.40.10.366 N049.41.21.290 E022.48.04.550
N049.41.21.290 E022.48.04.550 N049.43.01.609 E022.51.12.526
N049.43.01.609 E022.51.12.526 N049.51.07.410 E022.59.59.512
N049.51.07.410 E022.59.59.512 N049.52.26.622 E023.02.05.182
N049.52.26.622 E023.02.05.182 N049.53.10.965 E023.02.35.814
N049.53.10.965 E023.02.35.814 N049.53.48.992 E023.03.13.833
N049.53.48.992 E023.03.13.833 N049.56.01.006 E023.05.55.408
N049.56.01.006 E023.05.55.408 N049.56.41.134 E023.06.22.867
N049.56.41.134 E023.06.22.867 N049.57.18.089 E023.07.04.052
N049.57.18.089 E023.07.04.052 N049.57.39.210 E023.07.46.294
N049.57.39.210 E023.07.46.294 N049.58.11.949 E023.08.19.033
N049.58.11.949 E023.08.19.033 N049.58.32.013 E023.08.54.945
N049.58.32.013 E023.08.54.945 N049.59.59.670 E023.10.39.494
N049.59.59.670 E023.10.39.494 N050.01.03.034 E023.12.05.036
N050.01.03.034 E023.12.05.036 N050.03.36.170 E023.14.10.706
N050.03.36.170 E023.14.10.706 N050.04.04.679 E023.15.44.701
N050.04.04.679 E023.15.44.701 N050.05.49.228 E023.17.37.695
N050.05.49.228 E023.17.37.695 N050.08.16.033 E023.21.38.481
N050.08.16.033 E023.21.38.481 N050.10.45.996 E023.25.54.057
N050.10.45.996 E023.25.54.057 N050.12.21.042 E023.27.25.937
N050.12.21.042 E023.27.25.937 N050.16.38.726 E023.35.53.904
N050.16.38.726 E023.35.53.904 N050.18.12.714 E023.36.50.930
N050.18.12.714 E023.36.50.930 N050.19.46.702 E023.40.12.646
N050.19.46.702 E023.40.12.646 N050.20.40.562 E023.41.23.405
N050.20.40.562 E023.41.23.405 N050.23.44.323 E023.43.24.852
N050.23.44.323 E023.43.24.852 N050.24.20.220 E023.45.04.120
N050.24.20.220 E023.45.04.120 N050.25.10.922 E023.47.14.019
N050.25.10.922 E023.47.14.019 N050.24.50.858 E023.54.41.795
N050.24.50.858 E023.54.41.795 N050.25.25.699 E023.59.59.670
N050.25.25.699 E023.59.59.670 N050.27.10.247 E024.02.58.150
N050.27.10.247 E024.02.58.150 N050.38.18.752 E024.05.59.795
N050.38.18.752 E024.05.59.795 N050.41.15.110 E024.03.57.291
N050.41.15.110 E024.03.57.291 N050.42.58.615 E024.04.50.094
N050.42.58.615 E024.04.50.094 N050.46.25.597 E023.59.59.670
N050.46.25.597 E023.59.59.670 N050.47.00.451 E023.58.13.014
N050.47.00.451 E023.58.13.014 N050.48.56.618 E023.58.04.561
N050.48.56.618 E023.58.04.561 N050.50.27.448 E023.59.59.670
N050.50.27.448 E023.59.59.670 N050.50.14.772 E024.06.40.980
N050.50.14.772 E024.06.40.980 N050.51.49.818 E024.08.56.160
N050.51.49.818 E024.08.56.160 N050.56.29.680 E023.59.59.670
N050.56.29.680 E023.59.59.670 N050.56.56.075 E023.59.14.263
N050.56.56.075 E023.59.14.263 N050.57.16.139 E023.58.49.976
N050.57.16.139 E023.58.49.976 N050.58.43.796 E023.58.24.632
N050.58.43.796 E023.58.24.632 N050.58.58.586 E023.58.09.841
N050.58.58.586 E023.58.09.841 N050.59.59.835 E023.56.21.063
N050.59.59.835 E023.56.21.063 N051.00.09.338 E023.55.45.158
N051.00.09.338 E023.55.45.158 N051.02.18.181 E023.56.03.114
N051.02.18.181 E023.56.03.114 N051.04.08.016 E023.55.18.757
N051.04.08.016 E023.55.18.757 N051.07.19.165 E023.51.34.869
N051.07.19.165 E023.51.34.869 N051.08.56.325 E023.52.42.463
N051.08.56.325 E023.52.42.463 N051.13.01.334 E023.44.37.718
N051.13.01.334 E023.44.37.718 N051.16.11.425 E023.43.22.737
N051.16.11.425 E023.43.22.737 N051.17.30.636 E023.39.15.620
N051.17.30.636 E023.39.15.620 N051.18.51.949 E023.38.44.989
N051.18.51.949 E023.38.44.989 N051.20.01.657 E023.39.06.110
N051.20.01.657 E023.39.06.110 N051.24.39.405 E023.42.29.934
N051.24.39.405 E023.42.29.934 N051.26.46.119 E023.39.31.454
N051.26.46.119 E023.39.31.454 N051.27.54.770 E023.40.28.487
N051.27.54.770 E023.40.28.487 N051.32.05.066 E023.34.22.024
N051.32.05.066 E023.34.22.024 N051.33.42.226 E023.34.46.317
N051.33.42.226 E023.34.46.317 N051.37.09.208 E023.32.36.418
N051.37.09.208 E023.32.36.418 N051.39.29.669 E023.32.42.756
N051.39.29.669 E023.32.42.756 N051.39.47.631 E023.33.28.163
N051.39.47.631 E023.33.28.163 N051.42.57.708 E023.33.29.228
N051.42.57.708 E023.33.29.228 N051.43.30.448 E023.32.27.972
N051.43.30.448 E023.32.27.972 N051.44.46.487 E023.32.31.138
N051.44.46.487 E023.32.31.138 N051.47.52.362 E023.38.44.989
N051.47.52.362 E023.38.44.989 N051.51.04.568 E023.36.42.484
N051.51.04.568 E023.36.42.484 N051.51.46.810 E023.37.18.396
N051.51.46.810 E023.37.18.396 N051.53.03.907 E023.36.49.879
N051.53.03.907 E023.36.49.879 N051.53.34.531 E023.38.14.364
N051.53.34.531 E023.38.14.364 N051.54.49.513 E023.37.03.605
N051.54.49.513 E023.37.03.605 N051.55.41.258 E023.37.24.727
N051.55.41.258 E023.37.24.727 N052.00.00.000 E023.41.37.131
N052.00.00.000 E023.41.37.131 N052.01.26.600 E023.39.37.792
N052.01.26.600 E023.39.37.792 N052.05.07.315 E023.38.53.441
N052.05.07.315 E023.38.53.441 N052.06.51.864 E023.36.25.586
N052.06.51.864 E023.36.25.586 N052.06.52.921 E023.33.04.934
N052.06.52.921 E023.33.04.934 N052.09.09.152 E023.29.55.894
N052.09.09.152 E023.29.55.894 N052.10.37.866 E023.30.05.397
N052.10.37.866 E023.30.05.397 N052.10.32.593 E023.26.07.783
N052.10.32.593 E023.26.07.783 N052.11.17.000 E023.24.16.000


;E 
N052.11.17.000 E023.24.16.000 N052.12.23.472 E023.22.18.615
N052.12.23.472 E023.22.18.615 N052.13.59.575 E023.12.06.093
N052.13.59.575 E023.12.06.093 N052.14.48.162 E023.11.51.303
N052.14.48.162 E023.11.51.303 N052.15.29.347 E023.12.36.718
N052.15.29.347 E023.12.36.718 N052.16.36.927 E023.12.06.093
N052.16.36.927 E023.12.06.093 N052.17.06.508 E023.10.18.372
N052.17.06.508 E023.10.18.372 N052.21.47.414 E023.14.29.719
N052.21.47.414 E023.14.29.719 N052.27.50.705 E023.18.28.390
N052.27.50.705 E023.18.28.390 N052.33.23.371 E023.25.09.700
N052.33.23.371 E023.25.09.700 N052.36.39.806 E023.33.58.795
N052.36.39.806 E023.33.58.795 N052.40.01.515 E023.54.54.470
N052.40.01.515 E023.54.54.470 N052.56.26.838 E023.56.20.013
N052.56.26.838 E023.56.20.013 N052.57.34.417 E023.57.04.370
N052.57.34.417 E023.57.04.370 N052.58.14.559 E023.56.34.796
N052.58.14.559 E023.56.34.796 N053.00.00.165 E023.56.49.579
N053.00.00.165 E023.56.49.579 N053.04.08.332 E023.53.25.756
N053.04.08.332 E023.53.25.756 N053.09.07.202 E023.55.16.642
N053.09.07.202 E023.55.16.642 N053.11.48.783 E023.52.05.494
N053.11.48.783 E023.52.05.494 N053.13.43.906 E023.52.15.004
N053.13.43.906 E023.52.15.004 N053.18.04.749 E023.46.38.108
N053.18.04.749 E023.46.38.108 N053.22.52.000 E023.44.23.000

;S
N053.22.52.000 E023.44.23.000 N053.35.23.932 E023.38.10.141
N053.35.23.932 E023.38.10.141 N053.36.03.002 E023.37.01.497
N053.36.03.002 E023.37.01.497 N053.40.13.298 E023.36.11.860
N053.40.13.298 E023.36.11.860 N053.44.15.135 E023.36.29.809
N053.44.15.135 E023.36.29.809 N053.46.54.601 E023.33.39.781
N053.46.54.601 E023.33.39.781 N053.50.41.661 E023.33.36.616
N053.50.41.661 E023.33.36.616 N054.00.00.330 E023.28.52.530
;granica z EYVL poczatek
N054.00.00.330 E023.28.52.530 N054.00.23.552 E023.29.02.033
N054.00.23.552 E023.29.02.033 N054.01.00.521 E023.29.46.391
N054.01.00.521 E023.29.46.391 N054.01.32.203 E023.30.47.646
N054.01.32.203 E023.30.47.646 N054.07.50.270 E023.30.05.397
N054.07.50.270 E023.30.05.397 N054.13.37.726 E023.21.52.214
N054.13.37.726 E023.21.52.214 N054.18.53.487 E023.02.54.820
N054.18.53.487 E023.02.54.820 N054.20.44.380 E023.03.30.725
N054.20.44.380 E023.03.30.725 N054.22.19.426 E022.59.59.512
N054.22.19.426 E022.59.59.512 N054.25.43.250 E022.51.27.316
N054.25.43.250 E022.51.27.316 N054.24.31.440 E022.48.24.613
N054.24.31.440 E022.48.24.613 N054.22.02.534 E022.47.14.912
;granica z EYVL koniec
N054.22.02.534 E022.47.14.912 N054.21.29.795 E022.43.04.623
N054.21.29.795 E022.43.04.623 N054.20.02.138 E022.00.00.405
N054.20.02.138 E022.00.00.405 N054.19.50.520 E021.53.00.089
N054.19.50.520 E021.53.00.089 N054.19.53.692 E021.33.56.357
N054.19.53.692 E021.33.56.357 N054.19.12.507 E021.27.26.665
N054.19.12.507 E021.27.26.665 N054.21.12.890 E021.00.00.240
N054.21.12.890 E021.00.00.240 N054.22.04.635 E020.38.20.214
N054.22.04.635 E020.38.20.214 N054.22.54.000 E020.30.00.000

;G
N054.22.54.000 E020.30.00.000  N054.24.27.210 E020.15.35.760
N054.24.27.210 E020.15.35.760 N054.24.30.383 E020.11.12.803
N054.24.30.383 E020.11.12.803 N054.25.11.568 E020.05.30.634
N054.25.11.568 E020.05.30.634 N054.25.17.899 E020.00.00.082
N054.25.17.899 E020.00.00.082 N054.25.34.804 E019.58.27.145
N054.25.34.804 E019.58.27.145 N054.25.52.753 E019.54.30.589
N054.25.52.753 E019.54.30.589 N054.26.09.644 E019.52.46.033
N054.26.09.644 E019.52.46.033 N054.26.11.759 E019.51.27.879
N054.26.11.759 E019.51.27.879 N054.26.27.607 E019.49.06.368
N054.26.27.607 E019.49.06.368 N054.26.31.837 E019.48.14.623




;;;;;;ZALEW WISLANY;;;;;;; 
;- NOAA object 131
N054.26.31.837 E019.48.14.623 N054.25.58.040 E019.47.23.935 
N054.25.58.040 E019.47.23.935 N054.26.07.543 E019.45.54.163 
N054.26.07.543 E019.45.54.163 N054.25.54.868 E019.44.47.634 
N054.25.54.868 E019.44.47.634 N054.25.42.192 E019.44.32.843 
N054.25.42.192 E019.44.32.843 N054.25.08.395 E019.44.57.137 
N054.25.08.395 E019.44.57.137 N054.24.50.446 E019.44.44.461 
N054.24.50.446 E019.44.44.461 N054.24.34.599 E019.44.05.391 
N054.24.34.599 E019.44.05.391 N054.24.09.261 E019.43.08.358 
N054.24.09.261 E019.43.08.358 N054.23.30.191 E019.43.03.078 
N054.23.30.191 E019.43.03.078 N054.23.09.070 E019.42.45.129 
N054.23.09.070 E019.42.45.129 N054.22.43.719 E019.42.06.052 
N054.22.43.719 E019.42.06.052 N054.22.33.159 E019.41.26.975 
N054.22.33.159 E019.41.26.975 N054.22.08.865 E019.41.38.593 
N054.22.08.865 E019.41.38.593 N054.21.32.953 E019.40.20.439 
N054.21.32.953 E019.40.20.439 N054.21.21.335 E019.40.15.166 
N054.21.21.335 E019.40.15.166 N054.20.43.323 E019.38.41.171 
N054.20.43.323 E019.38.41.171 N054.20.25.374 E019.37.17.743 
N054.20.25.374 E019.37.17.743 N054.20.25.374 E019.36.35.501 
N054.20.25.374 E019.36.35.501 N054.20.31.705 E019.35.41.640 
N054.20.31.705 E019.35.41.640 N054.20.28.546 E019.35.36.360 
N054.20.28.546 E019.35.36.360 N054.20.25.374 E019.34.18.213 
N054.20.25.374 E019.34.18.213 N054.20.10.583 E019.33.05.339 
N054.20.10.583 E019.33.05.339 N054.19.55.807 E019.32.29.435 
N054.19.55.807 E019.32.29.435 N054.19.36.787 E019.32.06.199 
N054.19.36.787 E019.32.06.199 N054.19.36.787 E019.31.35.574 
N054.19.36.787 E019.31.35.574 N054.19.22.010 E019.31.06.000 
N054.19.22.010 E019.31.06.000 N054.19.25.169 E019.30.29.038 
N054.19.25.169 E019.30.29.038 N054.19.18.838 E019.29.59.471 
N054.19.18.838 E019.29.59.471 N054.17.56.468 E019.27.44.291 
N054.17.56.468 E019.27.44.291 N054.17.24.786 E019.26.41.985 
N054.17.24.786 E019.26.41.985 N054.17.22.671 E019.26.24.029 
N054.17.22.671 E019.26.24.029 N054.17.08.938 E019.25.50.233 
N054.17.08.938 E019.25.50.233 N054.15.44.453 E019.23.57.238 
N054.15.44.453 E019.23.57.238 N054.15.03.268 E019.23.50.901 
N054.15.03.268 E019.23.50.901 N054.14.11.523 E019.23.26.607 
N054.14.11.523 E019.23.26.607 N054.13.41.942 E019.23.08.658 
N054.13.41.942 E019.23.08.658 N054.13.19.777 E019.22.41.199 
N054.13.19.777 E019.22.41.199 N054.13.13.433 E019.22.24.301 
N054.13.13.433 E019.22.24.301 N054.13.13.433 E019.22.00.014 
N054.13.13.433 E019.22.00.014 N054.13.32.439 E019.21.44.173 
N054.13.32.439 E019.21.44.173 N054.13.50.402 E019.21.56.842 
N054.13.50.402 E019.21.56.842 N054.14.14.681 E019.22.32.753 
N054.14.14.681 E019.22.32.753 N054.15.23.332 E019.23.02.320 
N054.15.23.332 E019.23.02.320 N054.16.44.659 E019.24.08.849 
N054.16.44.659 E019.24.08.849 N054.16.46.760 E019.24.00.404 
N054.16.46.760 E019.24.00.404 N054.16.38.314 E019.23.44.563 
N054.16.38.314 E019.23.44.563 N054.16.02.402 E019.23.14.996 
N054.16.02.402 E019.23.14.996 N054.15.55.014 E019.23.00.206 
N054.15.55.014 E019.23.00.206 N054.15.55.014 E019.22.35.919 
N054.15.55.014 E019.22.35.919 N054.16.28.811 E019.20.05.956 
N054.16.28.811 E019.20.05.956 N054.16.37.256 E019.18.11.904 
N054.16.37.256 E019.18.11.904 N054.16.43.587 E019.17.53.948 
N054.16.43.587 E019.17.53.948 N054.16.40.429 E019.17.35.992 
N054.16.40.429 E019.17.35.992 N054.16.47.817 E019.17.32.827 
N054.16.47.817 E019.17.32.827 N054.16.52.047 E019.17.24.381 
N054.16.52.047 E019.17.24.381 N054.16.48.875 E019.16.47.412 
N054.16.48.875 E019.16.47.412 N054.16.30.926 E019.16.24.176 
N054.16.30.926 E019.16.24.176 N054.16.37.256 E019.15.41.933 
N054.16.37.256 E019.15.41.933 N054.16.23.537 E019.15.20.812 
N054.16.23.537 E019.15.20.812 N054.16.33.040 E019.15.20.812 
N054.16.33.040 E019.15.20.812 N054.16.41.486 E019.15.38.768 
N054.16.41.486 E019.15.38.768 N054.16.47.817 E019.15.32.430 
N054.16.47.817 E019.15.32.430 N054.17.02.607 E019.15.45.106 
N054.17.02.607 E019.15.45.106 N054.17.38.505 E019.15.02.863 
N054.17.38.505 E019.15.02.863 N054.18.27.092 E019.16.03.055 
N054.18.27.092 E019.16.03.055 N054.18.32.366 E019.15.38.768 
N054.18.32.366 E019.15.38.768 N054.18.53.487 E019.15.38.768 
N054.18.53.487 E019.15.38.768 N054.19.11.450 E019.15.02.863 
N054.19.11.450 E019.15.02.863 N054.19.20.953 E019.15.09.201 
N054.19.20.953 E019.15.09.201 N054.19.45.233 E019.15.02.863 
N054.19.45.233 E019.15.02.863 N054.19.52.635 E019.14.48.080 
N054.19.52.635 E019.14.48.080 N054.19.49.462 E019.13.54.219 
N054.19.49.462 E019.13.54.219 N054.19.56.851 E019.13.33.098 
N054.19.56.851 E019.13.33.098 N054.20.11.641 E019.13.39.429 
N054.20.11.641 E019.13.39.429 N054.20.22.202 E019.14.05.837 
N054.20.22.202 E019.14.05.837 N054.20.34.877 E019.14.41.742 
N054.20.34.877 E019.14.41.742 N054.20.40.150 E019.15.23.985 
N054.20.40.150 E019.15.23.985 N054.20.52.826 E019.16.11.507 
N054.20.52.826 E019.16.11.507 N054.21.07.616 E019.18.41.471 
N054.21.07.616 E019.18.41.471 N054.21.01.272 E019.21.06.154 
N054.21.01.272 E019.21.06.154 N054.21.07.616 E019.21.17.772 
N054.21.07.616 E019.21.17.772 N054.21.16.062 E019.22.11.632 
N054.21.16.062 E019.22.11.632 N054.21.43.514 E019.23.23.442 
N054.21.43.514 E019.23.23.442 N054.21.58.304 E019.24.47.933 
N054.21.58.304 E019.24.47.933 N054.22.16.253 E019.25.53.405 
N054.22.16.253 E019.25.53.405 N054.22.25.757 E019.26.11.361 
N054.22.25.757 E019.26.11.361 N054.22.31.044 E019.26.41.985 
N054.22.31.044 E019.26.41.985 N054.22.47.949 E019.26.56.769 
N054.22.47.949 E019.26.56.769 N054.22.58.496 E019.27.23.170 
N054.22.58.496 E019.27.23.170 N054.23.28.076 E019.29.17.229 
N054.23.28.076 E019.29.17.229 N054.23.43.911 E019.29.54.191 
N054.23.43.911 E019.29.54.191 N054.23.46.025 E019.30.11.089 
N054.23.46.025 E019.30.11.089 N054.23.52.356 E019.30.17.427 
N054.23.52.356 E019.30.17.427 N054.23.55.529 E019.30.41.714 
N054.23.55.529 E019.30.41.714 N054.24.10.319 E019.31.23.956 
N054.24.10.319 E019.31.23.956 N054.24.16.650 E019.32.17.817 
N054.24.16.650 E019.32.17.817 N054.24.25.096 E019.32.47.384 
N054.24.25.096 E019.32.47.384 N054.25.07.338 E019.34.18.213 
N054.25.07.338 E019.34.18.213 N054.25.28.459 E019.35.41.640 
N054.25.28.459 E019.35.41.640 N054.26.01.198 E019.36.35.501 
N054.26.01.198 E019.36.35.501 N054.26.11.759 E019.37.09.291 
N054.26.11.759 E019.37.09.291 N054.26.23.377 E019.37.14.571 
N054.26.23.377 E019.37.14.571 N054.26.44.498 E019.38.08.432 
N054.26.44.498 E019.38.08.432 N054.26.57.174 E019.38.21.107 
N054.26.57.174 E019.38.21.107 N054.27.11.964 E019.39.02.292 
N054.27.11.964 E019.39.02.292 N054.27.28.856 E019.39.19.190

;- NOAA object 134
N054.27.45.747 E019.38.41.171 N054.27.33.085 E019.39.04.407 
N054.27.33.085 E019.39.04.407 N054.27.28.856 E019.39.19.190 

;- NOAA object 133
N054.27.45.747 E019.38.41.171 N054.26.22.320 E019.35.59.596 
N054.26.22.320 E019.35.59.596 N054.25.15.797 E019.33.18.015 
N054.25.15.797 E019.33.18.015 N054.24.34.599 E019.30.59.669 
N054.24.34.599 E019.30.59.669 N054.24.21.937 E019.30.35.376 
N054.24.21.937 E019.30.35.376 N054.23.21.732 E019.26.53.603 
N054.23.21.732 E019.26.53.603 N054.22.58.496 E019.24.53.207 
N054.22.58.496 E019.24.53.207 N054.22.45.834 E019.24.12.022 
N054.22.45.834 E019.24.12.022 N054.22.22.598 E019.21.48.396 
N054.22.22.598 E019.21.48.396 N054.22.09.922 E019.20.59.816 
N054.22.09.922 E019.20.59.816 N054.22.07.808 E019.20.23.911 
N054.22.07.808 E019.20.23.911 N054.22.01.477 E019.19.59.618 
N054.22.01.477 E019.19.59.618 N054.21.58.304 E019.19.17.375 
N054.21.58.304 E019.19.17.375 N054.21.51.974 E019.18.59.426 
N054.21.51.974 E019.18.59.426 N054.21.51.974 E019.18.29.853 
N054.21.51.974 E019.18.29.853 N054.21.46.686 E019.18.05.566 
N054.21.46.686 E019.18.05.566 N054.21.46.686 E019.17.42.330 
N054.21.46.686 E019.17.42.330 N054.21.34.011 E019.16.23.125 
N054.21.34.011 E019.16.23.125 N054.21.22.393 E019.13.29.926 
N054.21.22.393 E019.13.29.926 N054.21.16.062 E019.12.59.301 
N054.21.16.062 E019.12.59.301 N054.21.10.789 E019.11.29.536 
N054.21.10.789 E019.11.29.536 N054.21.04.444 E019.10.53.632 
N054.21.04.444 E019.10.53.632 N054.21.01.272 E019.08.29.999 
N054.21.01.272 E019.08.29.999 N054.20.58.113 E019.08.23.668 
N054.20.58.113 E019.08.23.668 N054.20.58.113 E019.07.41.426 
N054.20.58.113 E019.07.41.426 N054.20.54.941 E019.07.35.088 
N054.20.54.941 E019.07.35.088 N054.20.54.941 E019.06.59.183 
N054.20.54.941 E019.06.59.183 N054.20.49.667 E019.06.00.043 
N054.20.49.667 E019.06.00.043 N054.20.49.667 E019.04.29.220 
N054.20.49.667 E019.04.29.220 N054.20.46.495 E019.04.23.940 
N054.20.46.495 E019.04.23.940 N054.20.43.323 E019.02.18.263 
N054.20.43.323 E019.02.18.263 N054.20.40.150 E019.02.11.932 
N054.20.40.150 E019.02.11.932 N054.20.40.150 E019.01.11.727 
N054.20.40.150 E019.01.11.727 N054.20.36.992 E019.01.05.396 
N054.20.36.992 E019.01.05.396 N054.20.40.150 E019.00.53.778 
N054.20.40.150 E019.00.53.778 N054.20.40.150 E018.59.59.918 
N054.20.40.150 E018.59.59.918 N054.20.43.323 E018.58.23.815 
N054.20.43.323 E018.58.23.815 N054.20.57.056 E018.57.44.738 
N054.20.57.056 E018.57.44.738 N054.21.01.272 E018.57.36.292 
N054.21.01.272 E018.57.36.292 N054.20.58.113 E018.57.17.286 
N054.20.58.113 E018.57.17.286 N054.21.23.450 E018.57.21.508 
N054.21.23.450 E018.57.21.508 N054.21.25.565 E018.57.12.005 
N054.21.25.565 E018.57.12.005 N054.21.08.674 E018.56.57.215 
N054.21.08.674 E018.56.57.215 N054.20.03.195 E018.56.38.209 
N054.20.03.195 E018.56.38.209 N054.19.52.635 E018.56.23.425 
N054.19.52.635 E018.56.23.425 N054.20.14.813 E018.56.21.310 
N054.20.14.813 E018.56.21.310 N054.21.03.387 E018.56.44.546 
N054.21.03.387 E018.56.44.546 N054.21.19.234 E018.56.42.431 
N054.21.19.234 E018.56.42.431 N054.21.04.444 E018.56.18.145 
N054.21.04.444 E018.56.18.145 N054.20.43.323 E018.55.17.947 
N054.20.43.323 E018.55.17.947 N054.20.49.667 E018.53.17.550 
N054.20.49.667 E018.53.17.550 N054.21.01.272 E018.51.36.167 
N054.21.01.272 E018.51.36.167 N054.21.28.737 E018.49.11.491 
N054.21.28.737 E018.49.11.491 N054.22.19.426 E018.47.41.719 
N054.22.19.426 E018.47.41.719 N054.22.19.426 E018.47.17.432 
N054.22.19.426 E018.47.17.432 N054.22.25.757 E018.46.54.196 
N054.22.25.757 E018.46.54.196 N054.22.08.865 E018.46.57.368 
N054.22.08.865 E018.46.57.368 N054.22.04.635 E018.47.41.719 
N054.22.04.635 E018.47.41.719 N054.22.00.419 E018.47.44.891 
N054.22.00.419 E018.47.44.891 N054.21.54.075 E018.47.33.273 
N054.21.54.075 E018.47.33.273 N054.21.44.572 E018.48.15.515 
N054.21.44.572 E018.48.15.515 N054.21.26.623 E018.47.08.979 
N054.21.26.623 E018.47.08.979 N054.20.52.826 E018.47.36.438 
N054.20.52.826 E018.47.36.438 N054.20.46.495 E018.49.06.210 
N054.20.46.495 E018.49.06.210 N054.20.39.093 E018.49.27.332 
N054.20.39.093 E018.49.27.332 N054.20.34.877 E018.49.24.159 
N054.20.34.877 E018.49.24.159 N054.20.34.877 E018.49.06.210 
N054.20.34.877 E018.49.06.210 N054.20.40.150 E018.48.48.255 
N054.20.40.150 E018.48.48.255 N054.20.36.992 E018.47.48.056 
N054.20.36.992 E018.47.48.056 N054.21.03.387 E018.47.08.979 
N054.21.03.387 E018.47.08.979 N054.21.18.177 E018.47.08.979 
N054.21.18.177 E018.47.08.979 N054.21.39.298 E018.46.51.031 
N054.21.39.298 E018.46.51.031 N054.21.47.744 E018.46.26.737 
N054.21.47.744 E018.46.26.737 N054.22.00.419 E018.46.26.737 
N054.22.00.419 E018.46.26.737 N054.22.02.534 E018.46.51.031 
N054.22.02.534 E018.46.51.031 N054.22.12.037 E018.46.44.693 
N054.22.12.037 E018.46.44.693 N054.22.22.598 E018.46.29.909 
N054.22.22.598 E018.46.29.909 N054.22.19.426 E018.45.59.278 
N054.22.19.426 E018.45.59.278 N054.22.16.253 E018.45.53.998 
N054.22.16.253 E018.45.53.998 N054.22.19.426 E018.44.35.851 
N054.22.19.426 E018.44.35.851 N054.22.36.331 E018.43.32.487 
N054.22.36.331 E018.43.32.487 N054.23.30.191 E018.41.56.384 
N054.23.30.191 E018.41.56.384 N054.23.59.758 E018.41.51.104 
N054.23.59.758 E018.41.51.104 N054.23.59.758 E018.41.33.148 
N054.23.59.758 E018.41.33.148 N054.24.12.434 E018.41.39.486 
N054.24.12.434 E018.41.39.486 N054.24.17.707 E018.41.02.524 
N054.24.17.707 E018.41.02.524 N054.24.27.210 E018.40.57.243 
N054.24.27.210 E018.40.57.243 N054.24.37.771 E018.40.36.122 
N054.24.37.771 E018.40.36.122 N054.24.46.217 E018.39.47.542 
N054.24.46.217 E018.39.47.542 N054.24.42.001 E018.39.39.096 
N054.24.42.001 E018.39.39.096 N054.24.27.210 E018.39.50.707 
N054.24.27.210 E018.39.50.707 N054.24.37.771 E018.39.35.924 
N054.24.37.771 E018.39.35.924 N054.24.31.440 E018.39.11.637 
N054.24.31.440 E018.39.11.637 N054.24.31.440 E018.38.42.063 
N054.24.31.440 E018.38.42.063 N054.24.37.771 E018.38.06.159 
N054.24.37.771 E018.38.06.159 N054.25.22.128 E018.36.23.718 
N054.25.22.128 E018.36.23.718 N054.26.11.759 E018.34.57.125 
N054.26.11.759 E018.34.57.125 N054.27.20.410 E018.33.50.589 
N054.27.20.410 E018.33.50.589 N054.28.02.652 E018.33.45.309 
N054.28.02.652 E018.33.45.309 N054.28.36.449 E018.33.50.589 
N054.28.36.449 E018.33.50.589 N054.29.02.844 E018.34.14.883 
N054.29.02.844 E018.34.14.883 N054.29.17.634 E018.34.14.883 
N054.29.17.634 E018.34.14.883 N054.30.50.565 E018.33.08.347 
N054.30.50.565 E018.33.08.347 N054.31.00.068 E018.33.09.404 
N054.31.00.068 E018.33.09.404 N054.31.08.527 E018.33.38.971 
N054.31.08.527 E018.33.38.971 N054.31.10.628 E018.33.11.512 
N054.31.10.628 E018.33.11.512 N054.31.14.858 E018.33.08.347 
N054.31.14.858 E018.33.08.347 N054.31.16.973 E018.33.29.468 
N054.31.16.973 E018.33.29.468 N054.31.26.476 E018.33.38.971 
N054.31.26.476 E018.33.38.971 N054.31.28.591 E018.33.06.232 
N054.31.28.591 E018.33.06.232 N054.31.32.807 E018.33.03.067 
N054.31.32.807 E018.33.03.067 N054.31.37.037 E018.33.35.806 
N054.31.37.037 E018.33.35.806 N054.31.47.597 E018.33.45.309 
N054.31.47.597 E018.33.45.309 N054.31.47.597 E018.33.03.067 
N054.31.47.597 E018.33.03.067 N054.31.53.928 E018.32.56.729 
N054.31.53.928 E018.32.56.729 N054.32.00.273 E018.33.21.022 
N054.32.00.273 E018.33.21.022 N054.32.04.489 E018.33.17.850 
N054.32.04.489 E018.33.17.850 N054.32.04.489 E018.32.41.945 
N054.32.04.489 E018.32.41.945 N054.31.46.540 E018.31.53.365 
N054.31.46.540 E018.31.53.365 N054.31.52.871 E018.31.54.423 
N054.31.52.871 E018.31.54.423 N054.32.02.388 E018.32.20.824 
N054.32.02.388 E018.32.20.824 N054.32.07.661 E018.32.06.034 
N054.32.07.661 E018.32.06.034 N054.31.58.158 E018.31.36.467 
N054.31.58.158 E018.31.36.467 N054.32.08.719 E018.31.56.531 
N054.32.08.719 E018.31.56.531 N054.32.13.992 E018.31.53.365 
N054.32.13.992 E018.31.53.365 N054.32.12.935 E018.31.41.747 
N054.32.12.935 E018.31.41.747 N054.32.07.661 E018.31.23.791 
N054.32.07.661 E018.31.23.791 N054.32.19.279 E018.31.30.129 
N054.32.19.279 E018.31.30.129 N054.32.16.107 E018.30.59.505 
N054.32.16.107 E018.30.59.505 N054.32.39.343 E018.30.44.721 
N054.32.39.343 E018.30.44.721 N054.32.22.451 E018.31.41.747 
N054.32.22.451 E018.31.41.747 N054.32.22.451 E018.32.23.990 
N054.32.22.451 E018.32.23.990 N054.32.12.935 E018.32.35.608 
N054.32.12.935 E018.32.35.608 N054.32.13.992 E018.32.53.557 
N054.32.13.992 E018.32.53.557 N054.32.18.222 E018.33.08.347 
N054.32.18.222 E018.33.08.347 N054.32.29.840 E018.33.08.347 
N054.32.29.840 E018.33.08.347 N054.32.34.056 E018.33.17.850 
N054.32.34.056 E018.33.17.850 N054.32.25.610 E018.33.35.806 
N054.32.25.610 E018.33.35.806 N054.32.26.667 E018.33.50.589 
N054.32.26.667 E018.33.50.589 N054.32.41.458 E018.33.26.296 
N054.32.41.458 E018.33.26.296 N054.33.05.751 E018.33.45.309 
N054.33.05.751 E018.33.45.309 N054.33.47.994 E018.33.08.347 
N054.33.47.994 E018.33.08.347 N054.34.12.274 E018.33.08.347 
N054.34.12.274 E018.33.08.347 N054.34.50.300 E018.32.50.391 
N054.34.50.300 E018.32.50.391 N054.35.32.542 E018.31.56.531 
N054.35.32.542 E018.31.56.531 N054.36.45.409 E018.30.51.052 
N054.36.45.409 E018.30.51.052 N054.37.41.385 E018.30.44.721 
N054.37.41.385 E018.30.44.721 N054.38.29.958 E018.31.15.346 
N054.38.29.958 E018.31.15.346 N054.38.29.958 E018.31.02.670 
N054.38.29.958 E018.31.02.670 N054.38.07.779 E018.30.41.549 
N054.38.07.779 E018.30.41.549 N054.37.58.276 E018.29.54.026 
N054.37.58.276 E018.29.54.026 N054.37.53.003 E018.29.11.784 
N054.37.53.003 E018.29.11.784 N054.37.55.104 E018.28.47.497 
N054.37.55.104 E018.28.47.497 N054.38.05.678 E018.28.03.140 
N054.38.05.678 E018.28.03.140 N054.38.12.009 E018.28.03.140 
N054.38.12.009 E018.28.03.140 N054.38.23.627 E018.28.26.376 
N054.38.23.627 E018.28.26.376 N054.38.44.748 E018.28.21.096 
N054.38.44.748 E018.28.21.096 N054.38.51.079 E018.28.39.044 
N054.38.51.079 E018.28.39.044 N054.39.05.869 E018.28.39.044 
N054.39.05.869 E018.28.39.044 N054.39.30.163 E018.27.56.802 
N054.39.30.163 E018.27.56.802 N054.40.30.354 E018.28.09.478 
N054.40.30.354 E018.28.09.478 N054.41.03.094 E018.28.03.140 
N054.41.03.094 E018.28.03.140 N054.41.32.661 E018.28.26.376 
N054.41.32.661 E018.28.26.376 N054.41.48.508 E018.28.21.096 
N054.41.48.508 E018.28.21.096 N054.42.23.349 E018.26.44.993 
N054.42.23.349 E018.26.44.993 N054.43.00.318 E018.26.02.750 
N054.43.00.318 E018.26.02.750 N054.43.29.885 E018.25.03.609 
N054.43.29.885 E018.25.03.609 N054.43.28.827 E018.24.41.431 
N054.43.28.827 E018.24.41.431 N054.43.28.827 E018.24.29.813 
N054.43.28.827 E018.24.29.813 N054.43.44.675 E018.23.50.736 
N054.43.44.675 E018.23.50.736 N054.44.30.090 E018.23.50.736 
N054.44.30.090 E018.23.50.736 N054.45.30.281 E018.24.15.029 
N054.45.30.281 E018.24.15.029 N054.46.14.638 E018.25.15.228 
N054.46.14.638 E018.25.15.228 N054.47.11.657 E018.25.20.501 
N054.47.11.657 E018.25.20.501 N054.47.10.600 E018.25.41.622 
N054.47.10.600 E018.25.41.622 N054.47.01.097 E018.25.54.298 
N054.47.01.097 E018.25.54.298 N054.46.46.320 E018.26.59.776 
N054.46.46.320 E018.26.59.776 N054.46.31.530 E018.27.24.063 
N054.46.31.530 E018.27.24.063 N054.46.16.740 E018.28.30.599 
N054.46.16.740 E018.28.30.599 N054.45.58.791 E018.29.00.166 
N054.45.58.791 E018.29.00.166 N054.45.46.115 E018.29.42.408 
N054.45.46.115 E018.29.42.408 N054.45.24.994 E018.30.23.600 
N054.45.24.994 E018.30.23.600 N054.45.19.720 E018.31.12.173 
N054.45.19.720 E018.31.12.173 N054.44.55.427 E018.31.41.747 
N054.44.55.427 E018.31.41.747 N054.44.55.427 E018.32.06.034 
N054.44.55.427 E018.32.06.034 N054.44.46.981 E018.32.35.608 
N054.44.46.981 E018.32.35.608 N054.44.27.975 E018.33.17.850 
N054.44.27.975 E018.33.17.850 N054.44.10.012 E018.34.29.666 
N054.44.10.012 E018.34.29.666 N054.43.48.891 E018.35.11.909 
N054.43.48.891 E018.35.11.909 N054.43.22.496 E018.36.54.342 
N054.43.22.496 E018.36.54.342 N054.42.42.355 E018.38.20.942 
N054.42.42.355 E018.38.20.942 N054.42.01.184 E018.39.11.637 
N054.42.01.184 E018.39.11.637 N054.41.58.011 E018.40.00.217 
N054.41.58.011 E018.40.00.217 N054.41.36.890 E018.40.23.447 
N054.41.36.890 E018.40.23.447 N054.41.36.890 E018.41.17.307 
N054.41.36.890 E018.41.17.307 N054.41.18.928 E018.42.05.887 
N054.41.18.928 E018.42.05.887 N054.40.20.851 E018.43.27.207 
N054.40.20.851 E018.43.27.207 N054.39.53.385 E018.43.50.443 
N054.39.53.385 E018.43.50.443 N054.39.23.818 E018.44.32.685 
N054.39.23.818 E018.44.32.685 N054.38.59.539 E018.44.50.634 
N054.38.59.539 E018.44.50.634 N054.38.08.837 E018.45.57.170 
N054.38.08.837 E018.45.57.170 N054.36.52.798 E018.46.54.196 
N054.36.52.798 E018.46.54.196 N054.36.49.639 E018.47.17.432 
N054.36.49.639 E018.47.17.432 N054.36.32.734 E018.47.51.229 
N054.36.32.734 E018.47.51.229 N054.35.56.822 E018.48.20.796 
N054.35.56.822 E018.48.20.796 N054.35.31.485 E018.48.29.241 
N054.35.31.485 E018.48.29.241 N054.35.31.485 E018.48.41.917 
N054.35.31.485 E018.48.41.917 N054.35.48.376 E018.49.14.656 
N054.35.48.376 E018.49.14.656 N054.36.08.440 E018.49.38.943 
N054.36.08.440 E018.49.38.943 N054.36.29.561 E018.49.50.561 
N054.36.29.561 E018.49.50.561 N054.37.08.645 E018.49.45.281 
N054.37.08.645 E018.49.45.281 N054.37.36.097 E018.49.26.274 
N054.37.36.097 E018.49.26.274 N054.39.12.200 E018.47.20.598 
N054.39.12.200 E018.47.20.598 N054.40.02.902 E018.45.32.877 
N054.40.02.902 E018.45.32.877 N054.41.07.310 E018.43.35.652 
N054.41.07.310 E018.43.35.652 N054.42.01.184 E018.41.29.983 
N054.42.01.184 E018.41.29.983 N054.42.52.929 E018.39.24.313 
N054.42.52.929 E018.39.24.313 N054.43.55.236 E018.36.05.769 
N054.43.55.236 E018.36.05.769 N054.44.29.032 E018.34.36.004 
N054.44.29.032 E018.34.36.004 N054.44.34.306 E018.34.06.430 
N054.44.34.306 E018.34.06.430 N054.44.58.599 E018.32.59.901 
N054.44.58.599 E018.32.59.901 N054.45.22.879 E018.32.12.378 
N054.45.22.879 E018.32.12.378 N054.45.49.287 E018.30.36.269 
N054.45.49.287 E018.30.36.269 N054.47.01.097 E018.27.35.681 
N054.47.01.097 E018.27.35.681 N054.47.33.836 E018.25.47.967 
N054.47.33.836 E018.25.47.967 N054.47.54.957 E018.25.05.717 
N054.47.54.957 E018.25.05.717 N054.47.54.957 E018.24.54.106 
N054.47.54.957 E018.24.54.106 N054.48.07.633 E018.24.47.762 
N054.48.07.633 E018.24.47.762 N054.48.07.633 E018.24.29.813 
N054.48.07.633 E018.24.29.813 N054.48.34.041 E018.23.05.328 
N054.48.34.041 E018.23.05.328 N054.49.23.672 E018.21.09.161 
N054.49.23.672 E018.21.09.161 N054.49.41.621 E018.20.56.486 
N054.49.41.621 E018.20.56.486 N054.50.01.685 E018.20.17.409 
N054.50.01.685 E018.20.17.409 N054.50.13.303 E018.19.00.319 
N054.50.13.303 E018.19.00.319 N054.50.10.144 E018.18.47.644 
N054.50.10.144 E018.18.47.644 N054.50.13.303 E018.16.47.254 
N054.50.13.303 E018.16.47.254 N054.50.01.685 E018.14.12.010 
N054.50.01.685 E018.14.12.010 N054.50.06.972 E018.09.59.606 
N054.50.06.972 E018.09.59.606 N054.50.01.685 E018.05.41.922 
N054.50.01.685 E018.05.41.922 N054.50.06.972 E018.03.29.914 
N054.50.06.972 E018.03.29.914 N054.49.58.526 E017.59.59.753 
N054.49.58.526 E017.59.59.753 N054.49.58.526 E017.59.23.848 
N054.49.58.526 E017.59.23.848 N054.49.55.354 E017.59.17.510 
N054.49.55.354 E017.59.17.510 N054.49.55.354 E017.56.53.885 
N054.49.55.354 E017.56.53.885 N054.49.49.023 E017.56.29.598 
N054.49.49.023 E017.56.29.598 N054.49.43.736 E017.55.17.782 
N054.49.43.736 E017.55.17.782 N054.49.40.563 E017.55.12.502 
N054.49.40.563 E017.55.12.502 N054.49.40.563 E017.54.48.215 
N054.49.40.563 E017.54.48.215 N054.49.37.405 E017.54.41.877 
N054.49.37.405 E017.54.41.877 N054.49.37.405 E017.54.17.584 
N054.49.37.405 E017.54.17.584 N054.49.13.111 E017.52.05.576 
N054.49.13.111 E017.52.05.576 N054.49.13.111 E017.51.42.340 
N054.49.13.111 E017.51.42.340 N054.49.07.838 E017.51.05.385 
N054.49.07.838 E017.51.05.385 N054.48.55.162 E017.50.24.193 
N054.48.55.162 E017.50.24.193 N054.48.37.200 E017.48.35.414 
N054.48.37.200 E017.48.35.414 N054.48.30.869 E017.48.17.466 
N054.48.30.869 E017.48.17.466 N054.48.31.926 E017.47.59.510 
N054.48.31.926 E017.47.59.510 N054.48.28.754 E017.47.54.229 
N054.48.28.754 E017.47.54.229 N054.48.25.595 E017.46.54.031 
N054.48.25.595 E017.46.54.031 N054.48.12.920 E017.46.05.458 
N054.48.12.920 E017.46.05.458 N054.48.13.977 E017.45.35.884 
N054.48.13.977 E017.45.35.884 N054.48.07.633 E017.45.11.597 
N054.48.07.633 E017.45.11.597 N054.48.07.633 E017.44.53.642 
N054.48.07.633 E017.44.53.642 N054.47.58.130 E017.44.24.075 
N054.47.58.130 E017.44.24.075 N054.47.52.856 E017.43.35.495 
N054.47.52.856 E017.43.35.495 N054.47.37.008 E017.42.12.060 
N054.47.37.008 E017.42.12.060 N054.47.13.772 E017.40.53.913 
N054.47.13.772 E017.40.53.913 N054.47.07.441 E017.39.53.715 
N054.47.07.441 E017.39.53.715 N054.46.49.479 E017.38.30.287 
N054.46.49.479 E017.38.30.287 N054.46.49.479 E017.37.59.663 
N054.46.49.479 E017.37.59.663 N054.46.39.976 E017.37.30.089 
N054.46.39.976 E017.37.30.089 N054.46.37.861 E017.36.41.509 
N054.46.37.861 E017.36.41.509 N054.46.34.702 E017.36.36.229 
N054.46.34.702 E017.36.36.229 N054.46.28.358 E017.35.29.700 
N054.46.28.358 E017.35.29.700 N054.46.16.740 E017.34.24.221 
N054.46.16.740 E017.34.24.221 N054.46.10.409 E017.32.53.399 
N054.46.10.409 E017.32.53.399 N054.45.55.618 E017.31.29.964 
N054.45.55.618 E017.31.29.964 N054.45.52.460 E017.30.47.722 
N054.45.52.460 E017.30.47.722 N054.45.46.115 E017.30.18.155 
N054.45.46.115 E017.30.18.155 N054.45.40.842 E017.29.06.339 
N054.45.40.842 E017.29.06.339 N054.45.31.339 E017.28.29.383 
N054.45.31.339 E017.28.29.383 N054.45.31.339 E017.28.06.147 
N054.45.31.339 E017.28.06.147 N054.45.22.879 E017.27.17.567 
N054.45.22.879 E017.27.17.567 N054.45.19.720 E017.24.53.941 
N054.45.19.720 E017.24.53.941 N054.45.13.376 E017.24.24.375 
N054.45.13.376 E017.24.24.375 N054.45.13.376 E017.22.23.978 
N054.45.13.376 E017.22.23.978 N054.45.01.758 E017.21.23.780 
N054.45.01.758 E017.21.23.780 N054.45.01.758 E017.20.59.493 
N054.45.01.758 E017.20.59.493 N054.44.58.599 E017.20.54.213 
N054.44.58.599 E017.20.54.213 N054.44.55.427 E017.20.11.971 
N054.44.55.427 E017.20.11.971 N054.44.27.975 E017.18.24.250 
N054.44.27.975 E017.18.24.250 N054.44.25.860 E017.17.48.345 
N054.44.25.860 E017.17.48.345 N054.44.19.515 E017.17.24.051 
N054.44.19.515 E017.17.24.051 N054.44.19.515 E017.16.41.809 
N054.44.19.515 E017.16.41.809 N054.44.16.357 E017.16.23.853 
N054.44.16.357 E017.16.23.853 N054.43.40.445 E017.13.42.279 
N054.43.40.445 E017.13.42.279 N054.43.12.993 E017.12.35.743 
N054.43.12.993 E017.12.35.743 N054.43.10.878 E017.12.17.794 
N054.43.10.878 E017.12.17.794 N054.42.52.929 E017.11.48.220 
N054.42.52.929 E017.11.48.220 N054.42.22.305 E017.10.12.117 
N054.42.22.305 E017.10.12.117 N054.41.55.897 E017.08.18.058 
N054.41.55.897 E017.08.18.058 N054.41.25.272 E017.07.05.191 
N054.41.25.272 E017.07.05.191 N054.41.18.928 E017.06.35.625 
N054.41.18.928 E017.06.35.625 N054.40.52.533 E017.05.05.859 
N054.40.52.533 E017.05.05.859 N054.40.28.239 E017.04.05.661 
N054.40.28.239 E017.04.05.661 N054.40.13.449 E017.03.00.183 
N054.40.13.449 E017.03.00.183 N054.39.44.940 E017.02.08.430 
N054.39.44.940 E017.02.08.430 N054.39.02.697 E017.01.20.907 
N054.39.02.697 E017.01.20.907 N054.38.19.397 E016.59.59.595 



;- NOAA object 122
N054.04.49.682 E015.00.00.323 N054.05.07.645 E015.01.17.419 
N054.05.07.645 E015.01.17.419 N054.05.46.715 E015.03.24.147 
N054.05.46.715 E015.03.24.147 N054.05.55.161 E015.04.35.963 
N054.05.55.161 E015.04.35.963 N054.06.01.505 E015.05.00.249 
N054.06.01.505 E015.05.00.249 N054.06.04.664 E015.05.54.110 
N054.06.04.664 E015.05.54.110 N054.06.25.785 E015.06.59.588 
N054.06.25.785 E015.06.59.588 N054.06.37.403 E015.08.06.118 
N054.06.37.403 E015.08.06.118 N054.06.55.366 E015.08.53.644 
N054.06.55.366 E015.08.53.644 N054.06.55.366 E015.09.11.596 
N054.06.55.366 E015.09.11.596 N054.07.13.315 E015.10.29.743 
N054.07.13.315 E015.10.29.743 N054.07.19.645 E015.11.18.327 
N054.07.19.645 E015.11.18.327 N054.07.46.054 E015.12.41.758 
N054.07.46.054 E015.12.41.758 N054.07.46.054 E015.12.59.710 
N054.07.46.054 E015.12.59.710 N054.07.55.557 E015.13.48.287 
N054.07.55.557 E015.13.48.287 N054.08.16.678 E015.15.05.383 
N054.08.16.678 E015.15.05.383 N054.08.58.921 E015.17.59.633 
N054.08.58.921 E015.17.59.633 N054.09.04.208 E015.19.24.122 
N054.09.04.208 E015.19.24.122 N054.09.16.870 E015.20.23.259 
N054.09.16.870 E015.20.23.259 N054.09.22.157 E015.21.54.082 
N054.09.22.157 E015.21.54.082 N054.09.36.933 E015.23.05.894 
N054.09.36.933 E015.23.05.894 N054.09.36.933 E015.23.23.850 
N054.09.36.933 E015.23.23.850 N054.09.58.055 E015.25.24.240 
N054.09.58.055 E015.25.24.240 N054.09.58.055 E015.27.36.251 
N054.09.58.055 E015.27.36.251 N054.10.01.227 E015.27.41.535 
N054.10.01.227 E015.27.41.535 N054.09.58.055 E015.28.54.401 
N054.09.58.055 E015.28.54.401 N054.10.01.227 E015.28.59.682 
N054.10.01.227 E015.28.59.682 N054.10.01.227 E015.29.17.634 
N054.10.01.227 E015.29.17.634 N054.10.10.730 E015.29.48.262 
N054.10.10.730 E015.29.48.262 N054.10.10.730 E015.30.06.214 
N054.10.10.730 E015.30.06.214 N054.10.19.176 E015.30.42.119 
N054.10.19.176 E015.30.42.119 N054.10.28.693 E015.31.00.075 
N054.10.28.693 E015.31.00.075 N054.10.43.469 E015.32.00.269 
N054.10.43.469 E015.32.00.269 N054.11.08.820 E015.32.50.961 
N054.11.08.820 E015.32.50.961 N054.11.16.208 E015.33.05.744 
N054.11.16.208 E015.33.05.744 N054.11.16.208 E015.33.59.605 
N054.11.16.208 E015.33.59.605 N054.11.13.036 E015.34.05.946 
N054.11.13.036 E015.34.05.946 N054.11.13.036 E015.34.35.513 
N054.11.13.036 E015.34.35.513 N054.11.25.712 E015.35.35.711 
N054.11.25.712 E015.35.35.711 N054.11.28.884 E015.36.35.906 
N054.11.28.884 E015.36.35.906 N054.11.46.833 E015.37.47.719 
N054.11.46.833 E015.37.47.719 N054.11.45.775 E015.37.59.337 
N054.11.45.775 E015.37.59.337 N054.11.48.948 E015.38.05.671 
N054.11.48.948 E015.38.05.671 N054.11.52.120 E015.38.54.251 
N054.11.52.120 E015.38.54.251 N054.12.04.796 E015.39.53.392 
N054.12.04.796 E015.39.53.392 N054.12.04.796 E015.40.12.402 
N054.12.04.796 E015.40.12.402 N054.12.13.241 E015.40.59.925 
N054.12.13.241 E015.40.59.925 N054.12.19.572 E015.41.17.877 
N054.12.19.572 E015.41.17.877 N054.12.19.572 E015.41.35.833 
N054.12.19.572 E015.41.35.833 N054.12.31.190 E015.42.41.308 
N054.12.31.190 E015.42.41.308 N054.12.43.866 E015.43.18.270 
N054.12.43.866 E015.43.18.270 N054.12.55.484 E015.44.41.701 
N054.12.55.484 E015.44.41.701 N054.13.43.013 E015.47.35.951 
N054.13.43.013 E015.47.35.951 N054.14.04.135 E015.48.29.811 
N054.14.04.135 E015.48.29.811 N054.14.07.293 E015.48.59.382 
N054.14.07.293 E015.48.59.382 N054.14.16.796 E015.49.30.010 
N054.14.16.796 E015.49.30.010 N054.14.40.032 E015.51.30.403 
N054.14.40.032 E015.51.30.403 N054.14.40.032 E015.52.17.925 
N054.14.40.032 E015.52.17.925 N054.14.49.536 E015.53.11.786 
N054.14.49.536 E015.53.11.786 N054.14.49.536 E015.54.18.318 
N054.14.49.536 E015.54.18.318 N054.14.52.708 E015.54.23.599 
N054.14.52.708 E015.54.23.599 N054.14.52.708 E015.55.30.131 
N054.14.52.708 E015.55.30.131 N054.14.57.981 E015.55.59.702 
N054.14.57.981 E015.55.59.702 N054.14.57.981 E015.56.48.282 
N054.14.57.981 E015.56.48.282 N054.15.01.154 E015.56.53.559 
N054.15.01.154 E015.56.53.559 N054.15.01.154 E015.57.17.852 
N054.15.01.154 E015.57.17.852 N054.15.07.498 E015.57.35.804 
N054.15.07.498 E015.57.35.804 N054.15.10.657 E015.58.24.385 
N054.15.10.657 E015.58.24.385 N054.15.15.944 E015.58.42.337 
N054.15.15.944 E015.58.42.337 N054.15.19.102 E015.59.41.478 
N054.15.19.102 E015.59.41.478 N054.15.25.447 E016.00.00.488 
N054.15.25.447 E016.00.00.488 N054.15.25.447 E016.00.30.054 
N054.15.25.447 E016.00.30.054 N054.15.31.778 E016.00.59.628 
N054.15.31.778 E016.00.59.628 N054.15.31.778 E016.01.48.208 
N054.15.31.778 E016.01.48.208 N054.15.52.899 E016.03.06.356 
N054.15.52.899 E016.03.06.356 N054.15.58.186 E016.03.53.878 
N054.15.58.186 E016.03.53.878 N054.17.01.550 E016.07.41.989 
N054.17.01.550 E016.07.41.989 N054.17.04.709 E016.07.48.327 
N054.17.04.709 E016.07.48.327 N054.17.01.550 E016.08.06.282 
N054.17.01.550 E016.08.06.282 N054.16.41.486 E016.08.14.728 
N054.16.41.486 E016.08.14.728 N054.16.41.486 E016.07.50.441 
N054.16.41.486 E016.07.50.441 N054.16.49.932 E016.07.48.327 
N054.16.49.932 E016.07.48.327 N054.16.47.817 E016.07.38.823 
N054.16.47.817 E016.07.38.823 N054.16.23.537 E016.07.09.256 
N054.16.23.537 E016.07.09.256 N054.16.07.690 E016.06.30.179 
N054.16.07.690 E016.06.30.179 N054.15.58.186 E016.05.17.313 
N054.15.58.186 E016.05.17.313 N054.15.40.224 E016.04.36.121 
N054.15.40.224 E016.04.36.121 N054.15.38.123 E016.04.00.216 
N054.15.38.123 E016.04.00.216 N054.15.32.835 E016.03.50.713 
N054.15.32.835 E016.03.50.713 N054.15.19.102 E016.04.18.172 
N054.15.19.102 E016.04.18.172 N054.15.07.498 E016.05.18.363 
N054.15.07.498 E016.05.18.363 N054.15.34.950 E016.06.05.893 
N054.15.34.950 E016.06.05.893 N054.15.37.065 E016.06.30.179 
N054.15.37.065 E016.06.30.179 N054.15.15.944 E016.07.41.989 
N054.15.15.944 E016.07.41.989 N054.15.13.829 E016.08.11.563 
N054.15.13.829 E016.08.11.563 N054.15.04.326 E016.08.29.518 
N054.15.04.326 E016.08.29.518 N054.15.14.886 E016.08.56.971 
N054.15.14.886 E016.08.56.971 N054.15.26.505 E016.09.08.589 
N054.15.26.505 E016.09.08.589 N054.15.38.123 E016.09.29.710 
N054.15.38.123 E016.09.29.710 N054.15.44.453 E016.10.08.787 
N054.15.44.453 E016.10.08.787 N054.16.00.301 E016.10.21.462 
N054.16.00.301 E016.10.21.462 N054.16.34.084 E016.10.17.233 
N054.16.34.084 E016.10.17.233 N054.16.37.256 E016.10.54.202 
N054.16.37.256 E016.10.54.202 N054.16.28.811 E016.11.35.387 
N054.16.28.811 E016.11.35.387 N054.16.28.811 E016.12.17.629 
N054.16.28.811 E016.12.17.629 N054.16.25.638 E016.12.23.967 
N054.16.25.638 E016.12.23.967 N054.16.29.868 E016.12.51.426 
N054.16.29.868 E016.12.51.426 N054.16.39.371 E016.12.51.426 
N054.16.39.371 E016.12.51.426 N054.16.57.320 E016.12.27.132 
N054.16.57.320 E016.12.27.132 N054.17.30.060 E016.12.32.412 
N054.17.30.060 E016.12.32.412 N054.17.57.525 E016.12.20.794 
N054.17.57.525 E016.12.20.794 N054.18.19.704 E016.11.53.335 
N054.18.19.704 E016.11.53.335 N054.18.16.532 E016.11.35.387 
N054.18.16.532 E016.11.35.387 N054.17.13.168 E016.09.24.429 
N054.17.13.168 E016.09.24.429 N054.17.01.550 E016.08.42.187 
N054.17.01.550 E016.08.42.187 N054.17.01.550 E016.08.17.900 
N054.17.01.550 E016.08.17.900 N054.17.08.938 E016.08.03.110 
N054.17.08.938 E016.08.03.110 N054.17.52.238 E016.10.05.614 
N054.17.52.238 E016.10.05.614 N054.18.20.748 E016.11.02.647 
N054.18.20.748 E016.11.02.647 N054.19.24.111 E016.13.03.037 
N054.19.24.111 E016.13.03.037 N054.21.16.062 E016.16.05.739 
N054.21.16.062 E016.16.05.739 N054.21.11.832 E016.16.26.861 
N054.21.11.832 E016.16.26.861 N054.21.04.444 E016.16.23.695 
N054.21.04.444 E016.16.23.695 N054.20.39.093 E016.15.26.662 
N054.20.39.093 E016.15.26.662 N054.20.14.813 E016.14.57.095 
N054.20.14.813 E016.14.57.095 N054.19.35.729 E016.13.38.948 
N054.19.35.729 E016.13.38.948 N054.19.14.608 E016.13.38.948 
N054.19.14.608 E016.13.38.948 N054.19.13.564 E016.13.53.732 
N054.19.13.564 E016.13.53.732 N054.19.16.723 E016.14.06.400 
N054.19.16.723 E016.14.06.400 N054.19.04.048 E016.14.47.592 
N054.19.04.048 E016.14.47.592 N054.19.04.048 E016.15.05.541 
N054.19.04.048 E016.15.05.541 N054.19.11.450 E016.15.26.662 
N054.19.11.450 E016.15.26.662 N054.19.27.284 E016.15.33.000 
N054.19.27.284 E016.15.33.000 N054.20.00.023 E016.15.33.000 
N054.20.00.023 E016.15.33.000 N054.20.01.080 E016.15.47.784 
N054.20.01.080 E016.15.47.784 N054.19.57.908 E016.16.00.459 
N054.19.57.908 E016.16.00.459 N054.20.07.425 E016.16.35.313 
N054.20.07.425 E016.16.35.313 N054.20.07.425 E016.17.12.269 
N054.20.07.425 E016.17.12.269 N054.20.15.871 E016.17.41.842 
N054.20.15.871 E016.17.41.842 N054.20.36.992 E016.18.17.747 
N054.20.36.992 E016.18.17.747 N054.20.40.150 E016.19.06.327 
N054.20.40.150 E016.19.06.327 N054.20.49.667 E016.19.48.570 
N054.20.49.667 E016.19.48.570 N054.21.08.674 E016.20.02.303 
N054.21.08.674 E016.20.02.303 N054.21.36.126 E016.20.03.360 
N054.21.36.126 E016.20.03.360 N054.22.34.216 E016.18.59.996 
N054.22.34.216 E016.18.59.996 N054.21.50.916 E016.17.20.721 
N054.21.50.916 E016.17.20.721 N054.21.36.126 E016.17.02.765 
N054.21.36.126 E016.17.02.765 N054.21.26.623 E016.17.02.765 
N054.21.26.623 E016.17.02.765 N054.21.13.947 E016.16.41.644 
N054.21.13.947 E016.16.41.644 N054.21.24.508 E016.16.20.523 
N054.21.24.508 E016.16.20.523 N054.22.47.949 E016.18.20.919 
N054.22.47.949 E016.18.20.919 N054.23.05.898 E016.18.56.824 
N054.23.05.898 E016.18.56.824 N054.24.02.917 E016.20.08.640 
N054.24.02.917 E016.20.08.640 N054.25.39.020 E016.21.57.412 
N054.25.39.020 E016.21.57.412 N054.26.24.435 E016.22.33.316 
N054.26.24.435 E016.22.33.316 N054.26.57.174 E016.23.38.795 
N054.26.57.174 E016.23.38.795 N054.27.18.295 E016.24.03.089 
N054.27.18.295 E016.24.03.089 N054.28.51.226 E016.25.21.236 
N054.28.51.226 E016.25.21.236 N054.29.13.404 E016.25.53.975 
N054.29.13.404 E016.25.53.975 N054.29.09.188 E016.26.08.758 
N054.29.09.188 E016.26.08.758 N054.28.59.685 E016.26.02.421 
N054.28.59.685 E016.26.02.421 N054.28.51.226 E016.25.44.472 
N054.28.51.226 E016.25.44.472 N054.28.33.277 E016.25.39.191 
N054.28.33.277 E016.25.39.191 N054.28.08.983 E016.25.14.898 
N054.28.08.983 E016.25.14.898 N054.27.54.207 E016.25.14.898 
N054.27.54.207 E016.25.14.898 N054.27.52.092 E016.25.23.351 
N054.27.52.092 E016.25.23.351 N054.28.01.595 E016.26.05.593 
N054.28.01.595 E016.26.05.593 N054.28.13.213 E016.26.29.880 
N054.28.13.213 E016.26.29.880 N054.28.16.385 E016.27.12.122 
N054.28.16.385 E016.27.12.122 N054.28.40.665 E016.27.41.696 
N054.28.40.665 E016.27.41.696 N054.28.41.722 E016.28.02.817 
N054.28.41.722 E016.28.02.817 N054.28.56.513 E016.28.02.817 
N054.28.56.513 E016.28.02.817 N054.29.19.749 E016.28.35.556 
N054.29.19.749 E016.28.35.556 N054.29.30.309 E016.28.50.340 
N054.29.30.309 E016.28.50.340 N054.29.48.258 E016.28.50.340 
N054.29.48.258 E016.28.50.340 N054.30.04.106 E016.28.30.276 
N054.30.04.106 E016.28.30.276 N054.30.04.106 E016.28.17.601 
N054.30.04.106 E016.28.17.601 N054.29.40.870 E016.27.35.358 
N054.29.40.870 E016.27.35.358 N054.29.31.367 E016.26.47.835 
N054.29.31.367 E016.26.47.835 N054.29.23.965 E016.26.26.714 
N054.29.23.965 E016.26.26.714 N054.29.15.519 E016.26.20.376 
N054.29.15.519 E016.26.20.376 N054.29.14.462 E016.26.08.758 
N054.29.14.462 E016.26.08.758 N054.29.30.309 E016.26.08.758 
N054.29.30.309 E016.26.08.758 N054.31.10.628 E016.28.48.225 
N054.31.10.628 E016.28.48.225 N054.31.10.628 E016.28.59.843 
N054.31.10.628 E016.28.59.843 N054.31.22.246 E016.29.29.417 
N054.31.22.246 E016.29.29.417 N054.32.31.955 E016.31.47.762 
N054.32.31.955 E016.31.47.762 N054.32.43.573 E016.32.30.005 
N054.32.43.573 E016.32.30.005 N054.32.43.573 E016.32.59.572 
N054.32.43.573 E016.32.59.572 N054.32.55.177 E016.33.48.152 
N054.32.55.177 E016.33.48.152 N054.33.04.694 E016.34.11.388 
N054.33.04.694 E016.34.11.388 N054.33.43.764 E016.37.05.638 
N054.33.43.764 E016.37.05.638 N054.33.45.879 E016.37.54.218 
N054.33.45.879 E016.37.54.218 N054.34.01.713 E016.39.23.983 
N054.34.01.713 E016.39.23.983 N054.34.01.713 E016.40.06.232 
N054.34.01.713 E016.40.06.232 N054.34.16.503 E016.41.05.366 
N054.34.16.503 E016.41.05.366 N054.34.16.503 E016.41.53.947 
N054.34.16.503 E016.41.53.947 N054.34.10.159 E016.42.41.469 
N054.34.10.159 E016.42.41.469 N054.34.13.331 E016.43.05.763 
N054.34.13.331 E016.43.05.763 N054.34.10.159 E016.45.17.770 
N054.34.10.159 E016.45.17.770 N054.34.49.243 E016.48.12.027 
N054.34.49.243 E016.48.12.027 N054.34.52.415 E016.49.23.837 
N054.34.52.415 E016.49.23.837 N054.35.01.918 E016.49.41.792 
N054.35.01.918 E016.49.41.792 N054.35.04.033 E016.50.06.079 
N054.35.04.033 E016.50.06.079 N054.35.23.039 E016.51.06.277 
N054.35.23.039 E016.51.06.277 N054.35.31.485 E016.52.41.323 
N054.35.31.485 E016.52.41.323 N054.35.39.931 E016.53.29.903 
N054.35.39.931 E016.53.29.903 N054.36.13.727 E016.55.12.344 
N054.36.13.727 E016.55.12.344 N054.36.19.015 E016.55.41.911 
N054.36.19.015 E016.55.41.911 N054.36.52.798 E016.57.18.013 
N054.36.52.798 E016.57.18.013 N054.38.05.678 E016.59.44.811 
N054.38.05.678 E016.59.44.811 N054.38.19.397 E016.59.59.595 

 
;- NOAA object 115
N054.04.49.682 E015.00.00.323 N054.04.37.007 E014.59.11.746 
N054.04.37.007 E014.59.11.746 N054.04.34.905 E014.58.42.176 
N054.04.34.905 E014.58.42.176 N054.04.19.058 E014.57.53.595 
N054.04.19.058 E014.57.53.595 N054.04.10.612 E014.56.59.735 
N054.04.10.612 E014.56.59.735 N054.03.49.491 E014.55.54.260 
N054.03.49.491 E014.55.54.260 N054.03.46.318 E014.55.23.632 
N054.03.46.318 E014.55.23.632 N054.03.25.197 E014.54.05.481 
N054.03.25.197 E014.54.05.481 N054.03.10.421 E014.51.59.812 
N054.03.10.421 E014.51.59.812 N054.02.49.299 E014.50.36.381 
N054.02.49.299 E014.50.36.381 N054.02.37.681 E014.48.53.940 
N054.02.37.681 E014.48.53.940 N054.02.19.719 E014.47.53.742 
N054.02.19.719 E014.47.53.742 N054.02.10.215 E014.46.41.929 
N054.02.10.215 E014.46.41.929 N054.01.55.439 E014.45.48.072 
N054.01.55.439 E014.45.48.072 N054.01.55.439 E014.45.30.116 
N054.01.55.439 E014.45.30.116 N054.01.37.476 E014.44.36.259 
N054.01.37.476 E014.44.36.259 N054.01.34.318 E014.43.54.017 
N054.01.34.318 E014.43.54.017 N054.01.22.700 E014.43.41.345 
N054.01.22.700 E014.43.41.345 N054.01.19.527 E014.44.36.259 
N054.01.19.527 E014.44.36.259 N054.01.40.648 E014.45.30.116 
N054.01.40.648 E014.45.30.116 N054.01.37.476 E014.46.17.642 
N054.01.37.476 E014.46.17.642 N054.01.46.979 E014.46.30.314 
N054.01.46.979 E014.46.30.314 N054.02.01.770 E014.47.17.837 
N054.02.01.770 E014.47.17.837 N054.02.01.770 E014.47.42.127 
N054.02.01.770 E014.47.42.127 N054.01.54.381 E014.48.08.529 
N054.01.54.381 E014.48.08.529 N054.00.57.349 E014.47.56.911 
N054.00.57.349 E014.47.56.911 N054.00.41.515 E014.47.45.293 
N054.00.41.515 E014.47.45.293 N054.00.40.457 E014.47.30.509 
N054.00.40.457 E014.47.30.509 N054.00.37.285 E014.47.06.219 
N054.00.37.285 E014.47.06.219 N054.00.40.457 E014.46.41.929 
N054.00.40.457 E014.46.41.929 N054.00.29.897 E014.46.14.474 
N054.00.29.897 E014.46.14.474 N054.00.11.948 E014.45.56.521 
N054.00.11.948 E014.45.56.521 N054.00.00.330 E014.46.02.856

;- NOAA object 85
N053.41.55.732 E014.16.10.697 N053.41.58.904 E014.18.05.806 
N053.41.58.904 E014.18.05.806 N053.42.17.910 E014.18.26.927 
N053.42.17.910 E014.18.26.927 N053.42.45.363 E014.18.20.593 
N053.42.45.363 E014.18.20.593 N053.43.07.541 E014.17.59.472 
N053.43.07.541 E014.17.59.472 N053.43.16.001 E014.16.59.274 
N053.43.16.001 E014.16.59.274 N053.43.27.605 E014.16.38.153 
N053.43.27.605 E014.16.38.153 N053.43.37.122 E014.16.47.659 
N053.43.37.122 E014.16.47.659 N053.43.31.835 E014.17.29.902 
N053.43.31.835 E014.17.29.902 N053.43.39.223 E014.18.02.637 
N053.43.39.223 E014.18.02.637 N053.44.05.631 E014.17.56.303 
N053.44.05.631 E014.17.56.303 N053.44.11.962 E014.18.08.975 
N053.44.11.962 E014.18.08.975 N053.44.26.753 E014.17.08.780 
N053.44.26.753 E014.17.08.780 N053.44.36.256 E014.17.08.780 
N053.44.36.256 E014.17.08.780 N053.44.25.695 E014.18.53.329 
N053.44.25.695 E014.18.53.329 N053.44.03.517 E014.20.08.311 
N053.44.03.517 E014.20.08.311 N053.42.50.650 E014.20.38.939 
N053.42.50.650 E014.20.38.939 N053.40.49.196 E014.24.29.164 
N053.40.49.196 E014.24.29.164 N053.40.22.801 E014.28.47.902 
N053.40.22.801 E014.28.47.902 N053.39.58.508 E014.30.24.005 
N053.39.58.508 E014.30.24.005 N053.39.28.941 E014.31.35.818 
N053.39.28.941 E014.31.35.818 N053.38.41.411 E014.32.50.800 
N053.38.41.411 E014.32.50.800 N053.37.21.156 E014.33.38.322 
N053.37.21.156 E014.33.38.322 N053.36.27.296 E014.34.26.903 
N053.36.27.296 E014.34.26.903 N053.36.07.232 E014.34.29.014 
N053.36.07.232 E014.34.29.014 N053.36.06.174 E014.35.28.155 
N053.36.06.174 E014.35.28.155 N053.36.11.448 E014.35.45.053 
N053.36.11.448 E014.35.45.053 N053.36.38.914 E014.35.32.378 
N053.36.38.914 E014.35.32.378 N053.37.17.984 E014.35.32.378 
N053.37.17.984 E014.35.32.378 N053.37.32.774 E014.35.45.053 
N053.37.32.774 E014.35.45.053 N053.37.39.105 E014.36.27.296 
N053.37.39.105 E014.36.27.296 N053.37.58.111 E014.36.29.407 
N053.37.58.111 E014.36.29.407 N053.37.53.895 E014.37.02.146 
N053.37.53.895 E014.37.02.146 N053.38.18.189 E014.36.44.194 
N053.38.18.189 E014.36.44.194 N053.38.32.965 E014.36.56.866 
N053.38.32.965 E014.36.56.866 N053.38.34.023 E014.37.11.649 
N053.38.34.023 E014.37.11.649 N053.38.39.310 E014.37.21.156 
N053.38.39.310 E014.37.21.156 N053.38.57.259 E014.37.14.818 
N053.38.57.259 E014.37.14.818 N053.39.01.475 E014.36.53.697 
N053.39.01.475 E014.36.53.697 N053.38.55.144 E014.36.24.127 
N053.38.55.144 E014.36.24.127 N053.39.19.438 E014.36.24.127 
N053.39.19.438 E014.36.24.127 N053.39.19.438 E014.35.23.932 
N053.39.19.438 E014.35.23.932 N053.39.09.934 E014.35.05.980 
N053.39.09.934 E014.35.05.980 N053.39.36.329 E014.34.08.947 
N053.39.36.329 E014.34.08.947 N053.39.51.119 E014.34.15.288 
N053.39.51.119 E014.34.15.288 N053.39.58.508 E014.33.35.154 
N053.39.58.508 E014.33.35.154 N053.40.30.190 E014.32.44.462 
N053.40.30.190 E014.32.44.462 N053.41.06.101 E014.32.50.800 
N053.41.06.101 E014.32.50.800 N053.41.41.999 E014.32.39.182 
N053.41.41.999 E014.32.39.182 N053.41.53.617 E014.32.26.510 
N053.41.53.617 E014.32.26.510 N053.42.17.910 E014.32.26.510 
N053.42.17.910 E014.32.26.510 N053.42.35.859 E014.32.50.800 
N053.42.35.859 E014.32.50.800 N053.43.18.102 E014.33.08.752 
N053.43.18.102 E014.33.08.752 N053.44.18.307 E014.33.14.032 
N053.44.18.307 E014.33.14.032 N053.44.47.874 E014.33.33.042 
N053.44.47.874 E014.33.33.042 N053.45.23.772 E014.33.31.985 
N053.45.23.772 E014.33.31.985 N053.45.20.613 E014.34.02.612 
N053.45.20.613 E014.34.02.612 N053.45.39.619 E014.33.49.940 
N053.45.39.619 E014.33.49.940 N053.45.52.295 E014.34.12.119 
N053.45.52.295 E014.34.12.119 N053.45.19.556 E014.34.48.024 
N053.45.19.556 E014.34.48.024 N053.45.26.944 E014.35.14.425 
N053.45.26.944 E014.35.14.425 N053.45.44.907 E014.35.27.101 
N053.45.44.907 E014.35.27.101 N053.45.52.295 E014.36.47.363 
N053.45.52.295 E014.36.47.363 N053.45.56.511 E014.36.56.866 
N053.45.56.511 E014.36.56.866 N053.46.23.977 E014.36.56.866 
N053.46.23.977 E014.36.56.866 N053.46.59.888 E014.36.56.866 
N053.46.59.888 E014.36.56.866 N053.47.11.506 E014.36.38.914 
N053.47.11.506 E014.36.38.914 N053.48.35.991 E014.36.44.194 
N053.48.35.991 E014.36.44.194 N053.49.18.234 E014.36.26.242 
N053.49.18.234 E014.36.26.242 N053.49.50.973 E014.37.14.818 
N053.49.50.973 E014.37.14.818 N053.50.36.374 E014.37.21.156 
N053.50.36.374 E014.37.21.156 N053.51.05.941 E014.37.44.389 
N053.51.05.941 E014.37.44.389 N053.51.27.062 E014.37.44.389 
N053.51.27.062 E014.37.44.389 N053.52.20.923 E014.38.26.631 
N053.52.20.923 E014.38.26.631 N053.52.53.662 E014.38.26.631 
N053.52.53.662 E014.38.26.631 N053.53.39.077 E014.38.56.201 
N053.53.39.077 E014.38.56.201 N053.54.01.255 E014.39.29.995 
N053.54.01.255 E014.39.29.995 N053.54.14.988 E014.40.20.686 
N053.54.14.988 E014.40.20.686 N053.54.45.612 E014.40.43.922 
N053.54.45.612 E014.40.43.922 N053.55.07.791 E014.41.17.716 
N053.55.07.791 E014.41.17.716 N053.55.05.676 E014.41.56.789 
N053.55.05.676 E014.41.56.789 N053.55.36.301 E014.41.56.789 
N053.55.36.301 E014.41.56.789 N053.56.09.040 E014.43.20.220 
N053.56.09.040 E014.43.20.220 N053.56.15.385 E014.43.14.940 
N053.56.15.385 E014.43.14.940 N053.56.20.658 E014.43.26.558 
N053.56.20.658 E014.43.26.558 N053.56.23.830 E014.43.08.605 
N053.56.23.830 E014.43.08.605 N053.56.34.391 E014.43.11.774 
N053.56.34.391 E014.43.11.774 N053.56.20.658 E014.44.38.371 
N053.56.20.658 E014.44.38.371 N053.55.44.746 E014.45.08.995 
N053.55.44.746 E014.45.08.995 N053.55.26.797 E014.45.02.661 
N053.55.26.797 E014.45.02.661 N053.55.13.065 E014.45.17.444 
N053.55.13.065 E014.45.17.444 N053.55.18.352 E014.45.32.231 
N053.55.18.352 E014.45.32.231 N053.58.21.054 E014.45.56.521 
N053.58.21.054 E014.45.56.521 N053.58.32.672 E014.47.14.668 
N053.58.32.672 E014.47.14.668 N053.58.50.621 E014.46.02.856 
N053.58.50.621 E014.46.02.856 N053.59.18.073 E014.46.02.856 
N053.59.18.073 E014.46.02.856 N053.59.24.418 E014.45.50.183 
N053.59.24.418 E014.45.50.183 N054.00.00.330 E014.46.02.856 



;- NOAA object 59
;C
N049.59.59.670 E017.58.06.752 N050.00.21.849 E017.58.32.103 
N050.00.21.849 E017.58.32.103 N050.00.50.359 E017.59.11.180 
N050.00.50.359 E017.59.11.180 N050.00.58.818 E017.59.43.912 
N050.00.58.818 E017.59.43.912 N050.00.55.646 E017.59.59.753 
N050.00.55.646 E017.59.59.753 N050.00.55.646 E017.59.59.753 



;- NOAA object 80
N054.00.00.330 E014.43.02.264 N053.59.55.042 E014.42.53.819 
N053.59.55.042 E014.42.53.819 N053.59.55.042 E014.42.47.481 
N053.59.55.042 E014.42.47.481 N053.59.59.272 E014.42.40.089 
N053.59.59.272 E014.42.40.089 N054.00.00.330 E014.42.39.035 
;- NOAA object 81
N053.55.40.530 E014.13.53.406 N053.55.19.409 E014.15.29.509 
N053.55.19.409 E014.15.29.509 N053.55.19.409 E014.16.18.089 
N053.55.19.409 E014.16.18.089 N053.55.23.625 E014.16.57.162 
N053.55.23.625 E014.16.57.162 N053.55.03.561 E014.16.56.108 
N053.55.03.561 E014.16.56.108 N053.54.46.670 E014.16.42.375 
N053.54.46.670 E014.16.42.375 N053.54.11.816 E014.15.26.340 
N053.54.11.816 E014.15.26.340 N053.53.53.867 E014.15.14.725 
N053.53.53.867 E014.15.14.725 N053.53.32.746 E014.15.21.059 
N053.53.32.746 E014.15.21.059 N053.52.56.834 E014.16.08.582 
N053.52.56.834 E014.16.08.582 N053.52.45.216 E014.16.08.582 
N053.52.45.216 E014.16.08.582 N053.52.27.267 E014.15.50.630 
N053.52.27.267 E014.15.50.630 N053.52.24.095 E014.15.56.968 
N053.52.24.095 E014.15.56.968 N053.52.02.974 E014.15.56.968 
N053.52.02.974 E014.15.56.968 N053.52.38.885 E014.16.08.582 
N053.52.38.885 E014.16.08.582 N053.52.35.713 E014.16.26.538 
N053.52.35.713 E014.16.26.538 N053.52.20.923 E014.16.26.538 
N053.52.20.923 E014.16.26.538 N053.52.09.318 E014.16.39.210 
N053.52.09.318 E014.16.39.210 N053.51.09.113 E014.16.57.162 
N053.51.09.113 E014.16.57.162 N053.50.41.661 E014.17.15.115 
N053.50.41.661 E014.17.15.115 N053.50.18.425 E014.17.56.303 
N053.50.18.425 E014.17.56.303 N053.48.29.647 E014.20.14.652 
N053.48.29.647 E014.20.14.652 N053.48.28.589 E014.20.05.142 
N053.48.28.589 E014.20.05.142 N053.49.10.832 E014.18.53.329 
N053.49.10.832 E014.18.53.329 N053.49.19.277 E014.17.59.472 
N053.49.19.277 E014.17.59.472 N053.49.16.119 E014.17.29.902 
N053.49.16.119 E014.17.29.902 N053.49.31.953 E014.16.47.659 
N053.49.31.953 E014.16.47.659 N053.49.50.973 E014.16.08.582 
N053.49.50.973 E014.16.08.582 N053.51.09.113 E014.14.38.817 
N053.51.09.113 E014.14.38.817 N053.51.41.852 E014.13.44.957 
N053.51.41.852 E014.13.44.957 N053.51.58.758 E014.12.53.207 
N053.51.58.758 E014.12.53.207 N053.51.58.758 E014.12.31.032 
;- NOAA object 82
N053.55.40.530 E014.13.53.406 N053.54.21.319 E014.11.24.500 
N053.54.21.319 E014.11.24.500 N053.51.58.758 E014.12.31.032 
;- NOAA object 84
N054.00.00.330 E014.38.50.921 N053.59.22.303 E014.35.59.837 
N053.59.22.303 E014.35.59.837 N053.58.07.321 E014.31.47.436 
N053.58.07.321 E014.31.47.436 N053.58.00.991 E014.31.17.866 
N053.58.00.991 E014.31.17.866 N053.57.58.876 E014.30.24.005 
N053.57.58.876 E014.30.24.005 N053.57.49.373 E014.29.53.381 
N053.57.49.373 E014.29.53.381 N053.56.38.607 E014.28.08.829 
N053.56.38.607 E014.28.08.829 N053.55.55.307 E014.26.42.229 
N053.55.55.307 E014.26.42.229 N053.55.13.065 E014.24.48.170 
N053.55.13.065 E014.24.48.170 N053.54.55.116 E014.23.30.023 
N053.54.55.116 E014.23.30.023 N053.54.46.670 E014.22.11.873 
N053.54.46.670 E014.22.11.873 N053.54.37.167 E014.21.29.630 
N053.54.37.167 E014.21.29.630 N053.54.35.052 E014.20.11.480 
N053.54.35.052 E014.20.11.480 N053.55.16.237 E014.17.11.946 
N053.55.16.237 E014.17.11.946 N053.55.08.849 E014.17.02.443 
N053.55.08.849 E014.17.02.443 N053.54.50.900 E014.17.02.443 
N053.54.50.900 E014.17.02.443 N053.54.11.816 E014.15.44.296 
N053.54.11.816 E014.15.44.296 N053.53.57.039 E014.15.32.677 
N053.53.57.039 E014.15.32.677 N053.53.42.249 E014.15.39.012 
N053.53.42.249 E014.15.39.012 N053.53.12.682 E014.16.50.825 
N053.53.12.682 E014.16.50.825 N053.52.51.561 E014.17.02.443 
N053.52.51.561 E014.17.02.443 N053.51.38.680 E014.17.08.780 
N053.51.38.680 E014.17.08.780 N053.51.31.292 E014.17.23.564 
N053.51.31.292 E014.17.23.564 N053.51.31.292 E014.17.41.516 
N053.51.31.292 E014.17.41.516 N053.51.41.852 E014.17.56.303 
N053.51.41.852 E014.17.56.303 N053.51.48.183 E014.17.57.357 
N053.51.48.183 E014.17.57.357 N053.52.19.879 E014.19.06.001 
N053.52.19.879 E014.19.06.001 N053.52.21.980 E014.20.06.203 
N053.52.21.980 E014.20.06.203 N053.52.28.325 E014.20.17.817 
N053.52.28.325 E014.20.17.817 N053.52.21.980 E014.20.24.155 
N053.52.21.980 E014.20.24.155 N053.52.12.477 E014.21.02.171 
N053.52.12.477 E014.21.02.171 N053.51.33.407 E014.21.26.465 
N053.51.33.407 E014.21.26.465 N053.51.22.846 E014.21.47.586 
N053.51.22.846 E014.21.47.586 N053.51.19.674 E014.22.18.210 
N053.51.19.674 E014.22.18.210 N053.51.23.904 E014.22.32.994 
N053.51.23.904 E014.22.32.994 N053.51.38.680 E014.22.38.278 
N053.51.38.680 E014.22.38.278 N053.52.02.974 E014.23.26.854 
N053.52.02.974 E014.23.26.854 N053.52.09.318 E014.23.26.854 
N053.52.09.318 E014.23.26.854 N053.52.17.764 E014.23.08.902 
N053.52.17.764 E014.23.08.902 N053.52.27.267 E014.23.08.902 
N053.52.27.267 E014.23.08.902 N053.52.31.497 E014.22.59.399 
N053.52.31.497 E014.22.59.399 N053.52.28.325 E014.22.47.781 
N053.52.28.325 E014.22.47.781 N053.52.31.497 E014.22.36.163 
N053.52.31.497 E014.22.36.163 N053.52.21.980 E014.21.59.201 
N053.52.21.980 E014.21.59.201 N053.52.30.439 E014.21.44.417 
N053.52.30.439 E014.21.44.417 N053.52.41.000 E014.21.47.586 
N053.52.41.000 E014.21.47.586 N053.52.48.388 E014.22.21.379 
N053.52.48.388 E014.22.21.379 N053.53.21.128 E014.22.32.994 
N053.53.21.128 E014.22.32.994 N053.53.34.861 E014.23.17.351 
N053.53.34.861 E014.23.17.351 N053.53.36.962 E014.24.23.884 
N053.53.36.962 E014.24.23.884 N053.53.07.395 E014.25.23.024 
N053.53.07.395 E014.25.23.024 N053.53.22.185 E014.25.42.031 
N053.53.22.185 E014.25.42.031 N053.53.12.682 E014.25.45.200 
N053.53.12.682 E014.25.45.200 N053.52.45.216 E014.25.26.190 
N053.52.45.216 E014.25.26.190 N053.52.02.974 E014.25.26.190 
N053.52.02.974 E014.25.26.190 N053.51.55.585 E014.25.29.359 
N053.51.55.585 E014.25.29.359 N053.51.43.967 E014.26.11.601 
N053.51.43.967 E014.26.11.601 N053.51.46.082 E014.27.17.080 
N053.51.46.082 E014.27.17.080 N053.51.52.413 E014.27.54.042 
N053.51.52.413 E014.27.54.042 N053.51.49.254 E014.28.41.568 
N053.51.49.254 E014.28.41.568 N053.51.19.674 E014.31.11.528 
N053.51.19.674 E014.31.11.528 N053.51.28.133 E014.31.59.051 
N053.51.28.133 E014.31.59.051 N053.50.52.222 E014.34.30.071 
N053.50.52.222 E014.34.30.071 N053.50.44.820 E014.34.44.858 
N053.50.44.820 E014.34.44.858 N053.50.05.750 E014.35.08.088 
N053.50.05.750 E014.35.08.088 N053.49.46.743 E014.34.48.024 
N053.49.46.743 E014.34.48.024 N053.49.44.628 E014.34.08.947 
N053.49.44.628 E014.34.08.947 N053.49.33.010 E014.34.20.565 
N053.49.33.010 E014.34.20.565 N053.48.57.112 E014.34.20.565 
N053.48.57.112 E014.34.20.565 N053.48.50.768 E014.34.38.517 
N053.48.50.768 E014.34.38.517 N053.48.32.819 E014.34.44.858 
N053.48.32.819 E014.34.44.858 N053.48.18.029 E014.35.02.811 
N053.48.18.029 E014.35.02.811 N053.48.13.813 E014.35.23.932 
N053.48.13.813 E014.35.23.932 N053.48.29.647 E014.35.50.333 
N053.48.29.647 E014.35.50.333 N053.48.42.322 E014.35.50.333 
N053.48.42.322 E014.35.50.333 N053.48.57.112 E014.35.27.101 
N053.48.57.112 E014.35.27.101 N053.49.36.183 E014.35.50.333 
N053.49.36.183 E014.35.50.333 N053.49.49.915 E014.36.47.363 
N053.49.49.915 E014.36.47.363 N053.50.05.750 E014.37.08.484 
N053.50.05.750 E014.37.08.484 N053.50.38.489 E014.37.14.818 
N053.50.38.489 E014.37.14.818 N053.51.05.941 E014.37.32.771 
N053.51.05.941 E014.37.32.771 N053.51.35.522 E014.37.08.484 
N053.51.35.522 E014.37.08.484 N053.52.12.477 E014.37.08.484 
N053.52.12.477 E014.37.08.484 N053.52.56.834 E014.37.57.061 
N053.52.56.834 E014.37.57.061 N053.53.57.039 E014.38.26.631 
N053.53.57.039 E014.38.26.631 N053.54.13.931 E014.38.54.090 
N053.54.13.931 E014.38.54.090 N053.54.22.376 E014.39.23.660 
N053.54.22.376 E014.39.23.660 N053.54.22.376 E014.39.41.613 
N053.54.22.376 E014.39.41.613 N053.54.32.937 E014.40.02.734 
N053.54.32.937 E014.40.02.734 N053.55.00.403 E014.40.02.734 
N053.55.00.403 E014.40.02.734 N053.55.15.179 E014.40.32.304 
N053.55.15.179 E014.40.32.304 N053.56.12.212 E014.41.45.175 
N053.56.12.212 E014.41.45.175 N053.56.30.161 E014.41.50.452 
N053.56.30.161 E014.41.50.452 N053.57.06.073 E014.41.26.165 
N053.57.06.073 E014.41.26.165 N053.57.09.231 E014.41.20.881 
N053.57.09.231 E014.41.20.881 N053.57.38.812 E014.41.50.452 
N053.57.38.812 E014.41.50.452 N053.58.03.092 E014.41.50.452 
N053.58.03.092 E014.41.50.452 N053.58.17.882 E014.42.08.407 
N053.58.17.882 E014.42.08.407 N053.59.14.915 E014.42.08.407 
N053.59.14.915 E014.42.08.407 N053.59.42.367 E014.41.44.117 
N053.59.42.367 E014.41.44.117 N054.00.00.330 E014.42.03.127 

;- NOAA object 86
N054.00.00.330 E014.06.26.688 N053.58.50.621 E014.08.26.023 
N053.58.50.621 E014.08.26.023 N053.58.17.882 E014.09.02.986 
N053.58.17.882 E014.09.02.986 N053.57.45.143 E014.10.02.126 
N053.57.45.143 E014.10.02.126 N053.57.17.691 E014.10.26.413 
N053.57.17.691 E014.10.26.413 N053.56.57.627 E014.10.57.041 
N053.56.57.627 E014.10.57.041 N053.56.04.824 E014.12.41.589 
N053.56.04.824 E014.12.41.589 N053.55.40.530 E014.13.53.406 
;- NOAA object 99
N053.51.23.904 E014.22.38.278 N053.51.52.413 E014.23.23.685 
N053.51.52.413 E014.23.23.685 N053.51.55.585 E014.24.17.546 
N053.51.55.585 E014.24.17.546 N053.51.45.025 E014.24.56.619 
N053.51.45.025 E014.24.56.619 N053.51.09.113 E014.25.08.237 
N053.51.09.113 E014.25.08.237 N053.50.36.374 E014.24.51.339 
N053.50.36.374 E014.24.51.339 N053.50.04.692 E014.23.17.351 
N053.50.04.692 E014.23.17.351 N053.50.15.253 E014.23.02.564 
N053.50.15.253 E014.23.02.564 N053.50.41.661 E014.23.32.135 
N053.50.41.661 E014.23.32.135 N053.50.59.610 E014.23.33.192 
N053.50.59.610 E014.23.33.192 N053.51.20.731 E014.23.20.520 
N053.51.20.731 E014.23.20.520 N053.51.43.967 E014.24.04.874 
N053.51.43.967 E014.24.04.874 N053.51.22.846 E014.22.41.443 
N053.51.22.846 E014.22.41.443 N053.51.23.904 E014.22.38.278 
;- NOAA object 100
N053.51.12.285 E014.17.02.443 N053.51.26.018 E014.17.05.611 
N053.51.26.018 E014.17.05.611 N053.51.19.674 E014.17.11.946 
N053.51.19.674 E014.17.11.946 N053.51.31.292 E014.18.23.759 
N053.51.31.292 E014.18.23.759 N053.52.04.031 E014.18.59.667 
N053.52.04.031 E014.18.59.667 N053.51.59.801 E014.19.14.450 
N053.51.59.801 E014.19.14.450 N053.51.51.356 E014.19.02.836 
N053.51.51.356 E014.19.02.836 N053.51.46.082 E014.19.17.619 
N053.51.46.082 E014.19.17.619 N053.51.59.801 E014.19.20.788 
N053.51.59.801 E014.19.20.788 N053.52.10.376 E014.19.53.527 
N053.52.10.376 E014.19.53.527 N053.52.09.318 E014.20.20.986 
N053.52.09.318 E014.20.20.986 N053.51.45.025 E014.20.38.939 
N053.51.45.025 E014.20.38.939 N053.51.19.674 E014.21.23.296 
N053.51.19.674 E014.21.23.296 N053.51.11.228 E014.22.05.538 
N053.51.11.228 E014.22.05.538 N053.51.13.343 E014.23.12.071 
N053.51.13.343 E014.23.12.071 N053.50.30.043 E014.23.14.182 
N053.50.30.043 E014.23.14.182 N053.50.13.152 E014.22.41.443 
N053.50.13.152 E014.22.41.443 N053.50.22.655 E014.22.11.873 
N053.50.22.655 E014.22.11.873 N053.50.09.979 E014.22.05.538 
N053.50.09.979 E014.22.05.538 N053.50.13.152 E014.21.41.248 
N053.50.13.152 E014.21.41.248 N053.49.58.361 E014.20.53.725 
N053.49.58.361 E014.20.53.725 N053.49.33.010 E014.20.27.324 
N053.49.33.010 E014.20.27.324 N053.48.35.991 E014.20.44.219 
N053.48.35.991 E014.20.44.219 N053.48.28.589 E014.20.35.773 
N053.48.28.589 E014.20.35.773 N053.50.41.661 E014.17.26.733 
N053.50.41.661 E014.17.26.733 N053.51.09.113 E014.17.08.780 
N053.51.09.113 E014.17.08.780 N053.51.12.285 E014.17.02.443 
;- NOAA object 106
N053.56.59.728 E014.42.14.742 N053.57.53.589 E014.42.32.697 
N053.57.53.589 E014.42.32.697 N053.58.11.551 E014.43.02.264 
N053.58.11.551 E014.43.02.264 N053.58.48.506 E014.42.44.312 
N053.58.48.506 E014.42.44.312 N053.58.52.736 E014.43.36.061 
N053.58.52.736 E014.43.36.061 N053.58.27.385 E014.45.26.951 
N053.58.27.385 E014.45.26.951 N053.57.56.761 E014.45.26.951 
N053.57.56.761 E014.45.26.951 N053.57.41.971 E014.45.44.903 
N053.57.41.971 E014.45.44.903 N053.57.27.194 E014.45.44.903 
N053.57.27.194 E014.45.44.903 N053.57.12.404 E014.45.38.565 
N053.57.12.404 E014.45.38.565 N053.57.03.958 E014.45.11.110 
N053.57.03.958 E014.45.11.110 N053.57.16.633 E014.44.47.874 
N053.57.16.633 E014.44.47.874 N053.56.47.066 E014.42.53.819 
N053.56.47.066 E014.42.53.819 N053.56.56.570 E014.42.21.083 
N053.56.56.570 E014.42.21.083 N053.56.59.728 E014.42.14.742 
;- NOAA object 112
N054.03.39.987 E014.00.00.000 N054.03.39.987 E014.00.00.161 
;- NOAA object 113
N054.01.45.936 E014.00.00.161 N054.01.45.936 E014.00.00.000 
;- NOAA object 114
N054.03.39.987 E014.00.00.161 N054.03.17.809 E014.01.03.525 
N054.03.17.809 E014.01.03.525 N054.02.48.242 E014.01.39.433 
N054.02.48.242 E014.01.39.433 N054.02.09.158 E014.02.44.908 
N054.02.09.158 E014.02.44.908 N054.01.59.655 E014.02.51.246 
N054.01.59.655 E014.02.51.246 N054.00.57.349 E014.04.38.967 
N054.00.57.349 E014.04.38.967 N054.00.39.400 E014.04.56.919 
N054.00.39.400 E014.04.56.919 N054.00.21.451 E014.05.39.162 
N054.00.21.451 E014.05.39.162 N054.00.16.164 E014.05.42.331 
N054.00.16.164 E014.05.42.331 N054.00.00.330 E014.06.26.688 

;- NOAA object 116
N054.00.00.330 E014.42.03.127 N054.00.01.373 E014.42.06.296 
N054.00.01.373 E014.42.06.296 N054.00.01.373 E014.42.11.573 
N054.00.01.373 E014.42.11.573 N054.00.04.546 E014.42.17.914 
N054.00.04.546 E014.42.17.914 N054.00.04.546 E014.42.29.529 
N054.00.04.546 E014.42.29.529 N054.00.00.330 E014.42.39.035 
;- NOAA object 117
N054.00.00.330 E014.38.50.921 N054.00.12.991 E014.39.05.705 
N054.00.12.991 E014.39.05.705 N054.00.37.285 E014.41.06.098 
N054.00.37.285 E014.41.06.098 N054.01.07.909 E014.42.11.573 
N054.01.07.909 E014.42.11.573 N054.01.22.700 E014.43.29.727 
N054.01.22.700 E014.43.29.727 N054.01.13.196 E014.44.23.587 
N054.01.13.196 E014.44.23.587 N054.01.37.476 E014.45.41.734 
N054.01.37.476 E014.45.41.734 N054.01.30.088 E014.45.57.575 
N054.01.30.088 E014.45.57.575 N054.00.57.349 E014.45.56.521 
N054.00.57.349 E014.45.56.521 N054.00.40.457 E014.45.30.116 
N054.00.40.457 E014.45.30.116 N054.00.30.954 E014.43.54.017 
N054.00.30.954 E014.43.54.017 N054.00.00.330 E014.43.02.264 

;- NOAA object 126
N054.38.08.837 E018.28.08.420 N054.38.07.779 E018.28.11.592 
N054.38.07.779 E018.28.11.592 N054.38.07.779 E018.28.17.923 
N054.38.07.779 E018.28.17.923 N054.38.08.837 E018.28.21.096 
N054.38.08.837 E018.28.21.096 N054.38.12.009 E018.28.21.096 
N054.38.12.009 E018.28.21.096 N054.38.13.066 E018.28.17.923 
N054.38.13.066 E018.28.17.923 N054.38.08.837 E018.28.08.420 

[VOR]
BYZ 112.70 N053.05.54.300 E017.58.18.200 ;BYDGOSZCZ
CZA XXX.XX N053.30.28.000 E016.18.04.000 ;CZAPLINEK
CMP 114.50 N052.08.00.000 E016.43.09.000 ;CZEMPIN
DAR 114.20 N054.24.37.000 E016.23.17.000 ;DARLOWO
DRE XXX.XX N052.49.01.000 E015.49.57.000 ;DREZDENKO
GZD 116.10 N054.23.16.000 E018.25.31.000 ;GDANSK
TBN XXX.XX N051.16.28.000 E017.08.03.000 ;GLUCHOW GORNY
GRU 114.60 N053.31.16.000 E018.46.53.000 ;GRUDZIADZ
IZB XXX.XX N050.52.39.000 E023.08.58.000 ;IZBICA
JAB 116.40 N049.28.58.000 E019.40.43.000 ;JABLONKA
JED XXX.XX N050.38.50.000 E020.15.04.320 ;JEDRZEJOW
KRN XXX.XX N051.56.47.000 E020.26.41.000 ;KARNICE
KAX 114.80 N050.28.40.000 E019.05.06.000 ;KATOWICE / PYRZOWICE
KMI XXX.XX N054.12.06.000 E019.08.41.000 ;KMIECIN
KAK 112.80 N050.04.36.000 E019.47.17.000 ;KRAKOW
LIN XXX.XX N051.55.58.000 E021.09.31.000 ;LININ
MRA 117.30 N053.47.05.660 E021.07.58.240 ;MRAGOWO
NTA XXX.XX N049.20.33.000 E019.58.03.000 ;NOWY TARG
OLX XXX.XX N050.12.42.000 E020.56.08.000 ;OLESNO
PCK XXX.XX N052.42.42.000 E019.34.12.000 ;PLONSK
LAW 115.80 N052.25.20.510 E016.49.48.610 ;POZNAN
RAD 113.85 N051.23.22.000 E021.12.13.000 ;RADOM
RZE 116.20 N050.06.28.720 E022.01.08.080 ;RZESZOW
SIE 114.70 N052.09.19.440 E022.12.02.880 ;SIEDLCE
RUD 115.10 N052.49.49.930 E023.42.25.690 ;SKUPOWO
SUW 117.70 N054.04.05.880 E022.53.48.479 ;SUWALKI
SYN 111.05 N053.36.25.700 E021.00.33.200 ;SZYMANY
SCZ 114.75 N053.35.43.000 E014.52.53.000 ;SZCZECIN
SWI 112.20 N051.14.10.200 E022.41.07.700 ;SWIDNIK
TZE XXX.XX N054.12.38.000 E017.04.24.000 ;TRZEBIELINO
MOL 116.60 N052.27.09.000 E020.40.40.000 ;WARSZAWA / MODLIN
OKC 113.45 N052.10.11.130 E020.57.36.190 ;OKECIE
LOZ 112.40 N051.46.34.000 E019.37.29.000 ;WIACZYN DOLNY
WIC XXX.XX N054.40.46.000 E017.40.33.000 ;WICKO
WCL 111.65 N051.05.34.000 E016.55.08.000 ;WROCLAW / STRACHOWICE
WAR 114.90 N052.15.33.340 E020.39.25.780 ;ZABOROWEK
ZLG 110.65 N052.08.27.300 E015.48.02.500 ;ZIELONA GORA
OKX 000.00 N050.54.10.000 E015.01.55.000 ;FRYDLANT

[NDB]
CHO 375.0   N053.28.31.999 E015.19.59.000 ;CHOCIWEL
GDB 383.0	N054.22.03.900 E018.30.21.200 ;LOCATOR GDANSK
GDN 322.0   N054.20.43.000 E018.35.46.000 ;GDANSK
H   255.0   N051.05.42.630 E016.54.37.000 ;WROCLAW
HG  525.0   N051.04.56.920 E016.57.05.700 ;WROCLAW
WRW 525.0   N051.04.56.920 E016.57.05.700 ;WROCLAW
WRC 255.0 	N051.05.42.600 E016.54.37.000 ;WROCLAW
;KRA 379.0	N050.04.54.760 E019.48.52.580 ;LOCATOR KRAKOW
;KRW 353.0   N050.05.44.520 E019.54.46.000 ;KRAKOW
OL 397.0   N053.33.18.000 E014.57.36.000 ;SZCZECIN
;KTC 285.0   N050.28.26.759 E019.09.01.000 ;KATOWICE
;KTW 326.0	N050.28.27.100 E019.06.27.200 ;Katowice L
RZ  474.0   N050.06.31.420 E022.08.02.550 ;RZESZOW
BDG 388.0   N053.06.11.159 E018.03.11.160 ;BYDGOSZCZ
PNO 330.0   N052.03.12.240 E021.03.45.719 ;PIASECZNO
BIA 474.0 	N050.06.31.420 E022.08.02.550 ;RZESZOW
;JAS 341.5 	N050.06.33.950 E022.03.12.760 ;LOCATOR RZESZOW
AR  290.0	N052.16.40.840 E020.50.31.940 ;NDB WARSZAWA/BABICE

[FIXES]
ABAKU N051.40.37.000 E019.04.53.000 ;N871
ABAPA N052.00.36.000 E021.11.40.000 ;STAR EPWA, EPWA GNSS29
ABERO N052.13.40.000 E023.12.32.000 ;P851, Z182
ABEXA N051.36.17.000 E020.55.18.000 ;Q99
ABGEG N051.13.35.000 E016.25.54.000 ;TMA POZNAN SOUTH
ABIBO N053.06.27.000 E017.32.16.000 ;Z96, STAR EPBY
ABSEL N051.55.36.000 E020.31.32.000 ;SID EPMO
ADADO N050.12.34.000 E017.44.53.000 ;M992
ADIKA N051.32.18.000 E021.19.46.000 ;Q99
ADINI N052.00.33.000 E021.15.23.000 ;STAR EPWA,GNSS EPWA33
ADOXO N052.06.11.000 E019.30.26.000 ;N133, SID EPLL, STAR EPLL
ADURU N052.04.45.000 E021.12.58.000 ;L621, T265
ADVAB N052.07.50.000 E016.43.38.000 ;L617, L619, L623, L980, L981, P150
ADVEX N050.20.54.000 E017.52.11.000 ;Z159
AGALU N051.28.17.000 E017.23.08.000 ;N869
AGAVA N051.34.53.000 E019.57.39.000 ;Q277, STAR EPMO, STAR EPWA, T355
AGESI N052.19.53.000 E020.42.06.000 ;STAR EPWA, EPWA GNSS11
AGNOP N051.54.28.000 E016.37.00.000 ;SID EPKS, STAR EPKS
AGODU N053.56.40.000 E016.06.59.000
AKAPI N051.55.12.000 E016.28.22.000
AKETU N050.18.00.000 E022.16.13.000
ALUKA N052.53.57.000 E014.18.24.000
AMLAS N052.09.46.000 E020.39.01.000 ;STAR EPWA, STAR EPMO
AMROR N054.53.24.152 E015.05.49.999
AMSOS N051.33.40.000 E020.41.44.000 ;STAR EPWA, STAR EPMO
AMTEK N050.00.11.998 E017.57.24.998
AMUTO N052.19.59.998 E018.56.44.998
APSIK N054.40.00.000 E016.40.00.000
APTAS N050.54.41.000 E017.41.45.000
ARBIR N052.12.00.000 E017.09.18.000
ARDUT N053.51.29.000 E021.10.02.000 ;L29, STAR EPSY
ARGIX N050.56.42.000 E021.58.20.000 ;SID EPLB, T709
ARKUG N053.30.24.000 E016.50.18.000
ARMEX N051.29.44.000 E017.07.26.000
ARPEL N054.10.57.000 E016.09.00.000
ARSAP N052.13.41.000 E014.42.45.000
ARSOG N049.59.26.000 E022.41.59.000 ;L981, SID EPRZ
ARVAL N052.00.59.000 E021.06.34.000;EPWA VOR 33
ASBIM N053.09.24.000 E021.44.20.000
ASDAG N052.13.38.000 E020.42.08.000
ASGID N049.51.54.000 E020.33.13.000 ;SID EPKK, SID EPKT, STAR EPKK, STAR EPKT
ASGUL N053.38.19.000 E016.56.50.000
ASLUX N052.19.14.000 E022.09.38.000
ASTEX N052.08.28.000 E021.05.14.000
ASTUD N050.33.46.000 E018.53.18.000 ;STAR EPKK, STAR EPKT
ASVEM N051.28.56.000 E021.13.38.000
ATKEK N049.55.18.000 E021.41.02.000
ATKUN N052.40.38.000 E018.04.12.000
ATMEV N050.43.59.000 E017.30.11.000
ATMIR N052.47.16.000 E017.27.48.000
BABAS N052.01.07.000 E021.31.00.000 ;STAR EPMO, STAR EPWA
BABEN N054.23.17.000 E015.14.31.000
BABKO N049.36.42.000 E019.28.10.000 ;L856, M66, M866, Q35, Z169, SID EPKK, SID EPKT
BABOT N055.10.12.000 E016.41.25.000 ;Y41
BADNO N051.45.00.000 E017.40.41.998
BADUP N052.03.33.200 E017.25.15.999
BALBA N050.51.42.000 E023.01.24.000 ;M977, T267, T425
BALBA N050.51.42.199 E023.01.23.998
BALOS N050.16.32.600 E019.39.29.998 ;L623, T714
BAMOX N054.42.56.000 E017.17.00.000 ;TSA14
BAMSO N052.20.09.100 E021.54.35.500
BANUB N054.27.43.000 E014.17.50.000 ;Z131, Z212
BAPAS N052.10.42.999 E015.31.10.999
BAREP N052.16.16.000 E015.33.52.000
BAREX N050.53.40.000 E018.44.18.000 ;L623, SID EPKK, SID EPKT, STAR EPKK, STAR EPKT,T205
BARGU N053.59.40.000 E021.15.11.000 ;N858
BARNA N051.48.47.000 E021.07.13.000 ;STAR EPWA
BASEK N052.10.46.000 E020.35.24.000 ;STAR EPWA,EPWA GNSS11, STAR EPMO
BASRI N052.26.14.000 E021.26.13.000 N5
BAVGO N053.14.45.000 E018.15.04.000 ;Z95, STAR EPBY
BAVIM N052.32.04.000 E017.35.45.000 ;MATZ EPWW, TSA08
BAVNU N053.06.28.000 E020.27.48.000
BAVOK N050.00.10.000 E018.11.43.000 ;T709, SID EPKT, STAR EPKT
BAXIS N051.48.31.000 E018.51.50.000 ;N869, SID EPLL, STAR EPLL
BEBUM N052.05.36.000 E021.40.38.000 ;MATZ EPMM
BEDAM N053.44.22.999 E015.11.31.999 ;EPSC ARRIVALS, Z491
BELNO N052.13.53.000 E018.15.11.000 ;MATZ EPWW
BEMRA N051.49.51.000 E020.57.59.000 ;STAR EPWA
BESIS N053.40.18.000 E016.29.24.000 ;MATZ EPSN, TSA09
BESOT N052.55.18.000 E022.56.40.000
BESTO N051.43.47.999 E017.23.56.000
BETUP N053.11.53.000 E020.00.00.000 ;TSA02
BEVOS N051.09.49.000 E021.14.19.000 ;TSA05
BEXON N052.07.23.000 E021.09.28.000 ;STAR EPWA
BEZMI N054.23.14.000 E017.24.24.000 ;L733, P31
BIBKA N053.11.27.000 E018.57.18.000
BIGLU N051.43.23.000 E023.32.35.000
BILRA N054.46.29.000 E014.20.20.000 ;Q800, Z493
BIMPA N052.22.28.000 E019.46.29.000 ;STAR EPWA UP150,UP851
BINKA N053.45.34.000 E014.16.32.000
BINPO N051.40.11.000 E016.37.00.000
BITVA N052.20.46.000 E021.05.11.300
BOBLU N050.23.59.000 E021.54.35.000 ;TMA EPRZ
BODLA N053.16.33.000 E014.24.36.000
BOKSU N054.18.27.000 E023.03.33.000
BOLVU N052.52.00.000 E021.00.00.000 ;TSA02
BULEP N052.46.16.000 E022.25.08.000
BUNOS N054.59.22.000 E018.10.54.000 ;T224
DEKOX N051.16.18.000 E021.06.36.000 ;MATZ EPRA, TSA05
DEKUT N053.06.58.000 E017.02.07.000
DELIR N053.04.50.000 E017.06.49.000
DEMIN N050.00.06.199 E021.30.39.999 ;EPRZ arrivals, Q258
DEMUR N054.04.48.000 E015.00.28.000
DENKO N052.49.01.000 E015.49.57.000
DERAM N051.50.49.000 E019.16.51.000 ;L980
DESEN N050.16.12.126 E017.31.00.998
DETOR N052.01.55.000 E021.36.59.000
DEVEG N050.51.27.000 E017.30.38.000 ;ILS RWY 29 EPWR, VOR Z RWY 29 EPWR, STAR EPWR
DEVEL N054.43.51.000 E015.44.53.000 ;L621
DEXIR N054.13.27.000 E017.26.56.000	;SID EPGD, T671, Y100
DIBED N049.53.18.000 E023.03.30.000 ;L981, L984, M977, N195, N983
DIBLO N052.07.47.000 E019.20.39.000
DILMU N052.19.49.000 E021.20.42.000 ;SID EPMO
DIMEX N051.37.50.000 E016.07.43.000
DINOV N050.55.43.000 E016.05.08.000 ;STAR EPWR, T738, T871
DINRI N052.26.02.000 E020.34.19.000 ;STAR EPWA
DINVA N052.13.47.200 E021.03.53.700 ;STAR EPWA
DIPKI N052.12.10.000 E017.27.46.000
DISBI N052.03.59.000 E022.58.41.000
DISEK N052.55.28.000 E014.52.04.000 ;TSA10
DODOD N050.36.53.000 E020.09.31.000
DOGIG N050.49.25.000 E022.05.10.000 ;L999
DOMAG N054.58.28.000 E017.41.08.000
DOMOB N052.34.02.000 E020.44.47.000
DOMUV N052.28.11.000 E020.11.49.000
DOPOX N052.17.25.400 E021.07.16.400
DOSAL N053.23.55.000 E015.23.32.000
DOSIX N052.20.53.000 E019.13.39.000
DOTEX N051.12.01.000 E021.51.44.000 ;N195
EBOGU N053.22.44.000 E018.08.58.999
EDAXU N050.00.48.000 E022.34.08.000 ;EPRZ ARRIVALS
EGLON N051.25.00.000 E021.59.05.000 ;L621, M857, M860
EKBUT N052.51.50.000 E015.00.17.000
EKRIV N052.09.01.000 E017.01.51.000
EKRON N054.35.01.000 E014.42.34.000
EKRUL N050.44.46.000 E021.21.40.000
EKSEK N051.07.42.000 E015.36.39.000
EKVAT N049.50.26.000 E020.17.29.000 ;L623
ELGAD N052.29.57.000 E020.33.38.000 ;STAR EPWA
ELGEL N052.26.22.000 E020.52.51.000 ;STAR EPWA
ELGOX N050.33.53.000 E018.18.03.000
ELKAR N053.41.54.000 E020.30.00.000
ELKIR N051.34.26.000 E020.15.14.000 ;STAR EPWA
ELNUD N052.19.52.000 E016.21.57.000
ELPOL N054.36.23.000 E015.38.02.000
ELSUP N052.32.24.000 E015.24.41.000
ELTUB N053.40.21.000 E015.25.21.000
ELVEP N050.18.00.000 E019.09.41.000 ;SID EPKK, SID EPKT
ELVOT N050.36.42.000 E016.24.33.000
EMBIK N050.12.29.000 E018.06.11.000 ;M992, SID EPKK, SID EPKT
EMGAR N054.26.07.000 E016.33.07.000 ;Z717
EMGIP N052.36.18.000 E018.34.29.000
EMGOV N052.01.39.000 E016.32.55.000
EMKEN N051.58.15.100 E021.19.54.500
EMKUX N049.39.15.000 E019.41.26.000 ;STAR EPKT, STAR EPKK
EMLES N053.16.21.000 E016.28.06.000 ;MATZ EPMI, TSA09
EMPIM N052.17.22.000 E016.33.19.000
ENIMO N051.55.34.100 E021.29.17.000 ;STAR EPWA
ENOBI N053.35.34.000 E023.37.46.999
ENORU N050.20.25.000 E016.22.13.000
ENUBU N051.29.13.000 E018.40.49.000 ;MATZ EPLK
EPOPA N050.22.05.000 E017.47.59.000
EREDA N051.50.54.000 E020.38.04.000 ;SID EPMO
ERGON N052.54.22.000 E014.09.24.000
ERKEB N049.34.24.000 E020.48.25.000 ;STAR EPKT, STAR EPKK
ERLEG N052.00.47.000 E021.06.00.000;EPWA ILS, GNSS, STAR 33
ERMIV N051.48.43.000 E020.44.18.000
ERNOX N052.01.36.000 E016.01.14.000
ERPAB N052.38.06.000 E018.19.09.000
ERPOK N049.57.00.000 E020.06.55.000 ;STAR EPKK, STAR EPKT
ERPUX N054.00.00.000 E018.00.00.000 ;EPD53
ERTIM N052.24.04.000 E017.24.37.000
ERUNI N052.26.15.000 E021.44.14.000 ;MATZ EPMM
ESINI N051.40.19.000 E020.48.23.000 ;STAR EPWA
ETEDI N053.35.32.000 E019.52.17.000 ;T720
ETITI N050.23.45.000 E021.13.11.000 ;L981
ETNEL N050.50.27.000 E017.09.25.000
ETUBO N052.28.09.000 E022.57.45.000
EVDEX N051.56.46.500 E020.26.40.800 ;SID EPWA, SID EPMO, EPWA GNSS 11/15/29
EVEPU N051.54.06.000 E019.36.23.000 ;N133
EVGAG N051.54.23.000 E015.15.09.000
EVGUR N051.18.22.000 E019.36.45.000
EVINA N051.23.16.000 E020.21.36.000 ;SID EPWA, SID EPMO, M66, M985, N744, T353
EVMIL N051.40.38.000 E018.45.47.000 ;MATZ EPLK
EVNOB N054.15.53.900 E018.11.04.700 ;SID EPGD, STAR EPGD
EVODO N053.17.39.000 E022.55.45.000
GAMDA N051.37.44.000 E021.40.42.000 ;MATZ EPDE, TAS05
GATPO N051.25.14.000 E016.51.39.000 ;STAR EPWR
GAVDU N050.50.28.000 E022.04.11.000 ;STAR EPLB, T282, T375
GERVI N052.09.19.000 E022.12.03.000
GESDU N051.48.39.000 E020.30.13.000
GEVNA N049.56.06.000 E020.43.29.000
GIGAL N051.04.42.999 E016.29.30.998
GILAL N052.01.37.000 E020.32.52.000 ;SID EPWA
GILAS N052.37.54.200 E014.31.32.998
GIMAP N051.13.09.000 E023.05.45.000 ;N191
GIMKU N052.29.53.000 E020.49.45.000 ;STAR EPWA
GINEX N051.27.48.000 E022.21.33.000 ;MATZ EPDE, TSA04
GINOK N052.31.35.000 E016.28.44.999
GIPOS N051.41.54.000 E019.42.36.000
GIPUL N051.39.26.000 E020.57.34.000 ;STAR EPWA
GITOV N054.22.06.000 E020.41.54.000 ;N5, P159
GIVAR N055.01.35.000 E016.18.08.000
GIXOL N049.49.45.000 E019.21.07.000 ;Z121
GOBNI N053.22.17.000 E018.29.29.000 ;Z95, SID EPBY, STAR EPBY
GOBRA N053.35.05.000 E015.42.09.000 ;L730, T672
GODIL N052.25.29.000 E020.22.24.000 ;EPMO ILS 08, STAR EPMO
GODLO N051.00.14.000 E016.30.15.000 SID EPWR, T714, T871
GODMA N053.35.40.000 E018.26.04.000 ;P733
GOGUS N051.34.48.000 E019.37.59.000
GOLAD N054.20.00.000 E022.10.50.000
GOMED N054.27.11.998 E019.39.29.998
GOMEX N053.44.04.000 E015.14.34.000 ;EPSC ARRIVALS
GOMOR N051.11.00.000 E017.37.02.000
GOMSA N052.17.23.000 E020.18.48.000 ;STAR EPWA
GONTU N053.29.44.000 E019.19.07.000
GORAT N053.10.41.599 E023.53.39.199
GORON N052.13.51.000 E015.38.16.000 ;STAR EPZG
GORPI N054.55.00.000 E015.39.18.000 ;N746, Z80
GOSAK N050.33.28.000 E020.18.16.000
GOSIT N052.14.16.000 E020.42.34.000 ;ILS CAT II OR LOC EPWA, EPWAGNSS11, STAR EPWA
GOSOT N054.48.42.998 E014.51.20.600
GOTIX N050.01.18.200 E023.12.42.998 ;L621
GOVEN N052.03.29.998 E014.45.20.600 ;L735, L979, M607, P31, T205
GOVRI N050.06.25.000 E021.01.54.000 ;STAR EPKK, STAR EPKT, T738
GRUDA N053.31.16.000 E018.46.53.000 ;L23, L29, L621, N122, N191, N858, T720, Z95
GUDON N050.54.35.000 E014.51.24.000
GUPMA N051.14.40.000 E017.01.06.000 ;TMA POZNAN SOUTH
IBEKA N050.01.40.000 E018.56.30.000
IBINO N053.33.46.000 E019.58.50.000 ;STAR EPSY, T720
IBNUS N053.00.19.000 E018.36.05.000 ;TSA08
IDEXU N052.41.50.000 E017.02.10.000
IDLIS N052.27.53.800 E016.32.08.900 ;GNSS 10 EPPO
IDMAV N052.19.05.000 E016.27.59.000
INDAD N050.04.29.000 E021.16.06.000
INDIG N051.59.48.000 E018.00.00.000
INGES N052.06.05.000 E023.30.50.000
INKOK N051.37.00.000 E016.33.23.000 ;TSA08
INLUT N052.23.09.000 E020.30.12.000 ;STAR EPWA
INPAL N052.02.57.000 E021.41.45.000 ;STAR EPWA
INPIV N050.27.55.000 E020.02.44.000 ;SID EPKK, SID EPKT
INPUM N050.39.04.000 E018.51.11.000 ;STAR EPKT, STAR EPKK
INRAS N052.29.56.300 E020.47.31.800 ;SID EPWA
INREN N052.15.35.000 E020.17.53.000 ;STAR EPWA
INSAB N050.17.22.800 E018.51.12.000 ;SID EPKK, SID EPKT
INSEX N051.37.49.000 E020.56.24.000 ;STAR EPWA
INSON N052.29.49.000 E020.57.29.000 ;SID EPWA
INTUN N053.10.03.000 E018.41.48.000 ;Z96, SID SPBY, STAR EPBY
IPLAM N054.17.01.000 E018.50.37.000; ILS 29 EPGD, VOR 29 EPGD, STAR EPGD
IPLIT N054.38.16.000 E019.21.20.000
IPSIM N052.10.03.000 E021.28.18.000 ;STAR EPWA
IPSOD N050.52.06.000 E017.25.58.000
IRBON N051.24.50.000 E021.35.24.000 ;MATZ EPRZ, TSA05
IRBOS N051.26.33.000 E019.50.39.000 ;N133, T353
IRDEB N051.48.38.000 E021.53.32.000 ;P139; T720
IRDOM N052.35.25.000 E020.08.53.000 ;STAR EPMO, STAR EPWA
IRGAM N050.45.42.000 E021.46.53.000 ;T375
IRGET N053.40.11.000 E014.36.53.000 ;EPSC ARRIVALS
IRKAP N052.08.19.000 E017.14.36.000
IRLUN N053.45.02.100 E018.36.53.500 ;N133, P733
IVGOR N055.35.04.000 E017.57.32.000
IVMEM N050.11.43.000 E018.36.45.000 ;SID EPKK, STAR EPKT
IVNER N051.07.05.000 E023.51.26.000 ;Q34
IXIXI N053.41.04.000 E019.53.28.000
IXOGA N051.22.01.000 E022.27.39.000 ;L856
IXURO N051.01.04.000 E015.32.38.000
IXUSU N052.17.33.000 E016.10.21.000
IXUVI N050.02.46.000 E019.33.32.000 ;STAR EPKK
KARTI N054.17.59.000 E018.12.29.000 ;N133, P861, Y100, Y41, Z72
KELEL N049.18.49.000 E020.10.31.000
KELOD N052.14.02.000 E015.53.00.000
KOGUD N052.20.07.000 E021.22.44.000 ;STAR EPMO, STAR EPWA
KOLOB N054.49.31.999 E014.56.00.999
KORUP N051.34.59.599 E014.44.17.600
KOSEX N054.07.34.400 E017.32.10.300
KOTEK N050.38.50.000 E020.15.04.000 ;L981, M866, M984, M985, N133,P746, Q10, T709
KUKAM N050.48.22.000 E020.03.38.000 ;M66, STAR EPKK, STAR EPKT
KUKOP N052.08.52.000 E020.24.38.000 ;N869, N871 + U
KULEK N053.33.10.000 E020.30.00.000
KULUV N051.38.52.000 E016.20.21.199
KUMUT N051.57.15.000 E021.23.24.000 ;STAR EPWA
KUNER N055.15.31.000 E018.26.53.600 ;P31, T224, Z717, Z72
KURAV N051.18.57.000 E020.44.48.000; M866, SID EPRA, STAR EPRA, T353, T355
KURON N050.37.54.000 E020.08.53.000 ;SID EPKT, T709
KUSUL N051.02.47.000 E017.04.09.000 ;EPWR RW 29
KUTEV N052.12.53.000 E020.55.28.000 ;ILS 33 EPWA GNSS33
KUVAM N051.43.49.000 E020.56.29.000 ;STAR EPWA
KUXEN N052.24.28.000 E020.11.54.000 ; EPMO ILS 08, STAR EPMO
LAGAR N050.47.42.989 E015.22.01.520 ;N871, T781
LARMA N055.16.27.998 E016.30.06.998
LASGU N053.12.47.998 E019.11.52.999 ;N191, Z96
LASIS N051.24.25.000 E014.57.42.000
LATAG N051.43.18.199 E015.44.48.200
LATMI N055.26.55.000 E018.10.02.000
LAVMO N052.12.58.000 E020.46.02.000 ;STAR EPWA
LAVPI N049.56.08.000 E018.27.03.000 ;L984
LEGNO N051.41.24.000 E021.47.08.000 ;P139, T356
LEMBU N051.53.29.000 E021.21.27.000 ;STAR EPWA
LENOV N049.20.11.000 E021.00.37.000; L619, L623, N133, SID EPKK, SID EPKT, STAR EPKK, STAR EPKT
LETKI N052.11.17.000 E023.24.16.000
LIBGA N050.49.31.000 E022.12.42.000 ;N195, SID EPLB
LIGDI N050.18.03.000 E019.33.13.000 ;SID EPKK, STAR EPKT
LIMVI N051.44.42.000 E021.41.08.000 ;L621, N191, N5, STAR EPMO, STAR EPWA
LOBMU N050.46.15.000 E019.37.42.000 ;SID EPKK, SID EPKT
LODBO N051.02.34.000 E021.52.51.000 ;L856, M857
LOGDA N051.17.04.000 E020.41.38.000 ;STAR EPWA, UM866
LOLKA N049.13.11.999 E020.06.00.095
LOLKO N051.41.33.151 E015.56.06.737
LOLSI N052.10.38.900 E019.52.17.000 ;UZ71, SID EPWA
LUBEN N051.13.27.200 E019.57.27.000
LUGEL N052.12.25.000 E020.29.28.000 ;STAR EPWA
LUGOL N049.12.20.000 E022.44.17.000
LUGUG N051.23.13.000 E023.00.13.000 ;M977
LUKOR N050.35.12.000 E020.12.16.000
LULIN N050.34.41.000 E021.07.46.000 ;T375, T709
LUNUK N051.26.56.000 E018.03.27.000
LUPOG N052.12.45.000 E020.55.06.000 ; EPWA VOR 33
LURAD N050.11.31.000 E018.34.28.000
LUREK N053.39.51.000 E017.21.33.000
LUSID N054.55.00.199 E015.17.45.999
LUSUL N053.49.31.000 E021.16.59.000 ;SID EPSY, T727
LUVOD N050.13.45.000 E019.05.39.000
LUXAL N053.54.56.000 E016.32.35.000
LUXAR N049.55.48.000 E021.10.31.000 ;VOR Y 09 EPRZ, L984, L986, Q258, EID EPKK, SID EPKT
LUXIB N052.21.37.000 E020.38.30.000 ;STAR EPWA
LUXUD N053.06.45.000 E017.15.57.000 ;Z96, SID EPBY, STAR EPBY
MAGAN N052.51.00.000 E017.37.00.000
MAKOV N051.08.57.199 E019.06.42.998
MAKUS N052.09.10.000 E020.30.03.000 ;SID EPMO, SID EPWA
MALOX N054.14.39.000 E016.52.53.000 ;L621, Y100
MAPEX N053.42.22.000 E017.00.13.000
MAPIK N050.31.34.000 E018.14.51.000 ;STAR EPKK, STAR EPKT, T710, T714, Z73
MAPIX N051.58.56.000 E021.17.33.000 ;STAR EPWA
MARUP N052.18.06.000 E020.41.37.000 ;STAR EPWA, STAR EPMO, EPWAGNSS15
MASIV N052.00.45.000 E017.51.24.000
MASUN N053.38.12.000 E015.16.36.000 ;EPSC ARRIVALS
MAVIV N052.31.39.000 E020.31.00.000 ;STAR EPMO, STAR EPWA
MAVOT N051.49.48.000 E017.13.52.000
MAXAM N049.58.24.999 E021.22.44.000 ;EPRZ ARRIVALS
MEBAN N049.27.18.000 E019.38.48.000 ;M985, T375, STAR EPKK, STAR EPKT
MEBIV N052.48.36.000 E020.08.02.000 ;L621
MIGVI N052.24.22.000 E020.53.47.000 ;STAR EPWA
MIRVO N053.23.17.000 E015.55.15.000
MISKA N051.11.08.998 E016.56.03.998
MIXAT N051.29.18.000 E018.00.29.000
MODGU N049.44.46.000 E020.24.58.000 ;STAR EPKK, STAR EPKT
MOKMU N049.56.22.000 E020.08.27.000 ;VOR RWY 25 EPKK, L984
MOKOS N050.30.25.999 E019.21.21.999
MOLIL N052.35.31.999 E018.00.00.000
MONOV N050.59.54.000 E022.22.19.000 ;L621, T425
MOSIR N050.12.25.000 E022.46.30.000 ;N195
MOTAD N055.12.34.000 E017.30.20.000
MYSKO N050.32.11.000 E019.16.46.000
NAKER N051.29.49.000 E021.34.49.000 ;N195, Q99
NANOM N052.25.08.000 E020.35.23.000 ;STAR EPWA
NAPUT N052.54.24.000 E020.33.33.000 ;TSA02
NAROX N051.12.11.000 E015.00.38.000
NASOK N053.05.31.000 E019.00.23.000
NATEV N050.52.08.000 E022.10.16.000 ;N195, T267, T269
NATIX N049.55.36.000 E021.23.01.000
NAVDI N052.31.31.000 E014.59.39.000
NAVUR N051.00.47.000 E019.54.40.000; N744, SID EPKK, SID EPKT
NAXAR N049.45.38.000 E019.48.45.000; M985
NEDNA N052.10.30.000 E021.06.46.000 ;STAR EPWA
NEGEN N051.52.19.000 E021.04.11.000 ;STAR EPWA
NEGUV N050.54.53.000 E020.06.57.000 ;M66, N133
NEPOX N052.09.33.000 E021.59.57.000 ;STAR EPWA
NETAB N051.29.51.000 E021.54.41.000 ;L621, T357
NETIR N049.41.41.000 E018.42.32.000 ;Z121, STAR EPKK
NETMA N050.28.10.000 E018.51.31.000 ;EPKT VOR 09
NEVAP N050.47.13.000 E022.33.58.000 ;L621
NIDIP N050.17.26.000 E021.36.46.000
NIKMI N054.12.04.700 E019.08.42.300 ;M944 N191 P733 SID EPGD STAR EPGD T672 Y100
NILPU N051.57.10.000 E017.10.30.000
NIMIS N052.15.30.000 E020.57.45.000 ;STAR EPWA
NIMOM N050.56.48.000 E017.30.19.000
NIPUS N051.39.10.800 E020.23.59.800 ;SID EPWA
NITKI N051.56.56.000 E020.34.20.000 ;SID EPWA
NIVNO N051.30.37.000 E019.40.20.000 ;MATZ EPLK
NIVON N053.38.41.000 E020.02.30.000 ;SID EPSY, Y564
NOMIX N049.56.23.000 E018.55.23.000
NORNO N053.46.37.000 E022.47.21.000 ;M857
NOSKU N051.10.07.000 E015.52.17.000
NOVGA N050.18.54.000 E018.27.42.000 ;SID EPKK, SID EPKT
NUBLI N051.21.31.000 E019.53.16.000
NUDMO N053.08.41.000 E018.27.08.000 ;Z96, STAR EPBY
NUDRO N051.09.55.000 E017.19.32.000
NUMBA N050.22.32.000 E018.06.31.000 ;SID EPKK, SID EPKT, T738
NUTSO N051.49.58.000 E021.24.29.000 ;STAR EPWA
OBALU N050.42.38.998 E020.06.33.998
OBAVA N052.02.48.000 E020.32.24.000 ;STAR EPMO, STAR EPWA
OBOKU N052.15.07.999 E018.00.00.000
OBOLA N052.11.40.000 E016.12.41.000 ;EPZG ARRIVALS, L980, STAR EPZG
OBOSO N050.37.00.000 E021.45.45.000
OBOVI N051.01.17.000 E016.29.05.000 ;SID EPWR, STAR EPWR
OBUTU N053.55.51.000 E015.38.10.000 ;MATZ EPSN, TSA12
ODERA N050.54.16.000 E014.59.34.000
ODLOT N053.29.46.000 E017.24.14.000
ODMEK N052.09.04.000 E021.20.36.000 ;STAR EPWA
ODRAP N049.44.31.000 E021.50.28.000
ODRIM N052.09.40.000 E021.18.27.000 ;STAR EPWA
ODRUX N051.41.56.000 E021.21.48.000 ;N195, STAR EPRA
ODSOB N050.23.10.000 E019.01.56.000 ;STAR EPKK, STAR EPKT
OGDAV N054.48.07.000 E017.59.54.000 ;EPWA GNSS 29, STAR EPGD, T224, T240
OGRAR N052.25.05.000 E020.18.22.000 ;EPMO ILS 08, STAR EPMO
OGRES N054.00.38.000 E017.00.55.000 ;u/N195
OGVET N050.53.00.000 E022.28.40.000 ;L621, STAR EPLB
OKENO N051.34.11.000 E018.35.38.000 ;N871, Q277, UN871, UQ277
OKSIL N054.27.45.000 E018.42.20.000
OKSOV N054.41.29.000 E018.19.49.000
OLBIL N052.08.01.000 E021.04.55.000 ;ILS CAT II OR LOC EPWA11, EPWAGNSS11
OLDIM N052.30.39.000 E020.23.33.000;SPAR EPMO, STAR EPWA
OLDOX N052.18.32.000 E017.38.11.000
OLDUK N052.12.14.000 E021.57.12.000 ;MATZ EPKK
OLILA N052.42.16.000 E020.19.42.000 ;L621, SID EPMO, SID EPWA, T270, Y565
OLKIN N053.46.09.200 E020.30.00.000
OLKOL N050.46.56.000 E022.54.00.000 ;TSA 03
OLMUK N050.42.01.000 E016.56.32.000
OLNAG N050.24.11.000 E018.28.28.000 ;SID EPKK, SID EPKT
OLNED N053.09.57.000 E016.37.39.000
OLOKU N052.01.01.000 E020.58.25.000 ;STAR EPWA
OLUMA N051.53.48.000 E015.45.22.000
OMAVA N051.23.02.000 E021.41.17.599 ;L980, N195, SID EPRA, T354
ORSOX N050.19.11.000 E018.32.14.000
ORTEB N050.06.08.000 E020.34.11.000 ;T738
ORVOG N051.29.44.000 E020.13.45.000
OSBUG N050.08.00.000 E021.00.52.000
OSKEX N051.05.22.000 E017.34.11.000
OSKUD N053.43.03.000 E019.45.43.000
OSLOG N053.45.57.000 E018.45.13.000 ;STAR EPGD, T270, Z95
OSMAT N050.14.34.000 E023.02.44.000 ;L621, M977
OSMOV N053.53.08.000 E017.28.55.000
OSNON N050.36.35.000 E017.56.59.000 ;T714
OSNUT N052.18.12.000 E020.50.47.000 ;EPWA GNSS RWY 15
OSTET N051.50.49.000 E020.56.34.000 ;STAR EPWA
OTMAX N053.05.23.000 E021.11.42.000 ;N5, Y566
OTMUL N051.55.51.000 E021.01.07.000 ;STAR EPWA, EPWA GNSS33
OTPES N053.26.22.000 E020.20.57.000
OTPOP N051.57.56.000 E019.34.30.000 ;N869
OTRIV N054.09.49.000 E022.11.52.000 ;N858
OVBIX N050.02.03.000 E020.39.35.000 ;SID EPKT, SID EPKK
OVBOR N051.06.15.000 E020.01.09.000 ;N133, N744
PADKA N049.56.01.978 E018.16.59.768 ;L984, Q10, STAR EPKK
PEKOT N050.23.18.000 E017.26.36.000
PENEX N052.33.47.000 E019.16.38.000
PENOR N055.38.11.500 E017.09.46.101
PEPOX N053.14.41.000 E016.37.22.000
PESEL N053.30.28.000 E014.19.33.000
PEXAS N050.06.29.000 E021.18.57.000 ;SID EPRZ
PEXUL N051.22.54.000 E019.36.46.000 ;MATZ EPLK
PIBAR N052.14.02.000 E020.23.33.000 ;STAR EPWA
PIDAT N051.17.36.000 E018.29.00.000 ;TSA06
PIKEB N049.48.55.000 E019.57.39.000 ;SID EPKK, SID EPKT
PISEN N052.10.03.000 E021.17.34.000 ;STAR EPWA
PIVIP N051.59.33.000 E020.44.50.000 ;STAR EPWA
PIVIS N053.56.25.000 E018.46.30.000 ;MATZ EPMB
PIXOR N053.17.19.000 E015.28.35.000
POBIG N050.50.06.000 E021.43.09.000 ;T282, T709
POBOK N050.34.59.599 E020.13.08.000 ;STAR EPKK, M985, SID EPKK
PODAN N049.24.39.999 E021.26.12.998
POKEN N054.49.10.999 E014.33.51.199
POLON N051.48.00.000 E019.39.22.000 ;L980, M70, M863, N133, N871, N893, Q99, T266, T355, Z169
RANOK N054.54.46.000 E018.57.29.998
RASAN N051.00.50.000 E015.05.41.000
RASUT N051.08.44.000 E016.15.33.000
RATOR N053.57.49.000 E017.52.50.000
RAVAD N051.25.27.000 E021.25.23.000 ;EPRA NDB RWY25
RAVAG N053.45.03.000 E016.44.56.000 ;T762
REBSO N052.16.16.000 E021.01.44.000 ;STAR EPWA
REDSA N052.15.40.000 E020.17.35.000 ;STAR EPWA
REGLI N050.01.49.000 E017.59.44.600
REMDI N052.17.57.000 E020.49.01.000 ;STAR EPWA
REMVU N051.09.56.000 E015.13.57.000
REPTU N051.26.41.000 E015.59.13.000
RETSU N051.25.00.000 E023.29.27.000
RIKNO N052.06.19.000 E021.30.13.000 ;STAR EPWA
RILAB N053.03.40.000 E019.37.59.000 ;L621 T270
RILET N051.54.22.000 E021.38.49.000 ;STAR EPWA
RILSU N052.15.27.000 E020.43.58.000 ;STAR EPWA
RIPOT N053.28.02.000 E015.07.46.000
RIVDI N055.11.39.000 E017.04.20.000
ROBOV N054.15.45.000 E015.03.21.000
RODAK N050.36.23.000 E020.09.46.000
RODEV N052.36.12.200 E020.33.27.200
ROGAL N050.59.13.000 E019.29.08.000
ROLKA N050.24.15.000 E023.49.32.000 ;M860, P159, T269
ROMEG N051.32.51.000 E021.32.17.000 ;STAR EPRA, T356, T357
RONEX N052.55.20.999 E016.13.31.999
RONIR N052.28.38.000 E020.32.15.000 ;STAR EPWA
ROPIK N051.27.02.000 E016.10.36.000
ROPUX N052.13.31.000 E021.36.56.000 ;STAR EPWA
ROTOL N050.57.57.000 E016.17.27.000 ;T871
ROVEK N053.22.44.000 E014.52.54.000
ROXOD N050.28.00.000 E019.17.53.000 ;EPKT VOR 27
ROXUG N050.18.51.000 E020.46.21.000 ;T375
RUDKA N052.51.05.999 E023.55.18.998
RUDUB N050.58.23.000 E016.04.02.000
RUMAR N055.02.01.000 E016.04.15.000
RUNIN N052.26.18.000 E020.46.51.000 ;STAR EPWA
RUTUK N051.35.08.000 E022.07.28.000
SABAB N050.46.13.999 E017.53.57.199
SISLU N051.57.01.000 E021.18.26.000 ;STAR EPWA
SKAVI N049.56.25.000 E019.54.00.000; L984, M985, Z121
SOGPI N050.46.10.000 E017.33.48.000
SOMOR N053.13.37.000 E019.21.00.000 ;L621, Z96
SOMOX N051.28.05.000 E022.26.35.000 ;UM70, UN191
SOPAM N052.28.00.000 E020.40.43.000 ;STAR EPWA
SOPIK N054.18.11.000 E018.45.29.000
SOPUK N051.18.00.000 E019.05.00.000 ;MATZ EPLK
SORIX N052.41.43.000 E019.49.12.000 ;N191, N195, STAR EPMO, STAR EPWA
SOROT N051.56.48.000 E020.56.38.000 ;STAR EPWA
SOSIN N052.07.24.000 E020.47.32.000 ;STAR EPMO, STAR EPWA
SOTET N053.49.47.000 E023.33.11.000
SOVAM N051.26.25.000 E016.42.52.000
SOXER N052.02.37.800 E019.56.05.900 ;UN869 (SID EPWA)
SUBEG N052.22.51.000 E020.55.57.000 ;STAR EPWA
SUBIX N052.22.47.000 E014.35.08.000;L867, L980, N858, T710
SUDOL N050.39.12.000 E018.24.42.000 ;L619, L986, SID EPKK, SID EPKT, STAR EPWR
SUMAM N051.36.38.000 E022.02.27.000 ;T270
SUPAK N049.18.13.000 E019.47.59.000 ;L999, P139, Q34
SUPID N052.13.24.000 E021.44.40.000 ;STAR EPMO, STAR EPWA, T270
SUSER N053.05.54.000 E017.58.17.000 ;Z95, Z96
SUVID N053.02.00.000 E020.18.00.000 ;TSA02
TABET N052.21.31.000 E020.36.09.000 ;STAR EPWA
TADAK N053.16.57.000 E016.53.56.000
TEBRU N052.06.14.000 E021.11.13.000; EPWA GNSS RWY 29
TELDU N050.14.53.000 E022.44.16.000 ;N195
TENVO N052.13.54.000 E017.46.27.000
TEPNA N049.30.17.000 E022.39.22.000
TEVGU N052.26.17.000 E021.35.04.000
TIGTU N052.08.00.000 E021.24.20.000 ;STAR EPWA
TILAV N054.24.59.000 E015.00.00.000
TIMSO N051.30.03.000 E022.07.18.000 ;T270
TINBU N052.17.32.000 E020.58.13.000 ;STAR EPWA
TISEX N052.20.38.000 E021.09.19.000
TISTA N051.44.56.000 E021.08.50.500
TITLU N052.33.18.000 E020.45.21.000
TITUV N053.11.28.000 E022.01.39.000
TOLPA N051.18.10.000 E023.38.45.000 ;M70, Q35
TOMKO N053.41.45.000 E015.50.34.000
TOMTI N050.57.11.000 E015.17.36.000
TOSLU N052.00.31.000 E021.11.58.000 ;STAR EPWA
TOSPO N052.00.59.000 E023.39.53.000
TOXAR N052.36.48.000 E022.32.20.000
TUPUR N053.07.47.000 E015.48.54.000
TUROL N053.51.31.000 E020.30.00.000
TUSIN N049.50.50.978 E018.34.22.209 ;M984, N744, Z128, Z127, SID EPKK, SID EPKT
UBOMI N052.31.11.000 E015.40.17.000 ;SID EPPO
UDROV N053.15.39.000 E020.50.00.000 ;SID EPSY, STAR EPSY, Y565, Y566
UGNUR N054.36.22.200 E018.16.22.800 ;SID EPGD, STAR EPGD
ULGIL N051.05.55.000 E016.01.12.000
ULGOS N051.12.55.000 E021.22.18.000
ULNOD N050.18.01.000 E019.46.14.000 ;STAR EPKK, STAR EPKT
UMIRU N052.29.27.000 E016.21.16.000
UMTIX N052.03.05.000 E020.54.49.000 ;STAR EPWA
UNDES N052.13.42.000 E021.24.06.000 ;STAR EPWA
UNDUK N053.34.33.999 E017.58.35.000
UNELO N052.57.33.000 E019.29.31.000 ;N191
UNPEG N053.15.25.000 E022.35.44.000
UNTIT N052.28.42.000 E016.26.29.000
UNVOX N053.30.51.000 E015.31.35.000 ;L730
UPKIS N050.21.01.000 E017.59.54.000
UPMAK N050.41.25.300 E019.43.24.500 ;STAR EPKK, STAR EPKT
UPUMO N052.08.56.000 E016.38.05.000
UREKO N050.37.46.000 E022.42.31.000 ;L621, Q258
URORA N054.15.37.000 E016.29.51.000
USALO N049.56.25.000 E019.03.53.000
USTIL N050.49.59.998 E024.06.00.095 ;L980, N191, T425
UTOLU N051.53.49.000 E018.52.03.000
UVIVI N051.35.15.000 E017.53.00.000
UVNUL N052.35.32.000 E017.37.53.000
UVRET N049.53.29.000 E019.44.36.000; STAR EPKK, STAR EPKT
UVRIK N054.27.07.000 E018.09.44.000 ;VOR 11 EPGD, RNAV RWY11 EPGD, STAR EPGD
UVROB N052.34.01.000 E021.01.18.000
UXOSA N052.08.30.000 E016.46.41.000
VABAT N052.32.36.000 E016.11.37.000 ;L619
VABER N054.11.40.000 E023.24.25.000
VADOL N051.17.23.000 E022.06.09.000 ;L621, SID EPLB, T270
VADRU N055.41.51.000 E017.47.08.000
VAGDU N050.52.20.000 E021.21.52.000
VAGNI N051.14.20.000 E015.59.03.000
VAGON N051.18.29.000 E017.06.52.000 ;P193 T205 T707 T710
VAGSA N051.19.59.000 E017.33.21.000
VAKNU N050.28.27.000 E019.09.01.000 ;M992 T709 Z73 Z126
VAMPU N051.51.57.000 E019.07.30.000 ;L980, N869
VAPOS N054.47.43.000 E017.49.36.000 ;N133, SID EPGD, T670
VAREN N049.53.57.998 E022.40.05.998
VAVEL N050.03.59.000 E019.57.43.000
VAVUN N053.28.31.000 E015.19.59.000 ;EPSC arrivals, ILS z or LOC z RWY 31 EPSC, RNAV(GNSS) RWY31 EPSC, L730, L996, M602, Z491
VAXOB N050.06.32.000 E020.00.37.000 ;STAR EPKK
VAXUR N051.48.33.000 E022.05.55.000
VEDOX N054.22.00.000 E016.39.00.000 ;EPD53
VEKAV N053.33.52.000 E019.25.32.000 ;T720
VEKON N054.05.51.000 E017.01.06.000
VELAB N051.28.11.000 E016.44.56.000 ;T710, L616, Z225
VELAX N050.29.20.000 E022.31.14.000 ;EPRZ arrivals, N195, Q258, SID EPRZ
VEMAL N052.27.06.000 E019.10.18.000
VENES N051.08.58.000 E021.54.38.000 ;M857, N195, N5, STAR EPLB
VIBAT N052.05.44.000 E021.10.49.000 ;EPWA VOR 29
VIBUL N054.20.30.000 E015.16.28.000
VIDEV N051.31.19.400 E019.48.09.100
XALUR N051.51.03.000 E019.59.43.000
XANAR N052.28.04.000 E020.43.36.000
XATOG N052.27.35.000 E021.19.56.000
XELET N050.50.15.000 E017.07.33.000
XELOL N054.16.39.000 E014.53.42.000
XELRA N049.31.12.000 E020.55.13.000 ;SID EPKK, SID EPKT
XEMRO N051.51.49.100 E020.49.01.900
XENGO N050.16.05.000 E020.27.51.000 ;STAR EPKT, STAR EPKK
XENIS N052.29.39.000 E020.53.35.000
XENOM N051.45.57.500 E020.44.54.500 ;SID EPWA
XERBI N053.01.56.000 E015.40.16.000
XERTU N052.18.26.000 E020.51.36.000 ;EPWA VOR 15
XESNA N052.25.33.000 E022.17.45.000 ;M857, Y566, Z460
XETED N052.10.20.000 E016.43.53.000
XEVBA N049.56.23.000 E020.04.53.000 ;L984
XEVLU N050.05.44.000 E019.54.46.000 ;M866, T738, Z127
XIBOL N051.48.22.000 E020.29.20.000
XIDNA N051.42.00.000 E016.59.51.000
XIGRI N052.30.39.000 E014.36.49.000
XIMBA N051.39.21.000 E021.25.40.000 ;M860, N195, SID EPMO, SID EPWA, T266
XIMPU N052.08.00.000 E021.04.53.000 ;STAR EPWA
XINDI N052.25.54.000 E020.24.11.000 ;STAR EPMO
XONRA N050.44.44.000 E018.48.21.000 ;STAR EPKK, STAR EPKT


;EPSC
SC361 N053.33.18.300 E014.57.35.900
SC362 N053.26.45.800 E014.57.26.000
SC363 N053.23.29.900 E015.03.44.800

SC364 N053.58.31.100 E015.19.58.900 ;RNAV31
SC366 N053.27.16.100 E015.09.13.600 ;RNAV31
SC367 N015.02.55.100 E015.02.55.100	;RNAV31
SC368 N053.34.38.600 E014.54.59.300 ;RNAV31
SC369 N053.38.32.800 E014.47.23.800 ;RNAV31
SC361 N053.33.18.300 E014.57.35.900 ;RNAV31
SC362 N053.26.45.800 E014.57.26.000 ;RNAV31
SC363 N053.23.29.900 E014.57.26.000 ;RNAV31

SC401 N053.35.43.500 E014.52.53.400
SC402 N053.42.14.700 E014.53.03.600
SC403 N053.45.30.400 E014.46.41.000
SC404 N053.41.42.800 E014.41.11.100
SC406 N053.38.27.500 E014.47.33.500
SC408 N053.32.26.600 E014.59.16.900


;BYDGOSZCZ
BY361 N053.06.15.000 E018.03.56.900 ;ILSX26
BY621 N053.01.49.400 E018.11.18.000 ;GNSS 26
BY622 N053.02.21.700 E018.17.51.800 ;GNSS 26
BY623 N053.07.18.400 E018.16.45.000 ;GNSS 26, VOR 26

BY624 N053.07.36.200 E018.20.24.000 ;VOR 26
BY626 N053.08.09.000 E018.27.22.900 ;VOR 26

BY801 N083.04.27.600 E017.42.51.600 ;GNSS 08
BY802 N052.59.31.100 E017.44.02.100 ;GNSS 08
BY803 N053.00.05.800 E017.50.45.900 ;GNSS 08
BY811 N053.05.02.700 E017.39.45.200 ;GNSS 08

BY821 N083.02.11.300 E017.48.27.600 ;VOR y 08
BY823 N053.06.23.800 E017.34.59.700 ;VOR z 08
BY822 N053.03.49.600 E017.41.30.600 ;VOR z 08


;GDANSK
DER11GD N054.22.16.600 E018.29.30.200 ;SID 11
DER29GD N054.22.51.800 E018.27.07.400 ;SID 29

AGBER N051.15.42.900 E018.55.46.600 ;GNSS 29

GD402 N054.18.40.100 E018.44.00.600
GD411 N054.20.36.000 E018.36.15.900
GD412 N054.16.00.400 E018.32.55.700
GD413 N054.17.54.100 E018.03.10.500
GD421 N054.19.32.600 E018.40.30.500
GD422 N054.28.59.700 E018.47.13.400
GD423 N054.38.14.700 E018.08.24.900
GD431 N053.53.12.300 E018.38.03.100
GD441 N054.19.15.400 E018.41.39.400
GD442 N054.28.16.100 E018.05.14.300

GD511 N054.25.34.600 E018.16.05.400
GD512 N054.20.58.500 E018.12.47.000
GD513 N054.18.51.000 E018.21.26.500
GD514 N054.20.16.900 E018.36.05.900
GD521 N054.35.40.400 E018.05.22.700
GD531 N054.07.41.700 E018.21.46.700
GD532 N053.50.20.700 E018.33.22.600

GD801 N054.24.57.300 E018.18.37.400
GD802 N054.25.32.000 E018.16.15.400
GD803 N054.29.02.000 E018.01.49.200
GD804 N054.30.56.200 E017.53.54.200
GD806 N054.26.19.200 E017.50.38.400
GD807 N054.24.25.200 E017.58.32.700
GD808 N054.22.30.600 E018.06.26.900
GD809 N054.20.34.300 E018.14.24.700
GD811 N054.11.36.600 E018.06.43.300
GD821 N054.33.38.400 E018.05.06.800
GD822 N054.31.43.200 E018.13.01.700
GD823 N054.40.12.500 E018.08.49.500
GD831 N054.23.11.000 E018.47.39.500
GD841 N053.58.55.400 E018.25.23.900
GD851 N054.17.24.500 E018.49.09.900


GD901 N054.19.09.800 E018.42.02.000
GD902 N054.18.34.500 E018.44.23.300
GD903 N054.15.02.500 E018.58.26.700
GD904 N054.13.03.600 E019.06.15.800
GD906 N054.08.28.900 E019.02.52.900
GD907 N054.10.27.500 E018.55.04.600
GD908 N054.12.25.700 E018.47.15.500
GD909 N054.14.23.300 E018.39.25.600
GD911 N054.13.11.800 E018.27.11.300
GD912 N054.11.31.700 E018.10.24.300
GD921 N054.19.37.300 E019.01.49.600
GD922 N054.21.35.800 E018.53.59.100
GD923 N054.23.33.900 E018.46.07.900
GD924 N054.25.31.500 E018.38.15.900
GD926 N054.40.27.600 E018.09.52.400
GD931 N054.09.47.900 E018.36.05.600
GD932 N054.07.15.400 E018.46.14.200
GD933 N053.56.25.800 E018.45.42.800

GD301 N054.18.45.000 E018.12.35.000 ;SID 29

GD401 N054.17.41.100 E018.47.56.600 ;GNSS 29
GD402 N054.18.40.100 E018.44.00.700 ;GNSS 29

GD501 N054.18.34.500 E018.44.23.300 ;ILS 29
GD504 N054.20.33.700 E018.09.04.000 ;GNSS 11
GD506 N051.26.42.700 E018.11.26.400 ;GNSS 11
GD507 N054.25.32.200 E018.16.15.400 ;GNSS 11

GD601 N054.23.55.000 E018.42.52.000
GD602 N054.07.52.000 E018.45.47.000
GD603 N054.08.41.000 E017.53.39.000
GD604 N054.13.07.000 E018.03.16.000
GD606 N054.00.56.000 E018.08.57.000
GD607 N053.53.05.000 E018.46.14.000
GD608 N053.43.46.000 E018.35.25.000
GD609 N053.46.13.000 E018.46.26.000

GD701 N054.18.53.000 E018.10.23.000
GD702 N054.14.20.000 E018.13.56.000
GD703 N053.59.01.000 E018.25.48.000
GD704 N054.04.41.000 E018.01.34.000
GD706 N054.13.41.000 E017.52.43.000
GD707 N053.41.52.000 E018.26.00.000
GD708 N053.44.09.000 E018.37.10.000

;LUBLIN
DER_RWY07 N051.14.33.700 E022.43.52.000
DER_RWY25 N051.14.15.500 E022.41.45.400

LB377 N050.55.13.300 E022.13.59.200
LB386 N051.04.03.100 E022.09.10.100
LB387 N050.59.13.500 E022.18.28.900
LB388 N051.02.28.000 E022.22.15.300
LB389 N051.07.05.800 E022.27.39.800
LB394 N051.11.57.500 E022.25.52.000
LB421 N051.09.49.200 E022.03.37.900
LB422 N051.10.46.500 E022.13.28.300
LB423 N051.11.25.800 E022.20.18.800

LB471 N051.10.17.000 E022.05.13.100
LB472 N051.12.46.300 E022.25.05.600
LB473 N051.18.22.000 E022.33.47.100
LB474 N050.55.10.000 E022.16.35.300
LB476 N050.57.01.000 E022.26.41.800
LB477 N050.59.02.800 E022.37.54.200
LB479 N051.10.13.900 E022.52.55.500
LB481 N051.12.24.900 E022.58.16.600
LB482 N051.20.23.300 E022.55.25.400
LB484 N051.16.35.000 E022.58.04.800

LB509 N051.10.30.000 E022.08.18.000
LB511 N051.11.54.000 E022.20.34.000
LB512 N051.13.20.000 E022.33.30.000
LB513 N050.57.29.000 E022.15.02.000
LB514 N051.01.54.000 E022.21.53.000
LB516 N051.08.30.000 E022.32.12.000
LB384 N051.06.20.000 E022.28.48.000
LB383 N051.03.50.000 E022.35.01.000

LB601 N051.13.52.400 E022.39.04.600
LB602 N051.19.05.100 E022.33.50.400
LB603 N051.18.15.300 E022.27.19.100
LB606 N051.04.37.400 E022.33.33.900
LB607 N051.03.36.200 E022.21.34.900
LB608 N051.02.49.000 E022.12.30.000
LB611 N051.13.01.400 E022.33.11.300
LB612 N051.14.44.400 E022.22.37.700
LB613 N051.16.51.200 E022.15.51.800

LB701 N051.15.25.400 E022.49.54.900
LB702 N051.15.37.800 E022.51.22.400
LB703 N051.20.29.900 E022.49.36.800
LB704 N051.18.57.800 E022.34.44.500
LB706 N051.17.25.200 E022.23.44.700
LB707 N051.15.03.200 E022.10.00.300
LB711 N051.10.41.400 E022.51.37.100
LB712 N051.06.45.900 E022.41.01.700
LB713 N050.58.50.500 E022.32.53.800
LB714 N050.59.31.900 E022.21.00.100
LB716 N051.00.20.000 E022.06.44.000
LB717 N050.54.33.000 E022.13.14.000

;KRAKOW
KK801 N050.05.52.600 E019.55.50.900
KK802 N050.14.49.400 E019.56.05.600
KK803 N050.28.01.600 E019.54.35.400
KK804 N050.34.52.700 E019.54.36.300
KK806 N050.50.08.800 E019.54.38.500
KK807 N050.19.04.300 E019.46.06.900
KK808 N050.10.13.900 E020.28.01.900
KK812 N049.58.00.200 E019.59.43.300
KK813 N049.51.39.500 E020.01.43.800
KK816 N049.44.42.400 E019.33.55.700
KK817 N049.46.08.400 E019.20.29.000

KK601 N050.03.55.800 E019.41.49.900
KK602 N050.04.00.900 E019.24.15.000
KK603 N050.05.51.500 E019.12.56.000
KK604 N050.11.25.000 E018.54.35.200
KK611 N050.19.04.300 E019.46.06.900
KK612 N050.33.01.000 E019.43.12.900
KK613 N050.40.18.400 E019.40.11.200
KK614 N049.44.14.800 E020.08.03.200
KK616 N049.53.03.500 E019.36.46.800
KK617 N049.52.07.700 E019.11.41.900
KK618 N049.43.25.900 E019.31.25.200
KK619 N049.33.44.800 E020.31.15.300
KK599 N050.03.25.700 E019.38.16.000
KK606 N050.08.19.800 E019.36.36.000

KK592 N050.03.05.000 E019.35.48.200
KK701 N050.01.41.200 E019.25.57.300
KK702 N050.00.36.100 E019.18.23.100
KK703 N050.05.46.200 E019.16.35.600
KK704 N050.06.51.300 E019.24.10.400
KK706 N050.07.56.000 E019.31.45.700
KK707 N050.12.55.300 E019.30.03.000
KK708 N050.16.25.100 E019.20.29.800
KK712 N050.10.05.700 E019.47.11.400
KK714 N050.11.24.900 E019.56.00.000
KK717 N049.56.31.000 E019.27.43.700
KK718 N049.57.35.400 E019.35.17.400
KK719 N049.58.39.300 E019.42.51.400
KK721 N050.00.47.000 E019.58.10.700
KK723 N049.52.25.100 E019.37.02.600
KK724 N049.51.20.700 E019.29.29.800
KK726 N049.53.01.000 E019.20.12.500
KK727 N049.55.04.600 E018.47.31.500
KK728 N049.47.01.900 E019.43.09.700

KK371 N050.06.13.200 E019.58.19.800
KK377 N050.01.37.800 E019.18.01.800
KK501 N050.07.34.200 E020.08.13.000
KK502 N050.08.35.900 E020.15.49.300
KK503 N050.13.46.800 E020.14.07.600
KK504 N050.12.45.000 E020.06.30.500
KK506 N050.11.42.700 E019.58.53.800
KK507 N050.10.39.800 E019.51.17.400
KK508 N050.09.07.800 E019.40.16.300
KK509 N050.11.27.400 E019.33.58.800
KK511 N050.28.29.800 E018.32.18.100
KK512 N050.34.15.700 E020.02.54.800
KK513 N050.09.37.100 E020.23.25.900
KK514 N050.04.26.100 E020.25.06.300
KK516 N050.03.25.000 E020.17.30.500
KK517 N050.02.23.400 E020.09.55.000
KK518 N050.01.21.200 E020.02.19.900
KK519 N050.00.18.600 E019.54.45.100
KK521 N049.59.15.500 E019.47.10.600
KK524 N049.58.30.100 E019.22.43.800
KK526 N049.57.17.400 E018.48.21.000
KK527 N049.57.12.500 E020.11.36.700
KK528 N049.58.14.000 E020.19.11.400
KK529 N049.59.15.000 E020.26.46.400

;KK361 N050.08.00.700 E020.11.28.700 ;ILS 25
;KK362 N050.06.31.800 E020.00.36.500 ;ILS 25
;KK363 N050.05.43.800 E019.54.46.200 ;ILS 25
;KK364 N050.09.04.500 E020.11.03.500 ;VOR 25
;KK366 N050.07.04.800 E020.00.24.300 ;VOR 25
;KK367 N050.01.55.800 E019.20.46.800 ;VOR 07
;KK368 N050.03.12.400 E019.33.24.400 ;VOR 07
;KK488 N050.12.08.700 E020.04.19.300 ;GNSS 25
;KK489 N050.07.15.500 E020.05.56.100 ;GNSS 25
;KK492 N050.06.13.100 E019.58.20.000 ;GNSS 25
;KK493 N050.02.06.400 E019.28.54.800 ;GNSS 25
;KK494 N050.02.22.300 E020.07.32.500 ;GNSS 25
;KK588 N050.06.53.200 E019.26.33.200 ;GNSS 07
;KK591 N050.02.00.600 E019.28.13.700 ;GNSS 07
;KK592 N050.03.05.000 E019.35.48.200 ;GNSS 07
;KK593 N050.06.38.200 E020.01.22.600 ;GNSS 07


;KATOWICE
DER09 N050.28.33.500 E019.06.00.500
KT837 N050.28.31.400 E019.16.58.700
KT838 N050.23.07.300 E019.16.55.600
KT839 N050.33.42.700 E019.17.01.800
KT841 N050.28.23.100 E019.16.39.200
KT842 N050.33.42.800 E019.16.45.000
KT843 N050.39.45.300 E019.18.52.100
KT846 N050.45.57.500 E019.01.09.700
KT848 N050.28.10.000 E019.42.44.600
KT851 N050.21.17.700 E020.11.23.900
KT856 N050.23.07.400 E019.16.33.500
KT861 N050.39.22.900 E018.38.34.300
KT862 N050.10.31.600 E018.52.43.300
KT863 N050.06.21.500 E018.41.37.900
KT864 N050.03.15.900 E018.45.54.800
KT866 N050.06.17.000 E019.15.24.900
KT867 N049.54.34.200 E019.22.05.800
KT868 N049.49.59.900 E019.24.41.200
KT869 N050.02.49.700 E018.32.18.100
DER27 N050.28.33.800 E019.03.34.500
KT644 N050.28.34.600 E018.52.28.900
KT646 N050.28.27.000 E018.52.11.100
KT647 N050.33.19.200 E018.45.10.600
KT648 N050.39.23.900 E018.41.45.700
KT649 N050.43.57.000 E018.40.12.500
KT651 N050.39.16.100 E018.30.13.400
KT653 N050.38.45.400 E018.59.22.600
KT657 N050.23.24.000 E018.17.52.000
KT658 N050.20.39.700 E018.21.42.400
KT659 N050.19.00.700 E018.24.00.900
KT661 N050.07.51.800 E018.14.29.800
KT662 N050.20.31.000 E018.52.21.500
KT664 N050.15.23.100 E019.05.59.000
KT667 N050.02.59.900 E018.46.16.800
KT668 N050.13.18.600 E019.11.40.900
KT669 N049.58.30.100 E019.22.43.800
KT671 N050.03.54.300 E019.34.47.300

KT386 N050.28.28.300 E018.53.32.600
KT742 N050.28.28.200 E018.43.21.400
KT743 N050.28.27.500 E018.35.31.800
KT744 N050.23.09.800 E018.35.34.200
KT746 N050.23.10.500 E018.43.22.600
KT747 N050.23.10.600 E018.51.11.300
KT748 N050.23.01.700 E019.34.45.100
KT749 N050.09.01.600 E019.39.31.700
KT752 N050.03.42.700 E019.41.19.800
KT753 N050.17.22.800 E018.51.12.000
KT754 N050.10.39.500 E018.35.39.700
KT756 N050.33.45.900 E018.43.20.300
KT757 N050.33.46.000 E018.51.10.800
KT758 N050.33.43.400 E019.14.04.300
KT759 N050.33.41.700 E019.21.13.100
KT762 N050.39.02.700 E018.33.54.800
KT392 N050.28.25.500 E019.15.14.800
KT541 N050.28.22.800 E019.25.26.300
KT542 N050.28.20.100 E019.33.15.900
KT543 N050.23.02.300 E019.33.14.600
KT544 N050.23.05.000 E019.25.22.100
KT546 N050.23.07.200 E019.17.33.400
KT547 N050.23.08.800 E019.09.44.700
KT549 N050.16.10.500 E018.46.29.800
KT554 N050.17.54.100 E019.57.41.000
KT556 N050.17.07.000 E020.10.56.200
KT561 N050.33.40.400 E019.25.30.400
KT562 N050.38.40.100 E019.25.34.200
KT563 N050.38.36.600 E019.35.17.900
KT564 N050.43.17.600 E019.48.49.900
KT566 N050.33.42.700 E019.17.39.800
KT567 N050.33.44.200 E019.09.49.300
KT568 N050.33.45.400 E019.01.58.800
KT569 N050.33.07.900 E018.41.48.100


KT361 N050.31.12.100 E019.29.16.900 ;ILS Y 27
KT362 N050.28.22.900 E019.24.46.900 ;ILS Y 27
KT363 N050.28.24.900 E019.17.36.900
KT364 N050.28.26.100 E019.12.22.300
KT366 N050.27.07.900 E019.17.26.000
KT367 N050.27.45.900 E018.51.52.400 ;VOR 09
KT368 N050.26.16.700 E018.53.48.800
KT369 N050.25.20.300 E018.53.02.200
KT371 N050.27.48.200 E018.52.37.400
KT372 N050.27.14.400 E019.16.38.100 ;VOR 27
KT373 N050.26.37.000 E018.35.32.700 ;VOR 09
KT378 N050.25.08.100 E019.33.16.500 ;VOR 27
KT384 N050.21.02.000 E018.50.38.000 ;GNSS 09
KT385 N050.28.28.300 E018.47.51.200 ;GNSS 09
KT386 N050.28.28.300 E018.53.32.600 ;GNSS 09
KT387 N050.28.24.200 E019.20.22.100 ;GNSS 09
KT388 N050.33.23.100 E019.23.08.600 ;GNSS 27
KT389 N050.23.23.700 E019.23.01.400 ;GNSS 27
KT391 N050.28.23.400 E019.23.05.000 ;GNSS 27
KT392 N050.28.25.400 E019.15.15.400 ;GNSS 27
KT393 N050.28.28.300 E018.47.17.800 ;GNSS 27

KT736 N050.28.34.600 E018.53.50.400
KT737 N050.28.34.600 E018.51.29.500
KT738 N050.28.34.500 E018.43.21.400
KT739 N050.28.33.800 E018.35.31.700
KT536 N050.28.31.700 E019.15.34.700
KT537 N050.28.31.100 E019.17.56.800
KT538 N050.28.29.000 E019.25.26.500
KT539 N050.28.26.300 E019.33.16.100

KT773 N050.27.40.100 E018.38.14.100; VOR 09
KT772 N050.27.58.100 E018.46.02.800; VOR 09
KT771 N050.28.15.500 E018.53.51.600; VOR 09
KT573 N050.27.17.400 E019.31.08.500; VOR 27
KT572 N050.27.42.700 E019.23.20.700; VOR 27
KT571 N050.28.07.400 E019.15.32.800; VOR 27
KT581 N050.29.31.500 E018.47.37.300; VOR 27


;LUBLIN
LB362 N051.14.10.200 E022.41.07.700 ;ILS z 25
LB363 N051.18.20.100 E022.52.44.100 ;ILS y 25

LB370 N051.07.59.700 E022.33.50.800 ;GNSS 07
LB371 N051.06.52.200 E022.26.07.000 ;GNSS 07
LB372 N051.11.44.000 E022.24.19.100 ;GNSS 07
LB373 N051.13.16.600 E022.34.55.700 ;GNSS 07
LB374 N051.15.18.600 E022.49.06.300 ;GNSS 07

;LODZ
LL601 N051.41.38.700 E019.16.16.000
LL602 N051.46.21.300 E019.13.35.200
LL603 N051.47.17.400 E019.05.05.000
LL604 N051.56.37.000 E019.27.47.800
LL606 N051.47.41.100 E019.19.39.600
LL608 N051.46.45.900 E019.32.31.700
LL801 N051.45.24.000 E019.33.29.500
LL802 N051.51.25.900 E019.30.05.600
LL803 N051.52.37.400 E019.11.30.600
LL804 N051.41.53.500 E019.43.39.400
VIDEV N051.31.19.400 E019.48.09.100 
LL701 N051.46.27.100 E019.07.17.800
LL702 N051.48.07.200 E019.14.53.200
LL703 N051.52.49.700 E019.12.11.800
LL704 N051.51.09.400 E019.04.35.800
LL706 N051.43.24.600 E019.17.34.000
LL712 N051.52.19.800 E019.34.15.000
LL501 N051.46.33.900 E019.37.29.300
LL528 N051.41.31.200 E019.38.36.600
LL527 N051.43.09.300 E019.46.12.350
LL526 N051.52.27.700 E019.34.10.600
LL524 N051.53.46.400 E019.40.16.500
LL523 N051.49.10.700 E019.49.40.100
LL522 N051.47.52.500 E019.43.34.500


;POZNAN
PO371 N052.20.31.000 E017.13.49.800 ;GNSS 10
PO373 N052.20.32.100 E017.13.46.500 ;GNSS 28
PO374 N052.28.59.100 E016.30.09.100 ;GNSS 28
PO375 N052.20.42.000 E016.36.13.100 ;GNSS 28
PO378 N052.24.21.000 E016.54.17.100 ;GNSS 28, ILS 28
PO379 N052.27.05.300 E016.37.46.100 ;VOR 10
PO381 N052.21.15.800 E017.05.19.600 ;VOR 28
PO382 N052.24.11.800 E016.54.11.300 ;VOR 28
PO401 N052.22.06.100 E017.05.49.800 ;ILS 28
PO402 N052.24.25.100 E016.53.56.300 ;ILS 28
PO403 N052.27.05.300 E016.37.46.100 ;VOR 10
PO404 N052.21.16.600 E017.05.16.800 ;VOR 28
PO406 N052.24.17.000 E016.53.51.100 ;VOR 28
PO504 N052.35.57.000 E016.07.08.000 ;STAR 10
PO506 N052.32.34.000 E016.11.33.000 ;STAR 10
PO507 N052.30.26.000 E016.14.20.000 ;STAR 10
PO501 N052.03.03.000 E017.30.26.000 ;STAR 10
PO502 N052.04.49.000 E017.13.53.000 ;STAR 10
PO503 N052.05.08.000 E016.50.26.000 ;STAR 10
PO511 N052.21.18.000 E016.26.08.000 ;STAR 28
PO512 N052.11.41.000 E016.38.27.000 ;STAR 28
PO513 N052.11.43.000 E016.12.42.000 ;STAR 28
PO514 N052.11.10.000 E016.17.14.000 ;STAR 28
PO516 N052.09.39.000 E016.29.43.000 ;STAR 28
PO508 N052.00.20.000 E016.34.17.000 ;STAR 28
PO517 N052.04.06.000 E017.20.42.000 ;STAR 28

;RADOM
RA501 N051.23.21.800 E021.12.13.500
RA502 N051.18.25.900 E021.14.18.700
RA503 N051.21.47.700 E021.34.39.800
RA504 N051.26.37.600 E021.32.38.600
RA506 N051.25.21.400 E021.24.54.900
RA507 N051.21.23.500 E021.01.09.100
RA511 N051.30.53.000 E021.16.04.700
RA521 N051.18.13.700 E021.10.00.700
RA522 N051.16.05.200 E020.57.20.200
RA523 N051.20.25.500 E020.55.27.600
RA524 N051.21.43.700 E021.03.09.500
RA526 N051.24.43.100 E021.20.57.800
RA601 N051.21.53.900 E021.04.09.400
RA602 N051.17.04.500 E021.06.13.400
RA603 N051.15.46.600 E020.58.32.100
RA701 N051.24.45.100 E021.21.14.800
RA702 N051.19.55.400 E021.23.17.200
RA703 N051.18.38.600 E021.15.34.900

;RZESZOW
RZ361 N050.13.07.700 E022.35.06.700 ;ILS Y 27
RZ362 N050.01.20.400 E022.31.05.000 ;ILS Y 27
RZ363 N050.06.25.400 E022.13.22.800 ;ILS Y 27
RZ364 N050.03.50.600 E022.12.51.500 ;ILS X 27
RZ366 N050.06.56.100 E021.54.14.600 ;VOR Z 09
RZ367 N050.01.03.500 E021.35.10.800 ;VOR Y 09
RZ368 N050.06.56.000 E021.54.15.500 ;VOR Y 09
RZ369 N050.06.45.200 E022.08.03.200 ;VOR 27
RZ370 N050.11.43.300 E021.50.46.700 ;GNSS 09
RZ371 N050.04.49.000 E022.13.17.200 ;ILS X 27
RZ372 N050.11.48.600 E021.43.00.000 ;GNSS 09
RZ373 N050.06.49.000 E021.42.52.300 ;GNSS 09
RZ374 N050.06.23.000 E022.16.08.200 ;GNSS 09
RZ376 N050.11.27.300 E022.11.00.400 ;GNSS 27
RZ377 N050.11.20.300 E022.18.46.900 ;GNSS 27
RZ378 N050.06.20.700 E022.18.35.500 ;GNSS 27
RZ379 N050.06.47.100 E021.45.31.800 ;GNSS 27

;WROCLAW
WR701 N051.02.50.400 E017.03.56.800
WR702 N051.02.10.800 E017.06.05.000
WR703 N051.00.27.400 E017.11.38.900
WR704 N050.58.15.000 E017.18.44.800
WR706 N051.03.10.500 E017.22.36.400
WR707 N051.25.21.300 E017.09.41.500
WR711 N051.12.35.700 E017.28.53.600
WR712 N051.18.56.000 E017.33.09.000
WR721 N050.56.02.100 E017.25.50.100
WR722 N050.50.43.600 E017.44.36.900
WR731 N050.51.06.700 E017.21.58.800
WR732 N050.39.26.500 E017.32.30.600
WR741 N050.53.19.400 E017.14.54.100
WR742 N050.55.31.600 E017.07.48.800
WR743 N050.54.43.300 E016.29.26.100
WR751 N051.01.21.500 E016.48.52.800
WR752 N051.03.32.000 E016.41.45.000
WR753 N051.05.19.700 E016.33.30.500
WR754 N051.10.26.800 E016.14.01.100
WR601 N051.08.14.100 E016.46.21.700
WR602 N051.08.53.300 E016.44.13.100
WR603 N051.11.11.200 E016.36.38.900
WR604 N051.13.21.100 E016.29.29.000
WR606 N051.18.18.100 E016.33.16.500
WR607 N051.16.08.100 E016.40.27.000
WR608 N051.21.06.800 E016.44.09.200
WR609 N051.27.59.600 E016.49.43.300
WR611 N051.28.07.800 E017.17.49.700
WR612 N051.29.22.600 E017.23.54.500
WR621 N051.05.05.500 E017.06.45.500
WR631 N051.08.23.800 E016.25.42.400
WR632 N051.06.14.200 E016.32.51.600
WR633 N051.01.26.000 E016.48.38.500
WR634 N050.57.03.500 E017.02.52.000
WR636 N050.42.47.000 E017.21.27.900
WR641 N051.01.17.100 E016.29.05.100
WR642 N050.56.19.900 E016.25.19.500
WR652 N050.59.13.400 E017.15.37.200

THR11WR N051.05.56.300 E016.53.52.700
THR29WR N051.06.31.700 E016.51.57.000


WR801 N051.04.11.200 E016.59.34.800
WR802 N051.03.09.400 E017.02.55.300
WR803 N051.21.16.900 E017.12.37.100
WR811 N051.17.58.700 E017.35.48.900
WR821 N050.54.18.600 E016.51.57.200
WR822 N050.58.15.200 E016.39.04.100
WR823 N050.52.25.900 E016.34.37.700
WR824 N050.32.48.500 E017.09.49.800
WR831 N051.01.17.100 E016.29.05.100
WR832 N051.01.53.200 E016.21.13.500
WR841 N050.52.52.800 E017.26.41.400

WR901 N051.07.25.100 E016.49.02.200
WR902 N051.12.09.200 E016.33.27.300
WR903 N051.22.18.200 E016.42.21.400
WR904 N051.15.29.400 E017.04.42.000



WR361 N051.13.22.600 E017.16.10.600
WR362 N051.07.47.300 E017.26.17.500
WR363 N051.02.27.600 E017.05.10.800
WR364 N051.02.42.500 E017.04.21.300
WR366 N051.07.20.200 E016.43.34.100
WR367 N051.06.29.000 E016.43.20.900
WR369 N051.02.09.700 E017.06.07.400
WR371 N051.07.25.800 E016.43.13.100
WR372 N051.06.32.600 E016.43.00.700
WR373 N051.08.54.300 E016.44.10.400
WR374 N050.59.00.200 E017.16.19.200
WR376 N050.55.40.600 E017.26.57.200
WR377 N051.02.10.800 E017.06.05.000

WR382 N051.15.43.500 E016.37.51.100
WR383 N051.12.02.600 E016.33.50.800

WR401 N051.17.33.900 E016.35.53.300 ;GNSS 11
WR402 N051.12.34.400 E016.32.03.700 ;GNSS 11
WR403 N051.11.11.200 E016.36.38.900 ;GNSS 11
WR404 N051.08.53.300 E018.44.13.100 ;GNSS 11
WR406 N051.01.20.600 E016.50.45.500 ;GNSS 11

WR501 N050.56.29.900 E017.24.21.200 ;GNSS 29
WR502 N050.59.22.500 E017.15.08.100 ;GNSS 29
WR503 N050.54.53.600 E017.11.38.500 ;GNSS 29
WR504 N051.02.11.000 E017.06.04.600 ;GNSS 29
WR506 N051.01.48.300 E016.51.03.000 ;GNSS 29

;EPWA
WA401 N052.07.36.000 E021.00.04.500
WA402 N052.02.08.800 E020.55.28.400
WA403 N052.00.50.300 E021.02.28.600
WA404 N052.05.44.300 E021.10.04.500
WA411 N052.15.19.300 E020.38.44.300
WA412 N052.16.57.700 E020.32.48.000
WA413 N052.18.35.800 E020.26.51.300
WA414 N052.20.13.600 E020.20.54.200
WA442 N051.53.18.600 E021.27.40.900
WA444 N052.27.52.900 E020.04.46.000
WA448 N052.13.57.200 E020.23.51.200
WA452 N051.59.02.200 E020.58.20.600
WA468 N052.04.04.600 E021.13.40.400
WA507 N052.14.50.900 E020.34.30.600
WA508 N052.22.43.000 E020.43.40.600
WA511 N051.54.17.400 E021.42.18.200
WA512 N052.03.47.300 E021.43.28.400
WA531 N052.03.27.500 E021.01.33.900
WA532 N052.07.22.300 E020.46.28.800
WA533 N051.58.11.500 E021.08.15.100
WA534 N051.54.40.100 E021.11.17.800
WA536 N051.51.08.500 E021.14.20.000
WA537 N051.47.36.900 E021.17.21.800
WA564 N051.44.47.800 E020.52.44.300
WA571 N052.19.44.000 E021.26.32.000
WA572 N052.21.38.200 E021.28.59.400
WA573 N052.09.39.900 E021.53.28.100
WA593 N051.33.17.800 E020.53.09.700
WA594 N052.09.57.300 E021.35.01.700
WA601 N052.08.45.300 E021.12.08.200
WA602 N052.09.11.500 E021.00.42.600
WA604 N051.59.54.400 E021.05.43.400
WA606 N052.02.13.900 E020.55.55.800
WA607 N052.10.00.600 E021.11.51.200
WA608 N052.03.48.300 E021.02.04.800
WA609 N052.01.50.500 E020.57.11.600
WA614 N052.20.28.900 E020.48.46.200
WA616 N052.23.59.800 E020.45.20.200
WA617 N052.27.30.600 E020.42.33.400
WA618 N052.31.01.300 E020.39.26.200
WA651 N052.05.52.200 E021.10.11.300
WA653 N052.02.08.800 E020.55.28.400
WA656 N052.01.13.200 E021.04.47.700
WA657 N052.11.14.200 E021.14.51.900
WA663 N052.36.27.700 E020.37.26.200
WA664 N052.04.44.300 E020.18.58.000
WA666 N052.02.01.700 E020.18.33.600
WA698 N052.15.12.900 E021.41.42.600
WA699 N052.01.26.600 E021.05.26.000
WA701 N052.09.34.900 E020.43.52.900
WA702 N052.11.11.600 E020.47.10.200
WA703 N052.11.33.700 E020.43.18.800
WA704 N052.13.17.000 E021.51.50.300
WA706 N052.16.06.100 E020.47.14.900
WA707 N052.07.57.900 E020.40.47.200
WA708 N052.11.16.000 E020.39.31.700
WA709 N052.13.24.700 E020.43.19.200
WA729 N052.05.08.400 E021.15.03.100
WA731 N052.03.27.800 E021.20.56.100
WA732 N052.01.46.900 E021.26.48.700
WA733 N052.00.05.400 E021.32.41.700
WA751 N052.16.08.500 E020.47.10.700
WA753 N052.10.22.300 E020.42.10.700
WA754 N052.09.34.900 E020.19.58.800
WA756 N052.07.44.900 E020.22.35.800
WA791 N052.20.48.400 E020.46.26.000
WA797 N052.20.10.100 E020.49.58.200
WA798 N052.20.50.000 E020.53.08.000
WA799 N052.14.12.900 E020.42.44.200
WA901 N052.10.49.500 E020.54.53.200
WA902 N052.10.45.600 E020.50.06.400
WA903 N052.11.51.900 E020.42.14.400
WA921 N052.09.25.100 E020.42.37.800
WA931 N052.13.07.200 E020.52.43.000
WA932 N052.15.54.600 E020.47.57.000

WA801 N052.12.47.100 E020.55.32.500
WA802 N052.11.16.800 E020.41.21.300
WA803 N052.14.43.900 E020.46.52.200


FAF11 N052.13.38.600 E020.44.47.300
FAF15 N052.16.52.700 E020.51.56.900
FAF29 N052.06.51.000 E021.09.00.500
FAF33 N052.02.06.800 E021.04.51.000

OSNUT N052.18.11.900 E020.50.47.200 ;GNSS 15
WA699 N052.01.26.600 E021.05.26.000 ;GNSS 15
TEBRU N052.06.13.500 E021.11.13.200 ;GNSS 29
WA799 N052.14.12.900 E020.42.44.200 ;GNSS 29
WA599 N052.16.14.400 E020.35.17.800 ;GNSS 33

;EPMO
MO362 N052.19.29.800 E021.01.40.000
MO801 N052.23.49.600 E020.05.27.500
MO802 N052.28.45.300 E020.04.09.100
MO803 N052.29.23.600 E020.10.36.700
MO804 N052.30.01.800 E020.17.04.400
MO807 N052.20.18.500 E020.21.12.900
MO808 N052.25.36.600 E020.20.07.700
MO808 N052.25.35.600 E020.20.07.700
MO809 N052.18.07.200 E020.08.35.300
MO811 N052.19.48.500 E020.14.44.700
MO812 N052.25.05.500 E020.13.39.000
MO813 N052.24.35.100 E020.07.10.200
MO814 N052.29.32.200 E020.06.07.500
MO816 N052.35.46.700 E020.56.38.900
MO817 N052.33.42.400 E021.02.52.800
MO818 N052.15.34.700 E021.01.26.600
MO819 N052.30.02.600 E020.12.35.000
MO821 N052.27.54.400 E020.48.51.600
MO822 N052.32.00.800 E020.47.47.400
MO823 N052.36.27.700 E020.22.22.600
MO824 N052.30.32.900 E020.19.06.500
MO826 N052.31.02.600 E020.25.35.900
M0827 N052.31.32.900 E020.32.16.300
MO828 N052.32.39.600 E020.47.18.500
MO831 N052.32.52.900 E020.47.06.300
MO832 N052.19.49.300 E020.19.43.400
MO841 N052.33.47.400 E020.01.14.600
MO846 N052.36.42.100 E020.21.59.100
MO851 N052.19.19.100 E020.19.51.200
MO852 N052.18.32.300 E020.11.51.700
MO853 N052.25.15.400 E019.59.49.100
MO854 N052.30.33.200 E020.59.29.300
MO856 N052.25.57.600 E021.10.09.400
MO859 N052.22.58.300 E021.16.40.300
MO861 N052.09.48.500 E020.49.39.600
MO864 N052.31.15.200 E020.39.37.900
MO866 N052.27.58.900 E020.48.50.500
MO926 N052.30.23.800 E020.57.28.600
MO927 N052.31.25.700 E021.03.43.400
MO928 N052.32.47.000 E021.09.57.200
MO929 N052.37.32.900 E021.07.30.700
MO931 N052.36.21.300 E021.01.14.900
MO932 N052.35.09.300 E020.54.59.300
MO933 N052.30.18.300 E020.30.02.000
MO934 N052.29.23.500 E020.04.07.800
MO936 N052.26.20.000 E019.56.19.900
MO937 N051.37.07.500 E021.16.19.900
MO938 N051.33.30.700 E021.10.54.700
MO941 N052.18.39.200 E021.18.28.900
MO943 N052.23.27.100 E020.19.48.500
MO944 N052.14.09.600 E020.11.35.100
MO946 N052.25.06.500 E020.48.19.700
MO947 N052.25.26.200 E020.56.35.900
MO948 N051.53.02.400 E021.30.58.200
MO951 N052.24.18.300 E020.24.38.800
MO952 N052.19.30.400 E020.26.51.200
MO953 N052.20.45.300 E020.33.53.900
MO954 N052.24.47.900 E020.40.47.700
MO956 N052.12.12.300 E021.14.29.200
MO991 N052.29.01.000 E020.21.30.000
MO992 N052.27.19.600 E020.41.49.000
MO994 N052.28.50.300 E020.58.03.100
MO997 N052.28.30.200 E021.07.14.600
MO999 N051.46.24.300 E021.30.18.500

;SZCZECIN
SC361 N053.33.18.300 E014.57.35.900
SC362 N053.26.45.800 E014.57.26.000
SC363 N053.23.29.900 E015.03.44.800
SC364 N053.28.31.100 E015.19.58.900
SC366 N053.27.16.100 E015.09.13.600
SC367 N053.30.32.600 E015.02.55.100
SC368 N053.34.38.600 E014.54.59.300
SC369 N053.38.32.800 E014.47.23.800

;ZIELONA GORA
ZG361 N052.12.10.600 E015.44.55.200 ;GNSS 24
ZG362 N052.16.56.500 E016.00.01.400 ;GNSS 24
ZG363 N052.12.49.000 E016.03.27.500 ;GNSS 24
ZG364 N052.05.49.300 E015.39.21.600 ;GNSS 24

;OLSZTYN MAZURY
SY411 N053.32.55.700 E020.58.30.900
SY412 N053.36.59.100 E020.47.13.700
SY413 N053.33.57.300 E020.26.46.900
SY414 N053.28.16.800 E020.24.26.400
SY416 N053.40.51.600 E021.07.18.500
SY417 N053.44.40.800 E021.11.34.100
SY511 N053.24.50.400 E020.53.59.100
SY512 N053.26.37.200 E020.45.00.400
SY513 N053.33.32.100 E020.26.26.300
SY514 N053.34.30.600 E020.49.23.700
SY516 N053.36.36.800 E021.09.06.600
SY517 N053.32.43.400 E020.58.23.800

SY363 N053.31.53.500 E020.58.13.000
SY362 N053.48.54.700 E020.59.13.500
SY364 N053.33.44.500 E020.47.56.100
SY361 N053.27.10.800 E020.21.13.800
SY366 N053.21.49.500 E020.39.10.100
SY357 N053.42.45.700 E020.54.37.800
SY791 N053.26.34.600 E020.25.40.400
SY792 N053.33.17.700 E020.36.13.900
SY793 N053.49.01.100 E020.55.42.200
SY801 N053.44.23.900 E020.52.25.600
SY369 N053.19.28.800 E020.51.00.100
SY371 N053.51.29.000 E021.10.02.000
SY801 N053.44.23.900 E020.52.25.600
SY802 N053.41.38.000 E021.03.29.800
SY803 N053.36.20.600 E021.00.26.100
SY804 N053.21.57.000 E020.52.22.500
SY367 N053.18.23.000 E020.50.23.500
SY368 N053.23.47.600 E020.53.24.100

SY802 N053.41.38.000 E021.03.29.800

;PUNKTY VFR W CTRACH
;EPSY
EPSYB N053.32.40.000 E020.49.13.000
EPSYE N053.28.26.000 E020.58.03.000
EPSYW N053.30.07.000 E020.53.55.000
EPSYZ N053.25.13.000 E021.07.05.000
;EPWA/EPMO
EPWAA N052.03.48.000 E020.44.36.000
EPWAB N052.11.03.000 E020.36.50.000
EPWAD N052.20.36.000 E021.13.40.000
EPWAE N052.10.42.000 E020.59.00.000
EPWAF N052.15.39.000 E020.44.08.000
EPWAG N051.59.27.000 E021.14.05.000
EPWAJ N052.22.40.000 E020.55.00.000
EPWAK N052.05.29.000 E021.14.15.000
EPWAL N052.20.00.000 E020.53.00.000
EPWAM N052.13.22.000 E021.15.00.000
EPWAN N052.13.03.000 E021.05.50.000
EPWAO N052.11.51.000 E021.03.06.000
EPWAP N052.18.17.000 E021.05.02.000
EPWAR N052.08.06.000 E020.53.22.000
EPWAT N051.58.14.000 E020.50.01.000
EPWAW N052.09.25.000 E020.56.59.000
EPWAX N052.06.31.000 E020.49.51.000
EPWAZ N052.17.25.000 E021.00.39.000
EPMOH N052.32.57.000 E020.30.04.000
EPMOI N052.28.28.000 E020.38.55.000
EPMOJ N052.22.40.000 E020.55.00.000
EPMOS N052.36.21.000 E020.23.58.000
EPMOU N052.25.45.000 E020.39.15.000
EPMOV N052.23.41.000 E020.32.26.000
EPMOY N052.34.48.000 E020.46.25.000
EPMOQ N052.22.40.000 E020.11.13.000

;EPLB
EPLBD N051.20.44.00 E022.38.26.00 
EPLBB N051.05.25.00 E022.17.16.00 
EPLBR N051.19.42.00 E022.59.49.00 
EPLBJ N051.06.03.00 E022.34.58.00 
EPLBK N051.06.57.00 E022.45.43.00 
EPLBL N051.18.15.00 E022.52.13.00 
EPLBE N051.09.38.00 E022.56.43.00 
EPLBP N051.07.48.00 E022.56.43.00 
EPLBS N051.13.18.00 E022.44.31.00 
EPLBT N051.16.49.00 E022.42.14.00 
EPLBW N051.20.59.00 E022.20.42.00 
EPLBZ N051.10.40.00 E022.31.42.00 

;EPBY
EPBYC N052.58.16.00 E018.32.23.00
EPBYK N052.58.21.00 E017.43.33.00
EPBYM N053.13.25.00 E018.02.13.00
EPBYN N053.10.34.00 E018.03.23.00
EPBYO N053.08.23.00 E017.35.30.00
EPBYS N053.03.09.00 E017.59.46.00
EPBYU N053.12.28.00 E018.22.43.00
EPBYW N052.58.34.00 E018.05.58.00

;EPGD
EPGDG N054.22.28.00 E018.46.44.00 
EPGDI N054.28.16.00 E018.18.35.00 
EPGDM N054.26.41.00 E018.32.40.00 
EPGDN N054.24.42.00 E018.29.06.00 
EPGDS N054.20.42.00 E018.26.06.00 
EPGDX N054.16.34.00 E018.29.22.00 
EPGDZ N054.19.30.00 E018.11.01.00 

;EPSC
EPSCI N053.32.26.00 E014.47.14.00
EPSCN N053.36.06.00 E014.57.51.00
EPSCR N053.39.04.00 E015.04.01.00
EPSCS N053.34.04.00 E014.50.49.00

;EPPO
EPPOM N052.14.00.00 E016.50.00.00
EPPON N052.27.55.00 E016.51.34.00
EPPOW N052.22.33.00 E016.37.12.00
EPPOS N052.22.40.00 E016.49.32.00
EPPOZ N052.10.00.00 E017.10.00.00
EPPOC N052.30.41.00 E016.44.25.00
EPPOE N052.12.41.00 E017.17.09.00
EPPOK N052.19.53.00 E017.10.16.00
EPPOT N052.27.11.00 E016.58.48.00

;EPWR
EPWRB N051.08.04.00 E016.59.42.00
EPWRG N050.59.22.00 E016.50.03.00
EPWRK N051.02.54.00 E016.36.48.00
EPWRM N051.11.00.00 E016.47.38.00
EPWRN N051.07.07.00 E016.53.55.00
EPWRS N051.04.30.00 E016.53.02.00

;EPZG
EPZGC N052.01.54.00 E015.37.37.00
EPZGD N052.09.29.00 E015.31.12.00
EPZGI N052.18.15.00 E016.07.53.00
EPZGK N052.04.00.00 E015.51.36.00
EPZGN N052.09.53.00 E015.48.37.00
EPZGS N052.07.18.00 E015.48.37.00
EPZGW N052.05.51.00 E016.05.43.00
EPZGZ N052.13.51.00 E015.48.20.00

;EPRZ
EPRZA N050.16.34.00 E021.36.22.00 
EPRZB N049.59.02.00 E021.56.40.00 
EPRZC N049.59.25.00 E022.08.42.00 
EPRZD N050.19.14.00 E022.20.41.00 
EPRZE N050.03.09.00 E022.14.03.00 
EPRZJ N050.01.37.00 E022.42.51.00 
EPRZK N050.14.46.00 E021.47.12.00 
EPRZM N050.14.57.00 E022.07.19.00 
EPRZN N050.10.00.00 E022.02.00.00 
EPRZO N050.18.36.00 E021.44.12.00 
EPRZS N050.03.52.00 E022.02.06.00 
EPRZT N049.58.22.00 E022.02.02.00 
EPRZW N050.04.14.00 E021.43.45.00 
EPRZZ N050.03.23.00 E021.28.59.00 

;EPLL
EPLLC N051.43.55.00 E018.57.13.00
EPLLE N051.48.00.00 E019.38.10.00 
EPLLG N051.41.26.00 E019.08.02.00 
EPLLH N051.38.16.00 E019.16.17.00 
EPLLK N051.43.43.00 E019.48.38.00 
EPLLL N051.48.34.00 E019.17.10.00 
EPLLR N051.38.20.00 E019.29.55.00 
EPLLS N051.41.25.00 E019.26.36.00 
EPLLW N051.44.40.00 E019.07.12.00 
EPLLX N051.53.30.00 E019.38.06.00 
EPLLY N051.44.55.00 E019.21.00.00 

;EPKK/KT
EPKKB N050.16.00.00 E019.26.00.00  
EPKKC N050.37.25.00 E018.50.10.00  
EPKKD N049.51.25.00 E020.08.30.00  
EPKKE N050.02.31.00 E020.05.52.00  
EPKKG N050.24.00.00 E019.03.00.00  
EPKKH N050.19.00.00 E019.14.00.00  
EPKKI N050.09.00.00 E019.38.00.00  
EPKKJ N050.40.18.00 E019.12.18.00  
EPKKK N050.03.00.00 E019.48.00.00  
EPKKL N050.08.11.00 E020.06.52.00  
EPKKM N050.21.00.00 E020.02.00.00  
EPKKN N050.29.50.00 E019.04.45.00  
EPKKO N050.12.00.00 E019.53.00.00  
EPKKR N049.54.39.00 E019.24.48.00  
EPKKS N049.59.00.00 E019.49.00.00  
EPKKT N050.21.00.00 E018.51.00.00  
EPKKU N049.47.31.00 E019.46.41.00  
EPKKW N050.35.00.00 E019.03.30.00  
EPKKX N050.27.14.00 E019.04.53.00  
EPKKZ N050.06.33.00 E019.46.46.00  

EPKTB N050.16.00.00 E019.26.00.00  
EPKTC N050.37.25.00 E018.50.10.00  
EPKTD N049.51.25.00 E020.08.30.00  
EPKTE N050.02.31.00 E020.05.52.00  
EPKTG N050.24.00.00 E019.03.00.00  
EPKTH N050.19.00.00 E019.14.00.00  
EPKTI N050.09.00.00 E019.38.00.00  
EPKTJ N050.40.18.00 E019.12.18.00  
EPKTK N050.03.00.00 E019.48.00.00  
EPKTL N050.08.11.00 E020.06.52.00  
EPKTM N050.21.00.00 E020.02.00.00  
EPKTN N050.29.50.00 E019.04.45.00  
EPKTO N050.12.00.00 E019.53.00.00  
EPKTR N049.54.39.00 E019.24.48.00  
EPKTS N049.59.00.00 E019.49.00.00  
EPKTT N050.21.00.00 E018.51.00.00  
EPKTU N049.47.31.00 E019.46.41.00  
EPKTW N050.35.00.00 E019.03.30.00  
EPKTX N050.27.14.00 E019.04.53.00  
EPKTZ N050.06.33.00 E019.46.46.00  

EPRAB N051.14.50.00 E021.14.20.00
EPRAK N051.16.23.00 E021.27.37.00
EPRAM N051.21.58.00 E021.29.25.00
EPRAN N051.26.35.00 E021.12.00.00
EPRAP N051.32.15.00 E021.23.56.00
EPRAR N051.24.12.00 E021.05.20.00
EPRAS N051.18.38.00 E021.15.10.00
EPRAW N051.15.03.00 E021.04.45.00


;MIEJSCOWOSCI
AleksandrowKujawski N052.52.48.000 E018.42.00.000  
AleksandrowLodzki N051.49.12.000 E019.17.56.000  
Andrychow N049.51.36.000 E019.20.20.000  
Augustow N053.50.20.000 E023.00.00.000  
Barlinek N052.59.56.000 E015.11.56.000  
Bartoszyce N054.14.56.000 E020.48.32.000  
Bedzin N050.20.24.000 E019.07.44.000  
Belchatow N051.22.08.000 E019.21.36.000  
BialaPodlaska N052.02.20.000 E023.06.36.000  
Bialogard N054.00.32.000 E015.58.44.000  
Bialystok N053.08.20.000 E023.09.32.000  
Bielawa N050.41.20.000 E016.36.36.000  
BielskPodlaski N052.46.48.000 E023.17.24.000  
BielskoBiala N049.49.08.000 E019.02.56.000  
Bierun N050.06.00.000 E019.06.00.000  
Bilgoraj N050.32.20.000 E022.43.44.000  
Biskupiec N053.52.12.000 E020.57.00.000  
Blachownia N050.47.24.000 E018.57.32.000  
Blonie N052.11.56.000 E020.37.12.000  
Bochnia N049.58.44.000 E020.25.44.000  
Bogatynia N050.55.08.000 E014.57.36.000  
BoguszowGorce N050.45.36.000 E016.11.20.000  
Boguszow N050.45.36.000 E016.11.20.000
Boleslawiec N051.15.32.000 E015.33.36.000  
Braniewo N054.23.24.000 E019.49.08.000  
Brodnica N053.15.32.000 E019.23.56.000  
Brwinow N052.10.44.000 E020.47.56.000  
Brzeg N050.50.56.000 E017.28.12.000  
BrzegDolny N051.16.12.000 E016.44.20.000  
Brzesko N049.58.08.000 E020.36.00.000  
Brzeszcze N049.59.24.000 E019.08.56.000  
Brzeziny N051.48.32.000 E019.44.56.000  
Bukowno N050.17.24.000 E019.26.24.000  
BuskoZdroj N050.28.44.000 E020.43.08.000  
Busko N050.28.44.000 E020.43.08.000  
Bydgoszcz N053.07.12.000 E018.00.36.000  
BystrzycaKlodzka N050.17.56.000 E016.38.20.000  
Bystrzyca N050.17.56.000 E016.38.20.000  
Bytom N050.20.56.000 E018.54.32.000  
Bytow N054.10.44.000 E017.28.12.000  
Chelm N051.08.20.000 E023.29.24.000  
Chelmek N050.06.36.000 E019.14.56.000  
Chelmno N053.21.00.000 E018.25.44.000  
Chelmza N053.10.48.000 E018.36.32.000  
Chodziez N052.59.20.000 E016.54.36.000  
Chojnice N053.42.00.000 E017.34.08.000  
Chojnow N051.16.48.000 E015.55.48.000  
Chorzow N050.17.56.000 E019.01.48.000  
Choszczno N053.10.48.000 E015.24.00.000  
Chrzanow N050.08.20.000 E019.23.56.000  
Ciechanow N052.52.48.000 E020.37.12.000  
Ciechocinek N052.52.48.000 E018.47.24.000  
Cieszyn N049.45.00.000 E018.37.44.000  
CzarnaBialostocka N053.35.20.000 E022.34.44.000  
Czarnkow N052.54.36.000 E016.32.56.000  
CzechowiceDziedzice N049.54.36.000 E019.01.12.000  
Czechowice N049.54.36.000 E019.01.12.000 
Czeladz N050.19.12.000 E019.07.44.000  
Czersk N053.48.00.000 E017.58.12.000  
CzerwionkaLeszczyny N050.10.12.000 E018.40.48.000  
Czestochowa N050.48.36.000 E019.07.44.000  
Czluchow N053.40.12.000 E017.21.00.000  
DabrowaGornicza N050.19.48.000 E019.10.48.000  
Dabrowa N050.19.48.000 E019.10.48.000  
DabrowaTarnowska N050.10.44.000 E021.00.00.000  
Darlowo N054.25.08.000 E016.24.36.000  
Debica N050.03.36.000 E021.25.12.000  
Deblin N051.34.08.000 E021.49.48.000  
Debno N052.44.24.000 E014.41.56.000  
DobreMiasto N053.59.24.000 E020.23.24.000  
Drawsko Pomorskie N053.31.44.000 E015.48.00.000  
Drezdenko N052.49.44.000 E015.49.44.000  
Dzialdowo N053.13.44.000 E020.10.48.000  
Dzierzoniow N050.43.44.000 E016.39.00.000  
Elblag N054.10.44.000 E019.23.56.000  
Elk N053.49.48.000 E022.21.32.000  
Garwolin N051.54.32.000 E021.37.12.000  
Gdansk N054.21.36.000 E018.38.20.000  
Gdynia N054.31.12.000 E018.31.48.000  
Gizycko N054.02.24.000 E021.45.32.000  
Gliwice N050.18.36.000 E018.40.08.000  
Glogow N051.40.08.000 E016.04.48.000  
Glowno N051.58.44.000 E019.42.00.000  
Glubczyce N050.11.20.000 E017.49.48.000  
Glucholazy N050.19.12.000 E017.22.12.000  
Gniezno N052.31.48.000 E017.36.36.000  
Goldap N054.18.36.000 E022.18.32.000  
Goleniow N053.34.12.000 E014.49.08.000  
GolubDobrzyn N053.06.36.000 E019.02.24.000  
Gora N051.40.08.000 E016.31.12.000  
GoraKalwaria N051.59.24.000 E021.12.32.000  
Gorlice N049.40.12.000 E021.09.32.000  
GorzowWielkopolski N052.44.24.000 E015.13.48.000  
Gorzow N052.44.24.000 E015.13.48.000 
Gostyn N051.52.44.000 E017.00.00.000  
Gostynin N053.25.48.000 E019.25.48.000  
Grajewo N053.39.00.000 E022.26.24.000  
Grodkow N050.42.00.000 E017.22.12.000  
GrodziskMazowiecki N052.06.32.000 E020.37.12.000  
GrodziskWielkopolski N052.13.48.000 E016.21.36.000  
Grojec N051.52.44.000 E020.51.32.000  
Grudziadz N053.29.24.000 E018.44.56.000  
Gryfice N053.55.08.000 E015.11.24.000  
Gryfino N053.13.44.000 E014.28.44.000  
Gubin N051.57.32.000 E014.43.08.000  
Hajnowka N052.43.44.000 E023.34.44.000  
Hrubieszow N050.48.36.000 E023.53.20.000  
Ilawa N053.35.20.000 E019.33.36.000  
Inowroclaw N052.46.48.000 E018.14.56.000  
Janikowo N052.25.44.000 E017.01.48.000  
JanowLubelski N050.42.36.000 E022.24.36.000  
Jarocin N051.58.44.000 E017.29.56.000  
Jaroslaw N050.01.12.000 E022.40.44.000  
Jaslo N049.44.20.000 E021.28.08.000  
JastrzebieZdroj N049.59.24.000 E018.35.24.000  
Jawor N051.03.36.000 E016.12.00.000  
Jaworzno N050.12.32.000 E019.16.12.000  
Jedrzejow N050.39.00.000 E020.17.56.000  
JelczLaskowice N051.01.44.000 E017.17.56.000  
JeleniaGora N050.54.32.000 E015.43.44.000  
Jozefow N052.09.00.000 E021.15.36.000  
Kalety N050.34.12.000 E018.53.56.000  
Kalisz N051.46.12.000 E018.06.00.000  
KamienPomorski N053.58.12.000 E014.46.44.000  
KamiennaGora N050.47.24.000 E016.01.48.000  
Karczew N052.04.48.000 E021.14.56.000  
Kartuzy N054.19.44.000 E018.12.00.000  
Katowice N050.15.32.000 E019.01.12.000  
KedzierzynKozle N050.20.24.000 E018.12.32.000  
Kepno N051.16.48.000 E018.00.00.000  
Ketrzyn N054.04.44.000 E021.22.12.000  
Kety N049.52.12.000 E019.13.08.000  
Kielce N050.53.20.000 E020.38.56.000  
Klobuck N050.54.32.000 E018.56.24.000  
Klodzko N050.26.20.000 E016.39.32.000  
Kluczbork N050.58.48.000 E018.12.32.000  
Knurow N050.13.12.000 E018.40.08.000  
Kobylka N052.20.20.000 E021.12.00.000  
Kolno N053.25.08.000 E021.55.44.000  
Kolo N052.11.56.000 E018.38.20.000  
Kolobrzeg N054.11.20.000 E015.34.08.000  
Koluszki N051.45.00.000 E019.49.08.000  
Konin N052.12.32.000 E018.14.56.000  
Konskie N051.12.00.000 E020.23.56.000  
KonstancinJeziorna N052.05.56.000 E021.06.36.000  
KonstantynowLodzki N051.45.00.000 E019.19.08.000  
Koronowo N053.18.36.000 E017.55.44.000  
Koscian N052.05.24.000 E016.38.20.000  
Koscierzyna N054.07.48.000 E017.58.12.000  
Kostrzyn N052.35.20.000 E014.38.56.000  
Koszalin N054.11.20.000 E016.10.48.000  
Kowary N050.47.56.000 E015.49.44.000  
Kozienice N051.35.24.000 E021.33.00.000  
Kozuchow N051.45.00.000 E015.36.00.000  
Krakow N050.03.36.000 E019.57.32.000  
Krapkowice N050.28.44.000 E017.57.36.000  
Krasnik N050.55.44.000 E022.13.08.000  
Krasnystaw N050.59.24.000 E023.10.44.000  
Krosno N049.42.00.000 E021.45.32.000  
KrosnoOdrzanskie N052.03.36.000 E015.06.00.000  
Krotoszyn N051.42.00.000 E017.25.48.000  
Kruszwica N052.40.48.000 E018.17.56.000  
Krynica N049.25.08.000 E020.57.32.000  
Krzeszowice N050.07.48.000 E019.37.48.000  
KudowaZdroj N050.25.44.000 E016.13.44.000  
Kutno N052.14.24.000 E019.21.36.000  
Kwidzyn N053.44.24.000 E018.55.48.000  
Lebork N054.32.56.000 E017.45.00.000  
Ledziny N050.07.48.000 E019.03.32.000  
Legionowo N052.24.32.000 E020.55.12.000  
Legnica N051.12.32.000 E016.09.32.000  
Leszno N051.50.56.000 E016.34.12.000  
Lezajsk N050.15.32.000 E022.25.12.000  
Libiaz N050.06.00.000 E019.17.24.000  
LidzbarkWarminski N054.08.20.000 E020.35.24.000  
Lidzbark N054.08.20.000 E020.35.24.000
Limanowa N049.42.32.000 E020.25.08.000  
Lipno N052.50.20.000 E019.10.08.000  
Lobez N053.38.24.000 E015.37.12.000  
Lubaczow N050.09.36.000 E023.07.08.000  
Luban N051.07.08.000 E015.16.48.000  
Lubartow N051.27.32.000 E022.36.36.000  
Lubawa N053.30.00.000 E019.44.56.000  
Lubin N051.23.56.000 E016.12.00.000  
Lublin N051.14.24.000 E022.34.12.000  
Lubliniec N050.40.08.000 E018.41.20.000  
Lubon N052.20.20.000 E016.52.12.000  
Lubsko N051.47.24.000 E014.57.36.000  
LwowekSlaski N051.06.36.000 E015.36.00.000  
Lancut N050.04.08.000 E022.13.44.000  
Lapy N052.59.20.000 E022.53.24.000  
Lask N051.36.00.000 E019.08.24.000  
LaziskaGorne N050.10.12.000 E018.46.44.000  
Leczna N051.18.36.000 E022.52.12.000  
Leczyca N052.04.08.000 E019.11.56.000  
Lodz N051.46.12.000 E019.27.32.000  
Lomianki N052.20.56.000 E020.53.20.000  
Lomza N053.10.48.000 E022.04.12.000  
Lukow N051.56.24.000 E022.23.24.000  
MakowMazowiecki N052.51.36.000 E021.06.00.000  
Malbork N054.02.24.000 E019.02.24.000  
Marki N052.19.44.000 E021.06.36.000  
Miastko N054.00.00.000 E016.58.08.000  
Miechow N050.21.36.000 E020.01.08.000  
Miedzychod N052.36.36.000 E015.53.56.000  
MiedzyrzecPodlaski N051.59.24.000 E022.46.48.000  
Miedzyrzecz N052.27.00.000 E015.34.08.000  
Mielec N050.17.24.000 E021.25.48.000  
Mikolow N050.13.48.000 E018.58.08.000  
Milanowek N052.07.48.000 E020.39.32.000  
Milicz N051.31.48.000 E017.16.12.000  
MinskMazowiecki N052.10.44.000 E021.33.32.000  
Mlawa N053.07.12.000 E020.21.36.000  
Mogilno N052.39.00.000 E017.57.36.000  
Monki N053.24.00.000 E022.46.48.000  
Morag N053.55.08.000 E019.55.48.000  
Mosina N052.15.32.000 E016.50.24.000  
Mragowo N053.52.48.000 E021.18.00.000  
MurowanaGoslina N052.34.48.000 E017.00.36.000  
Myslenice N049.50.20.000 E019.56.20.000  
Mysliborz N052.55.44.000 E014.52.08.000  
Myslowice N050.14.24.000 E019.08.24.000  
Myszkow N050.34.48.000 E019.19.08.000  
NaklonadNotecia N053.08.20.000 E017.35.56.000  
Namyslow N051.04.44.000 E017.43.08.000  
Nidzica N053.22.08.000 E020.25.44.000  
Nisko N050.31.44.000 E022.08.20.000  
NowaDeba N050.26.20.000 E021.45.32.000  
NowaRuda N050.35.24.000 E016.30.00.000  
NowaSol N051.48.32.000 E015.42.32.000  
NoweMiastoLubawskie N053.25.48.000 E019.35.24.000  
Nowogard N053.39.36.000 E015.06.32.000  
NowyDworGdanski N054.13.12.000 E019.07.12.000  
NowyDworMazowiecki N052.25.44.000 E020.42.32.000  
NowySacz N049.37.48.000 E020.41.56.000  
NowyTarg N049.29.20.000 E020.01.48.000  
NowyTomysl N052.18.36.000 E016.07.12.000  
Nysa N050.28.44.000 E017.20.20.000  
Oborniki N052.39.00.000 E016.48.32.000  
Olawa N050.56.24.000 E017.17.56.000  
Olecko N054.02.24.000 E022.30.32.000  
Olesnica N051.12.32.000 E017.22.44.000  
Olesno N050.53.20.000 E018.24.32.000  
Olkusz N050.16.44.000 E019.32.56.000  
Olsztyn N053.46.44.000 E020.29.20.000  
Opalenica N052.18.36.000 E016.23.56.000  
Opoczno N051.22.44.000 E020.16.48.000  
Opole N050.40.44.000 E017.56.24.000  
Opole Lubelskie N051.08.56.000 E021.58.08.000  
Orneta N054.07.08.000 E020.07.44.000  
Orzesze N050.09.36.000 E018.46.44.000  
Ostroda N053.42.36.000 E019.57.32.000  
Ostroleka N053.05.24.000 E021.34.08.000  
OstrowMazowiecki N052.47.56.000 E021.54.00.000  
OstrowWielkopolski N051.39.36.000 E017.47.56.000  
OstrowiecSwietokrzyski N050.57.00.000 E021.23.20.000  
Ostrowiec N050.57.00.000 E021.23.20.000
Ostrzeszow N051.25.08.000 E017.57.00.000  
Oswiecim N050.02.20.000 E019.15.32.000  
Otwock N052.06.32.000 E021.16.48.000  
Ozimek N050.41.20.000 E018.13.08.000  
Ozorkow N051.58.08.000 E019.17.24.000  
Pabianice N051.40.08.000 E019.21.00.000  
Parczew N051.38.20.000 E022.54.00.000  
Paslek N054.04.08.000 E019.39.32.000  
Piaseczno N052.04.08.000 E021.01.12.000  
Piastow N052.12.32.000 E020.55.12.000  
PiekarySlaskie N050.24.00.000 E018.57.32.000  
Pieszyce N050.43.12.000 E016.35.24.000  
Pila N053.08.56.000 E016.44.20.000  
Pinczow N050.32.20.000 E020.31.44.000  
Pionki N051.29.24.000 E021.27.32.000  
PiotrkowTrybunalski N051.24.32.000 E019.42.00.000  
Piotrkow N051.24.32.000 E019.42.00.000
Pisz N053.37.48.000 E021.47.56.000  
Pleszew N051.54.32.000 E017.46.44.000  
Plock N052.33.00.000 E019.42.00.000  
Plonsk N052.37.44.000 E020.22.44.000  
Polaniec N050.25.44.000 E021.16.48.000  
PolczynZdroj N053.46.12.000 E016.06.00.000  
Police N053.32.56.000 E014.33.32.000  
Polkowice N051.30.00.000 E016.02.56.000  
Poniatowa N051.10.48.000 E022.07.12.000  
Poreba N050.29.20.000 E019.20.20.000  
Poznan N052.23.56.000 E016.54.00.000  
Prudnik N050.19.48.000 E017.34.08.000  
PruszczGdanski N050.19.48.000 E017.34.08.000  
Pruszkow N052.13.12.000 E020.49.08.000  
Przasnysz N053.00.36.000 E020.52.44.000  
Przemysl N049.47.24.000 E022.46.48.000  
Przeworsk N050.04.08.000 E022.30.00.000  
Pszczyna N049.58.44.000 E018.57.00.000  
Pszow N050.02.20.000 E018.24.00.000  
Puck N054.42.32.000 E018.24.00.000  
Pulawy N051.25.48.000 E021.58.48.000  
Pultusk N052.42.36.000 E021.05.20.000  
Pyrzyce N053.08.20.000 E014.52.44.000  
Pyskowice N050.24.36.000 E018.37.12.000  
Rabka N049.37.08.000 E019.56.20.000  
Raciborz N050.05.24.000 E018.13.08.000  
Radlin N050.02.20.000 E018.27.32.000  
Radom N051.23.56.000 E021.09.32.000  
Radomsko N051.04.08.000 E019.26.24.000  
Radzionkow N050.23.24.000 E018.53.20.000  
Radzyn Podlaski N051.47.24.000 E022.37.12.000  
RawaMazowiecka N051.46.12.000 E020.15.36.000  
Rawicz N051.36.32.000 E016.51.36.000  
Reda N054.37.12.000 E018.20.24.000  
Rogozno N052.45.00.000 E016.58.44.000  
Ropczyce N050.04.08.000 E021.44.56.000  
RudaSlaska N050.17.56.000 E018.52.48.000  
Rumia N054.35.24.000 E018.22.12.000  
Rybnik N050.06.00.000 E018.32.56.000  
Rydultowy N050.04.08.000 E018.25.44.000  
Ryki N051.38.20.000 E021.55.44.000  
Rypin N053.04.08.000 E019.24.36.000  
Rzeszow N050.02.56.000 E021.59.56.000  
Sandomierz N050.41.20.000 E021.44.24.000  
Sanok N049.34.12.000 E022.12.32.000  
SepolnoKrajenskie N053.26.56.000 E017.31.48.000  
Siedlce N052.10.08.000 E022.16.48.000  
SiemianowiceSlaskie N050.19.48.000 E019.02.56.000  
Siemiatycze N052.25.08.000 E022.52.12.000  
Sieradz N051.36.00.000 E018.44.24.000  
Sierpc N052.51.36.000 E019.39.00.000  
SkarzyskoKamienna N051.07.08.000 E020.52.44.000  
Skarzysko N051.07.08.000 E020.52.44.000
Skawina N049.58.44.000 E019.49.48.000  
Skierniewice N051.57.32.000 E020.08.20.000  
Skoczow N049.48.00.000 E018.47.56.000  
Skwierzyna N052.35.20.000 E015.29.20.000  
Slawno N054.20.56.000 E016.40.12.000  
Slubice N052.21.32.000 E014.34.08.000  
Slupca N052.17.24.000 E017.52.44.000  
Slupsk N054.28.12.000 E017.01.08.000  
Sochaczew N052.13.48.000 E020.13.44.000  
Sokolka N053.24.00.000 E023.30.00.000  
Sokolow Podlaski N052.24.32.000 E022.14.20.000  
SolecKujawski N053.04.08.000 E018.13.48.000  
Sopot N054.26.20.000 E018.33.32.000  
Sosnowiec N050.16.44.000 E019.07.12.000  
StalowaWola N050.34.12.000 E022.02.56.000  
Starachowice N051.03.36.000 E021.04.12.000  
Stargard N053.20.24.000 E015.01.12.000  
StarogardGdanski N053.58.12.000 E018.31.12.000  
StarySacz N049.34.12.000 E020.38.24.000  
Staszow N050.33.36.000 E021.10.48.000  
Strzegom N050.57.32.000 E016.21.00.000  
StrzelceKrajenskie N052.52.08.000 E015.31.44.000  
StrzelceOpolskie N050.31.12.000 E018.17.56.000  
Strzelin N050.46.48.000 E017.04.08.000  
SuchaBeskidzka N049.45.00.000 E019.35.24.000  
Suchedniow N051.04.08.000 E020.49.48.000  
Sulechow N052.05.24.000 E015.37.12.000  
Sulecin N052.27.00.000 E015.06.32.000  
Sulejowek N052.15.00.000 E021.16.12.000  
Suwalki N054.06.32.000 E022.56.24.000  
Swarzedz N052.24.32.000 E017.04.08.000  
Sycow N051.18.00.000 E017.42.32.000  
Szamotuly N052.36.36.000 E016.34.48.000  
Szczecin N053.25.48.000 E014.31.44.000  
Szczecinek N053.42.36.000 E016.41.20.000  
Szczytno N053.33.32.000 E020.59.24.000  
Szprotawa N051.34.08.000 E015.31.12.000  
Sztum N053.50.56.000 E018.57.32.000  
Szubin N053.00.36.000 E017.43.08.000  
Szydlowiec N051.13.44.000 E020.51.32.000  
Srem N052.05.24.000 E017.00.36.000  
ŒrodaWielkopolska N052.13.12.000 E017.16.12.000  
Swidnica N050.50.56.000 E016.29.20.000  
Swidnik N051.13.08.000 E022.47.24.000  
Swidwin N053.46.12.000 E015.46.44.000  
Swiebodzice N050.51.36.000 E016.19.44.000  
Swiebodzin N052.15.32.000 E015.31.44.000  
Swiecie N053.24.00.000 E018.26.24.000  
Swietochlowice N050.17.24.000 E018.56.24.000  
Swinoujscie N053.54.32.000 E014.14.56.000  
Tarnobrzeg N050.35.24.000 E021.40.48.000  
Tarnow N050.00.32.000 E020.59.24.000  
TarnowskieGory N050.27.32.000 E018.51.36.000  
Tczew N054.05.56.000 E018.46.44.000  
TomaszowLubelski N050.27.32.000 E023.25.08.000  
TomaszowMazowiecki N051.32.24.000 E020.01.48.000  
Torun N053.01.12.000 E018.36.32.000  
Trzcianka N053.02.24.000 E016.27.32.000  
Trzebiatow N054.04.08.000 E015.15.36.000  
Trzebinia N050.09.36.000 E019.27.00.000  
Trzebnica N051.18.36.000 E017.03.36.000  
Tuchola N053.35.20.000 E017.51.00.000  
Turek N052.01.12.000 E018.28.44.000  
Tychy N050.09.36.000 E019.00.00.000  
Ustka N054.34.48.000 E016.51.00.000  
Ustron N049.43.08.000 E018.47.56.000  
UstrzykiDolne N049.25.48.000 E022.36.36.000  
Wabrzezno N053.16.48.000 E018.56.24.000  
Wadowice N049.52.44.000 E019.29.20.000  
Wagrowiec N052.48.36.000 E017.12.00.000  
Walbrzych N050.46.48.000 E016.16.48.000  
Walcz N053.16.12.000 E016.28.12.000  
Warka N051.47.56.000 E021.11.24.000  
Warszawa N052.15.32.000 E021.01.12.000  
Wegorzewo N054.13.12.000 E021.44.56.000  
Wegrow N052.23.56.000 E022.00.36.000  
Wejherowo N054.35.56.000 E018.13.48.000  
Wesola N052.15.32.000 E021.12.00.000  
Wieliczka N049.59.24.000 E020.05.24.000  
Wielun N051.13.08.000 E018.34.08.000  
Wisla N049.39.32.000 E018.52.12.000  
Wladyslawowo N054.47.20.000 E018.24.00.000  
Wloclawek N052.39.32.000 E019.03.32.000  
Wlodawa N051.32.56.000 E023.33.32.000  
Wloszczowa N050.51.36.000 E019.58.08.000  
WodzislawSlaski N050.02.20.000 E018.24.00.000  
Wojkowice N050.21.36.000 E019.00.36.000  
Wolbrom N050.23.24.000 E019.46.12.000  
Wolomin N052.20.20.000 E021.13.44.000  
Wolow N051.19.44.000 E016.37.44.000  
Wolsztyn N052.06.32.000 E016.06.32.000  
Wroclaw N051.06.36.000 E017.01.48.000  
Wronki N052.42.00.000 E016.21.36.000  
Wrzesnia N052.19.12.000 E017.34.44.000  
Wschowa N051.47.56.000 E016.19.08.000  
Wysokie Mazowieckie N052.54.36.000 E022.30.32.000  
Wyszkow N052.35.56.000 E021.26.56.000  
ZabkowiceSlaskie N050.35.24.000 E016.49.08.000  
Zabrze N050.17.56.000 E018.46.44.000  
Zakopane N049.17.20.000 E019.57.32.000  
Zambrow N052.58.48.000 E022.14.20.000  
Zamosc N050.43.44.000 E023.15.36.000  
Zawadzkie N050.37.08.000 E018.27.32.000  
Zawiercie N050.29.20.000 E019.25.12.000  
ZdunskaWola N051.36.32.000 E018.56.24.000  
Zdzieszowice N050.25.08.000 E018.07.12.000  
Zgierz N051.52.08.000 E019.24.36.000  
Zgorzelec N051.08.56.000 E015.00.32.000  
Ziebice N050.35.56.000 E017.03.00.000  
ZielonaGora N051.56.24.000 E015.29.20.000  
Zielonka N052.17.56.000 E021.10.08.000  
Zlocieniec N053.31.44.000 E016.00.00.000  
Zlotoryja N051.07.08.000 E015.54.32.000  
Zlotow N053.21.32.000 E017.01.48.000  
Zabki N052.17.24.000 E021.06.36.000  
Zagan N051.37.08.000 E015.17.56.000  
Zary N051.38.56.000 E015.07.48.000  
Znin N052.51.00.000 E017.42.32.000  
Zory N050.04.08.000 E018.41.20.000  
Zychlin N052.15.00.000 E019.37.12.000  
Zyrardow N052.03.36.000 E020.27.00.000  
Zywiec N049.52.12.000 E019.10.48.000  


[AIRPORT]
EPBA    .    N049.48.17.999 E019.00.07.199 E ;Aleksandrowice 
EPBC    .    N052.16.00.000 E020.55.00.000 E ;Warszawa/Babice
EPBK    .    N053.06.05.999 E023.10.14.520 E ;Krywlany 
EPBP    .    N052.00.24.840 E023.08.56.760 E ;Biala Podlaska 
EPBY    .    N053.05.48.480 E017.58.39.719 E ;Szwederowo 
EPRU    .    N050.53.05.999 E019.12.16.919 E ;Rudniki 
EPDE    .    N051.33.05.000 E021.53.36.959 E ;Deblin Mil 
EPEL    .    N054.08.27.240 E019.25.24.240 E ;Elblag 
EPGD    .    N054.22.39.360 E018.27.58.320 E ;Rebiechowo 
EPGI    .    N053.31.27.839 E018.50.57.479 E ;Lisie Katy 
EPGL    .    N050.16.09.839 E018.40.22.999 E ;Gliwice 
EPGO    .    N052.11.03.900 E021.16.52.800 E ;Goraszka
EPIN    .    N052.48.22.680 E018.17.08.879 E ;Inowroclaw 
EPIW    .    N049.39.28.439 E021.49.02.639 E ;Iwonicz 
EPJG    .    N050.53.55.680 E015.47.07.800 E ;Jelenia Gora 
EPKA    .    N050.53.48.479 E020.43.53.760 E ;Maslow 
EPKK    .    N050.04.39.720 E019.47.05.280 E ;Balice Jps Intl 
EPKM    .    N050.14.17.880 E019.02.02.399 E ;Muchowiec 
EPKO    .    N054.02.32.999 E016.15.56.159 E ;Zegrze Pomorskie Mil 
EPKP    .    N050.05.22.920 E020.12.06.119 E ;Pobiednik Wielki 
EPKR    .    N049.40.59.160 E021.44.00.959 E ;Krosno 
EPKS    .    N052.19.50.520 E016.58.07.319 E ;Krzesiny 
EPKT    .    N050.28.27.120 E019.04.47.999 E ;Pyrzowice 
EPLB    .    N051.14.25.000 E022.42.49.000 E ;Lublin
EPLE    .    N051.10.58.799 E016.10.45.840 E ;Legnica 
EPLL    .    N051.43.18.839 E019.23.53.159 E ;Lublinek 
EPLR    .    N051.13.18.480 E022.23.40.560 E ;Radawiec 
EPLS    .    N051.50.06.936 E016.31.18.479 E ;Leszno 
EPLU    .    N051.25.22.800 E016.11.46.320 E ;Lubin 
EPMB    .    N054.01.36.839 E019.08.03.119 E ;Malbork Mil
EPML    .    N050.19.20.279 E021.27.43.559 E ;Mielec 
EPMO    .    N052.27.03.959 E020.39.02.160 E ;Modlin
EPNL    .    N049.44.43.799 E020.37.24.599 E ;Lososina Dolna 
EPNT    .    N049.27.45.360 E020.03.01.000 E ;Nowy Targ 
EPOD    .    N053.46.22.439 E020.24.53.999 E ;Dajtki 
EPOM    .    N051.42.09.206 E017.50.48.480 E ;Michalkow 
EPOP    .    N050.37.59.520 E017.46.54.120 E ;Polska Nowa Wies 
EPPI    .    N053.10.12.172 E016.42.44.999 E ;Pila 
EPPK    .    N052.26.02.000 E017.02.38.400 E ;Kobylnica 
EPPL    .    N052.33.43.919 E019.43.16.679 E ;Plock 
EPPO    .    N052.25.15.599 E016.49.34.679 E ;Lawica 
EPPR    .    N054.14.53.160 E018.40.23.880 E ;Pruszcz Gdanski Mil 
EPPT    .    N051.22.59.159 E019.41.18.240 E ;Piotrkow Trybunalski 
EPRA    .    N051.23.19.820 E021.12.41.972 E ;Radom
EPRG    .    N050.04.15.240 E018.37.42.239 E ;Gotartowice 
EPRJ    .    N050.06.19.999 E022.03.00.547 E ;Rzeszow 
EPRP    .    N051.28.44.399 E021.06.35.999 E ;Piastow 
EPRZ    .    N050.06.35.640 E022.01.08.399 E ;Jasionka 
EPSC    .    N053.35.04.919 E014.54.07.920 E ;Goleniow 
EPSD    .    N053.23.31.559 E014.38.01.680 E ;Dabie 
EPSJ    .    N051.57.09.700 E021.21.09.000 E ;Sobienie
EPSK    .    N054.28.44.000 E017.06.27.117 E ;Redzikowo Mil 
EPSN    .    N053.47.26.159 E015.49.41.159 E ;Swidwin 
EPSO    .    N052.11.54.959 E020.17.34.999 E ;Sochaczew 
EPSU    .    N054.04.21.719 E022.53.56.760 E ;Suwalki 
EPSW    .    N051.13.55.199 E022.41.25.080 E ;Swidnik 
EPSY    .    N053.28.54.690 E020.56.15.689 E ;Port Lotniczy Olsztyn - Mazury
EPTO    .    N053.01.45.120 E018.32.45.239 E ;Torun 
EPWA    .    N052.09.56.700 E020.58.01.639 E ;Warsaw Chopin 
EPWK    .    N052.35.04.560 E019.00.55.799 E ;Kruszyn 
EPWR    .    N051.06.09.719 E016.53.08.879 E ;Strachowice 
EPZA    .    N050.42.06.479 E023.12.15.479 E ;Mokre 
EPZG    .    N052.08.18.600 E015.47.54.960 E ;Babimost 
EPZP    .    N051.58.44.000 E015.27.49.680 E ;Przylep 
EPZR    .    N049.46.15.600 E019.13.04.799 E ;Zar 
Z24N    .    N054.12.02.519 E015.41.13.199 E ;Kolobrzeg 
Z24O    .    N052.32.03.839 E017.13.07.680 E ;Bednary 
Z24P    .    N053.45.39.959 E015.17.25.000 E ;Ploty 
Z24Q    .    N054.34.46.920 E018.31.01.919 E ;Babie Doly 
Z24S    .    N051.35.02.999 E020.05.47.399 E ;Spala Glinnik Nowy 

LKPR	.	N050.06.03.000 E014.15.36.000 E ;PRAHA RUZYNE
EDDB	.	N052.22.42.750 E013.31.14.230 E ;Berlin Schonefeld
EYVI	.	N054.38.13.470 E025.17.16.090 E ;Vilnius Tarptautinis
UKLL	.	N049.48.44.380 E023.57.16.140 E ;Lwow

[RUNWAY]
08  26  079 259 N053.05.42.847 E017.57.32.977 N053.05.54.112 E017.59.46.462 EPBY Szwederowo
11  29  109 289 N054.22.52.015 E018.27.07.208 N054.22.16.609 E018.29.30.471 EPGD Lech Walesa
07  25  075 255 N050.04.31.430 E019.46.05.140 N050.04.48.880 E019.48.10.480 EPKK Balice
09  27  087 267 N050.28.33.780 E019.03.34.450 N050.28.33.460 E019.06.00.500 EPKT Pyrzowice
07  25  075 255 N051.23.11.460 E021.11.51.840 N051.23.28.140 E021.13.31.770 EPRA Radom
09  27  090 270 N050.06.36.680 E022.00.05.558 N050.06.35.010 E022.02.11.461 EPRZ Jasionka
06  24  000 000 N052.08.01.496 E015.46.55.198 N052.08.35.703 E015.48.54.721 EPZG Babimost
11  29  114 294 N051.06.31.781 E016.51.56.910 N051.05.56.298 E016.53.52.769 EPWR Strachowice
13  31  130 310 N053.35.31.600 E014.53.16.333 N053.34.38.387 E014.54.59.632 EPSC Goleniow
15  33  148 328 N052.10.42.886 E020.57.21.113 N052.08.57.618 E020.58.53.285 EPWA Chopin
11  29  111 291 N052.10.17.349 E020.56.48.007 N052.09.39.686 E020.59.02.431 EPWA Chopin
10  28  105 285 N052.25.30.226 E016.48.21.686 N052.25.05.293 E016.50.27.513 EPPO Lawica
07  25  068 248 N051.42.58.165 E019.22.19.548 N051.43.25.081 E019.24.22.654 EPLL Lublinek
08  26  081 261 N052.26.58.240 E020.38.01.300 N052.27.10.540 E020.40.12.140 EPMO Modlin
11  29  118 298 N052.20.13.770 E016.57.01.670 N052.19.36.150 E016.58.57.790 EPKS Krzesiny
07  25  077	257 N051.14.15.520 E022.41.45.370 N051.14.33.680 E022.43.52.020 EPLB Lublin
01  19  016 196 N053.28.16.306 E020.55.54.114 N053.29.33.025 E020.56.37.454 EPSY Mazury

[STAR]
-EPSY 01 ROMEO IBINO IBINO SY361 SY361
SY361 SY361 SY366 SY366
ARDUT ARDUT SY362 SY362
SY362 SY362 SY357 SY357
SY357 SY357 SY364 SY364
SY364 SY364 SY366 SY366
UDROV UDROV SY363 SY363
SY363 SY363 SY364 SY364

-EPSY 19 TANGO IBINO IBINO SY791 SY791
SY791 SY791 SY792 SY792
SY792 SY792 SY801 SY801
SY801 SY801 SY802 SY802
ARDUT ARDUT SY793 SY793
SY793 SY793 SY801 SY801
UDROV UDROV SY792 SY792

-EPBY 08/26 NOVEMBER INTUN INTUN NUDMO NUDMO
NUDMO NUDMO BYZ BYZ

GOBNI GOBNI BAVGO BAVGO
BAVGO BAVGO BYZ BYZ

LUXUD LUXUD ABIBO ABIBO
ABIBO ABIBO BYZ BYZ

-EPKT 09 MAPIK MAPIK KT762 KT762
KT762 KT762 INPUM INPUM
INPUM INPUM KT757 KT757
KT757 KT757 KT756 KT756
KT756 KT756 KT738 KT738
KT738 KT738 KT737 KT737
KT737 KT737 KT736 KT736

BAREX BAREX XONRA XONRA
XONRA XONRA INPUM INPUM

KUKAM KUKAM UPMAK UPMAK
UPMAK UPMAK KT759 KT759
KT759 KT759 KT758 KT758
KT758 KT758 KT757 KT757

GOVRI GOVRI XENGO XENGO
XENGO XENGO KT749 KT749
KT749 KT749 KT748 KT748
KT748 KT748 KT747 KT747
KT747 KT747 KT746 KT746
KT746 KT746 KT744 KT744
KT744 KT744 KT739 KT739
KT739 KT739 KT738 KT738

LENOV LENOV MODGU MODGU
MODGU MODGU ERPOK ERPOK
ERPOK ERPOK KT752 KT752
KT752 KT752 KT749 KT749 

MEBAN MEBAN EMKUX EMKUX
EMKUX EMKUX UVRET UVRET
UVRET UVRET KT752 KT752

BAVOK BAVOK KT754 KT754
KT754 KT754 KT753 KT753
KT753 KT753 KT747 KT747


-EPKT 27 MAPIK MAPIK KT569 KT569
KT569 KT569 ASTUD ASTUD
ASTUD ASTUD KT568 KT568
KT568 KT568 KT567 KT567
KT567 KT567 KT566 KT566
KT566 KT566 KT561 KT561
KT561 KT561 KT538 KT538
KT538 KT538 KT537 KT537
KT537 KT537 KT536 KT536

BAREX BAREX XONRA XONRA
XONRA XONRA ASTUD ASTUD

KUKAM KUKAM KT564 KT564
KT564 KT564 KT563 KT563
KT563 KT563 KT562 KT562
KT562 KT562 KT561 KT561

GOVRI GOVRI XENGO XENGO
XENGO XENGO KT556 KT556
KT556 KT556 KT554 KT554
KT554 KT554 ULNOD ULNOD
ULNOD ULNOD LIGDI LIGDI
LIGDI LIGDI KT543 KT543
KT543 KT543 KT539 KT539
KT539 KT539 KT538 KT538
KT538 KT538 KT537 KT537
KT537 KT537 KT536 KT536

LENOV LENOV ERKEB ERKEB
ERKEB ERKEB ASGID ASGID
ASGID ASGID KT556 KT556

MEBAN MEBAN UVRET UVRET
UVRET UVRET ULNOD ULNOD

BAVOK BAVOK IVMEM IVMEM
IVMEM IVMEM KT549 KT549
KT549 KT549 ODSOB ODSOB
ODSOB ODSOB KT547 KT547
KT547 KT547 KT546 KT546
KT546 KT546 KT544 KT544
KT544 KT544 KT543 KT543



-EPLB 07/25 PAPA VENES VENES LB509 LB509
LB509 LB509 LB511 LB511
LB511 LB511 LB512 LB512
LB512 LB512 SWI SWI

GAVDU GAVDU LB513 LB513
LB513 LB513 LB514 LB514
LB514 LB514 LB384 LB384
LB384 LB384 LB516 LB516
LB516 LB516 SWI SWI

OGVET OGVET LB383 LB383
LB383 LB383 SWI SWI

-EPLB 07 HOTEL VENES VENES LB386 LB386
LB386 LB386 LB388 LB388
LB388 LB388 LB389 LB389

GAVDU GAVDU LB377 LB377
LB377 LB377 LB387 LB387
LB387 LB387 LB388 LB388
LB388 LB388 LB389 LB389

OGVET OGVET LB387 LB387

-EPLB 07 LIMA VENES VENES LB421 LB421
LB421 LB421 LB422 LB422
LB422 LB422 LB423 LB423
LB423 LB423 LB394 LB394

-EPLB 25 GOLF VENES VENES LB471 LB471
LB471 LB471 LB472 LB472
LB472 LB472 LB473 LB473
LB473 LB473 LB482 LB482
LB482 LB482 LB484 LB484
LB484 LB484 N051.15.29.000 E022.50.17.000

GAVDU GAVDU LB474 LB474
LB474 LB474 LB476 LB476
LB476 LB476 LB477 LB477
LB477 LB477 LB479 LB479
LB479 LB479 LB481 LB481
LB481 LB481 LB484 LB484

OGVET OGVET LB476 LB476

-EPLL 07 UTOLU UTOLU LL704 LL704
;luk od polnocy ll704-ll703-ll702

N051.52.19.660 E019.09.54.960 N051.52.49.700 E019.12.11.800 stargray
N051.51.25.300 E019.13.00.020 N051.52.49.700 E019.12.11.800 stargray
N051.49.31.910 E019.14.04.760 N051.48.07.200 E019.14.53.200 stargray
N051.51.09.400 E019.04.35.800 N051.52.19.660 E019.09.54.960
N051.52.19.660 E019.09.54.960 N051.52.23.480 E019.10.17.940
N051.52.23.480 E019.10.17.940 N051.52.24.690 E019.10.43.140
N051.52.24.690 E019.10.43.140 N051.52.23.690 E019.11.08.500
N051.52.23.690 E019.11.08.500	N051.52.19.420 E019.11.32.900
N051.52.19.420 E019.11.32.900 N051.52.12.620 E019.11.55.780
N051.52.12.620 E019.11.55.780 N051.52.03.720 E019.12.16.480
N051.52.03.720 E019.12.16.480 N051.51.52.560 E019.12.34.380
N051.51.52.560 E019.12.34.380 N051.51.39.820 E019.12.48.970
N051.51.39.820 E019.12.48.970 N051.51.25.300 E019.13.00.020
N051.51.25.300 E019.13.00.020 N051.49.31.910 E019.14.04.760
N051.49.31.910 E019.14.04.760 N051.49.17.160 E019.14.10.620
N051.49.17.160 E019.14.10.620 N051.49.01.540 E019.14.13.350
N051.49.01.540 E019.14.13.350 N051.48.46.090 E019.14.10.510
N051.48.46.090 E019.14.10.510 N051.48.30.860 E019.14.04.520
N051.48.30.860 E019.14.04.520 N051.48.16.740 E019.13.53.480
N051.48.16.740 E019.13.53.480 N051.48.04.030 E019.13.38.460
N051.48.04.030 E019.13.38.460 N051.47.52.840 E019.13.21.060
N051.47.52.840 E019.13.21.060 N051.47.43.820 E019.13.00.340
N051.47.43.820 E019.13.00.340 N051.47.37.300 E019.12.37.010
N051.47.37.300 E019.12.37.010 N051.46.27.100 E019.07.17.800

;luk od poludnia ABAKU-LL706-LL702
N051.44.49.300 E019.16.45.640 N051.43.24.600 E019.17.34.000 stargray
N051.43.24.600 E019.17.34.000 N051.42.54.780 E019.15.17.600 stargray
N051.46.42.800 E019.15.41.600 N051.48.07.200 E019.14.53.200 stargray
ABAKU ABAKU N051.42.54.780 E019.15.17.600
N051.42.54.780 E019.15.17.600 N051.43.01.160 E019.15.42.260
N051.43.01.160 E019.15.42.260 N051.43.10.120 E019.16.03.210
N051.43.10.120 E019.16.03.210 N051.43.21.350 E019.16.20.880
N051.43.21.350 E019.16.20.880 N051.43.34.230 E019.16.35.260
N051.43.34.230 E019.16.35.260 N051.43.48.330 E019.16.46.000
N051.43.48.330 E019.16.46.000 N051.44.03.600 E019.16.52.010
N051.44.03.600 E019.16.52.010 N051.44.19.150 E019.16.54.400
N051.44.19.150 E019.16.54.400 N051.44.34.700 E019.16.51.790
N051.44.34.700 E019.16.51.790 N051.44.49.300 E019.16.45.640
N051.44.49.300 E019.16.45.640 N051.46.42.800 E019.15.41.600
N051.46.42.800 E019.15.41.600 N051.46.57.620 E019.15.30.470
N051.46.57.620 E019.15.30.470 N051.47.10.490 E019.15.16.100
N051.47.10.490 E019.15.16.100 N051.47.21.460 E019.14.57.920
N051.47.21.460 E019.14.57.920 N051.47.30.580 E019.14.37.350 
N051.47.30.580 E019.14.37.350 N051.47.36.920 E019.14.14.450
N051.47.36.920 E019.14.14.450 N051.47.41.180 E019.13.50.050
N051.47.41.180 E019.13.50.050 N051.47.43.080 E019.13.24.820
N051.47.43.080 E019.13.24.820	N051.47.41.300 E019.12.59.600
N051.47.41.300 E019.12.59.600 N051.47.41.300 E019.12.59.600

LL702 LL702 LL701 LL701

ADOXO ADOXO LL712 LL712
LL712 LL712 LL702 LL702

SOXER SOXER LL712 LL712

VIDEV VIDEV LL501 LL501
LL501 LL501 LL712 LL712

-EPLL 25 UTOLU UTOLU LL526 LL526

;luk LL526-LL524-LL522 od polnocy
LL526 LL526 N051.53.20.270 E019.38.24.920
N051.53.20.270 E019.38.24.920 N051.53.21.470 E019.38.48.520
N051.53.21.470 E019.38.48.520 N051.53.20.340 E019.39.13.890
N051.53.20.340 E019.39.13.890 N051.53.15.760 E019.39.38.400
N051.53.15.760 E019.39.38.400 N051.53.09.500 E019.40.01.460
N051.53.09.500 E019.40.01.460 N051.53.00.100 E019.40.21.920
N051.53.00.100 E019.40.21.920 N051.52.49.230 E019.40.39.810
N051.52.49.230 E019.40.39.810 N051.52.36.100 E019.40.54.660
N051.52.36.100 E019.40.54.660 N051.49.17.310 E019.42.47.600
N051.49.17.310 E019.42.47.600 N051.49.02.360 E019.42.52.650
N051.49.02.360 E019.42.52.650 N051.48.46.950 E019.42.54.710
N051.48.46.950 E019.42.54.710 N051.48.16.240 E019.42.46.310
N051.48.16.240 E019.42.46.310 N051.48.02.120 E019.42.35.540
N051.48.02.120 E019.42.35.540 N051.47.49.420 E019.42.20.960
N051.47.49.420 E019.42.20.960 N051.47.38.300 E019.42.03.090
N051.47.38.300 E019.42.03.090 N051.47.29.360 E019.41.43.940
N051.49.17.310 E019.42.47.600 LL522 LL522 stargray
N051.53.20.270 E019.38.24.920 LL524 LL524 stargray
LL524 LL524 N051.52.36.100 E019.40.54.660

;luk LL528-LL527-LL522 od poludnia
N051.47.29.360 E019.41.43.940 N051.47.26.800 E019.41.42.340
N051.47.26.800 E019.41.42.340 N051.47.27.820 E019.42.07.370
N051.47.27.820 E019.42.07.370 N051.47.26.820 E019.42.32.470
N051.47.26.820 E019.42.32.470 N051.47.22.620 E019.42.57.170
N051.47.22.620 E019.42.57.170 N051.47.16.020 E019.43.20.000
N051.47.16.020 E019.43.20.000 N051.47.07.410 E019.43.40.710
N051.47.07.410 E019.43.40.710 N051.46.56.160 E019.43.58.340
N051.46.56.160 E019.43.58.340 N051.46.42.870 E019.44.12.490
N051.46.42.870 E019.44.12.490 N051.46.28.580 E019.44.23.800
N051.46.28.580 E019.44.23.800 LL522 LL522 stargray
N051.46.28.580 E019.44.23.800 N051.44.34.060 E019.45.25.030
N051.44.34.060 E019.45.25.030 N051.44.20.320 E019.45.30.690
N051.44.20.320 E019.45.30.690 N051.44.04.810 E019.45.32.870
N051.44.04.810 E019.45.32.870 N051.43.49.240 E019.45.30.500
N051.43.49.240 E019.45.30.500 N051.43.34.140 E019.45.23.940
N051.43.34.140 E019.45.23.940 N051.43.19.920 E019.45.13.580
N051.43.19.920 E019.45.13.580 N051.43.07.290 E019.44.58.710
N051.43.07.290 E019.44.58.710 N051.42.56.270 E019.44.40.970
N051.42.56.270 E019.44.40.970 N051.42.47.210 E019.44.20.230
N051.42.47.210 E019.44.20.230 N051.42.40.100 E019.43.55.290
N051.42.40.100 E019.43.55.290 N051.41.31.200 E019.38.36.600
N051.42.40.100 E019.43.55.290 LL527 LL527 stargray
N051.46.28.580 E019.44.23.800 N051.43.09.300 E019.46.12.350
N051.43.25.200 E019.24.22.800 LL501 LL501 stargray

LL522 LL522 LL501 LL501

ADOXO ADOXO LL524 LL524

SOXER SOXER LL523 LL523
LL523 LL523 LL522 LL522

VIDEV VIDEV LL527 LL527

ABAKU ABAKU LL528 LL528

-EPMO 26 X-RAY SORIX SORIX MO934 MO934
MO934 MO934 DOMUV DOMUV
DOMUV DOMUV MO933 MO933
MO933 MO933 TITLU TITLU
TITLU TITLU MO932 MO932
MO932 MO932 MO931 MO931
MO931 MO931 MO929 MO929
MO929 MO929 MO928 MO928
MO928 MO928 MO927 MO927
MO927 MO927 MO926 MO926
MO926 MO926 XENIS XENIS

BIMPA BIMPA MO936 MO936
MO936 MO936 DOMUV DOMUV

LOGDA LOGDA WA593 WA593
WA593 WA593 MO999 MO999
MO999 MO999 RILET RILET
RILET RILET DETOR DETOR
DETOR DETOR WA594 WA594
WA594 WA594 IPSIM IPSIM
IPSIM IPSIM MO941 MO941
MO941 MO941 MO997 MO997
MO997 MO997 MO927 MO927

LIMVI LIMVI RILET RILET

NEPOX NEPOX WA573 WA573
WA573 WA573 WA594 WA594

AGAVA AGAVA ELKIR ELKIR
ELKIR ELKIR AMSOS AMSOS
AMSOS AMSOS WA593 WA593

-EPMO 26 YANKEE SORIX SORIX MO934 MO934
MO934 MO934 DOMUV DOMUV
DOMUV DOMUV MO933 MO933
MO933 MO933 TITLU TITLU
TITLU TITLU MO932 MO932
MO932 MO932 MO931 MO931
MO931 MO931 MO929 MO929
MO929 MO929 MO928 MO928
MO928 MO928 MO927 MO927
MO927 MO927 MO926 MO926
MO926 MO926 XENIS XENIS

BIMPA BIMPA MO936 MO936
MO936 MO936 DOMUV DOMUV

LOGDA LOGDA WA593 WA593
WA593 WA593 MO999 MO999
MO999 MO999 WA511 WA511
WA511 WA511 WA512 WA512
WA512 WA512 SUPID SUPID
SUPID SUPID ROPUX ROPUX
ROPUX ROPUX UNDES UNDES
UNDES UNDES MO941 MO941
MO941 MO941 MO997 MO997
MO997 MO997 MO927 MO927

LIMVI LIMVI WA511 WA511

NEPOX NEPOX WA704 WA704
WA704 WA704 SUPID SUPID

AGAVA AGAVA ELKIR ELKIR
ELKIR ELKIR AMSOS AMSOS
AMSOS AMSOS WA593 WA593

-EPMO 08 ROMEO SORIX SORIX IRDOM IRDOM
IRDOM IRDOM MO846 MO846
MO846 MO846 OLDIM OLDIM
OLDIM OLDIM MO804 MO804
MO804 MO804 MO803 MO803
MO803 MO803 MO802 MO802
MO802 MO802 MO801 MO801
MO801 MO801 KUXEN KUXEN
KUXEN KUXEN OGRAR OGRAR
OGRAR OGRAR GODIL GODIL

BIMPA BIMPA MO841 MO841
MO841 MO841 IRDOM IRDOM

LOGDA LOGDA GIPUL GIPUL
GIPUL GIPUL BEMRA BEMRA
BEMRA BEMRA OLOKU OLOKU
OLOKU OLOKU SOSIN SOSIN
SOSIN SOSIN BASEK BASEK
BASEK BASEK LUGEL LUGEL
LUGEL LUGEL PIBAR PIBAR
PIBAR PIBAR REDSA REDSA
REDSA REDSA MO809 MO809
MO809 MO809 KUXEN KUXEN

LIMVI LIMVI WA442 WA442
WA442 WA442 EMKEN EMKEN
EMKEN EMKEN TOSLU TOSLU
TOSLU TOSLU SOSIN SOSIN

NEPOX NEPOX INPAL INPAL
INPAL INPAL DETOR DETOR
DETOR DETOR EMKEN EMKEN

AGAVA AGAVA ELKIR ELKIR
ELKIR ELKIR AMSOS AMSOS
AMSOS AMSOS ESINI ESINI
ESINI ESINI BEMRA BEMRA

-EPMO 08 SIERRA SORIX SORIX MO853 MO853
MO853 MO853 MO852 MO852
MO852 MO852 MO851 MO851
MO851 MO851 OGRAR OGRAR
OGRAR OGRAR GODIL GODIL

BIMPA BIMPA MO852 MO852

LOGDA LOGDA WA593 WA593
WA593 WA593 MO999 MO999
MO999 MO999 WA511 WA511
WA511 WA511 WA512 WA512
WA512 WA512 SUPID SUPID
SUPID SUPID ROPUX ROPUX
ROPUX ROPUX UNDES UNDES
UNDES UNDES MO941 MO941
MO941 MO941 MO856 MO856
MO856 MO856 MO854 MO854
MO854 MO854 MO831 MO831
MO831 MO831 OLDIM OLDIM
OLDIM OLDIM MO804 MO804
MO804 MO804 MO803 MO803
MO803 MO803 KUXEN KUXEN
KUXEN KUXEN OGRAR OGRAR
OGRAR OGRAR GODIL GODIL

LIMVI LIMVI WA511 WA511

NEPOX NEPOX WA704 WA704
WA704 WA704 SUPID SUPID

AGAVA AGAVA ELKIR ELKIR
ELKIR ELKIR AMSOS AMSOS
AMSOS AMSOS WA593 WA593
WA593 WA593 MO999 MO999

-EPMO 08 TANGO SORIX SORIX INREN INREN
INREN INREN WA448 WA448
WA448 WA448 LUGEL LUGEL
LUGEL LUGEL AMLAS AMLAS
AMLAS AMLAS RILSU RILSU
RILSU RILSU MARUP MARUP
MARUP MARUP LUXIB LUXIB
LUXIB LUXIB MO832 MO832
MO832 MO832 OGRAR OGRAR
OGRAR OGRAR GODIL GODIL

BIMPA BIMPA INREN INREN

LOGDA LOGDA GIPUL GIPUL
GIPUL GIPUL BEMRA BEMRA
BEMRA BEMRA WA452 WA452
WA452 WA452 NEDNA NEDNA
NEDNA NEDNA SUBEG SUBEG
SUBEG SUBEG ELGEL ELGEL
ELGEL ELGEL GIMKU GIMKU
GIMKU GIMKU MO831 MO831
MO831 MO831 OLDIM OLDIM
OLDIM OLDIM MO804 MO804
MO804 MO804 MO803 MO803
MO803 MO803 KUXEN KUXEN
KUXEN KUXEN OGRAR OGRAR

LIMVI LIMVI WA442 WA442
WA442 WA442 EMKEN EMKEN
EMKEN EMKEN WA468 WA468
WA468 WA468 NEDNA NEDNA

NEPOX NEPOX INPAL INPAL
INPAL INPAL DETOR DETOR
DETOR DETOR EMKEN EMKEN

AGAVA AGAVA ELKIR ELKIR
ELKIR ELKIR AMSOS AMSOS
AMSOS AMSOS ESINI ESINI
ESINI ESINI BEMRA BEMRA
BEMRA BEMRA WA452 WA452
WA452 WA452 NEDNA NEDNA

-EPMO 08 WHISKEY SORIX SORIX MO853 MO853
MO853 MO853 MO852 MO852
MO852 MO852 MO851 MO851
MO851 MO851 OGRAR OGRAR
OGRAR OGRAR GODIL GODIL

BIMPA BIMPA MO852 MO852

LOGDA LOGDA WA593 WA593
WA593 WA593 MO999 MO999
MO999 MO999 RILET RILET
RILET RILET DETOR DETOR
DETOR DETOR WA594 WA594
WA594 WA594 IPSIM IPSIM
IPSIM IPSIM MO941 MO941
MO941 MO941 MO856 MO856
MO856 MO856 MO854 MO854
MO854 MO854 MO831 MO831
MO831 MO831 OLDIM OLDIM
OLDIM OLDIM MO804 MO804
MO804 MO804 MO803 MO803
MO803 MO803 KUXEN KUXEN
KUXEN KUXEN OGRAR OGRAR

LIMVI LIMVI RILET RILET

NEPOX NEPOX WA573 WA573
WA573 WA573 WA594 WA594

AGAVA AGAVA ELKIR ELKIR
ELKIR ELKIR AMSOS AMSOS
AMSOS AMSOS WA593 WA593
WA593 WA593 MO999 MO999

-EPPO 28 N001.39.20.999 E021.25.40.001 N001.41.44.999 E020.58.09.998 
                          N052.12.00.000 e017.09.18.000 N052.11.49.920 E017.09.02.412
                          N052.11.49.920 E017.09.02.412 N052.11.37.752 E017.08.39.011
                          N052.11.37.752 E017.08.39.011 N052.11.25.836 E017.08.15.323
                          N052.11.25.836 E017.08.15.323 N052.11.14.171 E017.07.51.240
                          N052.11.14.171 E017.07.51.240 N052.11.02.760 E017.07.26.868
                          N052.11.02.760 E017.07.26.868 N052.10.51.599 E017.07.02.172
                          N052.10.51.599 E017.07.02.172 N052.10.40.727 E017.06.37.115
                          N052.10.40.727 E017.06.37.115 N052.10.30.107 E017.06.11.808
                          N052.10.30.107 E017.06.11.808 N052.10.19.775 E017.05.46.176
                          N052.10.19.775 E017.05.46.176 N052.10.09.695 E017.05.20.256
                          N052.10.09.695 E017.05.20.256 N052.09.59.904 E017.04.54.047
                          N052.09.59.904 E017.04.54.047 N052.09.50.400 E017.04.27.552
                          N052.09.50.400 E017.04.27.552 N052.09.41.148 E017.04.00.804
                          N052.09.41.148 E017.04.00.804 N052.09.32.219 E017.03.33.804
                          N052.09.32.219 E017.03.33.804 N052.09.23.543 E017.03.06.515
                          N052.09.23.543 E017.03.06.515 N052.09.15.192 E017.02.39.012
                          N052.09.15.192 E017.02.39.012 N052.09.07.128 E017.02.11.292
                          N052.09.07.128 E017.02.11.292 N052.08.59.351 E017.01.43.320
                          N052.08.59.351 E017.01.43.320 N052.08.51.863 E017.01.15.131
                          N052.08.51.863 E017.01.15.131 N052.08.44.699 E017.00.46.727
                          N052.08.44.699 E017.00.46.727 N052.08.37.823 E017.00.18.108
                          N052.08.37.823 E017.00.18.108 N052.08.31.272 E016.59.49.343
                          N052.08.31.272 E016.59.49.343 N052.08.25.007 E016.59.20.364
                          N052.08.25.007 E016.59.20.364 N052.08.19.067 E016.58.51.203
                          N052.08.19.067 E016.58.51.203 N052.08.13.415 E016.58.21.900
                          N052.08.13.415 E016.58.21.900 N052.08.08.087 E016.57.52.415
                          N052.08.08.087 E016.57.52.415 N052.08.03.083 E016.57.22.788
                          N052.08.03.083 E016.57.22.788 N052.07.58.404 E016.56.53.052
                          N052.07.58.404 E016.56.53.052 N052.07.54.011 E016.56.23.171
                          N052.07.54.011 E016.56.23.171 N052.07.49.979 E016.55.53.147
                          N052.07.49.979 E016.55.53.147 N052.07.46.236 E016.55.23.015
                          N052.07.46.236 E016.55.23.015 N052.07.42.816 E016.54.52.812
                          N052.07.42.816 E016.54.52.812 N052.07.39.719 E016.54.22.500
                          N052.07.39.719 E016.54.22.500 N052.07.36.948 E016.53.52.080
                          N052.07.36.948 E016.53.52.080 N052.07.34.499 E016.53.21.624
                          N052.07.34.499 E016.53.21.624 N052.07.32.376 E016.52.51.095
                          N052.07.32.376 E016.52.51.095 N052.07.30.576 E016.52.20.496
                          N052.07.30.576 E016.52.20.496 N052.07.29.099 E016.51.49.823
                          N052.07.29.099 E016.51.49.823 N052.07.27.983 E016.51.19.151
                          N052.07.27.983 E016.51.19.151 N052.07.27.155 E016.50.48.443
                          N052.07.27.155 E016.50.48.443 N052.07.26.652 E016.50.17.735
                          N052.07.26.652 E016.50.17.735 N052.07.26.507 E016.49.46.991
                          N052.07.26.507 E016.49.46.991 N052.07.26.652 E016.49.16.247
                          N052.07.26.652 E016.49.16.247 N052.07.27.155 E016.48.45.540
                          N052.07.27.155 E016.48.45.540 N052.07.27.983 E016.48.14.832
                          N052.07.27.983 E016.48.14.832 N052.07.29.099 E016.47.44.124
                          N052.07.29.099 E016.47.44.124 N052.07.30.576 E016.47.13.487
                          N052.07.30.576 E016.47.13.487 N052.07.32.376 E016.46.42.888
                          N052.07.32.376 E016.46.42.888 N052.07.34.499 E016.46.12.359
                          N052.07.34.499 E016.46.12.359 N052.07.36.948 E016.45.41.903
                          N052.07.36.948 E016.45.41.903 N052.07.39.719 E016.45.11.484
                          N052.07.39.719 E016.45.11.484 N052.07.42.816 E016.44.41.171
                          N052.07.42.816 E016.44.41.171 N052.07.46.236 E016.44.10.968
                          N052.07.46.236 E016.44.10.968 N052.07.50.160 E016.43.37.560
                          N052.49.01.000 E015.49.57.000 N052.32.36.000 E016.11.37.000
                          N052.32.36.000 E016.11.37.000 N052.21.21.000 E016.26.15.000
                          N052.21.21.000 E016.26.15.000 N052.11.46.000 E016.38.36.000
                          N052.11.46.000 E016.38.36.000 N052.07.50.160 E016.43.37.560
                          N052.14.02.999 E015.52.59.998 N052.11.44.000 E016.12.11.000
                          N052.11.44.000 E016.12.11.000 N052.11.07.000 E016.17.12.000
                          N052.11.07.000 E016.17.12.000 N052.07.50.160 E016.43.37.560
                          N051.55.12.000 E016.28.22.000 N052.00.16.000 E016.34.28.000
                          N052.00.16.000 E016.34.28.000 N052.07.50.160 E016.43.37.560 
                          NILPU NILPU EKRIV EKRIV
                          N052.00.45.000 E017.51.24.000 N052.04.02.000 E017.20.47.000
                          N052.04.02.000 E017.20.47.000 N052.08.19.000 E017.14.36.000
                          N052.08.19.000 E017.14.36.000 N052.12.00.000 E017.09.18.000

-EPPO 10 N001.39.20.999 E021.25.40.001 N001.41.44.999 E020.58.09.998 
                          N052.07.50.160 E016.43.37.560 N052.07.59.255 E016.42.43.307
                          N052.07.59.255 E016.42.43.307 N052.08.04.235 E016.42.13.607
                          N052.08.04.235 E016.42.13.607 N052.08.09.239 E016.41.44.016
                          N052.08.09.239 E016.41.44.016 N052.08.14.568 E016.41.14.568
                          N052.08.14.568 E016.41.14.568 N052.08.20.220 E016.40.45.299
                          N052.08.20.220 E016.40.45.299 N052.08.26.159 E016.40.16.176
                          N052.08.26.159 E016.40.16.176 N052.08.32.388 E016.39.47.231
                          N052.08.32.388 E016.39.47.231 N052.08.38.940 E016.39.18.467
                          N052.08.38.940 E016.39.18.467 N052.08.45.815 E016.38.49.920
                          N052.08.45.815 E016.38.49.920 N052.08.52.979 E016.38.21.552
                          N052.08.52.979 E016.38.21.552 N052.09.00.432 E016.37.53.399
                          N052.09.00.432 E016.37.53.399 N052.09.08.207 E016.37.25.427
                          N052.09.08.207 E016.37.25.427 N052.09.16.271 E016.36.57.744
                          N052.09.16.271 E016.36.57.744 N052.09.24.624 E016.36.30.239
                          N052.09.24.624 E016.36.30.239 N052.09.33.263 E016.36.03.024
                          N052.09.33.263 E016.36.03.024 N052.09.42.192 E016.35.36.024
                          N052.09.42.192 E016.35.36.024 N052.09.51.407 E016.35.09.312
                          N052.09.51.407 E016.35.09.312 N052.10.00.911 E016.34.42.851
                          N052.10.00.911 E016.34.42.851 N052.10.10.704 E016.34.16.680
                          N052.10.10.704 E016.34.16.680 N052.10.20.784 E016.33.50.795
                          N052.10.20.784 E016.33.50.795 N052.10.31.116 E016.33.25.199
                          N052.10.31.116 E016.33.25.199 N052.10.41.699 E016.32.59.891
                          N052.10.41.699 E016.32.59.891 N052.10.52.571 E016.32.34.871
                          N052.10.52.571 E016.32.34.871 N052.11.03.732 E016.32.10.211
                          N052.11.03.732 E016.32.10.211 N052.11.15.108 E016.31.45.839
                          N052.11.15.108 E016.31.45.839 N052.11.26.772 E016.31.21.827
                          N052.11.26.772 E016.31.21.827 N052.11.38.687 E016.30.58.139
                          N052.11.38.687 E016.30.58.139 N052.11.50.855 E016.30.34.776
                          N052.11.50.855 E016.30.34.776 N052.12.03.239 E016.30.11.772
                          N052.12.03.239 E016.30.11.772 N052.12.15.911 E016.29.49.164
                          N052.12.15.911 E016.29.49.164 N052.12.28.799 E016.29.26.880
                          N052.12.28.799 E016.29.26.880 N052.12.41.904 E016.29.04.991
                          N052.12.41.904 E016.29.04.991 N052.12.55.260 E016.28.43.463
                          N052.12.55.260 E016.28.43.463 N052.13.08.831 E016.28.22.332
                          N052.13.08.831 E016.28.22.332 N052.13.22.656 E016.28.01.596
                          N052.13.22.656 E016.28.01.596 N052.13.36.659 E016.27.41.255
                          N052.13.36.659 E016.27.41.255 N052.13.50.915 E016.27.21.311
                          N052.13.50.915 E016.27.21.311 N052.14.05.351 E016.27.01.763
                          N052.14.05.351 E016.27.01.763 N052.14.20.003 E016.26.42.648
                          N052.14.20.003 E016.26.42.648 N052.14.34.872 E016.26.23.964
                          N052.14.34.872 E016.26.23.964 N052.14.49.919 E016.26.05.712
                          N052.14.49.919 E016.26.05.712 N052.15.05.147 E016.25.47.892
                          N052.15.05.147 E016.25.47.892 N052.15.20.591 E016.25.30.503
                          N052.15.20.591 E016.25.30.503 N052.15.36.216 E016.25.13.547
                          N052.15.36.216 E016.25.13.547 N052.15.51.984 E016.24.57.059
                          N052.15.51.984 E016.24.57.059 N052.16.07.968 E016.24.41.004
                          N052.16.07.968 E016.24.41.004 N052.16.24.095 E016.24.25.416
                          N052.16.24.095 E016.24.25.416 N052.16.40.403 E016.24.10.296
                          N052.16.40.403 E016.24.10.296 N052.16.56.856 E016.23.55.644
                          N052.16.56.856 E016.23.55.644 N052.17.13.451 E016.23.41.460
                          N052.17.13.451 E016.23.41.460 N052.17.30.228 E016.23.27.779
                          N052.17.30.228 E016.23.27.779 N052.17.47.111 E016.23.14.568
                          N052.17.47.111 E016.23.14.568 N052.18.04.139 E016.23.01.823
                          N052.18.04.139 E016.23.01.823 N052.18.21.312 E016.22.49.584
                          N052.18.21.312 E016.22.49.584 N052.18.38.627 E016.22.37.847
                          N052.18.38.627 E016.22.37.847 N052.18.56.052 E016.22.26.580
                          N052.18.56.052 E016.22.26.580 N052.19.13.583 E016.22.15.815
                          N052.19.13.583 E016.22.15.815 N052.19.31.223 E016.22.05.592
                          N052.19.31.223 E016.22.05.592 N052.19.48.971 E016.21.55.836
                          N052.19.48.971 E016.21.55.836 N052.20.06.828 E016.21.46.620
                          N052.20.06.828 E016.21.46.620 N052.20.24.792 E016.21.37.872
                          N052.20.24.792 E016.21.37.872 N052.20.42.828 E016.21.29.663
                          N052.20.42.828 E016.21.29.663 N052.21.00.972 E016.21.21.996
                          N052.21.00.972 E016.21.21.996 N052.21.19.188 E016.21.14.832
                          N052.21.19.188 E016.21.14.832 N052.21.37.439 E016.21.08.172
                          N052.21.37.439 E016.21.08.172 N052.21.55.799 E016.21.02.052
                          N052.21.55.799 E016.21.02.052 N052.22.14.195 E016.20.56.471
                          N052.22.14.195 E016.20.56.471 N052.22.32.664 E016.20.51.395
                          N052.22.32.664 E016.20.51.395 N052.22.51.204 E016.20.46.860
                          N052.22.51.204 E016.20.46.860 N052.23.09.744 E016.20.42.864
                          N052.23.09.744 E016.20.42.864 N052.23.28.356 E016.20.39.372
                          N052.23.28.356 E016.20.39.372 N052.23.47.003 E016.20.36.420
                          N052.23.47.003 E016.20.36.420 N052.24.05.651 E016.20.34.008
                          N052.24.05.651 E016.20.34.008 N052.24.24.335 E016.20.32.135
                          N052.24.24.335 E016.20.32.135 N052.24.43.056 E016.20.30.803
                          N052.24.43.056 E016.20.30.803 N052.25.01.776 E016.20.30.012
                          N052.25.01.776 E016.20.30.012 N052.25.20.495 E016.20.29.724
                          N052.25.20.495 E016.20.29.724 N052.25.39.215 E016.20.30.012
                          N052.25.39.215 E016.20.30.012 N052.25.57.936 E016.20.30.803
                          N052.25.57.936 E016.20.30.803 N052.26.16.655 E016.20.32.135
                          N052.26.16.655 E016.20.32.135 N052.26.35.340 E016.20.34.008
                          N052.26.35.340 E016.20.34.008 N052.26.53.987 E016.20.36.420
                          N052.26.53.987 E016.20.36.420 N052.27.12.636 E016.20.39.372
                          N052.27.12.636 E016.20.39.372 N052.27.31.248 E016.20.42.864
                          N052.27.31.248 E016.20.42.864 N052.27.49.788 E016.20.46.860
                          N052.27.49.788 E016.20.46.860 N052.28.08.328 E016.20.51.395
                          N052.28.08.328 E016.20.51.395 N052.28.26.796 E016.20.56.471
                          N052.28.26.796 E016.20.56.471 N052.28.45.191 E016.21.02.052
                          N052.28.45.191 E016.21.02.052 N052.29.03.551 E016.21.08.172
                          N052.29.03.551 E016.21.08.172 N052.29.27.000 E016.21.16.000
                          N052.49.01.000 E015.49.57.000 N052.35.58.000 E016.07.12.000
                          N052.35.58.000 E016.07.12.000 N052.32.36.000 E016.11.37.000
                          N052.32.36.000 E016.11.37.000 N052.30.24.000 E016.14.29.000
                          N052.30.24.000 E016.14.29.000 N052.29.27.000 E016.21.16.000
                          N052.29.27.000 E016.21.16.000 N052.28.42.000 E016.26.29.000
                          N052.28.42.000 E016.26.29.000 N052.27.54.000 E016.32.09.000
                          N052.14.02.000 E015.53.00.000 N052.17.33.000 E016.10.21.000
                          N052.17.33.000 E016.10.21.000 N052.19.52.000 E016.21.57.000
                          N051.55.12.000 E016.28.22.000 N052.01.39.000 E016.32.55.000
                          N052.01.39.000 E016.32.55.000 N052.08.56.000 E016.38.05.000
                          NILPU NILPU PO503 PO503
                          PO503 PO503 CMP CMP
                          N052.00.45.000 E017.51.24.000 N052.03.01.000 E017.30.26.000
                          N052.03.01.000 E017.30.26.000 N052.04.46.000 E017.13.52.000
                          N052.04.46.000 E017.13.52.000 N052.07.50.160 E016.43.37.560 

-EPRA 07/25 HOTEL ROMEG ROMEG RAD RAD
ODRUX ODRUX RA511 RA511
RA511 RA511 RAD RAD
KURAV KURAV RAD RAD

-EPZG 24 VICTOR BAREP BAREP ZLG ZLG
OBOLA OBOLA ZLG ZLG
-EPZG 24 WHISKEY BAREP BAREP BBM BBM
OBOLA OBOLA BBM BBM

-EPWR 29 XIDNA XIDNA WR707 WR707
	WR707 WR707 WR706 WR706
	WR706 WR706 WR704 WR704
	WR704 WR704 WR703 WR703
	WR703 WR703 WR702 WR702
	WR702 WR702 WR701 WR701

	UVIVI UVIVI WR712 WR712
	WR712 WR712 WR711 WR711
	WR711 WR711 WR706 WR706
	
	SUDOL SUDOL WR722 WR722
	WR722 WR722 WR721 WR721
	WR721 WR721 WR704 WR704

	EPOPA EPOPA WR732 WR732
	WR732 WR732 WR731 WR731
	WR731 WR731 WR721 WR721

	DINOV DINOV WR743 WR743
	WR743 WR743 WR742 WR742
	WR742 WR742 WR741 WR741
	WR741 WR741 WR731 WR731

	VAGNI VAGNI WR754 WR754
	WR754 WR754 WR753 WR753
	WR753 WR753 WR752 WR752
	WR752 WR752 WR751 WR751
	WR751 WR751 WR742 WR742

-EPWR 11 XIDNA XIDNA WR609 WR609
	WR609 WR609 WR608 WR608
	WR608 WR608 WR607 WR607
	WR607 WR607 WR606 WR606
	WR606 WR606 WR604 WR604
	WR604 WR604 WR603 WR603
	WR603 WR603 WR602 WR602
	WR602 WR602 WR601 WR601

	UVIVI UVIVI WR612 WR612
	WR612 WR612 WR611 WR611
	WR611 WR611 WR608 WR608

	SUDOL SUDOL APTAS APTAS
	APTAS APTAS WR621 WR621
	WR621 WR621 WR607 WR607

	EPOPA EPOPA WR636 WR636
	WR636 WR636 WR634 WR634
	WR634 WR634 WR633 WR633
	WR633 WR633 WR632 WR632
	WR632 WR632 WR631 WR631
	WR631 WR631 WR604 WR604

	DINOV DINOV WR642 WR642
	WR642 WR642 OBOVI OBOVI
	OBOVI OBOVI WR632 WR632
	
	VAGNI VAGNI WR631 WR631
	

-EPKK 07 MAPIK MAPIK ODSOB ODSOB
ODSOB ODSOB KK708 KK708

;luk przy KK707
KK708 KK708 N050.13.10.320 E019.29.22.390
N050.13.10.320 E019.29.22.390 N050.13.06.790 E019.29.30.290
N050.13.06.790 E019.29.30.290 N050.13.03.790 E019.29.37.750
N050.13.03.790 E019.29.37.750 N050.13.01.730 E019.29.45.240
N050.13.01.730 E019.29.45.240 N050.12.58.550 E019.29.51.640 
N050.12.58.550 E019.29.51.640 N050.12.54.870 E019.29.57.290
N050.12.54.870 E019.29.57.290 N050.12.50.620 E019.30.02.180
N050.12.50.620 E019.30.02.180 N050.12.45.860 E019.30.05.300
N050.12.45.860 E019.30.05.300 N050.12.39.570 E019.30.08.360
N050.12.39.570 E019.30.08.360 N050.12.26.360 E019.30.13.100
N050.12.26.360 E019.30.13.100 KK707 KK707 stargray
N050.13.10.320 E019.29.22.390 KK707 KK707 stargray
N050.12.26.360 E019.30.13.100 N050.09.23.870 E019.31.16.040
N050.09.23.870 E019.31.16.040 KK706 KK706 stargray
N050.09.23.870 E019.31.16.040 N050.09.09.180 E019.31.20.460
N050.09.09.180 E019.31.20.460 N050.08.53.790 E019.31.20.420
N050.08.53.790 E019.31.20.420 N050.08.38.310 E019.31.16.030
N050.08.38.310 E019.31.16.030 N050.08.23.690 E019.31.07.990
N050.08.23.690 E019.31.07.990 N050.08.10.210 E019.30.55.650
N050.08.10.210 E019.30.55.650 N050.07.57.910 E019.30.40.580
N050.07.57.910 E019.30.40.580 N050.07.48.010 E019.30.21.360
N050.07.48.010 E019.30.21.360 N050.07.40.860 E019.29.57.440
N050.07.40.860 E019.29.57.440 N050.07.36.740 E019.29.29.010
N050.07.36.740 E019.29.29.010 KK704 KK704

KK706 KK706 KK704 KK704

;zakret KK704-KK703-KK702-KK701
KK704 KK704 N050.06.05.840 E019.18.52.150
N050.06.05.840 E019.18.52.150 N050.06.01.370 E019.18.28.750
N050.06.01.370 E019.18.28.750 N050.05.53.940 E019.18.05.990
N050.05.53.940 E019.18.05.990 N050.05.44.230 E019.17.46.840
N050.05.44.230 E019.17.46.840 N050.05.32.650 E019.17.29.980
N050.05.32.650 E019.17.29.980 N050.05.19.160 E019.17.17.650
N050.05.19.160 E019.17.17.650 N050.05.04.700 E019.17.09.170
N050.05.04.700 E019.17.09.170 N050.04.49.230 E019.17.04.020
N050.04.49.230 E019.17.04.020 N050.04.33.710 E019.17.02.560
N050.04.33.710 E019.17.02.560 N050.04.18.200 E019.17.05.580
N050.04.18.200 E019.17.05.580 N050.02.03.090 E019.17.52.800
N050.02.03.090 E019.17.52.800 N050.01.48.040 E019.18.00.220
N050.01.48.040 E019.18.00.220 N050.01.34.110 E019.18.11.850
N050.01.34.110 E019.18.11.850 N050.01.22.040 E019.18.26.310
N050.01.22.040 E019.18.26.310 N050.01.11.390 E019.18.44.910
N050.01.11.390 E019.18.44.910 N050.00.57.400 E019.19.28.200
N050.00.57.400 E019.19.28.200 N050.00.53.790 E019.19.51.970
N050.00.53.790 E019.19.51.970 N050.00.53.590 E019.20.16.340
N050.00.53.590 E019.20.16.340 N050.00.55.800 E019.20.38.860
N050.00.55.800 E019.20.38.860 KK701 KK701
N050.06.05.840 E019.18.52.150 KK703 KK703 stargray
N050.04.18.200 E019.17.05.580 KK703 KK703 stargray
N050.00.55.800 E019.20.38.860 KK702 KK702 stargray
N050.02.03.090 E019.17.52.800 KK702 KK702 stargray

KK701 KK701 IXUVI IXUVI
IXUVI IXUVI KK592 KK592

BAREX BAREX XONRA XONRA
XONRA XONRA INPUM INPUM
INPUM INPUM ODSOB ODSOB

;luk przy UPMAK
KUKAM KUKAM N050.42.08.480 E019.45.27.920
N050.42.08.480 E019.45.27.920 N050.41.59.160 E019.45.06.060
N050.41.59.160 E019.45.06.060 N050.41.52.380 E019.44.43.720
N050.41.52.380 E019.44.43.720 N050.41.43.380 E019.44.23.590
N050.41.43.380 E019.44.23.590 N050.41.32.230 E019.44.05.800
N050.41.32.230 E019.44.05.800 N050.41.19.600 E019.43.51.760
N050.41.19.600 E019.43.51.760 N050.41.05.150 E019.43.42.070
N050.41.05.150 E019.43.42.070 N050.40.50.240 E019.43.34.990
N050.40.50.240 E019.43.34.990 N050.40.34.550 E019.43.32.950
N050.40.34.550 E019.43.32.950 N050.40.18.910 E019.43.33.960
N050.40.18.910 E019.43.33.960 N050.39.55.730 E019.43.35.350
N050.39.55.730 E019.43.35.350 ULNOD ULNOD
N050.39.55.730 E019.43.35.350 UPMAK UPMAK stargray
N050.42.08.480 E019.45.27.920 UPMAK UPMAK stargray

;luk przy KK712
ULNOD ULNOD N050.11.34.990 E019.47.00.630
N050.11.34.990 E019.47.00.630 N050.11.22.030 E019.47.00.630
N050.11.22.030 E019.47.00.630 N050.11.08.650 E019.47.01.890
N050.11.08.650 E019.47.01.890 N050.10.55.010 E019.46.59.320
N050.10.55.010 E019.46.59.320 N050.10.55.790 E019.46.59.620
N050.10.55.790 E019.46.59.620 N050.10.43.000 E019.46.54.720
N050.10.43.000 E019.46.54.720 N050.10.31.090 E019.46.46.580
N050.10.31.090 E019.46.46.580 N050.10.20.680 E019.46.34.450
N050.10.20.680 E019.46.34.450 N050.10.10.480 E019.46.22.060
N050.10.10.480 E019.46.22.060 N050.10.02.850 E019.46.05.460
N050.10.02.850 E019.46.05.460 N050.09.56.820 E019.45.47.460
N050.09.56.820 E019.45.47.460 N050.09.52.470 E019.45.27.230
N050.09.52.470 E019.45.27.230 N050.09.46.730 E019.44.54.990
N050.11.34.990 E019.47.00.630 KK712 KK712 stargray

;zakret KK701 KK717
N050.02.00.980 E019.28.14.320 N050.01.56.230 E019.27.51.420
N050.01.56.230 E019.27.51.420 N050.01.48.330 E019.27.28.190
N050.01.48.330 E019.27.28.190 N050.01.39.580 E019.27.10.360
N050.01.39.580 E019.27.10.360 N050.01.28.030 E019.26.54.370
N050.01.28.030 E019.26.54.370 N050.01.14.130 E019.26.40.660
N050.01.14.130 E019.26.40.660 N050.00.59.360 E019.26.30.690
N050.00.59.360 E019.26.30.690 N050.00.44.550 E019.26.28.880
N050.00.44.550 E019.26.28.880 N050.00.28.330 E019.26.25.090
N050.00.28.330 E019.26.25.090 N050.00.14.370 E019.26.27.150
N050.00.14.370 E019.26.27.150 N049.58.00.620 E019.27.12.720
N049.58.00.620 E019.27.12.720 N049.57.44.900 E019.27.20.720
N049.57.44.900 E019.27.20.720 N049.57.30.770 E019.27.31.300
N049.57.30.770 E019.27.31.300 N049.57.18.640 E019.27.46.360
N049.57.18.640 E019.27.46.360 N049.57.07.580 E019.28.04.040
N049.57.07.580 E019.28.04.040 N049.56.59.100 E019.28.23.760
N049.56.59.100 E019.28.23.760 N049.56.52.700 E019.28.45.960
N049.56.52.700 E019.28.45.960 N049.56.49.120 E019.29.10.190
N049.56.49.120 E019.29.10.190 N049.56.48.210 E019.29.34.400
N049.56.48.210 E019.29.34.400 N049.56.50.340 E019.29.59.510
N049.56.50.340 E019.29.59.510 KK718 KK718
N050.00.14.370 E019.26.27.150 KK701 KK701 stargray
N049.56.50.340 E019.29.59.510 KK717 KK717 stargray
N049.58.00.620 E019.27.12.720 KK717 KK717 stargray

;zakret KK719-UVRET
N049.58.20.400 E019.40.35.710 N049.58.22.710 E019.40.57.670
N049.58.22.710 E019.40.57.670 N049.58.22.310 E019.41.21.890
N049.58.22.310 E019.41.21.890 N049.58.18.800 E019.41.45.800
N049.58.18.800 E019.41.45.800 N049.58.13.150 E019.42.08.630
N049.58.13.150 E019.42.08.630 N049.58.04.560 E019.42.29.280
N049.58.04.560 E019.42.29.280 N049.57.54.110 E019.42.46.910
N049.57.54.110 E019.42.46.910 N049.57.41.540 E019.43.01.680
N049.57.41.540 E019.43.01.680 N049.57.27.690 E019.43.13.350
N049.57.27.690 E019.43.13.350 N049.57.21.400 E019.43.15.290
N049.57.21.400 E019.43.15.290 KK719 KK719 stargray
N049.57.21.400 E019.43.15.290 N049.54.56.830 E019.44.05.990
N049.54.56.830 E019.44.05.990 N049.54.41.040 E019.44.09.220
N049.54.41.040 E019.44.09.220 N049.54.26.120 E019.44.08.780
N049.54.26.120 E019.44.08.780 N049.54.10.730 E019.44.03.500
N049.54.10.730 E019.44.03.500 N049.53.56.040 E019.43.54.580
N049.53.56.040 E019.43.54.580 N049.53.42.830 E019.43.41.880
N049.53.42.830 E019.43.41.880 N049.53.31.350 E019.43.25.570
N049.53.31.350 E019.43.25.570 N049.53.22.450 E019.43.06.050
N049.53.22.450 E019.43.06.050 N049.53.15.060 E019.42.43.780
N049.53.15.060 E019.42.43.780 N049.53.11.730 E019.42.20.730
N049.53.11.730 E019.42.20.730 UVRET UVRET stargray
N049.54.56.830 E019.44.05.990 UVRET UVRET 
N049.53.11.730 E019.42.20.730 KK723 KK723
N049.53.11.730 E019.42.20.730 KK723 KK723

;ZAKRET PRZY KK727
N049.53.37.320 E018.46.58.900 KK727 KK727 stargray
NETIR NETIR N049.53.37.320 E018.46.58.900
N049.53.37.320 E018.46.58.900 N049.53.51.800 E018.47.04.930
N049.53.51.800 E018.47.04.930 N049.54.05.450 E018.47.12.430
N049.54.05.450 E018.47.12.430 N049.54.17.670 E018.47.25.400
N049.54.17.670 E018.47.25.400 N049.54.29.090 E018.47.39.490
N049.54.29.090 E018.47.39.490 N049.54.39.030 E018.47.55.950
N049.54.39.030 E018.47.55.950 N049.54.46.850 E018.48.15.030
N049.54.46.850 E018.48.15.030 N049.54.52.200 E018.48.37.760
N049.54.52.200 E018.48.37.760 N049.54.55.260 E018.48.58.150
N049.54.55.260 E018.48.58.150 N049.54.55.940 E018.49.21.710
N049.54.55.940 E018.49.21.710 N049.54.55.830 E018.49.50.260
N049.53.37.320 E018.46.58.900 KK727 KK727 stargray

KK712 KK712 KK706 KK706

GOVRI GOVRI XENGO XENGO
XENGO XENGO KK714 KK714
KK714 KK714 KK712 KK712

LENOV LENOV MODGU MODGU
MODGU MODGU ERPOK ERPOK
ERPOK ERPOK KK721 KK721
KK721 KK721 KK719 KK719 
KK719 KK719 KK718 KK718

MEBAN MEBAN EMKUX EMKUX
EMKUX EMKUX KK728 KK728
KK728 KK728 UVRET UVRET

PADKA PADKA KK727 KK727
KK727 KK727 KK726 KK726
KK726 KK726 KK724 KK724
KK724 KK724 KK723 KK723

-EPKK 25 MAPIK MAPIK KK511 KK511
KK511 KK511 ODSOB ODSOB
ODSOB ODSOB KK509 KK509

;luk prrzy KK508
KK509 KK509 N050.09.52.420 E019.38.16.060
N050.09.52.420 E019.38.16.060 N050.09.44.470 E019.38.44.540
N050.09.44.470 E019.38.44.540 N050.09.36.300 E019.39.07.930
N050.09.36.300 E019.39.07.930 N050.09.28.970 E019.39.30.100
N050.09.28.970 E019.39.30.100 N050.09.22.150 E019.39.49.430
N050.09.22.150 E019.39.49.430 N050.09.17.900 E019.40.10.030
N050.09.17.900 E019.40.10.030 N050.09.15.720 E019.40.31.930
N050.09.15.720 E019.40.31.930 N050.09.16.350 E019.40.54.160
N050.09.16.350 E019.40.54.160 N050.09.18.940 E019.41.15.070
N050.09.18.940 E019.41.15.070 N050.09.21.870 E019.41.37.530
N050.09.21.870 E019.41.37.530 N050.09.24.900 E019.42.03.870
N050.09.24.900 E019.42.03.870 N050.09.27.030 E019.42.33.250
N050.09.27.030 E019.42.33.250 KK507 KK507

KK507 KK507 KK506 KK506
KK506 KK506 KK504 KK504

;zakret KK504-KK503-KK502-KK501
KK504 KK503 N050.13.28.450 E020.11.50.510 
N050.13.28.450 E020.11.50.510 KK503 KK503 stargray
N050.13.28.450 E020.11.50.510 N050.13.30.230 E020.12.15.160
N050.13.30.230 E020.12.15.160 N050.13.29.920 E020.12.39.240
N050.13.29.920 E020.12.39.240 N050.13.26.280 E020.13.02.850
N050.13.26.280 E020.13.02.850 N050.13.19.880 E020.13.25.550
N050.13.19.880 E020.13.25.550 N050.13.11.700 E020.13.46.010
N050.13.11.700 E020.13.46.010 N050.13.00.740 E020.14.03.790 
N050.13.00.740 E020.14.03.790 N050.12.47.930 E020.14.18.400
N050.12.47.930 E020.14.18.400 N050.12.33.980 E020.14.29.600
N050.12.33.980 E020.14.29.600 N050.12.19.180 E020.14.36.280
N050.12.19.180 E020.14.36.280 KK503 KK503 stargray
N050.12.19.180 E020.14.36.280 N050.10.04.330 E020.15.21.000
N050.10.04.330 E020.15.21.000 KK502 stargray
N050.10.04.330 E020.15.21.000 N050.09.47.850 E020.15.24.100
N050.09.47.850 E020.15.24.100 N050.09.32.450 E020.15.22.400
N050.09.32.450 E020.15.22.400 N050.09.16.870 E020.15.17.140
N050.09.16.870 E020.15.17.140 N050.08.49.640 E020.14.54.630
N050.08.49.640 E020.14.54.630 N050.08.38.220 E020.14.37.720
N050.08.38.220 E020.14.37.720 N050.08.28.440 E020.14.18.150
N050.08.28.440 E020.14.18.150 N050.08.21.900 E020.13.56.850
N050.08.21.900 E020.13.56.850 N050.08.17.400 E020.13.32.960

KK502 KK502 KK501 KK501
KK501 KK501 VAXOB VAXOB

BAREX BAREX XONRA XONRA
XONRA XONRA ASTUD ASTUD
ASTUD ASTUD ODSOB ODSOB

KUKAM KUKAM KK512 KK512

;luk przy KK504
KK512 KK512 N050.14.13.970 E020.06.10.620
N050.14.13.970 E020.06.10.620 N050.13.59.380 E020.06.18.930
N050.13.59.380 E020.06.18.930 N050.13.45.310 E020.06.29.810
N050.13.45.310 E020.06.29.810 N050.13.32.810 E020.06.44.500
N050.13.32.810 E020.06.44.500 N050.13.22.250 E020.07.02.380
N050.13.22.250 E020.07.02.380 N050.13.13.700 E020.07.22.600
N050.13.13.700 E020.07.22.600 N050.13.07.170 E020.07.44.890
N050.13.07.170 E020.07.44.890 N050.13.03.770 E020.08.09.210
N050.13.03.770 E020.08.09.210 N050.13.04.240 E020.08.34.630
N050.13.04.240 E020.08.34.630 N050.13.03.440 E020.08.47.800
N050.14.13.970 E020.06.10.620 KK504 KK504 stargray

GOVRI GOVRI KK529 KK529
KK529 KK529 KK528 KK528

;zakret KK528-KK527-KK517-KK502
KK528 KK528 N049.57.28.800 E020.13.35.220
N049.57.28.800 E020.13.35.220 N049.57.26.860 E020.13.14.560 
N049.57.26.860 E020.13.14.560 N049.57.27.700 E020.12.53.450
N049.57.27.700 E020.12.53.450 N049.57.30.720 E020.12.32.810
N049.57.30.720 E020.12.32.810 N049.57.35.800 E020.12.13.410
N049.57.35.800 E020.12.13.410 N049.57.43.450 E020.11.55.880
N049.57.43.450 E020.11.55.880 N049.57.52.780 E020.11.40.230
N049.57.52.780 E020.11.40.230 N049.58.03.670 E020.11.27.820
N049.58.03.670 E020.11.27.820 N049.58.15.970 E020.11.18.780
N049.58.15.970 E020.11.18.780 N049.58.28.990 E020.11.11.690
N049.58.28.990 E020.11.11.690 KK527 KK527 stargray
N049.57.28.800 E020.13.35.220 KK527 KK527 stargray
N049.58.28.990 E020.11.11.690 N050.01.06.290 E020.10.20.050
N050.01.06.290 E020.10.20.050 N050.01.19.000 E020.10.17.740
N050.01.19.000 E020.10.17.740 N050.01.33.810 E020.10.19.080
N050.01.33.810 E020.10.19.080 N050.01.46.900 E020.10.23.830
N050.01.46.900 E020.10.23.830 N050.01.58.590 E020.10.30.630
N050.01.58.590 E020.10.30.630 N050.02.10.300 E020.10.42.370
N050.02.10.300 E020.10.42.370 N050.02.20.250 E020.10.56.030
N050.02.20.250 E020.10.56.030 N050.02.28.610 E020.11.13.880
N050.02.28.610 E020.11.13.880 N050.02.35.280 E020.11.32.840
N050.02.35.280 E020.11.32.840 N050.02.39.410 E020.11.54.200
N050.01.06.290 E020.10.20.050 KK517 KK517 stargray

KK517 KK517 KK516 KK516

;zakret KK516-KK514-KK513-KK502
KK516 KK516 N050.04.07.560 E020.22.49.160
N050.04.07.560 E020.22.49.160 KK514 KK514 stargray
N050.04.07.560 E020.22.49.160 N050.04.12.120 E020.23.12.590
N050.04.12.120 E020.23.12.590 N050.04.19.240 E020.23.35.460
N050.04.19.240 E020.23.35.460 N050.04.28.840 E020.23.54.710
N050.04.28.840 E020.23.54.710 N050.04.39.930 E020.24.11.450 
N050.04.39.930 E020.24.11.450 N050.04.53.520 E020.24.24.830
N050.04.53.520 E020.24.24.830 N050.05.07.780 E020.24.34.390
N050.05.07.780 E020.24.34.390 N050.05.22.870 E020.24.39.390
N050.05.22.870 E020.24.39.390 N050.05.38.800 E020.24.40.750
N050.05.38.800 E020.24.40.750 N050.05.54.050 E020.24.38.150
N050.05.54.050 E020.24.38.150 KK514 KK514 stargray
N050.05.54.050 E020.24.38.150 N050.08.08.910 E020.23.55.010
N050.08.08.910 E020.23.55.010 N050.08.23.670 E020.23.48.960
N050.08.23.670 E020.23.48.960 N050.08.38.700 E020.23.37.240
N050.08.38.700 E020.23.37.240 N050.08.51.170 E020.23.22.770
N050.08.51.170 E020.23.22.770 N050.09.01.240 E020.23.05.590
N050.09.01.240 E020.23.05.590 N050.09.09.830 E020.22.45.810
N050.09.09.830 E020.22.45.810 N050.09.16.320 E020.22.21.710
N050.09.16.320 E020.22.21.710 N050.09.20.110 E020.21.57.580
N050.09.20.110 E020.21.57.580 N050.09.21.060 E020.21.33.450
N050.09.21.060 E020.21.33.450 N050.09.18.910 E020.21.09.880
N050.09.18.910 E020.21.09.880 KK502 KK502
N050.09.18.910 E020.21.09.880 KK513 KK513 stargray
N050.08.08.910 E020.23.55.010 KK513 KK513 stargray

LENOV LENOV ERKEB ERKEB
ERKEB ERKEB ASGID ASGID

;luk przy KK529
ASGID ASGID N049.57.57.510 E020.27.54.540
N049.57.57.510 E020.27.54.540 N049.58.21.590 E020.27.32.230
N049.58.21.590 E020.27.32.230 N049.58.23.540 E020.27.29.100
N049.58.23.540 E020.27.29.100 N049.58.34.960 E020.27.15.480
N049.58.34.960 E020.27.15.480 N049.58.45.060 E020.26.59.360
N049.58.45.060 E020.26.59.360 N049.58.53.030 E020.26.40.050
N049.58.53.030 E020.26.40.050 N049.58.58.490 E020.26.19.340
N049.58.58.490 E020.26.19.340 N049.59.01.850 E020.25.57.360
N049.59.01.850 E020.25.57.360 N049.59.02.870 E020.25.35.190
N049.59.02.870 E020.25.35.190 N049.59.01.050 E020.25.12.730
N049.59.01.050 E020.25.12.730 N049.58.59.210 E020.24.50.300
N049.58.59.210 E020.24.50.300 N049.58.57.130 E020.24.30.940
N049.57.57.510 E020.27.54.540 KK529 KK29 stargray

MEBAN MEBAN EMKUX EMKUX
EMKUX EMKUX UVRET UVRET

-luk przy UVRET
UVRET UVRET N049.58.00.520 E019.46.37.530
N049.58.00.520 E019.46.37.530 N049.58.13.670 E019.46.44.810
N049.58.13.670 E019.46.44.810 N049.58.25.820 E019.46.49.420
N049.58.25.820 E019.46.49.420 N049.58.36.910 E019.46.56.470
N049.58.36.910 E019.46.56.470 N049.58.47.060 E019.47.03.100
N049.58.47.060 E019.47.03.100 N049.58.57.550 E019.47.13.070
N049.58.57.550 E019.47.13.070 N049.59.06.150 E019.47.24.060
N049.59.06.150 E019.47.24.060 N049.59.13.890 E019.47.39.440
N049.59.13.890 E019.47.39.440 N049.59.21.270 E019.47.57.880
N049.59.21.270 E019.47.57.880 N049.59.23.590 E019.48.12.650
N049.59.23.590 E019.48.12.650 N049.59.27.370 E019.48.34.450
N049.59.27.370 E019.48.34.450 N049.59.31.440 E019.49.07.020
N049.58.00.520 E019.46.37.530 KK521 KK521 stargray

KK521 KK521 KK519 KK519
KK519 KK519 KK518 KK518
KK518 KK518 KK517 KK517

PADKA PADKA KK526 KK526
KK526 KK526 KK524 KK524
KK524 KK524 KK521 KK521

;luk przy KK526
NETIR NETIR N049.56.01.420 E018.47.52.810
N049.56.01.420 E018.47.52.810 KK526 KK526 stargray
N049.56.01.420 E018.47.52.810 N049.56.14.120 E018.47.59.590
N049.56.14.120 E018.47.59.590 N049.56.26.910 E018.48.05.010
N049.56.26.910 E018.48.05.010 N049.56.39.190 E018.48.12.280
N049.56.39.190 E018.48.12.280 N049.56.50.500 E018.48.23.430
N049.56.50.500 E018.48.23.430 N049.57.00.480 E018.48.36.550
N049.57.00.480 E018.48.36.550 N049.57.08.730 E018.48.51.970
N049.57.08.730 E018.48.51.970 N049.57.15.030 E018.49.10.120
N049.57.15.030 E018.49.10.120 N049.57.19.220 E018.49.30.090
N049.57.19.220 E018.49.30.090 N049.57.20.490 E018.49.51.420


-EPGD 11	OGDAV OGDAV GD823 GD823
		GD823 GD823 UGNUR UGNUR
		UGNUR UGNUR GD822 GD822
		GD822 GD822 GD821 GD821
		GD821 GD821 GD803 GD803
		GD803 GD803 UVRIK UVRIK
		UVRIK UVRIK GD802 GD802
		GD802 GD802 GD801 GD801

		NIKMI NIKMI GD831 GD831
		GD831 GD831 GD822 GD822

		OSLOG OSLOG GD841 GD841
		GD841 GD841 EVNOB EVNOB
		EVNOB EVNOB GD809 GD809
		GD809 GD809 GD808 GD808
		GD808 GD808 GD807 GD807
		GD807 GD807 GD806 GD806
		GD806 GD806 GD804 GD804
		GD804 GD804 GD803 GD803

		IRLUN IRLUN GD841 GD841
		GD841 GD841 EVNOB EVNOB

		RATOR RATOR GD811 GD811
		GD811 GD811 EVNOB EVNOB

		KOSEX KOSEX GD811 GD811
		GD811 GD811 EVNOB EVNOB


-EPGD 29	OGDAV OGDAV GD926 GD926
		GD926 GD926 GD924 GD924
		GD924 GD924 GD923 GD923
		GD923 GD923 GD922 GD922
		GD922 GD922 GD921 GD921
		GD921 GD921 GD903 GD903
		GD903 GD903 IPLAM IPLAM
		IPLAM IPLAM GD902 GD902
		GD902 GD902 GD901 GD901

		NIKMI NIKMI GD903 GD903

		OSLOG OSLOG GD933 GD933
		GD933 GD933 GD932 GD932
		GD932 GD932 GD931 GD931
		GD931 GD931 GD909 GD909
		GD909 GD909 GD908 GD908
		GD908 GD908 GD907 GD907
		GD907 GD907 GD906 GD906
		GD906 GD906 GD904 GD904
		GD904 GD904 GD903 GD903

		IRLUN IRLUN GD933 GD933

		RATOR RATOR GD912 GD912
		GD912 GD912 GD911 GD911
		GD911 GD911 GD909 GD909

		KOSEX KOSEX GD912 GD912
		GD912 GD912 GD911 GD911
		GD911 GD911 GD909 GD909
		



-EPWA 11 N052.17.56.631 E020.49.02.313 N052.18.43.275 E020.46.17.204 
N052.41.42.855 E019.49.13.132 N052.35.25.151 E020.08.53.460 
N052.35.25.151 E020.08.53.460 N052.30.39.906 E020.23.34.772 
N052.09.33.026 E021.59.57.395 N052.02.56.634 E021.41.45.591 
N052.02.56.634 E021.41.45.591 N052.01.54.667 E021.36.59.362 
N052.01.54.667 E021.36.59.362 N051.58.15.323 E021.19.54.444 
N051.58.15.323 E021.19.54.444 N052.00.31.061 E021.11.58.378 
N052.00.31.061 E021.11.58.378 N052.08.00.567 E021.04.53.460 
N052.08.00.567 E021.04.53.460 N052.15.30.074 E020.57.45.591 
N052.15.30.074 E020.57.45.591 N052.17.56.631 E020.49.02.313 
N051.44.41.883 E021.41.09.198 N051.53.18.275 E021.27.40.673 
N051.53.18.275 E021.27.40.673 N051.58.15.323 E021.19.54.444 
N051.17.04.512 E020.41.38.706 N051.39.26.147 E020.57.34.772 
N051.39.26.147 E020.57.34.772 N051.49.50.735 E020.57.59.362 
N051.49.50.735 E020.57.59.362 N052.01.01.553 E020.58.25.919 
N052.01.01.553 E020.58.25.919 N052.07.24.174 E020.47.32.804 
N052.07.24.174 E020.47.32.804 N052.10.45.813 E020.35.24.936 
N052.10.45.813 E020.35.24.936 N052.12.25.156 E020.29.28.870 
N052.12.25.156 E020.29.28.870 N052.14.02.533 E020.23.33.788 
N052.14.02.533 E020.23.33.788 N052.14.50.688 E020.20.34.115 
N052.14.50.688 E020.20.34.115 N052.14.54.750 E020.20.20.470 
N052.14.54.750 E020.20.20.470 N052.14.58.942 E020.20.07.240 
N052.14.58.942 E020.20.07.240 N052.15.06.974 E020.19.47.435 
N052.15.06.974 E020.19.47.435 N052.15.13.179 E020.19.34.061 
N052.15.13.179 E020.19.34.061 N052.15.18.749 E020.19.25.315 
N052.15.18.749 E020.19.25.315 N052.15.29.443 E020.19.10.826 
N052.15.29.443 E020.19.10.826 N052.15.39.000 E020.19.00.166 
N052.15.39.000 E020.19.00.166 N052.15.47.770 E020.18.52.762 
N052.15.47.770 E020.18.52.762 N052.15.57.785 E020.18.45.965 
N052.15.57.785 E020.18.45.965 N052.16.06.612 E020.18.40.648 
N052.16.06.612 E020.18.40.648 N052.16.18.152 E020.18.36.830 
N052.16.18.152 E020.18.36.830 N052.16.32.023 E020.18.34.766 
N052.16.32.023 E020.18.34.766 N052.16.47.837 E020.18.35.184 
N052.16.47.837 E020.18.35.184 N052.16.56.823 E020.18.37.401 
N052.16.56.823 E020.18.37.401 N052.17.07.026 E020.18.41.777 
N052.17.07.026 E020.18.41.777 N052.17.17.044 E020.18.47.625 
N052.17.17.044 E020.18.47.625 N052.17.31.308 E020.18.56.527 
N052.17.31.308 E020.18.56.527 N052.17.41.574 E020.19.03.970 
N052.17.41.574 E020.19.03.970 N052.18.30.048 E020.19.39.127 
N052.18.30.048 E020.19.39.127 N052.18.39.038 E020.19.47.992 
N052.18.39.038 E020.19.47.992 N052.18.48.023 E020.19.57.437 
N052.18.48.023 E020.19.57.437 N052.18.54.953 E020.20.06.980 
N052.18.54.953 E020.20.06.980 N052.19.02.357 E020.20.18.455 
N052.19.02.357 E020.20.18.455 N052.19.09.501 E020.20.32.124 
N052.19.09.501 E020.20.32.124 N052.19.16.080 E020.20.46.626 
N052.19.16.080 E020.20.46.626 N052.19.21.691 E020.21.02.118 
N052.19.21.691 E020.21.02.118 N052.19.25.864 E020.21.17.408 
N052.19.25.864 E020.21.17.408 N052.19.29.721 E020.21.35.045 
N052.19.29.721 E020.21.35.045 N052.19.31.951 E020.21.48.407 
N052.19.31.951 E020.21.48.407 N052.19.33.920 E020.22.07.600 
N052.19.33.920 E020.22.07.600 N052.19.34.708 E020.22.22.523 
N052.19.34.708 E020.22.22.523 N052.19.34.771 E020.22.38.516 
N052.19.34.771 E020.22.38.516 N052.19.34.133 E020.22.53.641 
N052.19.34.133 E020.22.53.641 N052.19.31.890 E020.23.14.315 
N052.19.31.890 E020.23.14.315 N052.19.29.539 E020.23.28.290 
N052.19.29.539 E020.23.28.290 N052.19.23.523 E020.23.53.353 
N052.19.23.523 E020.23.53.353 N052.18.34.991 E020.26.51.493 
N051.34.52.705 E019.57.39.690 N051.34.26.148 E020.15.15.099 
N051.34.26.148 E020.15.15.099 N051.33.45.798 E020.38.33.388 
N051.33.45.798 E020.38.33.388 N051.33.45.327 E020.38.48.814 
N051.33.45.327 E020.38.48.814 N051.33.45.339 E020.39.12.492 
N051.33.45.339 E020.39.12.492 N051.33.46.023 E020.39.31.722 
N051.33.46.023 E020.39.31.722 N051.33.47.544 E020.39.50.388 
N051.33.47.544 E020.39.50.388 N051.33.50.059 E020.40.11.270 
N051.33.50.059 E020.40.11.270 N051.33.54.322 E020.40.36.620 
N051.33.54.322 E020.40.36.620 N051.34.01.126 E020.41.05.011 
N051.34.01.126 E020.41.05.011 N051.34.09.427 E020.41.30.744 
N051.34.09.427 E020.41.30.744 N051.34.19.612 E020.41.56.475 
N051.34.19.612 E020.41.56.475 N051.34.33.308 E020.42.23.932 
N051.34.33.308 E020.42.23.932 N051.34.46.197 E020.42.44.473 
N051.34.46.197 E020.42.44.473 N051.34.58.243 E020.43.00.232 
N051.34.58.243 E020.43.00.232 N051.35.06.393 E020.43.09.763 
N051.35.06.393 E020.43.09.763 N051.35.21.818 E020.43.26.283 
N051.35.21.818 E020.43.26.283 N051.40.19.262 E020.48.23.952 
N051.40.19.262 E020.48.23.952 N051.49.50.735 E020.57.59.362 
N052.22.28.105 E019.46.29.854 N052.27.51.711 E020.04.46.575 
N052.27.51.711 E020.04.46.575 N052.30.39.906 E020.23.34.772 
N052.30.39.906 E020.23.34.772 N052.29.56.629 E020.33.38.706 
N052.29.56.629 E020.33.38.706 N052.28.00.563 E020.40.43.624 
N052.28.00.563 E020.40.43.624 N052.26.18.268 E020.46.51.493 
N052.26.18.268 E020.46.51.493 N052.25.17.107 E020.50.30.997 
N052.25.17.107 E020.50.30.997 N052.25.05.690 E020.51.02.882 
N052.25.05.690 E020.51.02.882 N052.24.57.158 E020.51.22.296 
N052.24.57.158 E020.51.22.296 N052.24.46.130 E020.51.41.140 
N052.24.46.130 E020.51.41.140 N052.24.32.369 E020.51.59.445 
N052.24.32.369 E020.51.59.445 N052.24.19.812 E020.52.12.042 
N052.24.19.812 E020.52.12.042 N052.24.07.029 E020.52.22.059 
N052.24.07.029 E020.52.22.059 N052.23.51.111 E020.52.30.850 
N052.23.51.111 E020.52.30.850 N052.23.37.295 E020.52.35.620 
N052.23.37.295 E020.52.35.620 N052.23.24.165 E020.52.37.866 
N052.23.24.165 E020.52.37.866 N052.23.07.908 E020.52.37.661 
N052.23.07.908 E020.52.37.661 N052.22.54.023 E020.52.34.862 
N052.22.54.023 E020.52.34.862 N052.22.38.650 E020.52.28.821 
N052.22.38.650 E020.52.28.821 N052.22.28.042 E020.52.22.940 
N052.22.28.042 E020.52.22.940 N052.22.12.360 E020.52.11.327 
N052.22.12.360 E020.52.11.327 N052.19.39.409 E020.50.18.196 
N052.19.39.409 E020.50.18.196 N052.19.30.913 E020.50.10.079 
N052.19.30.913 E020.50.10.079 N052.19.22.586 E020.50.01.489 
N052.19.22.586 E020.50.01.489 N052.19.14.840 E020.49.51.428 
N052.19.14.840 E020.49.51.428 N052.19.07.022 E020.49.39.282 
N052.19.07.022 E020.49.39.282 N052.18.59.173 E020.49.25.007 
N052.18.59.173 E020.49.25.007 N052.18.52.819 E020.49.09.795 
N052.18.52.819 E020.49.09.795 N052.18.46.761 E020.48.52.779 
N052.18.46.761 E020.48.52.779 N052.18.42.261 E020.48.37.072 
N052.18.42.261 E020.48.37.072 N052.18.38.774 E020.48.18.637 
N052.18.38.774 E020.48.18.637 N052.18.36.043 E020.47.57.214 
N052.18.36.043 E020.47.57.214 N052.18.34.598 E020.47.33.762 
N052.18.34.598 E020.47.33.762 N052.18.34.864 E020.47.14.221 
N052.18.34.864 E020.47.14.221 N052.18.36.616 E020.46.53.204 
N052.18.36.616 E020.46.53.204 N052.18.39.549 E020.46.33.364 
N052.18.39.549 E020.46.33.364 N052.18.43.275 E020.46.17.204 
N052.18.43.275 E020.46.17.204 N052.18.48.452 E020.45.57.237 
N052.18.48.452 E020.45.57.237 N052.19.52.696 E020.42.07.231 
N052.19.52.696 E020.42.07.231 N052.21.31.056 E020.36.10.181 
N052.21.31.056 E020.36.10.181 N052.23.09.416 E020.30.13.132 
N052.23.09.416 E020.30.13.132 N052.23.16.247 E020.29.44.362 
N052.23.16.247 E020.29.44.362 N052.23.19.542 E020.29.18.685 
N052.23.19.542 E020.29.18.685 N052.23.20.720 E020.28.57.245 
N052.23.20.720 E020.28.57.245 N052.23.20.339 E020.28.33.966 
N052.23.20.339 E020.28.33.966 N052.23.18.488 E020.28.12.675 
N052.23.18.488 E020.28.12.675 N052.23.14.635 E020.27.50.391 
N052.23.14.635 E020.27.50.391 N052.23.10.123 E020.27.32.352 
N052.23.10.123 E020.27.32.352 N052.23.04.819 E020.27.15.871 
N052.23.04.819 E020.27.15.871 N052.22.58.300 E020.26.59.953 
N052.22.58.300 E020.26.59.953 N052.22.51.915 E020.26.47.306 
N052.22.51.915 E020.26.47.306 N052.22.46.304 E020.26.37.953 
N052.22.46.304 E020.26.37.953 N052.22.39.423 E020.26.27.465 
N052.22.39.423 E020.26.27.465 N052.22.30.778 E020.26.17.416 
N052.22.30.778 E020.26.17.416 N052.22.24.959 E020.26.11.243 
N052.22.24.959 E020.26.11.243 N052.22.15.227 E020.26.02.678 
N052.22.15.227 E020.26.02.678 N052.21.13.682 E020.25.17.527 
N052.21.13.682 E020.25.17.527 N052.21.04.608 E020.25.10.872 
N052.21.04.608 E020.25.10.872 N052.20.56.376 E020.25.06.182 
N052.20.56.376 E020.25.06.182 N052.20.46.909 E020.25.01.680 
N052.20.46.909 E020.25.01.680 N052.20.37.053 E020.24.58.588 
N052.20.37.053 E020.24.58.588 N052.20.24.828 E020.24.56.611 
N052.20.24.828 E020.24.56.611 N052.20.16.708 E020.24.57.107 
N052.20.16.708 E020.24.57.107 N052.20.05.377 E020.24.58.471 
N052.20.05.377 E020.24.58.471 N052.19.54.893 E020.25.01.744 
N052.19.54.893 E020.25.01.744 N052.19.45.513 E020.25.06.137 
N052.19.45.513 E020.25.06.137 N052.19.35.024 E020.25.12.328 
N052.19.35.024 E020.25.12.328 N052.19.26.343 E020.25.19.753 
N052.19.26.343 E020.25.19.753 N052.19.17.757 E020.25.27.545 
N052.19.17.757 E020.25.27.545 N052.19.10.548 E020.25.37.036 
N052.19.10.548 E020.25.37.036 N052.19.02.828 E020.25.47.200 
N052.19.02.828 E020.25.47.200 N052.18.58.583 E020.25.54.569 
N052.18.58.583 E020.25.54.569 N052.18.51.709 E020.26.07.673 
N052.18.51.709 E020.26.07.673 N052.18.45.410 E020.26.22.106 
N052.18.45.410 E020.26.22.106 N052.18.40.692 E020.26.35.580 
N052.18.40.692 E020.26.35.580 N052.18.34.991 E020.26.51.493 
N052.18.34.991 E020.26.51.493 N052.16.56.631 E020.32.48.542 
N052.16.56.631 E020.32.48.542 N052.15.19.255 E020.38.44.608 
N052.15.19.255 E020.38.44.608 N052.14.15.320 E020.42.36.739 
N052.14.15.320 E020.42.36.739 N052.13.37.943 E020.44.49.526 
N052.24.22.203 E020.53.47.559 N052.25.17.107 E020.50.30.997 stargray
N052.17.56.631 E020.49.02.313 N052.19.39.409 E020.50.18.196 stargray
N051.33.45.798 E020.38.33.388 N051.33.39.919 E020.41.44.608 stargray
N051.33.39.919 E020.41.44.608 N051.35.06.393 E020.43.09.763 stargray
N052.23.16.247 E020.29.44.362 N052.23.57.139 E020.27.17.528 stargray
N052.23.57.139 E020.27.17.528 N052.22.24.959 E020.26.11.243 stargray
N052.19.23.611 E020.23.56.873 N052.20.56.376 E020.25.06.182 stargray
N052.20.12.428 E020.20.53.460 N052.19.23.523 E020.23.53.353 stargray
N052.20.12.428 E020.20.53.460 N052.18.30.048 E020.19.39.127 stargray
N052.15.39.802 E020.17.35.755 N052.17.11.314 E020.18.44.280 stargray
N052.15.39.802 E020.17.35.755 N052.14.57.247 E020.20.12.589 stargray
N052.24.22.203 E020.53.47.559 N052.22.28.042 E020.52.22.940 stargray


                  
-EPWA 15 N052.15.26.557 E020.43.57.049 N052.18.05.902 E020.41.36.393 stargray

N052.10.59.997 E020.34.32.457 N052.09.45.246 E020.39.00.984 stargray
N052.09.45.246 E020.39.00.984 N052.12.27.676 E020.41.19.738 stargray

N052.15.26.557 E020.43.57.049 N052.13.46.847 E020.42.29.658 stargray

N052.26.59.091 E020.33.42.958 N052.28.37.377 E020.32.14.754 stargray
N052.28.37.377 E020.32.14.754 N052.29.25.290 E020.34.38.259 stargray

N052.30.03.535 E020.36.33.221 N052.31.00.984 E020.39.25.574 stargray
N052.31.00.984 E020.39.25.574 N052.29.20.514 E020.40.53.664 stargray

N052.27.29.508 E020.42.32.459 N052.28.24.376 E020.45.18.618 stargray

N052.28.54.717 E020.46.50.182 N052.29.52.131 E020.49.44.262 stargray
N052.29.52.131 E020.49.44.262 N052.28.05.838 E020.51.18.208 stargray

N052.10.29.508 E021.06.45.246 N052.08.27.541 E021.05.13.770 stargray

N051.33.49.300 E020.36.17.771 N051.33.39.344 E020.41.43.279 stargray
N051.33.39.344 E020.41.43.279 N051.36.03.296 E020.44.05.800 stargray

N051.58.14.754 E021.19.53.115 N051.59.15.215 E021.24.26.375 stargray

N051.58.14.754 E021.19.53.115 N052.01.04.005 E021.16.52.077

N052.22.27.541 E019.46.28.525 N052.15.34.426 E020.17.52.131
N052.15.34.426 E020.17.52.131 N052.13.56.066 E020.23.50.164
N052.13.56.066 E020.23.50.164 N052.12.24.590 E020.29.27.541
N052.12.24.590 E020.29.27.541 N052.11.06.342 E020.34.09.628
N052.11.06.342 E020.34.09.628 N052.10.57.646 E020.34.40.916
N052.10.57.646 E020.34.40.916 N052.10.51.615 E020.35.24.728
N052.10.51.615 E020.35.24.728 N052.10.48.331 E020.36.04.147
N052.10.48.331 E020.36.04.147 N052.10.47.898 E020.36.44.300
N052.10.47.898 E020.36.44.300 N052.10.50.391 E020.37.24.484
N052.10.50.391 E020.37.24.484 N052.10.56.531 E020.38.08.059
N052.10.56.531 E020.38.08.059 N052.11.07.881 E020.38.56.173
N052.11.07.881 E020.38.56.173 N052.11.21.425 E020.39.35.714
N052.11.21.425 E020.39.35.714 N052.11.38.951 E020.40.13.667
N052.11.38.951 E020.40.13.667 N052.12.00.065 E020.40.48.035
N052.12.00.065 E020.40.48.035 N052.12.10.436 E020.41.01.751
N052.12.10.436 E020.41.01.751 N052.12.38.803 E020.41.31.350
N052.12.38.803 E020.41.31.350 N052.13.36.021 E020.42.21.005
N052.13.36.021 E020.42.21.005 N052.13.54.011 E020.42.35.385
N052.13.54.011 E020.42.35.385 N052.14.11.340 E020.42.46.410
N052.14.11.340 E020.42.46.410 N052.14.31.204 E020.42.55.939
N052.14.31.204 E020.42.55.939 N052.14.53.056 E020.43.02.872
N052.14.53.056 E020.43.02.872 N052.15.14.413 E020.43.06.246
N052.15.14.413 E020.43.06.246 N052.15.39.241 E020.43.06.057
N052.15.39.241 E020.43.06.057 N052.16.00.199 E020.43.02.451
N052.16.00.199 E020.43.02.451 N052.16.20.404 E020.42.55.897
N052.16.20.404 E020.42.55.897 N052.16.38.175 E020.42.47.501
N052.16.38.175 E020.42.47.501 N052.16.52.946 E020.42.38.516
N052.16.52.946 E020.42.38.516 N052.17.17.648 E020.42.19.021
N052.17.17.648 E020.42.19.021 N052.18.05.902 E020.41.36.393
N052.18.05.902 E020.41.36.393 N052.21.36.393 E020.38.29.508
N052.21.36.393 E020.38.29.508 N052.25.07.869 E020.35.22.623
N052.25.07.869 E020.35.22.623 N052.26.59.091 E020.33.42.958
N052.26.59.091 E020.33.42.958 N052.27.13.420 E020.33.32.180
N052.27.13.420 E020.33.32.180 N052.27.29.233 E020.33.24.548
N052.27.29.233 E020.33.24.548 N052.27.44.161 E020.33.20.964
N052.27.44.161 E020.33.20.964 N052.27.59.521 E020.33.20.723
N052.27.59.521 E020.33.20.723 N052.28.12.719 E020.33.23.294
N052.28.12.719 E020.33.23.294 N052.28.27.690 E020.33.29.471
N052.28.27.690 E020.33.29.471 N052.28.40.396 E020.33.37.707
N052.28.40.396 E020.33.37.707 N052.28.54.350 E020.33.50.472
N052.28.54.350 E020.33.50.472 N052.29.07.517 E020.34.07.041
N052.29.07.517 E020.34.07.041 N052.29.16.336 E020.34.21.479
N052.29.16.336 E020.34.21.479 N052.29.25.290 E020.34.38.259
N052.29.25.290 E020.34.38.259 N052.29.34.037 E020.35.04.484
N052.29.34.037 E020.35.04.484 N052.29.54.955 E020.36.07.228
N052.29.54.955 E020.36.07.228 N052.30.03.535 E020.36.33.221
N052.30.03.535 E020.36.33.221 N052.30.08.253 E020.36.50.589
N052.30.08.253 E020.36.50.589 N052.30.11.471 E020.37.05.904
N052.30.11.471 E020.37.05.904 N052.30.13.922 E020.37.21.517
N052.30.13.922 E020.37.21.517 N052.30.15.847 E020.37.40.556
N052.30.15.847 E020.37.40.556 N052.30.16.608 E020.37.57.021
N052.30.16.608 E020.37.57.021 N052.30.16.396 E020.38.17.847
N052.30.16.396 E020.38.17.847 N052.30.15.204 E020.38.35.286
N052.30.15.204 E020.38.35.286 N052.30.12.859 E020.38.54.025
N052.30.12.859 E020.38.54.025 N052.30.09.482 E020.39.12.146
N052.30.09.482 E020.39.12.146 N052.30.03.854 E020.39.33.861
N052.30.03.854 E020.39.33.861 N052.29.57.171 E020.39.53.213
N052.29.57.171 E020.39.53.213 N052.29.49.609 E020.40.10.479
N052.29.49.609 E020.40.10.479 N052.29.41.515 E020.40.25.463
N052.29.41.515 E020.40.25.463 N052.29.34.999 E020.40.35.617
N052.29.34.999 E020.40.35.617 N052.29.27.622 E020.40.45.498
N052.29.27.622 E020.40.45.498 N052.29.20.514 E020.40.53.664
N052.29.20.514 E020.40.53.664 N052.29.06.417 E020.41.06.889
N052.29.06.417 E020.41.06.889 N052.27.29.508 E020.42.32.459
N052.27.29.508 E020.42.32.459 N052.23.58.033 E020.45.19.672
N052.23.58.033 E020.45.19.672 N052.20.27.541 E020.48.45.246
N052.20.27.541 E020.48.45.246 N052.18.28.525 E020.51.42.295
N052.18.28.525 E020.51.42.295 N052.17.05.902 E020.52.40.328

N052.28.54.717 E020.46.50.182 N052.28.55.655 E020.46.52.846
N052.28.55.655 E020.46.52.846 N052.28.56.566 E020.46.55.521
N052.28.56.566 E020.46.55.521 N052.28.57.449 E020.46.58.204
N052.28.57.449 E020.46.58.204 N052.28.58.303 E020.47.00.897
N052.28.58.303 E020.47.00.897 N052.28.59.130 E020.47.03.598
N052.28.59.130 E020.47.03.598 N052.28.59.929 E020.47.06.308
N052.28.59.929 E020.47.06.308 N052.29.00.700 E020.47.09.026
N052.29.00.700 E020.47.09.026 N052.29.01.442 E020.47.11.752
N052.29.01.442 E020.47.11.752 N052.29.02.156 E020.47.14.485
N052.29.02.156 E020.47.14.485 N052.29.02.842 E020.47.17.226
N052.29.02.842 E020.47.17.226 N052.29.03.499 E020.47.19.973
N052.29.03.499 E020.47.19.973 N052.29.04.127 E020.47.22.727
N052.29.04.127 E020.47.22.727 N052.29.04.727 E020.47.25.488
N052.29.04.727 E020.47.25.488 N052.29.05.299 E020.47.28.255
N052.29.05.299 E020.47.28.255 N052.29.05.841 E020.47.31.027
N052.29.05.841 E020.47.31.027 N052.29.06.355 E020.47.33.805
N052.29.06.355 E020.47.33.805 N052.29.06.840 E020.47.36.588
N052.29.06.840 E020.47.36.588 N052.29.07.296 E020.47.39.376
N052.29.07.296 E020.47.39.376 N052.29.07.723 E020.47.42.169
N052.29.07.723 E020.47.42.169 N052.29.08.121 E020.47.44.966
N052.29.08.121 E020.47.44.966 N052.29.08.490 E020.47.47.767
N052.29.08.490 E020.47.47.767 N052.29.08.829 E020.47.50.571
N052.29.08.829 E020.47.50.571 N052.29.09.140 E020.47.53.379
N052.29.09.140 E020.47.53.379 N052.29.09.422 E020.47.56.190
N052.29.09.422 E020.47.56.190 N052.29.09.674 E020.47.59.004
N052.29.09.674 E020.47.59.004 N052.29.09.897 E020.48.01.820
N052.29.09.897 E020.48.01.820 N052.29.10.091 E020.48.04.639
N052.29.10.091 E020.48.04.639 N052.29.10.256 E020.48.07.459
N052.29.10.256 E020.48.07.459 N052.29.10.391 E020.48.10.281
N052.29.10.391 E020.48.10.281 N052.29.10.497 E020.48.13.104
N052.29.10.497 E020.48.13.104 N052.29.10.574 E020.48.15.928
N052.29.10.574 E020.48.15.928 N052.29.10.622 E020.48.18.752
N052.29.10.622 E020.48.18.752 N052.29.10.640 E020.48.21.577
N052.29.10.640 E020.48.21.577 N052.29.10.629 E020.48.24.402
N052.29.10.629 E020.48.24.402 N052.29.10.588 E020.48.27.227
N052.29.10.588 E020.48.27.227 N052.29.10.518 E020.48.30.051
N052.29.10.518 E020.48.30.051 N052.29.10.419 E020.48.32.875
N052.29.10.419 E020.48.32.875 N052.29.10.291 E020.48.35.697
N052.29.10.291 E020.48.35.697 N052.29.10.133 E020.48.38.517
N052.29.10.133 E020.48.38.517 N052.29.09.946 E020.48.41.336
N052.29.09.946 E020.48.41.336 N052.29.09.730 E020.48.44.153
N052.29.09.730 E020.48.44.153 N052.29.09.485 E020.48.46.967
N052.29.09.485 E020.48.46.967 N052.29.09.210 E020.48.49.779
N052.29.09.210 E020.48.49.779 N052.29.08.906 E020.48.52.588
N052.29.08.906 E020.48.52.588 N052.29.08.573 E020.48.55.393
N052.29.08.573 E020.48.55.393 N052.29.08.211 E020.48.58.195
N052.29.08.211 E020.48.58.195 N052.29.07.820 E020.49.00.993
N052.29.07.820 E020.49.00.993 N052.29.07.400 E020.49.03.787
N052.29.07.400 E020.49.03.787 N052.29.06.951 E020.49.06.576
N052.29.06.951 E020.49.06.576 N052.29.06.473 E020.49.09.360
N052.29.06.473 E020.49.09.360 N052.29.05.966 E020.49.12.139
N052.29.05.966 E020.49.12.139 N052.29.05.431 E020.49.14.913
N052.29.05.431 E020.49.14.913 N052.29.04.866 E020.49.17.681
N052.29.04.866 E020.49.17.681 N052.29.04.273 E020.49.20.443
N052.29.04.273 E020.49.20.443 N052.29.03.651 E020.49.23.199
N052.29.03.651 E020.49.23.199 N052.29.03.001 E020.49.25.948
N052.29.03.001 E020.49.25.948 N052.29.02.322 E020.49.28.691
N052.29.02.322 E020.49.28.691 N052.29.01.615 E020.49.31.426
N052.29.01.615 E020.49.31.426 N052.29.00.879 E020.49.34.153
N052.29.00.879 E020.49.34.153 N052.29.00.116 E020.49.36.873
N052.29.00.116 E020.49.36.873 N052.28.59.324 E020.49.39.585
N052.28.59.324 E020.49.39.585 N052.28.58.503 E020.49.42.288
N052.28.58.503 E020.49.42.288 N052.28.57.655 E020.49.44.983
N052.28.57.655 E020.49.44.983 N052.28.56.779 E020.49.47.669
N052.28.56.779 E020.49.47.669 N052.28.55.875 E020.49.50.345
N052.28.55.875 E020.49.50.345 N052.28.54.944 E020.49.53.012
N052.28.54.944 E020.49.53.012 N052.28.53.984 E020.49.55.670
N052.28.53.984 E020.49.55.670 N052.28.52.998 E020.49.58.317
N052.28.52.998 E020.49.58.317 N052.28.51.983 E020.50.00.953
N052.28.51.983 E020.50.00.953 N052.28.50.942 E020.50.03.579
N052.28.50.942 E020.50.03.579 N052.28.49.873 E020.50.06.195
N052.28.49.873 E020.50.06.195 N052.28.48.777 E020.50.08.798
N052.28.48.777 E020.50.08.798 N052.28.47.655 E020.50.11.391
N052.28.47.655 E020.50.11.391 N052.28.46.505 E020.50.13.971
N052.28.46.505 E020.50.13.971 N052.28.45.329 E020.50.16.540
N052.28.45.329 E020.50.16.540 N052.28.44.126 E020.50.19.096
N052.28.44.126 E020.50.19.096 N052.28.42.896 E020.50.21.640
N052.28.42.896 E020.50.21.640 N052.28.41.641 E020.50.24.170
N052.28.41.641 E020.50.24.170 N052.28.40.359 E020.50.26.688
N052.28.40.359 E020.50.26.688 N052.28.39.051 E020.50.29.192
N052.28.39.051 E020.50.29.192 N052.28.37.717 E020.50.31.682
N052.28.37.717 E020.50.31.682 N052.28.36.357 E020.50.34.158
N052.28.36.357 E020.50.34.158 N052.28.34.972 E020.50.36.620
N052.28.34.972 E020.50.36.620 N052.28.33.561 E020.50.39.068
N052.28.33.561 E020.50.39.068 N052.28.32.125 E020.50.41.501
N052.28.32.125 E020.50.41.501 N052.28.30.664 E020.50.43.919
N052.28.30.664 E020.50.43.919 N052.28.29.178 E020.50.46.321
N052.28.29.178 E020.50.46.321 N052.28.27.666 E020.50.48.708
N052.28.27.666 E020.50.48.708 N052.28.26.131 E020.50.51.079
N052.28.26.131 E020.50.51.079 N052.28.24.570 E020.50.53.434
N052.28.24.570 E020.50.53.434 N052.28.22.985 E020.50.55.773
N052.28.22.985 E020.50.55.773 N052.28.21.377 E020.50.58.095
N052.28.21.377 E020.50.58.095 N052.28.19.744 E020.51.00.400
N052.28.19.744 E020.51.00.400 N052.28.18.087 E020.51.02.689
N052.28.18.087 E020.51.02.689 N052.28.16.407 E020.51.04.960
N052.28.16.407 E020.51.04.960 N052.28.14.703 E020.51.07.213
N052.28.14.703 E020.51.07.213 N052.28.12.975 E020.51.09.449
N052.28.12.975 E020.51.09.449 N052.28.11.225 E020.51.11.666
N052.28.11.225 E020.51.11.666 N052.28.09.452 E020.51.13.865
N052.28.09.452 E020.51.13.865 N052.28.07.656 E020.51.16.046
N052.28.07.656 E020.51.16.046 N052.28.05.838 E020.51.18.208

N051.34.52.131 E019.57.38.361 N051.34.25.574 E020.15.13.770
N051.34.25.574 E020.15.13.770 N051.33.49.300 E020.36.17.771
N051.33.49.300 E020.36.17.771 N051.33.48.283 E020.37.14.393
N051.33.48.283 E020.37.14.393 N051.33.49.665 E020.37.54.106
N051.33.49.665 E020.37.54.106 N051.33.52.247 E020.38.26.745
N051.33.52.247 E020.38.26.745 N051.33.57.563 E020.39.08.861
N051.33.57.563 E020.39.08.861 N051.34.03.915 E020.39.44.632
N051.34.03.915 E020.39.44.632 N051.34.14.673 E020.40.30.357
N051.34.14.673 E020.40.30.357 N051.34.23.933 E020.41.01.752
N051.34.23.933 E020.41.01.752 N051.34.36.653 E020.41.37.749
N051.34.36.653 E020.41.37.749 N051.34.49.008 E020.42.07.332
N051.34.49.008 E020.42.07.332 N051.35.01.293 E020.42.32.929
N051.35.01.293 E020.42.32.929 N051.35.14.713 E020.42.57.521
N051.35.14.713 E020.42.57.521 N051.35.30.177 E020.43.22.359
N051.35.30.177 E020.43.22.359 N051.35.49.802 E020.43.49.511
N051.35.49.802 E020.43.49.511 N051.36.03.296 E020.44.05.800
N051.36.03.296 E020.44.05.800 N051.36.24.638 E020.44.28.286
N051.36.24.638 E020.44.28.286 N051.40.18.689 E020.48.22.623
N051.40.18.689 E020.48.22.623 N051.49.50.164 E020.57.58.033

N051.17.03.934 E020.41.37.377 N051.39.25.574 E020.57.33.443
N051.39.25.574 E020.57.33.443 N051.49.50.164 E020.57.58.033
N051.49.50.164 E020.57.58.033 N051.59.01.967 E020.58.19.672
N051.59.01.967 E020.58.19.672 N052.08.28.078 E021.05.15.599
N052.08.28.078 E021.05.15.599 N052.08.50.869 E021.05.31.359
N052.08.50.869 E021.05.31.359 N052.09.12.950 E021.05.42.955
N052.09.12.950 E021.05.42.955 N052.09.33.561 E021.05.50.639
N052.09.33.561 E021.05.50.639 N052.09.52.607 E021.05.55.195
N052.09.52.607 E021.05.55.195 N052.10.12.338 E021.05.57.427
N052.10.12.338 E021.05.57.427 N052.10.29.346 E021.05.57.350
N052.10.29.346 E021.05.57.350 N052.10.49.001 E021.05.54.951
N052.10.49.001 E021.05.54.951 N052.11.08.401 E021.05.50.110
N052.11.08.401 E021.05.50.110 N052.11.24.938 E021.05.43.979
N052.11.24.938 E021.05.43.979 N052.11.43.916 E021.05.34.550
N052.11.43.916 E021.05.34.550 N052.11.56.588 E021.05.26.741
N052.11.56.588 E021.05.26.741 N052.12.31.571 E021.04.58.643
N052.12.31.571 E021.04.58.643 N052.12.43.446 E021.04.48.262

N051.44.41.311 E021.41.07.869 N051.53.17.705 E021.27.39.344
N051.53.17.705 E021.27.39.344 N051.58.14.754 E021.19.53.115

N052.09.32.361 E021.59.56.059 N052.02.55.968 E021.41.44.256
N052.02.55.968 E021.41.44.256 N052.01.54.001 E021.36.58.027
N052.01.54.001 E021.36.58.027 N051.59.27.153 E021.25.30.262
N051.59.27.153 E021.25.30.262 N051.59.12.636 E021.24.12.583
N051.59.12.636 E021.24.12.583 N051.59.09.112 E021.23.39.242
N051.59.09.112 E021.23.39.242 N051.59.07.241 E021.23.05.420
N051.59.07.241 E021.23.05.420 N051.59.07.073 E021.22.30.477
N051.59.07.073 E021.22.30.477 N051.59.09.386 E021.21.46.780
N051.59.09.386 E021.21.46.780 N051.59.14.697 E021.21.02.306
N051.59.14.697 E021.21.02.306 N051.59.24.020 E021.20.14.234
N051.59.24.020 E021.20.14.234 N051.59.34.351 E021.19.36.079
N051.59.34.351 E021.19.36.079 N051.59.46.225 E021.19.01.637
N051.59.46.225 E021.19.01.637 N051.59.58.009 E021.18.33.510
N051.59.58.009 E021.18.33.510 N052.00.12.034 E021.18.05.372
N052.00.12.034 E021.18.05.372 N052.00.28.239 E021.17.38.127
N052.00.28.239 E021.17.38.127 N052.00.44.811 E021.17.14.720
N052.00.44.811 E021.17.14.720 N052.01.04.005 E021.16.52.077
N052.01.04.005 E021.16.52.077 N052.01.16.406 E021.16.38.804
N052.01.16.406 E021.16.38.804 N052.04.03.837 E021.13.39.339
N052.04.03.837 E021.13.39.339 N052.10.29.411 E021.06.45.241
N052.10.29.411 E021.06.45.241 N052.22.50.066 E020.55.56.061
N052.22.50.066 E020.55.56.061 N052.26.21.542 E020.52.50.160
N052.26.21.542 E020.52.50.160 N052.28.03.190 E020.51.20.456
N052.28.03.190 E020.51.20.456 N052.28.13.675 E020.51.10.649
N052.28.13.675 E020.51.10.649 N052.28.20.060 E020.51.03.463
N052.28.20.060 E020.51.03.463 N052.28.26.019 E020.50.55.802
N052.28.26.019 E020.50.55.802 N052.28.33.558 E020.50.44.547
N052.28.33.558 E020.50.44.547 N052.28.40.773 E020.50.31.742
N052.28.40.773 E020.50.31.742 N052.28.46.537 E020.50.19.634
N052.28.46.537 E020.50.19.634 N052.28.51.987 E020.50.06.082
N052.28.51.987 E020.50.06.082 N052.28.57.162 E020.49.50.428
N052.28.57.162 E020.49.50.428 N052.29.01.882 E020.49.32.202
N052.29.01.882 E020.49.32.202 N052.29.05.678 E020.49.11.918
N052.29.05.678 E020.49.11.918 N052.29.07.857 E020.48.54.107
N052.29.07.857 E020.48.54.107 N052.29.09.070 E020.48.34.844
N052.29.09.070 E020.48.34.844 N052.29.09.096 E020.48.14.433
N052.29.09.096 E020.48.14.433 N052.29.07.845 E020.47.54.198
N052.29.07.845 E020.47.54.198 N052.29.06.055 E020.47.39.064
N052.29.06.055 E020.47.39.064 N052.29.03.019 E020.47.21.540
N052.29.03.019 E020.47.21.540 N052.28.59.467 E020.47.06.266
N052.28.59.467 E020.47.06.266 N052.28.52.949 E020.46.45.117
N052.28.52.949 E020.46.45.117 N052.28.24.376 E020.45.18.618
N052.28.24.376 E020.45.18.618 N052.28.14.810 E020.44.54.154
N052.28.14.810 E020.44.54.154 N052.28.04.167 E020.44.33.906
N052.28.04.167 E020.44.33.906 N052.27.53.795 E020.44.18.563
N052.27.53.795 E020.44.18.563 N052.27.44.133 E020.44.07.093
N052.27.44.133 E020.44.07.093 N052.27.32.863 E020.43.56.428
N052.27.32.863 E020.43.56.428 N052.27.22.332 E020.43.48.680
N052.27.22.332 E020.43.48.680 N052.27.11.160 E020.43.42.502
N052.27.11.160 E020.43.42.502 N052.26.59.474 E020.43.38.078
N052.26.59.474 E020.43.38.078 N052.26.46.493 E020.43.35.440
N052.26.46.493 E020.43.35.440 N052.26.33.238 E020.43.35.124
N052.26.33.238 E020.43.35.124 N052.26.20.901 E020.43.36.979
N052.26.20.901 E020.43.36.979 N052.26.08.015 E020.43.41.192
N052.26.08.015 E020.43.41.192 N052.25.58.000 E020.43.46.170
N052.25.58.000 E020.43.46.170 N052.25.39.419 E020.43.59.486
N052.25.39.419 E020.43.59.486 N052.25.37.043 E020.44.01.365

N052.41.42.295 E019.49.11.803 N052.15.34.426 E020.17.52.131

N052.08.34.847 E021.05.20.592 N052.08.36.773 E021.05.22.101
N052.08.36.773 E021.05.22.101 N052.08.38.721 E021.05.23.581
N052.08.38.721 E021.05.23.581 N052.08.40.689 E021.05.25.034
N052.08.40.689 E021.05.25.034 N052.08.42.678 E021.05.26.458
N052.08.42.678 E021.05.26.458 N052.08.44.688 E021.05.27.853
N052.08.44.688 E021.05.27.853 N052.08.46.717 E021.05.29.220
N052.08.46.717 E021.05.29.220 N052.08.48.765 E021.05.30.557
N052.08.48.765 E021.05.30.557 N052.08.50.833 E021.05.31.864
N052.08.50.833 E021.05.31.864 N052.08.52.919 E021.05.33.142
N052.08.52.919 E021.05.33.142 N052.08.55.024 E021.05.34.389
N052.08.55.024 E021.05.34.389 N052.08.57.146 E021.05.35.606
N052.08.57.146 E021.05.35.606 N052.08.59.285 E021.05.36.793
N052.08.59.285 E021.05.36.793 N052.09.01.441 E021.05.37.948
N052.09.01.441 E021.05.37.948 N052.09.03.614 E021.05.39.073
N052.09.03.614 E021.05.39.073 N052.09.05.802 E021.05.40.166
N052.09.05.802 E021.05.40.166 N052.09.08.006 E021.05.41.228
N052.09.08.006 E021.05.41.228 N052.09.10.225 E021.05.42.258
N052.09.10.225 E021.05.42.258 N052.09.12.458 E021.05.43.256
N052.09.12.458 E021.05.43.256 N052.09.14.706 E021.05.44.221
N052.09.14.706 E021.05.44.221 N052.09.16.967 E021.05.45.155
N052.09.16.967 E021.05.45.155 N052.09.19.242 E021.05.46.055
N052.09.19.242 E021.05.46.055 N052.09.21.529 E021.05.46.923
N052.09.21.529 E021.05.46.923 N052.09.23.828 E021.05.47.759
N052.09.23.828 E021.05.47.759 N052.09.26.140 E021.05.48.560
N052.09.26.140 E021.05.48.560 N052.09.28.462 E021.05.49.329
N052.09.28.462 E021.05.49.329 N052.09.30.795 E021.05.50.064
N052.09.30.795 E021.05.50.064 N052.09.33.139 E021.05.50.766
N052.09.33.139 E021.05.50.766 N052.09.35.492 E021.05.51.434
N052.09.35.492 E021.05.51.434 N052.09.37.855 E021.05.52.068
N052.09.37.855 E021.05.52.068 N052.09.40.226 E021.05.52.668
N052.09.40.226 E021.05.52.668 N052.09.42.606 E021.05.53.233
N052.09.42.606 E021.05.53.233 N052.09.44.994 E021.05.53.765
N052.09.44.994 E021.05.53.765 N052.09.47.390 E021.05.54.262
N052.09.47.390 E021.05.54.262 N052.09.49.792 E021.05.54.725
N052.09.49.792 E021.05.54.725 N052.09.52.200 E021.05.55.153
N052.09.52.200 E021.05.55.153 N052.09.54.615 E021.05.55.547
N052.09.54.615 E021.05.55.547 N052.09.57.035 E021.05.55.905
N052.09.57.035 E021.05.55.905 N052.09.59.459 E021.05.56.229
N052.09.59.459 E021.05.56.229 N052.10.01.889 E021.05.56.518
N052.10.01.889 E021.05.56.518 N052.10.04.322 E021.05.56.773
N052.10.04.322 E021.05.56.773 N052.10.06.758 E021.05.56.992
N052.10.06.758 E021.05.56.992 N052.10.09.197 E021.05.57.176
N052.10.09.197 E021.05.57.176 N052.10.11.639 E021.05.57.325
N052.10.11.639 E021.05.57.325 N052.10.14.083 E021.05.57.439
N052.10.14.083 E021.05.57.439 N052.10.16.528 E021.05.57.518
N052.10.16.528 E021.05.57.518 N052.10.18.974 E021.05.57.562
N052.10.18.974 E021.05.57.562 N052.10.21.420 E021.05.57.570
N052.10.21.420 E021.05.57.570 N052.10.23.866 E021.05.57.544
N052.10.23.866 E021.05.57.544 N052.10.26.312 E021.05.57.482
N052.10.26.312 E021.05.57.482 N052.10.28.756 E021.05.57.385
N052.10.28.756 E021.05.57.385 N052.10.31.199 E021.05.57.254
N052.10.31.199 E021.05.57.254 N052.10.33.640 E021.05.57.087
N052.10.33.640 E021.05.57.087 N052.10.36.078 E021.05.56.884
N052.10.36.078 E021.05.56.884 N052.10.38.512 E021.05.56.647
N052.10.38.512 E021.05.56.647 N052.10.40.944 E021.05.56.375
N052.10.40.944 E021.05.56.375 N052.10.43.371 E021.05.56.069
N052.10.43.371 E021.05.56.069 N052.10.45.793 E021.05.55.727
N052.10.45.793 E021.05.55.727 N052.10.48.210 E021.05.55.350
N052.10.48.210 E021.05.55.350 N052.10.50.622 E021.05.54.939
N052.10.50.622 E021.05.54.939 N052.10.53.027 E021.05.54.493
N052.10.53.027 E021.05.54.493 N052.10.55.426 E021.05.54.013
N052.10.55.426 E021.05.54.013 N052.10.57.817 E021.05.53.498
N052.10.57.817 E021.05.53.498 N052.11.00.201 E021.05.52.949
N052.11.00.201 E021.05.52.949 N052.11.02.577 E021.05.52.366
N052.11.02.577 E021.05.52.366 N052.11.04.944 E021.05.51.749
N052.11.04.944 E021.05.51.749 N052.11.07.302 E021.05.51.097
N052.11.07.302 E021.05.51.097 N052.11.09.650 E021.05.50.412
N052.11.09.650 E021.05.50.412 N052.11.11.989 E021.05.49.694
N052.11.11.989 E021.05.49.694 N052.11.14.317 E021.05.48.941
N052.11.14.317 E021.05.48.941 N052.11.16.633 E021.05.48.156
N052.11.16.633 E021.05.48.156 N052.11.18.939 E021.05.47.337
N052.11.18.939 E021.05.47.337 N052.11.21.232 E021.05.46.485
N052.11.21.232 E021.05.46.485 N052.11.23.513 E021.05.45.600
N052.11.23.513 E021.05.45.600 N052.11.25.780 E021.05.44.683
N052.11.25.780 E021.05.44.683 N052.11.28.035 E021.05.43.733
N052.11.28.035 E021.05.43.733 N052.11.30.275 E021.05.42.751
N052.11.30.275 E021.05.42.751 N052.11.32.501 E021.05.41.737
N052.11.32.501 E021.05.41.737 N052.11.34.713 E021.05.40.691
N052.11.34.713 E021.05.40.691 N052.11.36.909 E021.05.39.613
N052.11.36.909 E021.05.39.613 N052.11.39.089 E021.05.38.504
N052.11.39.089 E021.05.38.504 N052.11.41.253 E021.05.37.363
N052.11.41.253 E021.05.37.363 N052.11.43.401 E021.05.36.192
N052.11.43.401 E021.05.36.192 N052.11.45.532 E021.05.34.990
N052.11.45.532 E021.05.34.990 N052.11.47.645 E021.05.33.757
N052.11.47.645 E021.05.33.757 N052.11.49.740 E021.05.32.494
N052.11.49.740 E021.05.32.494 N052.11.51.817 E021.05.31.201
N052.11.51.817 E021.05.31.201 N052.11.53.875 E021.05.29.879
N052.11.53.875 E021.05.29.879 N052.11.55.913 E021.05.28.527
N052.11.55.913 E021.05.28.527 N052.11.57.933 E021.05.27.146
N052.11.57.933 E021.05.27.146 N052.11.59.932 E021.05.25.736
N052.11.59.932 E021.05.25.736 N052.12.01.910 E021.05.24.297
N052.12.01.910 E021.05.24.297 N052.12.03.868 E021.05.22.830
N052.12.03.868 E021.05.22.830 N052.12.05.804 E021.05.21.335
N052.12.05.804 E021.05.21.335 N052.12.07.719 E021.05.19.813
N052.12.07.719 E021.05.19.813 N052.12.09.612 E021.05.18.263
N052.12.09.612 E021.05.18.263 N052.12.11.482 E021.05.16.686
N052.12.11.482 E021.05.16.686 N052.12.13.330 E021.05.15.083
N052.12.13.330 E021.05.15.083 N052.12.15.154 E021.05.13.453
N052.12.15.154 E021.05.13.453 N052.12.16.954 E021.05.11.797
N052.12.16.954 E021.05.11.797 N052.12.18.731 E021.05.10.115
N052.12.18.731 E021.05.10.115 N052.12.20.483 E021.05.08.408


-EPWA 29 N052.41.42.295 E019.49.11.803 N052.26.01.967 E020.34.18.689
N052.26.01.967 E020.34.18.689 N052.22.42.295 E020.43.39.344
N052.22.42.295 E020.43.39.344 N052.17.31.475 E020.58.12.787
N052.17.31.475 E020.58.12.787 N052.16.15.738 E021.01.43.279
N052.16.15.738 E021.01.43.279 N052.13.46.230 E021.03.52.131
N052.13.46.230 E021.03.52.131 N052.09.39.344 E021.18.26.557
N052.09.39.344 E021.18.26.557 N052.09.03.934 E021.20.35.410
N052.09.03.934 E021.20.35.410 N052.07.60.000 E021.24.19.672
N052.07.60.000 E021.24.19.672 N052.07.11.008 E021.27.10.612
N052.07.11.008 E021.27.10.612 N052.07.05.679 E021.27.26.016
N052.07.05.679 E021.27.26.016 N052.06.59.041 E021.27.42.948
N052.06.59.041 E021.27.42.948 N052.06.51.019 E021.27.59.570
N052.06.51.019 E021.27.59.570 N052.06.40.672 E021.28.16.190
N052.06.40.672 E021.28.16.190 N052.06.29.319 E021.28.30.497
N052.06.29.319 E021.28.30.497 N052.06.18.230 E021.28.41.511
N052.06.18.230 E021.28.41.511 N052.06.00.777 E021.28.54.447
N052.06.00.777 E021.28.54.447 N052.05.48.969 E021.29.00.440
N052.05.48.969 E021.29.00.440 N052.05.36.007 E021.29.04.742
N052.05.36.007 E021.29.04.742 N052.05.20.082 E021.29.06.560
N052.05.20.082 E021.29.06.560 N052.05.07.992 E021.29.05.745
N052.05.07.992 E021.29.05.745 N052.04.56.085 E021.29.03.460
N052.04.56.085 E021.29.03.460 N052.04.40.731 E021.28.56.399
N052.04.40.731 E021.28.56.399 N052.04.26.406 E021.28.48.277
N052.04.26.406 E021.28.48.277 N052.03.31.974 E021.28.07.230
N052.03.31.974 E021.28.07.230 N052.03.17.325 E021.27.52.719
N052.03.17.325 E021.27.52.719 N052.03.04.060 E021.27.35.111
N052.03.04.060 E021.27.35.111 N052.02.55.424 E021.27.20.835
N052.02.55.424 E021.27.20.835 N052.02.48.574 E021.27.06.888
N052.02.48.574 E021.27.06.888 N052.02.40.828 E021.26.47.171
N052.02.40.828 E021.26.47.171 N052.02.32.370 E021.26.16.802
N052.02.32.370 E021.26.16.802 N052.02.27.670 E021.25.47.750
N052.02.27.670 E021.25.47.750 N052.02.25.381 E021.25.14.065
N052.02.25.381 E021.25.14.065 N052.02.26.258 E021.24.49.789
N052.02.26.258 E021.24.49.789 N052.02.29.730 E021.24.19.310
N052.02.29.730 E021.24.19.310 N052.02.35.435 E021.23.53.112
N052.02.35.435 E021.23.53.112 N052.02.40.224 E021.23.36.304
N052.02.40.224 E021.23.36.304 N052.03.26.557 E021.20.55.082

N052.09.32.459 E021.59.56.066 N052.12.06.426 E021.54.22.070
N052.12.06.426 E021.54.22.070 N052.12.20.251 E021.53.52.021
N052.12.20.251 E021.53.52.021 N052.12.29.106 E021.53.29.768
N052.12.29.106 E021.53.29.768 N052.12.40.303 E021.52.58.451
N052.12.40.303 E021.52.58.451 N052.12.51.713 E021.52.20.373
N052.12.51.713 E021.52.20.373 N052.13.00.737 E021.51.43.294
N052.13.00.737 E021.51.43.294 N052.13.08.365 E021.51.03.299
N052.13.08.365 E021.51.03.299 N052.13.12.383 E021.50.36.094
N052.13.12.383 E021.50.36.094 N052.13.15.674 E021.50.07.054
N052.13.15.674 E021.50.07.054 N052.13.18.083 E021.49.36.055
N052.13.18.083 E021.49.36.055 N052.13.19.384 E021.49.06.153
N052.13.19.384 E021.49.06.153 N052.13.19.761 E021.48.42.740
N052.13.19.761 E021.48.42.740 N052.13.23.607 E021.44.39.344
N052.13.23.607 E021.44.39.344 N052.13.30.492 E021.36.55.082
N052.13.30.492 E021.36.55.082 N052.13.39.827 E021.25.57.582
N052.13.39.827 E021.25.57.582 N052.13.40.013 E021.25.43.683
N052.13.40.013 E021.25.43.683 N052.13.39.561 E021.25.28.900
N052.13.39.561 E021.25.28.900 N052.13.38.616 E021.25.13.762
N052.13.38.616 E021.25.13.762 N052.13.37.012 E021.25.02.789
N052.13.37.012 E021.25.02.789 N052.13.34.130 E021.24.48.498
N052.13.34.130 E021.24.48.498 N052.13.31.037 E021.24.35.467
N052.13.31.037 E021.24.35.467 N052.13.27.555 E021.24.25.610
N052.13.27.555 E021.24.25.610 N052.13.24.184 E021.24.16.068
N052.13.24.184 E021.24.16.068 N052.13.20.212 E021.24.07.920
N052.13.20.212 E021.24.07.920 N052.13.15.773 E021.23.58.813
N052.13.15.773 E021.23.58.813 N052.13.10.205 E021.23.50.390
N052.13.10.205 E021.23.50.390 N052.13.05.391 E021.23.43.108
N052.13.05.391 E021.23.43.108 N052.12.59.686 E021.23.36.679
N052.12.59.686 E021.23.36.679 N052.12.55.264 E021.23.31.695
N052.12.55.264 E021.23.31.695 N052.12.49.423 E021.23.26.462
N052.12.49.423 E021.23.26.462 N052.10.55.692 E021.22.00.119
N052.10.55.692 E021.22.00.119 N052.10.45.192 E021.21.53.167
N052.10.45.192 E021.21.53.167 N052.10.34.747 E021.21.47.287
N052.10.34.747 E021.21.47.287 N052.10.25.546 E021.21.42.771
N052.10.25.546 E021.21.42.771 N052.10.16.991 E021.21.40.737
N052.10.16.991 E021.21.40.737 N052.10.06.703 E021.21.38.617
N052.10.06.703 E021.21.38.617 N052.09.51.853 E021.21.39.019
N052.09.51.853 E021.21.39.019 N052.09.35.613 E021.21.42.902
N052.09.35.613 E021.21.42.902 N052.09.22.921 E021.21.48.931
N052.09.22.921 E021.21.48.931 N052.09.11.723 E021.21.56.366
N052.09.11.723 E021.21.56.366 N052.09.01.244 E021.22.04.943
N052.09.01.244 E021.22.04.943 N052.08.50.499 E021.22.16.437
N052.08.50.499 E021.22.16.437 N052.08.41.444 E021.22.29.072
N052.08.41.444 E021.22.29.072 N052.08.33.828 E021.22.41.638
N052.08.33.828 E021.22.41.638 N052.08.27.850 E021.22.53.366
N052.08.27.850 E021.22.53.366 N052.08.17.262 E021.23.19.179
N052.08.17.262 E021.23.19.179 N052.07.60.000 E021.24.19.672

N051.44.41.311 E021.41.07.869 N051.54.16.721 E021.42.17.705
N051.54.16.721 E021.42.17.705 N052.03.46.230 E021.43.27.541
N052.03.46.230 E021.43.27.541 N052.08.42.598 E021.44.04.323
N052.08.42.598 E021.44.04.323 N052.09.06.558 E021.44.04.347
N052.09.06.558 E021.44.04.347 N052.09.23.119 E021.44.04.363
N052.09.23.119 E021.44.04.363 N052.09.46.483 E021.43.58.841
N052.09.46.483 E021.43.58.841 N052.10.06.463 E021.43.52.611
N052.10.06.463 E021.43.52.611 N052.10.31.979 E021.43.40.847
N052.10.31.979 E021.43.40.847 N052.10.54.555 E021.43.24.993
N052.10.54.555 E021.43.24.993 N052.11.18.800 E021.43.04.464
N052.11.18.800 E021.43.04.464 N052.11.40.083 E021.42.41.941
N052.11.40.083 E021.42.41.941 N052.12.00.622 E021.42.15.881
N052.12.00.622 E021.42.15.881 N052.12.16.400 E021.41.49.859
N052.12.16.400 E021.41.49.859 N052.12.34.845 E021.41.14.414
N052.12.34.845 E021.41.14.414 N052.12.51.469 E021.40.35.812
N052.12.51.469 E021.40.35.812 N052.13.07.718 E021.39.44.608
N052.13.07.718 E021.39.44.608 N052.13.17.387 E021.39.04.996
N052.13.17.387 E021.39.04.996 N052.13.24.024 E021.38.23.885
N052.13.24.024 E021.38.23.885 N052.13.28.083 E021.37.32.100
N052.13.28.083 E021.37.32.100 N052.13.30.492 E021.36.55.082

N051.17.03.934 E020.41.37.377 N051.33.16.721 E020.53.08.852
N051.33.16.721 E020.53.08.852 N051.37.48.197 E020.56.23.607
N051.37.48.197 E020.56.23.607 N051.43.48.197 E020.56.28.525
N051.43.48.197 E020.56.28.525 N051.50.48.197 E020.56.33.443
N051.50.48.197 E020.56.33.443 N051.56.47.213 E020.56.37.377
N051.56.47.213 E020.56.37.377 N052.00.11.373 E020.59.08.028
N052.00.11.373 E020.59.08.028 N052.00.41.586 E020.59.31.282
N052.00.41.586 E020.59.31.282 N052.01.16.185 E021.00.06.867
N052.01.16.185 E021.00.06.867 N052.01.41.321 E021.00.45.901
N052.01.41.321 E021.00.45.901 N052.01.55.430 E021.01.16.489
N052.01.55.430 E021.01.16.489 N052.02.08.009 E021.01.52.953
N052.02.08.009 E021.01.52.953 N052.02.16.988 E021.02.29.907
N052.02.16.988 E021.02.29.907 N052.02.22.985 E021.03.09.150
N052.02.22.985 E021.03.09.150 N052.02.25.762 E021.03.51.732
N052.02.25.762 E021.03.51.732 N052.02.25.236 E021.04.27.232
N052.02.25.236 E021.04.27.232 N052.02.20.484 E021.05.11.004
N052.02.20.484 E021.05.11.004 N052.02.14.939 E021.05.40.973
N052.02.14.939 E021.05.40.973 N052.02.02.816 E021.06.29.946
N052.02.02.816 E021.06.29.946 N052.01.24.138 E021.08.46.998

N051.34.52.131 E019.57.38.361 N051.34.25.574 E020.15.13.770
N051.34.25.574 E020.15.13.770 N051.33.39.344 E020.41.43.279
N051.33.39.344 E020.41.43.279 N051.33.29.052 E020.46.59.400
N051.33.29.052 E020.46.59.400 N051.33.28.039 E020.47.30.100
N051.33.28.039 E020.47.30.100 N051.33.28.168 E020.48.16.256
N051.33.28.168 E020.48.16.256 N051.33.29.488 E020.49.12.216
N051.33.29.488 E020.49.12.216 N051.33.37.878 E020.50.17.104
N051.33.37.878 E020.50.17.104 N051.33.50.925 E020.51.16.687
N051.33.50.925 E020.51.16.687 N051.34.10.788 E020.52.17.852
N051.34.10.788 E020.52.17.852 N051.34.35.540 E020.53.13.682
N051.34.35.540 E020.53.13.682 N051.35.04.195 E020.54.00.396
N051.35.04.195 E020.54.00.396 N051.35.33.107 E020.54.37.093
N051.35.33.107 E020.54.37.093 N051.35.58.597 E020.55.04.893
N051.35.58.597 E020.55.04.893 N051.36.27.664 E020.55.25.757
N051.36.27.664 E020.55.25.757 N051.37.48.197 E020.56.23.607

N052.10.50.372 E021.21.56.083 N052.10.27.585 E021.21.43.256
N052.10.27.585 E021.21.43.256 N052.10.07.930 E021.21.38.583
N052.10.07.930 E021.21.38.583 N052.09.49.938 E021.21.39.070
N052.09.49.938 E021.21.39.070 N052.09.33.880 E021.21.43.366
N052.09.33.880 E021.21.43.366 N052.09.18.201 E021.21.51.328
N052.09.18.201 E021.21.51.328 N052.09.02.703 E021.22.03.383
N052.09.02.703 E021.22.03.383 N052.08.50.499 E021.22.16.437
N052.08.50.499 E021.22.16.437 N052.08.38.949 E021.22.32.553
N052.08.38.949 E021.22.32.553 N052.08.30.288 E021.22.47.917
N052.08.30.288 E021.22.47.917 N052.08.18.959 E021.23.13.231

N052.22.27.541 E019.46.28.525 N052.17.22.623 E020.18.47.213
N052.17.22.623 E020.18.47.213 N052.14.49.180 E020.34.29.508
N052.14.49.180 E020.34.29.508 N052.13.21.455 E020.43.12.633
N052.13.21.455 E020.43.12.633 N052.07.22.498 E020.46.26.892
N052.07.22.498 E020.46.26.892 N052.07.21.639 E020.46.27.541
N052.07.21.639 E020.46.27.541 N052.03.26.557 E021.01.32.459
N052.03.26.557 E021.01.32.459 N052.00.35.410 E021.11.39.344
N052.00.35.410 E021.11.39.344 N051.58.14.754 E021.19.53.115
N051.58.14.754 E021.19.53.115 N051.57.14.754 E021.23.23.607
N051.57.14.754 E021.23.23.607 N051.56.26.407 E021.26.12.300
N051.56.26.407 E021.26.12.300 N051.56.24.091 E021.26.20.373
N051.56.24.091 E021.26.20.373 N051.56.19.952 E021.26.39.213
N051.56.19.952 E021.26.39.213 N051.56.14.583 E021.27.11.005
N051.56.14.583 E021.27.11.005 N051.56.13.328 E021.27.32.197
N051.56.13.328 E021.27.32.197 N051.56.13.390 E021.27.54.160
N051.56.13.390 E021.27.54.160 N051.56.15.612 E021.28.22.119
N051.56.15.612 E021.28.22.119 N051.56.21.231 E021.28.53.149
N051.56.21.231 E021.28.53.149 N051.56.29.775 E021.29.20.986
N051.56.29.775 E021.29.20.986 N051.56.40.625 E021.29.45.710
N051.56.40.625 E021.29.45.710 N051.56.50.494 E021.30.02.897
N051.56.50.494 E021.30.02.897 N051.57.00.551 E021.30.16.253
N051.57.00.551 E021.30.16.253 N051.57.14.609 E021.30.32.505
N051.57.14.609 E021.30.32.505 N051.57.19.268 E021.30.35.998
N051.57.19.268 E021.30.35.998 N051.58.19.783 E021.31.21.384
N051.58.19.783 E021.31.21.384 N051.58.35.189 E021.31.30.163
N051.58.35.189 E021.31.30.163 N051.58.50.057 E021.31.35.840
N051.58.50.057 E021.31.35.840 N051.59.04.565 E021.31.37.927
N051.59.04.565 E021.31.37.927 N051.59.18.128 E021.31.37.969
N051.59.18.128 E021.31.37.969 N051.59.35.925 E021.31.33.237
N051.59.35.925 E021.31.33.237 N051.59.50.313 E021.31.25.878
N051.59.50.313 E021.31.25.878 N052.00.02.416 E021.31.16.728
N052.00.02.416 E021.31.16.728 N052.00.13.232 E021.31.05.684
N052.00.13.232 E021.31.05.684 N052.00.24.833 E021.30.51.360
N052.00.24.833 E021.30.51.360 N052.00.35.441 E021.30.33.943
N052.00.35.441 E021.30.33.943 N052.00.44.720 E021.30.13.534
N052.00.44.720 E021.30.13.534 N052.00.50.706 E021.29.57.161
N052.00.50.706 E021.29.57.161 N052.00.56.522 E021.29.38.886
N052.00.56.522 E021.29.38.886 N052.01.45.246 E021.26.47.213
N052.01.45.246 E021.26.47.213 N052.03.26.557 E021.20.55.082
N052.03.26.557 E021.20.55.082 N052.05.07.869 E021.15.02.951
N052.05.07.869 E021.15.02.951 N052.05.43.279 E021.10.48.197
N052.05.43.279 E021.10.48.197 N052.06.26.557 E021.08.40.328

N052.00.50.706 E021.29.57.161 N052.00.04.918 E021.32.40.328 stargray
N052.00.04.918 E021.32.40.328 N051.58.35.189 E021.31.30.163 stargray
N052.03.26.557 E021.01.32.459 N052.00.41.586 E020.59.31.282 stargray
N052.12.13.811 E021.54.06.020 N052.13.16.721 E021.51.49.180 stargray
N052.13.16.721 E021.51.49.180 N052.13.19.761 E021.48.42.740 stargray
N051.56.24.091 E021.26.20.373 N051.55.33.443 E021.29.16.721 stargray
N051.55.33.443 E021.29.16.721 N051.57.19.268 E021.30.35.998 stargray
N052.09.06.558 E021.44.04.347 N052.13.23.607 E021.44.39.344 stargray
N052.13.41.311 E021.24.05.902 N052.13.39.827 E021.25.57.582 stargray
N052.13.41.311 E021.24.05.902 N052.12.49.423 E021.23.26.462 stargray
N052.07.11.008 E021.27.10.612 N052.06.18.689 E021.30.12.787 stargray
N052.06.18.689 E021.30.12.787 N052.04.40.731 E021.28.56.399 stargray
N052.01.45.246 E021.26.47.213 N052.03.31.974 E021.28.07.230 stargray
N052.09.03.934 E021.20.35.410 N052.10.50.372 E021.21.56.083 stargray
N051.33.16.721 E020.53.08.852 N051.33.27.477 E020.47.47.123 stargray

-EPWA 33  N051.51.07.869 E021.14.19.672 N051.52.53.420 E021.12.48.425
N051.51.07.869 E021.14.19.672 N051.52.53.420 E021.12.48.425
N051.49.18.222 E021.15.53.141 N051.47.35.410 E021.17.20.656 stargray
N051.47.35.410 E021.17.20.656 N051.48.29.058 E021.20.04.834 stargray
N051.50.31.398 E021.05.42.779 N051.48.46.230 E021.07.12.787 stargray
N051.48.46.230 E021.07.12.787 N051.49.40.133 E021.09.55.003 stargray
N052.09.56.066 E021.35.00.984 N052.06.18.803 E021.35.53.111 stargray
N051.51.07.869 E021.14.19.672 N051.50.20.579 E021.11.53.178 stargray
N051.33.16.721 E020.53.08.852 N051.33.26.908 E020.48.04.324 stargray
N051.59.32.459 E020.44.49.180 N051.57.50.216 E020.45.44.763 stargray
N051.59.32.459 E020.44.49.180 N052.00.18.725 E020.47.00.753 stargray
N052.03.04.918 E020.54.48.197 N052.02.06.187 E020.52.02.207 stargray
N052.07.22.623 E021.09.27.541 N052.08.54.322 E021.14.09.750 stargray
N051.49.08.310 E021.22.00.244 N051.49.57.049 E021.24.28.525 stargray
N051.49.57.049 E021.24.28.525 N051.51.34.024 E021.23.05.147 stargray
N052.22.27.541 E019.46.28.525 N052.17.22.623 E020.18.47.213 
N052.17.22.623 E020.18.47.213 N052.14.49.180 E020.34.29.508 
N052.14.49.180 E020.34.29.508 N052.12.57.049 E020.46.01.967 
N052.12.57.049 E020.46.01.967 N052.03.04.918 E020.54.48.197 
N052.03.04.918 E020.54.48.197 N051.55.50.164 E021.01.06.885 
N051.55.50.164 E021.01.06.885 N051.52.18.689 E021.04.10.820 
N051.52.18.689 E021.04.10.820 N051.50.44.817 E021.05.31.285 
N051.50.44.817 E021.05.31.285 N051.50.31.398 E021.05.42.779 
N051.50.31.398 E021.05.42.779 N051.50.18.674 E021.05.55.667 
N051.50.18.674 E021.05.55.667 N051.50.06.060 E021.06.11.046 
N051.50.06.060 E021.06.11.046 N051.49.57.597 E021.06.24.502 
N051.49.57.597 E021.06.24.502 N051.49.48.957 E021.06.41.085 
N051.49.48.957 E021.06.41.085 N051.49.40.476 E021.07.03.289 
N051.49.40.476 E021.07.03.289 N051.49.32.579 E021.07.34.053 
N051.49.32.579 E021.07.34.053 N051.49.29.982 E021.07.52.619 
N051.49.29.982 E021.07.52.619 N051.49.27.910 E021.08.18.323 
N051.49.27.910 E021.08.18.323 N051.49.28.486 E021.08.50.659 
N051.49.28.486 E021.08.50.659 N051.49.31.247 E021.09.14.896 
N051.49.31.247 E021.09.14.896 N051.49.34.937 E021.09.34.304 
N051.49.34.937 E021.09.34.304 N051.49.40.133 E021.09.55.003 
N051.49.40.133 E021.09.55.003 N051.50.16.823 E021.11.43.521 
N051.50.16.823 E021.11.43.521 N051.50.23.728 E021.12.01.275 
N051.50.23.728 E021.12.01.275 N051.50.36.088 E021.12.23.031 
N051.50.36.088 E021.12.23.031 N051.50.50.472 E021.12.41.632 
N051.50.50.472 E021.12.41.632 N051.51.03.973 E021.12.54.765 
N051.51.03.973 E021.12.54.765 N051.51.15.442 E021.13.02.719 
N051.51.15.442 E021.13.02.719 N051.51.32.992 E021.13.10.288 
N051.51.32.992 E021.13.10.288 N051.51.56.091 E021.13.14.043 
N051.51.56.091 E021.13.14.043 N051.52.10.594 E021.13.12.329 
N051.52.10.594 E021.13.12.329 N051.52.27.502 E021.13.06.307 
N051.52.27.502 E021.13.06.307 N051.52.39.710 E021.13.00.284 
N051.52.39.710 E021.13.00.284 N051.52.55.502 E021.12.46.624 
N051.52.55.502 E021.12.46.624 N051.54.39.344 E021.11.16.721 
N051.54.39.344 E021.11.16.721 N051.58.10.820 E021.08.14.754 
N051.58.10.820 E021.08.14.754 N052.00.28.525 E021.06.15.738 
N052.00.28.525 E021.06.15.738 N052.01.47.213 E021.05.06.885 
N051.34.52.131 E019.57.38.361 N051.34.25.574 E020.15.13.770 
N051.34.25.574 E020.15.13.770 N051.33.39.344 E020.41.43.279 
N051.33.39.344 E020.41.43.279 N051.33.30.256 E020.46.22.798 
N051.33.30.256 E020.46.22.798 N051.33.28.200 E020.47.25.228 
N051.33.28.200 E020.47.25.228 N051.33.26.579 E020.48.14.288 
N051.33.26.579 E020.48.14.288 N051.33.25.935 E020.49.14.825 
N051.33.25.935 E020.49.14.825 N051.33.29.965 E020.50.06.470 
N051.33.29.965 E020.50.06.470 N051.33.37.630 E020.50.55.347 
N051.33.37.630 E020.50.55.347 N051.33.48.306 E020.51.39.851 
N051.33.48.306 E020.51.39.851 N051.34.02.500 E020.52.22.938 
N051.34.02.500 E020.52.22.938 N051.34.21.816 E020.53.06.836 
N051.34.21.816 E020.53.06.836 N051.34.42.555 E020.53.43.444 
N051.34.42.555 E020.53.43.444 N051.35.06.285 E020.54.15.882 
N051.35.06.285 E020.54.15.882 N051.35.35.765 E020.54.47.053 
N051.35.35.765 E020.54.47.053 N051.35.58.105 E020.55.04.540 
N051.35.58.105 E020.55.04.540 N051.36.35.416 E020.55.31.323 
N051.36.35.416 E020.55.31.323 N051.37.48.197 E020.56.23.607 
N051.17.03.934 E020.41.37.377 N051.33.16.721 E020.53.08.852 
N051.33.16.721 E020.53.08.852 N051.37.48.197 E020.56.23.607 
N051.37.48.197 E020.56.23.607 N051.44.46.230 E020.52.43.279 
N051.44.46.230 E020.52.43.279 N051.51.48.197 E020.49.00.984 
N051.51.48.197 E020.49.00.984 N051.57.50.216 E020.45.44.763 
N051.57.50.216 E020.45.44.763 N051.57.59.035 E020.45.39.971 
N051.57.59.035 E020.45.39.971 N051.58.10.446 E020.45.35.925 
N051.58.10.446 E020.45.35.925 N051.58.21.440 E020.45.32.432 
N051.58.21.440 E020.45.32.432 N051.58.31.868 E020.45.31.776 
N051.58.31.868 E020.45.31.776 N051.58.44.265 E020.45.32.075 
N051.58.44.265 E020.45.32.075 N051.58.53.795 E020.45.33.987 
N051.58.53.795 E020.45.33.987 N051.59.08.926 E020.45.39.063 
N051.59.08.926 E020.45.39.063 N051.59.21.658 E020.45.45.730 
N051.59.21.658 E020.45.45.730 N051.59.33.164 E020.45.54.333 
N051.59.33.164 E020.45.54.333 N051.59.41.083 E020.46.01.941 
N051.59.41.083 E020.46.01.941 N051.59.51.040 E020.46.12.483 
N051.59.51.040 E020.46.12.483 N051.59.59.897 E020.46.25.209 
N051.59.59.897 E020.46.25.209 N052.00.08.439 E020.46.39.027 
N052.00.08.439 E020.46.39.027 N052.00.14.030 E020.46.50.008 
N052.00.14.030 E020.46.50.008 N052.00.18.725 E020.47.00.753 
N052.00.18.725 E020.47.00.753 N052.00.27.538 E020.47.24.088 
N052.00.27.538 E020.47.24.088 N052.02.00.603 E020.51.46.441 
N052.02.00.603 E020.51.46.441 N052.02.06.187 E020.52.02.207 
N052.02.06.187 E020.52.02.207 N052.02.12.588 E020.52.24.514 
N052.02.12.588 E020.52.24.514 N052.02.17.692 E020.52.49.036 
N052.02.17.692 E020.52.49.036 N052.02.19.968 E020.53.08.136 
N052.02.19.968 E020.53.08.136 N052.02.21.274 E020.53.23.944 
N052.02.21.274 E020.53.23.944 N052.02.21.230 E020.53.41.941 
N052.02.21.230 E020.53.41.941 N052.02.20.249 E020.53.57.058 
N052.02.20.249 E020.53.57.058 N052.02.18.609 E020.54.13.171 
N052.02.18.609 E020.54.13.171 N052.02.16.387 E020.54.28.318 
N052.02.16.387 E020.54.28.318 N052.02.12.702 E020.54.44.770 
N052.02.12.702 E020.54.44.770 N052.02.09.360 E020.54.57.405 
N052.02.09.360 E020.54.57.405 N052.02.03.564 E020.55.13.277 
N052.02.03.564 E020.55.13.277 N052.01.56.714 E020.55.29.860 
N052.01.56.714 E020.55.29.860 N052.01.49.986 E020.55.42.658 
N052.01.49.986 E020.55.42.658 N052.01.45.031 E020.55.50.608 
N052.01.45.031 E020.55.50.608 N052.01.38.189 E020.56.00.568 
N052.01.38.189 E020.56.00.568 N052.01.33.580 E020.56.05.476 
N052.01.33.580 E020.56.05.476 N052.01.26.879 E020.56.13.621 
N052.01.26.879 E020.56.13.621 N051.59.01.967 E020.58.19.672 
N051.44.41.311 E021.41.07.869 N051.54.21.639 E021.38.48.197 
N051.54.21.639 E021.38.48.197 N052.01.54.098 E021.36.58.033 
N052.01.54.098 E021.36.58.033 N052.05.51.144 E021.36.00.547 
N052.05.51.144 E021.36.00.547 N052.06.18.803 E021.35.53.111 
N052.06.18.803 E021.35.53.111 N052.06.38.646 E021.35.45.657 
N052.06.38.646 E021.35.45.657 N052.07.01.171 E021.35.34.398 
N052.07.01.171 E021.35.34.398 N052.07.21.252 E021.35.21.104 
N052.07.21.252 E021.35.21.104 N052.07.45.638 E021.35.00.740 
N052.07.45.638 E021.35.00.740 N052.08.10.715 E021.34.34.026 
N052.08.10.715 E021.34.34.026 N052.08.31.531 E021.34.06.826 
N052.08.31.531 E021.34.06.826 N052.08.49.773 E021.33.36.858 
N052.08.49.773 E021.33.36.858 N052.09.08.957 E021.32.59.328 
N052.09.08.957 E021.32.59.328 N052.09.27.604 E021.32.12.802 
N052.09.27.604 E021.32.12.802 N052.09.40.128 E021.31.29.935 
N052.09.40.128 E021.31.29.935 N052.09.53.145 E021.30.29.528 
N052.09.53.145 E021.30.29.528 N052.09.59.388 E021.29.38.582 
N052.09.59.388 E021.29.38.582 N052.10.01.484 E021.29.03.088 
N052.10.01.484 E021.29.03.088 N052.10.02.951 E021.28.17.705 
N052.10.02.951 E021.28.17.705 N052.10.02.981 E021.27.34.756 
N052.10.02.981 E021.27.34.756 N052.10.02.951 E021.17.33.443 
N052.09.32.459 E021.59.56.066 N052.09.38.361 E021.53.27.541 
N052.09.38.361 E021.53.27.541 N052.09.56.066 E021.35.00.984 
N052.09.56.066 E021.35.00.984 N052.10.02.951 E021.28.17.705 
N052.10.02.951 E021.28.17.705 N052.10.02.951 E021.17.33.443 
N052.10.02.951 E021.17.33.443 N052.09.13.583 E021.15.03.538 
N052.09.13.583 E021.15.03.538 N052.08.54.322 E021.14.09.750 
N052.08.54.322 E021.14.09.750 N052.08.41.842 E021.13.42.345 
N052.08.41.842 E021.13.42.345 N052.08.25.025 E021.13.12.557 
N052.08.25.025 E021.13.12.557 N052.08.04.170 E021.12.43.156 
N052.08.04.170 E021.12.43.156 N052.07.44.992 E021.12.22.287 
N052.07.44.992 E021.12.22.287 N052.07.16.948 E021.11.59.916 
N052.07.16.948 E021.11.59.916 N052.06.58.506 E021.11.48.895 
N052.06.58.506 E021.11.48.895 N052.06.37.764 E021.11.40.236 
N052.06.37.764 E021.11.40.236 N052.06.16.841 E021.11.34.428 
N052.06.16.841 E021.11.34.428 N052.05.52.224 E021.11.32.369 
N052.05.52.224 E021.11.32.369 N052.05.25.474 E021.11.35.543 
N052.05.25.474 E021.11.35.543 N052.04.54.337 E021.11.45.971 
N052.04.54.337 E021.11.45.971 N052.04.26.273 E021.12.02.401 
N052.04.26.273 E021.12.02.401 N052.04.06.681 E021.12.17.423 
N052.04.06.681 E021.12.17.423 N052.03.47.748 E021.12.33.813 
N052.03.47.748 E021.12.33.813 N052.00.32.459 E021.15.22.623 
N052.41.42.295 E019.49.11.803 N052.26.01.967 E020.34.18.689 
N052.26.01.967 E020.34.18.689 N052.22.42.295 E020.43.39.344 
N052.22.42.295 E020.43.39.344 N052.17.31.475 E020.58.12.787 
N052.17.31.475 E020.58.12.787 N052.16.15.738 E021.01.43.279 
N052.16.15.738 E021.01.43.279 N052.07.22.623 E021.09.27.541 
N052.07.22.623 E021.09.27.541 N052.00.32.459 E021.15.22.623 
N052.00.32.459 E021.15.22.623 N051.57.00.984 E021.18.25.574 
N051.57.00.984 E021.18.25.574 N051.53.28.525 E021.21.26.557 
N051.53.28.525 E021.21.26.557 N051.51.45.438 E021.22.55.326 
N051.51.45.438 E021.22.55.326 N051.51.34.024 E021.23.05.147 
N051.51.34.024 E021.23.05.147 N051.51.18.348 E021.23.15.847 
N051.51.18.348 E021.23.15.847 N051.51.07.912 E021.23.20.604 
N051.51.07.912 E021.23.20.604 N051.50.56.989 E021.23.23.751 
N051.50.56.989 E021.23.23.751 N051.50.45.164 E021.23.25.155 
N051.50.45.164 E021.23.25.155 N051.50.32.622 E021.23.24.420 
N051.50.32.622 E021.23.24.420 N051.50.12.296 E021.23.17.896 
N051.50.12.296 E021.23.17.896 N051.49.56.035 E021.23.08.477 
N051.49.56.035 E021.23.08.477 N051.49.44.930 E021.22.58.888 
N051.49.44.930 E021.22.58.888 N051.49.34.866 E021.22.47.711 
N051.49.34.866 E021.22.47.711 N051.49.25.298 E021.22.34.319 
N051.49.25.298 E021.22.34.319 N051.49.15.930 E021.22.17.657 
N051.49.15.930 E021.22.17.657 N051.49.07.207 E021.21.57.722 
N051.49.07.207 E021.21.57.722 N051.48.29.444 E021.20.03.640 
N051.48.29.444 E021.20.03.640 N051.48.22.484 E021.19.36.236 
N051.48.22.484 E021.19.36.236 N051.48.18.798 E021.19.10.559 
N051.48.18.798 E021.19.10.559 N051.48.17.228 E021.18.46.522 
N051.48.17.228 E021.18.46.522 N051.48.18.038 E021.18.15.956 
N051.48.18.038 E021.18.15.956 N051.48.21.104 E021.17.49.814 
N051.48.21.104 E021.17.49.814 N051.48.25.096 E021.17.29.911 
N051.48.25.096 E021.17.29.911 N051.48.31.836 E021.17.06.555 
N051.48.31.836 E021.17.06.555 N051.48.38.600 E021.16.49.398 
N051.48.38.600 E021.16.49.398 N051.48.46.202 E021.16.34.012 
N051.48.46.202 E021.16.34.012 N051.48.58.817 E021.16.14.567 
N051.48.58.817 E021.16.14.567 N051.49.06.534 E021.16.05.049 
N051.49.06.534 E021.16.05.049 N051.49.18.222 E021.15.53.141 
N051.49.18.222 E021.15.53.141 N051.51.07.869 E021.14.19.672 
     

EPMO vor 08 N052.27.09.000 E020.40.40.000 N052.27.01.584 E020.39.02.303 Blue ;
                          N052.26.54.168 E020.37.24.599 N052.26.46.752 E020.35.46.896 Blue ;
                          N052.26.39.335 E020.34.09.228 N052.26.31.919 E020.32.31.560 Blue ;
                          N052.26.24.503 E020.30.53.892 N052.26.17.087 E020.29.16.223 Blue ;
                          N052.26.09.671 E020.27.38.555 N052.26.02.255 E020.26.00.887 Blue ;
                          N052.25.54.839 E020.24.23.219 N052.25.47.423 E020.22.45.551 Blue ;
                          N052.25.40.007 E020.21.07.919 N052.25.32.591 E020.19.30.287 Blue ;
                          N052.25.25.175 E020.17.52.655 N052.25.17.759 E020.16.15.023 Blue ;
                          N052.25.10.343 E020.14.37.391 N052.25.02.927 E020.12.59.759 Blue ;
						  
EPMO vor 26 N052.27.09.000 E020.40.40.000 N052.27.27.540 E020.42.13.644 Blue ;
                          N052.27.46.080 E020.43.47.280 N052.28.04.620 E020.45.20.951 Blue ;
                          N052.28.23.160 E020.46.54.623 N052.28.41.700 E020.48.28.296 Blue ;
                          N052.29.00.240 E020.50.02.004 N052.29.18.779 E020.51.35.711 Blue ;
                          N052.29.37.319 E020.53.09.420 N052.29.55.859 E020.54.43.127 Blue ;
                          N052.30.14.399 E020.56.16.872 N052.30.32.939 E020.57.50.615 Blue ;
                          N052.30.51.479 E020.59.24.360 N052.31.10.019 E021.00.58.139 Blue ;
                          N052.31.28.559 E021.02.31.920 N052.31.47.099 E021.04.05.699 Blue ;
                          N052.32.05.640 E021.05.39.516 N052.32.24.180 E021.07.13.332 Blue ;

            
EPWA vor/dme 33              N001.39.20.999 E021.25.40.001 N001.41.44.999 E020.58.09.998 Blue
N052.08.08.232 E020.59.39.939 N052.07.15.495 E021.00.30.050 Blue
N052.06.20.986 E021.01.21.825 N052.05.28.897 E021.02.11.270 Blue
N052.04.38.935 E021.02.58.747 N052.03.46.387 E021.03.48.619 Blue
N052.02.57.397 E021.04.35.104 N052.02.01.215 E021.05.28.366 Blue
N052.01.09.654 E021.06.17.256 N052.00.19.553 E021.07.04.766 Blue
N051.59.30.701 E021.07.51.047 N051.58.37.617 E021.08.41.285 Blue
N051.55.59.466 E021.11.11.007 N051.55.11.437 E021.11.56.477 Blue
N051.57.44.680 E021.09.31.419 N051.56.52.746 E021.10.20.618 Blue
EPWA vor/dme 11           N052.10.52.175 E020.54.32.292 N052.11.12.696 E020.53.00.348 blue ;
                          N052.11.33.216 E020.51.28.368 N052.11.53.735 E020.49.56.387 blue ;
                          N052.12.14.256 E020.48.24.407 N052.12.34.775 E020.46.52.392 blue ;
                          N052.12.55.295 E020.45.20.375 N052.13.15.816 E020.43.48.360 blue ;
                          N052.13.36.335 E020.42.16.344 N052.13.56.856 E020.40.44.291 blue ;
                          N052.14.17.376 E020.39.12.240 N052.14.37.895 E020.37.40.187 blue ;
                          N052.14.58.416 E020.36.08.100 N052.15.18.935 E020.34.36.012 blue ;
                          N052.15.39.455 E020.33.03.923 N052.15.59.976 E020.31.31.800 blue ;

EPWA vor/dme 29               N001.39.20.999 E021.25.40.001 N001.41.44.999 E020.58.09.998 Blue
N052.09.11.000 E021.00.28.000 N052.08.43.000 E021.01.54.000 Blue
N052.08.14.000 E021.03.20.000 N052.07.46.000 E021.04.46.000 Blue
N052.07.17.000 E021.06.12.000 N052.06.49.000 E021.07.38.000 Blue
N052.06.20.000 E021.09.04.000 N052.05.52.000 E021.10.30.000 Blue
N052.05.23.000 E021.11.56.000 N052.04.55.000 E021.13.22.000 Blue
N052.04.26.000 E021.14.48.000 N052.03.58.000 E021.16.14.000 Blue
N052.03.29.000 E021.17.40.000 N052.03.00.000 E021.19.06.000 Blue
N052.02.32.000 E021.20.32.000 N052.02.03.000 E021.21.58.000 Blue

EPWA vor/dme 15        N001.39.20.999 E021.25.40.001 N001.41.44.999 E020.58.09.998 blue
                          N052.11.36.743 E020.56.36.347 N052.12.31.896 E020.55.57.791 blue
                          N052.13.27.047 E020.55.19.236 N052.14.22.199 E020.54.40.644 blue
                          N052.15.17.352 E020.54.02.051 N052.16.12.503 E020.53.23.423 blue
                          N052.17.07.656 E020.52.44.796 N052.18.02.808 E020.52.06.167 blue
                          N052.18.57.959 E020.51.27.503 N052.19.53.112 E020.50.48.840 blue
                          N052.20.48.263 E020.50.10.175 N052.21.43.415 E020.49.31.476 blue
                          N052.22.38.568 E020.48.52.775 N052.23.33.719 E020.48.14.039 blue
                          N052.24.28.872 E020.47.35.304 N052.25.24.024 E020.46.56.567 blue


EPPO vor 10 LAW LAW N052.28.20.707 E016.29.02.391 blue

EPPO vor 28	LAW LAW N052.18.15.100 E017.16.40.600 blue

EPWR vor 11 N051.05.34.000 E016.55.08.000 N051.05.59.856 E016.53.41.783 blue ;
                          N051.06.25.704 E016.52.15.527 N051.06.51.551 E016.50.49.272 blue ;
                          N051.07.17.399 E016.49.23.016 N051.07.43.248 E016.47.56.723 blue ;
                          N051.08.09.096 E016.46.30.432 N051.08.34.943 E016.45.04.139 blue ;
                          N051.09.00.791 E016.43.37.812 N051.09.26.640 E016.42.11.483 blue ;
                          N051.09.52.488 E016.40.45.120 N051.10.18.335 E016.39.18.756 blue ;

EPWR vor 29 N051.05.34.000 E016.55.08.000 N051.05.08.159 E016.56.34.224 blue ;
                          N051.04.42.312 E016.58.00.443 N051.04.16.464 E016.59.26.627 blue ;
                          N051.03.50.615 E017.00.52.811 N051.03.24.767 E017.02.18.995 blue ;
                          N051.02.58.920 E017.03.45.143 N051.02.33.072 E017.05.11.291 blue ;
                          N051.02.07.223 E017.06.37.439 N051.01.41.375 E017.08.03.551 blue ;
                          N051.01.15.528 E017.09.29.663 N051.00.49.680 E017.10.55.740 blue ;

EPGD vor 11 GZD GDZ N054.30.05.271 E017.57.23.047 blue;
EPGD vor 29 GZD GZD N054.12.34.713 E019.08.17.330 blue;

EPLB vor 07 N051.12.51.000 E022.32.04.000 N051.14.10.200 E022.41.07.700 Blue;
EPLB vor 25 N051.15.37.000 E022.51.15.000 N051.14.10.200 E022.41.07.700 Blue;

EPKK vor 07 KAK KAK KK377 KK377 blue
EPKK vor 25 KAK KAK KK371 KK371 blue

EPKT vor 09 KAX KAX KT373 KT373 blue
EPKT vor 27 KAX KAX KT378 KT378 blue


;podejœcia RNAV
;EPWA rnav 11 N052.10.46.000 E020.35.24.000 N052.13.29.545 E020.37.30.403 blue
;N052.13.29.545 E020.37.30.403 N052.13.48.527 E020.37.57.438 blue
;N052.13.48.527 E020.37.57.438 N052.14.00.160 E020.38.24.035 blue
;N052.14.00.160 E020.38.24.035 N052.14.08.156 E020.38.43.799 blue
;N052.14.08.156 E020.38.43.799 N052.14.14.660 E020.39.02.546 blue
;N052.14.14.660 E020.39.02.546 N052.14.22.889 E020.39.39.361 blue
;N052.14.22.889 E020.39.39.361 N052.14.25.496 E020.40.00.899 blue
;N052.14.25.496 E020.40.00.899 N052.14.28.023 E020.40.25.789 blue
;N052.14.28.023 E020.40.25.789 N052.14.28.693 E020.40.56.335 blue
;N052.14.28.693 E020.40.56.335 N052.14.26.497 E020.41.36.324 blue
;N052.14.26.497 E020.41.36.324 N052.14.16.000 E020.42.34.000 blue
;N052.13.29.545 E020.37.30.403 N052.15.19.300 E020.38.44.300 stargray
;N052.19.53.000 E020.42.06.000 N052.17.39.379 E020.40.26.739 blue
;N052.17.39.379 E020.40.26.739 N052.17.05.580 E020.40.10.539 blue
;N052.17.05.580 E020.40.10.539 N052.16.41.363 E020.40.06.336 blue
;N052.16.41.363 E020.40.06.336 N052.16.22.703 E020.40.07.491 blue
;N052.16.22.703 E020.40.07.491 N052.16.07.237 E020.40.11.306 blue
;N052.16.07.237 E020.40.11.306 N052.15.54.410 E020.40.16.736 blue
;N052.15.54.410 E020.40.16.736 N052.15.42.911 E020.40.22.556 blue
;N052.15.42.911 E020.40.22.556 N052.15.31.763 E020.40.29.844 blue
;N052.15.31.763 E020.40.29.844 N052.15.19.873 E020.40.39.993 blue
;N052.15.19.873 E020.40.39.993 N052.15.08.660 E020.40.53.584 blue
;N052.15.08.660 E020.40.53.584 N052.14.52.180 E020.41.14.052 blue
;N052.14.52.180 E020.41.14.052 N052.14.36.007 E020.41.42.234 blue
;N052.14.36.007 E020.41.42.234 N052.14.16.000 E020.42.34.000 blue
;N052.17.39.379 E020.40.26.739 N052.15.19.300 E020.38.44.300 stargray
;N052.16.57.700 E020.32.48.000 N052.15.19.300 E020.38.44.300 blue
;N052.15.19.300 E020.38.44.300 N052.14.16.000 E020.42.34.000 blue
;N052.14.16.000 E020.42.34.000 N052.10.17.204 E020.56.47.931 blue

EPWA granica arr 11 N052.14.47.622 E019.16.54.369 N052.16.12.289 E020.02.31.126 PROHI
N052.16.12.289 E020.02.31.126 N052.04.13.784 E020.46.38.763 PROHI
N052.04.13.784 E020.46.38.763 N052.10.02.901 E020.57.52.272 PROHI
N052.10.02.901 E020.57.52.272 N052.13.46.331 E021.06.22.864 PROHI
N052.13.46.331 E021.06.22.864 N052.03.18.646 E021.12.59.601 PROHI
N052.03.18.646 E021.12.59.601 N052.14.30.357 E021.57.10.740 PROHI

EPWA granica arr 15 N052.15.06.606 E019.17.07.735 N052.15.29.026 E019.50.19.386 PROHI
N052.15.29.026 E019.50.19.386 N052.08.47.895 E020.30.30.143 PROHI
N052.08.47.895 E020.30.30.143 N052.04.22.670 E020.46.46.760 PROHI
N052.04.22.670 E020.46.46.760 N052.14.17.670 E021.07.54.186 PROHI
N052.14.17.670 E021.07.54.186 N052.04.08.926 E021.17.07.616 PROHI
N052.04.08.926 E021.17.07.616 N052.14.10.455 E021.57.29.327 PROHI

EPWA granica arr 29 N052.38.07.200 E019.33.55.214 N052.10.02.357 E020.57.59.546 PROHI
N052.10.02.357 E020.57.59.546 N052.05.53.270 E020.44.31.552 PROHI
N052.05.53.270 E020.44.31.552 N051.56.04.176 E020.48.12.235 PROHI
N051.56.04.176 E020.48.12.235 N051.52.05.372 E020.55.00.301 PROHI
N051.52.05.372 E020.55.00.301 N051.46.55.718 E021.26.16.173 PROHI
N051.46.55.718 E021.26.16.173 N051.40.13.293 E021.32.19.059 PROHI

EPWA granica arr 33 N052.37.52.299 E019.34.00.698 N052.10.06.100 E020.57.05.692 PROHI
N052.10.06.100 E020.57.05.692 N052.05.58.225 E020.44.14.118 PROHI
N052.05.58.225 E020.44.14.118 N052.01.01.954 E020.40.52.882 PROHI
N052.01.01.954 E020.40.52.882 N051.48.48.478 E020.46.32.833 PROHI
N051.48.48.478 E020.46.32.833 N051.45.12.973 E021.23.57.731 PROHI
N051.45.12.973 E021.23.57.731 N051.39.51.097 E021.32.30.766 PROHI

[SID]
EPLB 07 DER_RWY07 DER_RWY07 LB701 LB701
LB701 LB701 LB702 LB702
LB702 LB702 LB703 LB703
LB703 LB703 LB704 LB704
LB704 LB704 LB706 LB706
LB706 LB706 LB707 LB707
LB707 LB707 VADOl VADOL

LB701 LB701 LB711 LB711
LB711 LB711 LB712 LB712
LB712 LB712 LB713 LB713
LB713 LB713 LB714 LB714
LB714 LB714 LB716 LB716
LB716 LB716 ARGIX ARGIX

LB714 LB714 LB717 LB717
LB717 LB717 LIBGA LIBGA

EPLB 25 DER_RWY25 DER_RWY25 LB601 LB601
LB601 LB601 LB602 LB602
LB602 LB602 LB603 LB603
LB603 LB603 LB613 LB613
LB613 LB613 VADOL VADOL

LB601 LB601 LB606 LB606
LB606 LB606 LB607 LB607
LB607 LB607 LB608 LB608
LB608 LB608 LIBGA LIBGA

LB608 LB608 ARGIX ARGIX

LB608 LB608 VADOL VADOL

DER_RWY25 DER_RWY25 LB611 LB611
LB611 LB611 LB612 LB612
LB612 LB612 LB613 LB613

EPSY 01 N053.29.33.100 E020.56.37.200 SY411 SY411
SY411 SY411 SY412 SY412
SY412 SY412 SY413 SY413
SY413 SY413 NIVON NIVON
SY413 SY413 SY414 SY414
SY414 SY414 UDROV UDROV
SY411 SY411 SY416 SY416
SY416 SY416 SY417 SY417
SY417 SY417 LUSUL LUSUL

EPSY 19 N053.28.16.400 E020.55.54.200 SY511 SY511
SY511 SY511 SY512 SY512
SY512 SY512 SY513 SY513
SY513 SY513 NIVON NIVON
SY512 SY512 SY514 SY514
SY514 SY514 SY517 SY517
SY517 SY517 UDROV UDROV
SY514 SY514 SY516 SY516
SY516 SY516 LUSUL LUSUL

EPKT 09 DER09 DER09 KT837 KT837
KT837 KT837 KT839 KT839
KT839 KT839 KT843 KT843
KT843 KT843 KT846 KT846
KT846 KT846 BAREX BAREX

KT843 KT843 LOBMU LOBMU
LOBMU LOBMU NAVUR NAVUR

KT837 KT837 KT848 KT848
KT848 KT848 INPIV INPIV
INPIV INPIV KURON KURON

INPIV INPIV KT851 KT851
KT851 KT851 OVBIX OVBIX
OVBIX OVBIX LUXAR LUXAR

OVBIX OVBIX XELRA XELRA
XELRA XELRA LENOV LENOV

KT837 KT837 KT838 KT838
KT838 KT838 ELVEP ELVEP
ELVEP ELVEP KT862 KT862
KT862 KT862 KT864 KT864
KT864 KT864 TUSIN TUSIN

KT862 KT862 KT863 KT863
KT863 KT863 KT869 KT869
KT869 KT869 BAVOK BAVOK

ELVEP ELVEP INSAB INSAB
INSAB INSAB NOVGA NOVGA
NOVGA NOVGA EMBIK EMBIK

NOVGA NOVGA NUMBA NUMBA

KT843 KT843 KT844 KT844
KT844 KT844 KT861 KT861
KT861 KT861 SUDOL SUDOL

EPKT 27 DER27 DER27 KT644 KT644
KT644 KT644 KT647 KT647
KT647 KT647 KT648 KT648
KT648 KT648 KT649 KT649
KT649 KT649 BAREX BAREX

KT644 KT644 KT653 KT653
KT653 KT653 LOBMU LOBMU
LOBMU LOBMU NAVUR NAVUR

LOBMU LOBMU KURON KURON

KT644 KT644 KT662 KT662
KT662 KT662 KT664 KT664
KT664 KT664 KT668 KT668
KT668 KT668 KT671 KT671
KT671 KT671 PIKEB PIKEB
PIKEB PIKEB ASGID ASGID
ASGID ASGID LUXAR LUXAR

PIKEB PIKEB LENOV LENOV

KT668 KT668 KT669 KT669
KT669 KT669 BABKO BABKO

KT664 KT664 KT667 KT667
KT667 KT667 TUSIN TUSIN

KT644 KT644 OLNAG OLNAG
OLNAG OLNAG KT659 KT659
KT659 KT659 KT661 KT661
KT661 KT661 BAVOK BAVOK

OLNAG OLNAG KT658 KT658
KT658 KT658 EMBIK EMBIK

OLNAG OLNAG KT657 KT657
KT657 KT657 NUMBA NUMBA

KT648 KT648 KT651 KT651
KT651 KT651 SUDOL SUDOL


EPKK 07 N050.05.33.760 E019.53.34.450 N050.05.52.600 E019.55.50.900 stargray
N050.04.26.920 E019.56.33.200 N050.05.52.600 E019.55.50.900 stargray
N050.04.47.300 E019.47.58.800 N050.05.33.760 E019.53.34.450
N050.05.33.760 E019.53.34.450 N050.05.36.070 E019.53.59.470
N050.05.36.070 E019.53.59.470 N050.05.36.910 E019.54.24.980
N050.05.36.910 E019.54.24.980 N050.05.34.940 E019.54.47.320
N050.05.34.940 E019.54.47.320 N050.05.30.490 E019.55.10.960
N050.05.30.490 E019.55.10.960 N050.05.23.180 E019.55.32.500
N050.05.23.180 E019.55.32.500 N050.05.13.630 E019.55.51.760
N050.05.13.630 E019.55.51.760 N050.05.02.420 E019.56.08.740
N050.05.02.420 E019.56.08.740 N050.04.48.950 E019.56.21.530
N050.04.48.950 E019.56.21.530 N050.04.26.920 E019.56.33.200
N050.04.26.920 E019.56.33.200 N049.58.00.200 E019.59.43.300
N049.53.07.230 E020.01.16.100 N049.51.39.500 E020.01.43.800 stargray
N049.51.07.310 E019.59.34.400 N049.51.39.500 E020.01.43.800 stargray
N049.58.00.200 E019.59.43.300 N049.53.07.230 E020.01.16.100
N049.53.07.230 E020.01.16.100 N049.52.52.050 E020.01.21.720
N049.52.52.050 E020.01.21.720 N049.52.45.160 E020.01.23.380
N049.52.45.160 E020.01.23.380 N049.52.25.210 E020.01.22.430
N049.52.25.210 E020.01.22.430 N049.52.05.940 E020.01.16.610
N049.52.05.940 E020.01.16.610 N049.51.51.440 E020.01.07.080
N049.51.51.440 E020.01.07.080 N049.51.38.470 E020.00.53.630
N049.51.38.470 E020.00.53.630 N049.51.27.330 E020.00.36.340
N049.51.27.330 E020.00.36.340 N049.51.18.120 E020.00.16.850
N049.51.18.120 E020.00.16.850 N049.51.11.880 E019.59.53.330
N049.51.11.880 E019.59.53.330 N049.51.07.310 E019.59.34.400
N049.51.07.310 E019.59.34.400 N049.47.01.900 E019.43.09.700
N050.04.47.300 E019.47.58.800 N050.05.52.600 E019.55.50.900 ;prosta od pasa
N050.05.52.600 E019.55.50.900 N050.09.55.610 E020.25.44.770 
N050.09.55.610 E020.25.44.770 N050.09.59.050 E020.26.10.260 
N050.09.59.050 E020.26.10.260 N050.10.01.140 E020.26.36.690
N050.10.01.140 E020.26.36.690 N050.10.02.040 E020.26.57.800
N050.10.02.040 E020.26.57.800 N050.10.00.020 E020.27.18.010 
N050.10.00.020 E020.27.18.010 N050.09.59.100 E020.27.37.260
N050.09.59.100 E020.27.37.260 N050.09.56.290 E020.27.56.290
N050.09.56.290 E020.27.56.290 N050.09.50.520 E020.28.15.280
N050.09.50.520 E020.28.15.280 N050.09.46.350 E020.28.33.530
N050.09.46.350 E020.28.33.530 N050.09.36.860 E020.28.48.100
N050.09.36.860 E020.28.48.100 N050.09.28.430 E020.29.03.740
N050.09.28.430 E020.29.03.740 N050.09.16.750 E020.29.21.910
N050.09.16.750 E020.29.21.910 N050.09.07.180 E020.29.35.820
N050.09.07.180 E020.29.35.820 N050.02.03.000 E020.39.35.000
N050.09.55.610 E020.25.44.770 N050.10.13.900 E020.28.01.900 stargray
N050.10.13.900 E020.28.01.900 N050.09.07.180 E020.29.35.820 stargray
N050.05.33.760 E019.53.34.450 N050.05.37.670 E019.53.57.470
N050.05.37.670 E019.53.57.470 N050.05.41.360 E019.54.21.020
N050.05.41.360 E019.54.21.020 N050.05.44.940 E019.54.45.310
N050.05.44.940 E019.54.45.310 N050.05.53.650 E019.55.05.230
N050.05.53.650 E019.55.05.230 N050.06.04.740 E019.55.22.860
N050.06.04.740 E019.55.22.860 N050.06.17.060 E019.55.37.480
N050.06.17.060 E019.55.37.480 N050.06.31.450 E019.55.48.340
N050.06.31.450 E019.55.48.340 N050.06.46.570 E019.55.50.350
N050.06.46.570 E019.55.50.350 N050.07.02.110 E019.55.52.430
N050.07.02.110 E019.55.52.430 N050.07.16.970 E019.55.51.920
N050.07.16.970 E019.55.51.920 N050.07.22.210 E019.55.51.220
N050.07.22.210 E019.55.51.220 N050.14.49.400 E019.56.05.600
N050.07.22.210 E019.55.51.220 N050.05.52.600 E019.55.50.900 stargray
N050.14.49.400 E019.56.05.600 N050.28.01.600 E019.54.35.400
N050.28.01.600 E019.54.35.400 N050.34.52.700 E019.54.36.300
N050.34.52.700 E019.54.36.300 N050.48.38.620 E019.54.37.480
N050.48.38.620 E019.54.37.480 N050.48.55.470 E019.54.36.820
N050.48.55.470 E019.54.36.820 N050.49.11.410 E019.54.32.080
N050.49.11.410 E019.54.32.080 N050.49.26.400 E019.54.21.870
N050.49.26.400 E019.54.21.870 N050.49.39.800 E019.54.08.480
N050.49.39.800 E019.54.08.480 N050.49.52.540 E019.53.52.550
N050.49.52.540 E019.53.52.550 N050.50.02.210 E019.53.32.150
N050.50.02.210 E019.53.32.150 N050.50.10.160 E019.53.09.950
N050.50.10.160 E019.53.09.950 N050.50.14.880 E019.52.45.730
N050.50.14.880 E019.52.45.730 N050.50.16.120 E019.52.14.940
N050.50.16.120 E019.52.14.940 N050.53.40.000 E018.44.18.000 
N050.50.16.120 E019.52.14.940 N050.50.08.800 E019.54.38.500 stargray
N050.48.38.620 E019.54.37.480 N050.50.08.800 E019.54.38.500
N050.50.08.800 E019.54.38.500 N051.00.47.000 E019.54.40.000
N050.14.49.400 E019.56.05.600 N050.27.55.000 E020.02.44.000 
N050.27.55.000 E020.02.44.000 N050.34.59.599 E020.13.08.000
N050.02.03.000 E020.39.35.000 N049.55.48.000 E021.10.31.000 
N050.02.03.000 E020.39.35.000 N049.31.12.000 E020.55.13.000 
N049.31.12.000 E020.55.13.000 N049.20.11.000 E021.00.37.000
N049.47.01.900 E019.43.09.700 N049.44.42.400 E019.33.55.700
N049.44.42.400 E019.33.55.700 N049.36.42.000 E019.28.10.000 
N049.44.42.400 E019.33.55.700 N049.46.08.400 E019.20.29.000
N049.46.08.400 E019.20.29.000 N049.50.50.978 E018.34.22.209 
N050.14.49.400 E019.56.05.600 N050.18.14.450 E019.48.03.670
N050.18.14.450 E019.48.03.670 N050.18.25.360 E019.47.33.810
N050.18.25.360 E019.47.33.810 N050.18.33.910 E019.47.06.210
N050.18.33.910 E019.47.06.210 N050.18.40.870 E019.46.40.900
N050.18.40.870 E019.46.40.900 N050.18.48.240 E019.46.14.490
N050.18.48.240 E019.46.14.490 N050.18.50.370 E019.46.02.050
N050.18.50.370 E019.46.02.050 N050.18.52.540 E019.45.47.560
N050.18.52.540 E019.45.47.560 N050.18.53.110 E019.45.19.600
N050.18.53.110 E019.45.19.600 N050.18.53.990 E019.44.52.780
N050.18.53.990 E019.44.52.780 N050.18.54.650 E019.44.21.130
N050.18.54.650 E019.44.21.130 N050.18.52.970 E019.43.47.940
N050.18.52.970 E019.43.47.940 N050.18.03.000 E019.33.13.000 
N050.18.14.450 E019.48.03.670 N050.19.04.300 E019.46.06.900 stargray
N050.19.04.300 E019.46.06.900 N050.18.52.970 E019.43.47.940 stargray
N050.18.03.000 E019.33.13.000 N050.18.00.000 E019.09.41.000 
N050.18.00.000 E019.09.41.000 N050.17.22.800 E018.51.12.000 
N050.17.22.800 E018.51.12.000 N050.18.45.680 E018.30.01.640
N050.18.45.680 E018.30.01.640 N050.18.48.200 E018.29.27.450
N050.18.48.200 E018.29.27.450 N050.18.53.290 E018.29.02.690
N050.18.53.290 E018.29.02.690 N050.19.00.610 E018.28.40.270
N050.19.00.610 E018.28.40.270 N050.19.08.980 E018.28.20.510
N050.19.08.980 E018.28.20.510 N050.19.22.020 E018.28.03.160
N050.19.22.020 E018.28.03.160 N050.19.35.740 E018.27.49.170
N050.19.35.740 E018.27.49.170 N050.19.50.510 E018.27.39.240 
N050.19.50.510 E018.27.39.240 N050.20.07.220 E018.27.33.720
N050.20.07.220 E018.27.33.720 N050.20.23.900 E018.27.28.760
N050.20.23.900 E018.27.28.760 N050.39.12.000 E018.24.42.000 
N050.20.23.900 E018.27.28.760 N050.18.54.000 E018.27.42.000 stargray
N050.18.45.680 E018.30.01.640 N050.18.54.000 E018.27.42.000 
N050.17.22.800 E018.51.12.000 N050.18.48.480 E018.29.14.400
N050.18.48.480 E018.29.14.400 N050.18.47.910 E018.28.49.540
N050.18.47.910 E018.28.49.540 N050.18.49.060 E018.28.28.010
N050.18.49.060 E018.28.28.010 N050.18.47.750 E018.28.06.800
N050.18.47.750 E018.28.06.800 N050.18.46.760 E018.27.44.230
N050.18.46.760 E018.27.44.230 N050.18.42.700 E018.27.22.920
N050.18.42.700 E018.27.22.920 N050.18.40.080 E018.27.03.130
N050.18.40.080 E018.27.03.130 N050.18.34.680 E018.26.44.730
N050.18.34.680 E018.26.44.730 N050.18.29.320 E018.26.17.460
N050.18.29.320 E018.26.17.460 N050.12.29.000 E018.06.11.000 
N050.18.48.480 E018.29.14.400 N050.18.54.000 E018.27.42.000 stargray
N050.18.54.000 E018.27.42.000 N050.18.29.320 E018.26.17.460 stargray
N050.18.54.000 E018.27.42.000 N050.22.32.000 E018.06.31.000 

EPKK 25 N050.04.31.400 E019.46.05.100 N050.03.45.080 E019.40.34.377
N050.03.45.080 E019.40.34.377 N050.03.41.821 E019.40.11.009
N050.03.41.821 E019.40.11.009 N050.03.40.619 E019.39.53.161
N050.03.40.619 E019.39.53.161 N050.03.40.516 E019.39.38.995
N050.03.40.516 E019.39.38.995 N050.03.43.549 E019.39.16.885
N050.03.43.549 E019.39.16.885 N050.03.49.601 E019.38.51.278
N050.03.49.601 E019.38.51.278 N050.03.57.850 E019.38.32.245
N050.03.57.850 E019.38.32.245 N050.04.09.102 E019.38.15.328
N050.04.09.102 E019.38.15.328 N050.04.25.176 E019.37.57.943
N050.04.25.176 E019.37.57.943 N050.04.36.696 E019.37.51.860
N050.04.36.696 E019.37.51.860 KK606 KK606
N050.03.45.080 E019.40.34.377 KK599 KK599
N050.03.45.080 E019.40.34.377 N050.03.38.156 E019.39.54.433
N050.03.38.156 E019.39.54.433 N050.03.30.335 E019.39.27.239
N050.03.30.335 E019.39.27.239 N050.03.23.528 E019.39.09.013
N050.03.23.528 E019.39.09.013 N050.03.12.643 E019.38.48.298
N050.03.12.643 E019.38.48.298 N050.02.58.992 E019.38.34.344
N050.02.58.992 E019.38.34.344 N050.02.41.515 E019.38.19.454
N050.02.41.515 E019.38.19.454 N050.02.27.698 E019.38.13.075
N050.02.27.698 E019.38.13.075 N050.02.13.274 E019.38.08.242
N050.02.13.274 E019.38.08.242 N050.01.57.594 E019.38.03.363
N050.01.57.594 E019.38.03.363 N049.54.29.470 E019.37.26.660
KK606 KK606 KK611 KK611
KK611 KK611 KK612 KK612
KK599 KK599 KK602 KK602

;luk przy kk612 strone pobok
N050.31.31.950 E019.43.31.560 N050.31.47.910 E019.43.30.700
N050.31.47.910 E019.43.30.700 N050.32.03.530 E019.43.35.560
N050.32.03.530 E019.43.35.560 N050.32.18.120 E019.43.44.210
N050.32.18.120 E019.43.44.210 N050.32.31.580 E019.43.56.790
N050.32.31.580 E019.43.56.790 N050.32.43.820 E019.44.12.020
N050.32.43.820 E019.44.12.020 N050.32.54.410 E019.44.30.470
N050.32.54.410 E019.44.30.470 N050.33.02.260 E019.44.51.790
N050.33.02.260 E019.44.51.790 N050.33.07.730 E019.45.14.920
N050.33.07.730 E019.45.14.920 N050.33.10.890 E019.45.34.860
N050.33.10.890 E019.45.34.860 POBOK POBOK
N050.33.10.890 E019.45.34.860 KK612 KK612 stargray

;luk przy LOBMU w stronê BAREX
KK612 KK612 KK613 KK613
KK613 KK613 N050.45.17.200 E019.38.06.480
N050.45.17.200 E019.38.06.480 N050.45.28.490 E019.37.54.800
N050.45.28.490 E019.37.54.800 N050.45.39.000 E019.37.43.530
N050.45.39.000 E019.37.43.530 N050.45.49.230 E019.37.30.480
N050.45.49.230 E019.37.30.480 N050.45.57.900 E019.37.16.600
N050.45.57.900 E019.37.16.600 N050.46.07.030 E019.37.01.530
N050.46.07.030 E019.37.01.530 N050.46.13.810 E019.36.46.020
N050.46.13.810 E019.36.46.020 N050.46.21.330 E019.36.29.080
N050.46.21.330 E019.36.29.080 N050.46.28.210 E019.36.10.450
N050.46.28.210 E019.36.10.450 BAREX BAREX
N050.45.17.200 E019.38.06.480 LOBMU LOBMU stargray
N050.46.28.210 E019.36.10.450 LOBMU LOBMU stargray

;LUK PRZY LOBMU W STRONÊ NAVUR
N050.45.17.200 E019.38.06.480 N050.45.31.210 E019.38.03.520
N050.45.31.210 E019.38.03.520 N050.45.45.140 E019.38.01.580
N050.45.45.140 E019.38.01.580 N050.45.58.400 E019.37.59.340
N050.45.58.400 E019.37.59.340 N050.46.11.960 E019.38.00.950
N050.46.11.960 E019.38.00.950 N050.46.24.910 E019.38.07.210
N050.46.24.910 E019.38.07.210 N050.46.37.320 E019.38.15.620
N050.46.37.320 E019.38.15.620 N050.46.48.550 E019.38.27.780
N050.46.48.550 E019.38.27.780 N050.47.03.370 E019.38.38.710
N050.47.03.370 E019.38.38.710 NAVUR NAVUR
N050.47.03.370 E019.38.38.710 LOBMU LOBMU stargray
N050.45.17.200 E019.38.06.480 LOBMU LOBMU stargray

;luk przy olnag w strone numba
KK604 KK604 N050.23.34.950 E018.29.43.270
N050.23.34.950 E018.29.43.270 N050.23.43.250 E018.29.23.760
N050.23.43.250 E018.29.23.760 N050.23.50.700 E018.29.06.060
N050.23.50.700 E018.29.06.060 N050.23.56.350 E018.28.47.240
N050.23.56.350 E018.28.47.240 N050.24.02.130 E018.28.24.230
N050.24.02.130 E018.28.24.230 N050.24.04.200 E018.28.00.500
N050.24.04.200 E018.28.00.500 N050.24.03.800 E018.27.40.210
N050.24.03.800 E018.27.40.210 N050.24.04.500 E018.27.16.690
N050.24.04.500 E018.27.16.690 N050.24.04.500 E018.26.55.730
N050.24.04.500 E018.26.55.730 NUMBA NUMBA

;luk przy OLNAG w strone SUDOL
KK604 KK604 N050.23.35.180 E018.29.43.380
N050.23.35.180 E018.29.43.380 N050.23.43.930 E018.29.28.060
N050.23.43.930 E018.29.28.060 N050.23.52.870 E018.29.14.210
N050.23.52.870 E018.29.14.210 N050.24.00.130 E018.29.01.030
N050.24.00.130 E018.29.01.030 N050.24.07.890 E018.28.49.220
N050.24.07.890 E018.28.49.220 N050.24.16.260 E018.28.40.780
N050.24.16.260 E018.28.40.780 N050.24.23.870 E018.28.33.930
N050.24.23.870 E018.28.33.930 N050.24.34.280 E018.28.29.300
N050.24.34.280 E018.28.29.300 N050.24.45.090 E018.28.24.470
N050.24.45.090 E018.28.24.470 N050.24.56.760 E018.28.18.000
N050.24.56.760 E018.28.18.000 N050.25.10.690 E018.28.13.050
N050.25.10.690 E018.28.13.050 SUDOL SUDOL

;luk przy kk616 w strone TUSIN
N049.54.29.470 E019.37.26.660 N049.54.13.280 E019.37.17.290
N049.54.13.280 E019.37.17.290 N049.53.59.950 E019.37.08.270
N049.53.59.950 E019.37.08.270 N049.53.46.560 E019.37.01.040
N049.53.46.560 E019.37.01.040 N049.53.34.790 E019.36.49.240
N049.53.34.790 E019.36.49.240 N049.53.23.910 E019.36.35.430
N049.53.23.910 E019.36.35.430 N049.53.19.510 E019.36.27.540
N049.53.19.510 E019.36.27.540 N049.53.16.870 E019.36.21.630
N049.53.16.870 E019.36.21.630 N049.53.09.590 E019.36.02.930
N049.53.09.590 E019.36.02.930 N049.53.04.500 E019.35.42.450
N049.53.04.500 E019.35.42.450 N049.53.01.900 E019.35.20.810
N049.53.01.900 E019.35.20.810 N049.52.59.730 E019.34.57.020
N049.52.59.730 E019.34.57.020 N049.52.58.780 E019.34.28.150
N049.52.58.780 E019.34.28.150 KK617 KK617
N049.52.59.730 E019.34.57.020 KK616 KK616 stargray

;luk przy KK616 w strone PIKEB
N049.54.29.470 E019.37.26.660 N049.54.14.140 E019.37.20.510
N049.54.14.140 E019.37.20.510 N049.53.58.670 E019.37.20.160
N049.53.58.670 E019.37.20.160 N049.53.43.120 E019.37.23.910
N049.53.43.120 E019.37.23.910 N049.53.28.350 E019.37.31.620
N049.53.28.350 E019.37.31.620 N049.53.14.520 E019.37.42.880
N049.53.14.520 E019.37.42.880 N049.53.02.360 E019.37.58.040
N049.53.02.360 E019.37.58.040 N049.52.52.150 E019.38.16.660
N049.52.52.150 E019.38.16.660 N049.52.44.130 E019.38.37.740
N049.52.44.130 E019.38.37.740 N049.52.37.420 E019.39.00.540
N049.52.37.420 E019.39.00.540 PIKEB PIKEB
N049.52.37.420 E019.39.00.540 KK616 KK616 stargray

N049.54.29.470 E019.37.26.660 KK616 KK616

PIKEB PIKEB ASGID ASGID
ASGID ASGID LUXAR LUXAR

PIKEB PIKEB KK614 KK614
KK614 KK614 KK619 KK619
KK619 KK619 LENOV LENOV

KK616 KK616 KK618 KK618
KK618 KK618 BABKO BABKO

KK617 KK617 TUSIN TUSIN

KK602 KK602 KK603 KK603
KK603 KK603 KK604 KK604

KK604 KK604 IVMEM IVMEM
IVMEM IVMEM EMBIK EMBIK


EPRA 07 RAD RAD RA701 RA701
RA701 RA701 RA702 RA702
RA702 RA702 RA703 RA703
RA703 RA703 KURAV KURAV
RA702 RA702 OMAVA OMAVA

EPRA 25 RAD RAD RA601 RA601
RA601 RA601 RA602 RA602
RA602 RA602 RA603 RA603
RA603 RA603 KURAV KURAV
RA602 RA602 OMAVA OMAVA

EPRZ 09 N050.06.32.915 E022.02.51.640 N050.06.33.119 E022.05.24.589 
N050.06.33.119 E022.05.24.589 N050.06.42.106 E022.06.30.867 
N050.06.42.106 E022.06.30.867 N050.06.59.352 E022.07.28.794 
N050.06.59.352 E022.07.28.794 N050.07.27.319 E022.08.24.628 
N050.07.27.319 E022.08.24.628 N050.07.58.264 E022.09.10.290 
N050.07.58.264 E022.09.10.290 N050.08.31.977 E022.09.48.155 
N050.08.31.977 E022.09.48.155 N050.09.02.883 E022.10.08.741 
N050.09.02.883 E022.10.08.741 N050.10.00.447 E022.10.24.164 
N050.10.00.447 E022.10.24.164 N050.14.35.295 E022.11.42.815 
N050.14.35.295 E022.11.42.815 N050.18.04.339 E022.16.20.588 
N050.18.04.339 E022.16.20.588 N050.29.19.680 E022.31.14.112 
N050.06.33.119 E022.05.24.589 N050.06.29.360 E022.07.01.709 
N050.06.29.360 E022.07.01.709 N050.06.27.549 E022.09.09.462 
N050.06.27.549 E022.09.09.462 N050.06.14.919 E022.10.16.997 
N050.06.14.919 E022.10.16.997 N050.05.38.911 E022.11.49.609 
N050.05.38.911 E022.11.49.609 N050.04.16.155 E022.13.55.176 
N050.04.16.155 E022.13.55.176 N049.59.26.545 E022.41.59.258

EPRZ 27 N050.06.38.315 E021.59.20.093 N050.06.42.565 E021.52.07.993 
N050.06.42.565 E021.52.07.993 N050.06.43.286 E021.51.23.349 
N050.06.43.286 E021.51.23.349 N050.06.32.023 E021.50.27.947 
N050.06.32.023 E021.50.27.947 N050.06.02.698 E021.49.21.072 
N050.06.02.698 E021.49.21.072 N050.05.23.963 E021.48.34.844 
N050.05.23.963 E021.48.34.844 N050.04.50.553 E021.48.20.114 
N050.04.50.553 E021.48.20.114 N050.04.11.752 E021.48.13.806 
N050.04.11.752 E021.48.13.806 N050.03.29.549 E021.48.24.313 
N050.03.29.549 E021.48.24.313 N050.02.49.768 E021.48.56.358 
N050.02.49.768 E021.48.56.358 N050.02.14.700 E021.50.03.599 
N050.02.14.700 E021.50.03.599 N050.01.57.838 E021.51.09.265 
N050.01.57.838 E021.51.09.265 N050.01.55.139 E021.52.17.031 
N050.01.55.139 E021.52.17.031 N050.02.07.618 E021.53.28.475 
N050.02.07.618 E021.53.28.475 N050.02.35.275 E021.54.40.064 
N050.02.35.275 E021.54.40.064 N050.03.46.118 E021.56.30.676 
N050.03.46.118 E021.56.30.676 N050.06.29.101 E022.01.10.189 
N050.06.29.101 E022.01.10.189 N050.29.21.021 E022.31.12.320 
N050.06.34.516 E021.50.40.208 N050.06.30.581 E021.50.07.784 
N050.06.30.581 E021.50.07.784 N050.06.31.318 E021.49.14.605 
N050.06.31.318 E021.49.14.605 N050.06.24.618 E021.01.52.891 

EPMO 08 FOXTROT N052.27.13.092 E020.41.03.677 N052.27.22.120 E020.42.06.845
N052.27.22.120 E020.42.06.845 N052.27.29.924 E020.42.54.352
N052.27.29.924 E020.42.54.352 N052.27.38.460 E020.43.20.579
N052.27.38.460 E020.43.20.579 N052.27.51.126 E020.43.45.901
N052.27.51.126 E020.43.45.901 N052.28.03.791 E020.44.03.536
N052.28.03.791 E020.44.03.536 N052.28.18.381 E020.44.18.458
N052.28.18.381 E020.44.18.458 N052.28.37.375 E020.44.30.667
N052.28.37.375 E020.44.30.667 N052.28.51.215 E020.44.36.575
N052.28.51.215 E020.44.36.575 N052.29.08.024 E020.44.38.836
N052.29.08.024 E020.44.38.836 N052.29.35.319 E020.44.34.314
N052.29.35.319 E020.44.34.314 N052.30.13.449 E020.44.23.677
N052.30.13.449 E020.44.23.677 N052.32.22.907 E020.43.43.246
N052.32.22.907 E020.43.43.246 N052.33.23.972 E020.44.36.316
N052.33.23.972 E020.44.36.316 N052.33.41.619 E020.44.56.249
N052.33.41.619 E020.44.56.249 N052.33.59.264 E020.45.29.281
N052.33.59.264 E020.45.29.281 N052.34.15.869 E020.46.30.788
N052.34.15.869 E020.46.30.788 N052.34.32.882 E020.48.03.104
N052.34.32.882 E020.48.03.104 N052.35.29.609 E020.54.41.805
N052.35.29.609 E020.54.41.805 N052.35.33.841 E020.55.26.238
N052.35.33.841 E020.55.26.238 N052.35.34.173 E020.55.58.157
N052.35.34.173 E020.55.58.157 N052.35.31.451 E020.56.48.375
N052.35.31.451 E020.56.48.375 N052.35.25.190 E020.57.40.387
N052.35.25.190 E020.57.40.387 N052.34.52.500 E020.59.26.355
N052.34.52.500 E020.59.26.355 N052.33.42.400 E021.02.52.800
N052.33.42.400 E021.02.52.800 N052.22.58.300 E021.16.40.300
N052.22.58.300 E021.16.40.300 N052.19.49.000 E021.20.42.000
N052.32.34.808 E020.43.53.587 N052.33.01.743 E020.44.03.349
N052.33.01.743 E020.44.03.349 N052.33.27.493 E020.43.59.376
N052.33.27.493 E020.43.59.376 N052.33.56.179 E020.43.45.704
N052.33.56.179 E020.43.45.704 N052.34.25.921 E020.43.16.157
N052.34.25.921 E020.43.16.157 N052.34.45.760 E020.42.39.107
N052.34.45.760 E020.42.39.107 N052.36.27.700 E020.37.26.200
N052.36.27.700 E020.37.26.200 N052.42.16.000 E020.19.42.000
N052.19.49.000 E021.20.42.000 N052.15.52.049 E021.38.49.690
N052.15.52.049 E021.38.49.690 N052.15.42.348 E021.39.45.995
N052.15.42.348 E021.39.45.995 N052.15.40.300 E021.40.41.479
N052.15.40.300 E021.40.41.479 N052.15.41.470 E021.41.48.920
N052.15.41.470 E021.41.48.920 N052.15.52.295 E021.42.54.926
N052.15.52.295 E021.42.54.926 N052.16.06.922 E021.43.59.019
N052.16.06.922 E021.43.59.019 N052.20.09.000 E021.54.35.000
N052.26.01.672 E021.12.45.057 N052.25.20.800 E021.13.27.590
N052.25.20.800 E021.13.27.590 N052.24.56.291 E021.13.44.282
N052.24.56.291 E021.13.44.282 N052.24.26.689 E021.13.57.939
N052.24.26.689 E021.13.57.939 N052.24.01.709 E021.14.03.250
N052.24.01.709 E021.14.03.250 N052.23.35.336 E021.14.05.526
N052.23.35.336 E021.14.05.526 N052.23.07.056 E021.14.00.964
N052.23.07.056 E021.14.00.964 N052.22.30.491 E021.13.48.824
N052.22.30.491 E021.13.48.824 N052.22.02.658 E021.13.30.577
N052.22.02.658 E021.13.30.577 N052.21.27.868 E021.12.57.914
N052.21.27.868 E021.12.57.914 N052.20.47.987 E021.12.03.251
N052.20.47.987 E021.12.03.251 N052.09.48.500 E020.49.39.600
N052.09.48.500 E020.49.39.600 N051.56.56.000 E020.34.20.000
N051.56.56.000 E020.34.20.000 N051.48.22.000 E020.29.20.000
N051.48.22.000 E020.29.20.000 N051.39.11.000 E020.24.00.000
N051.39.11.000 E020.24.00.000 N051.23.16.000 E020.21.36.000
N052.09.48.500 E020.49.39.600 N052.01.37.000 E020.32.52.000
N052.01.37.000 E020.32.52.000 N052.02.01.700 E020.18.33.600
N052.02.01.700 E020.18.33.600 N052.02.38.000 E019.56.06.000
N052.12.09.822 E020.54.27.066 N052.11.32.209 E020.53.39.561
N052.11.32.209 E020.53.39.561 N052.11.03.093 E020.53.10.483
N052.11.03.093 E020.53.10.483 N052.10.27.736 E020.52.53.896
N052.10.27.736 E020.52.53.896 N052.09.50.507 E020.52.44.542
N052.09.50.507 E020.52.44.542 N052.09.19.114 E020.52.45.985
N052.09.19.114 E020.52.45.985 N052.08.47.660 E020.52.54.643
N052.08.47.660 E020.52.54.643 N052.08.07.788 E020.53.15.567
N052.08.07.788 E020.53.15.567 N052.07.30.118 E020.53.53.796
N052.07.30.118 E020.53.53.796 N052.06.56.485 E020.54.45.722
N052.06.56.485 E020.54.45.722 N052.01.13.200 E021.04.47.700
N052.01.13.200 E021.04.47.700 N051.39.21.000 E021.25.40.000
N052.02.44.913 E020.35.11.041 N052.02.18.855 E020.33.59.553
N052.02.18.855 E020.33.59.553 N052.02.12.971 E020.33.30.839
N052.02.12.971 E020.33.30.839 N052.02.06.048 E020.32.45.798
N052.02.06.048 E020.32.45.798 N052.02.02.933 E020.31.52.875
N052.02.02.933 E020.31.52.875 N052.02.08.471 E020.30.37.995
N052.02.08.471 E020.30.37.995 N052.02.19.547 E020.29.42.820
N052.02.19.547 E020.29.42.820 N052.04.44.300 E020.18.58.000
N052.04.44.300 E020.18.58.000 N052.10.39.000 E019.52.17.000


EPMO 08 CHARLIE N052.27.15.513 E020.41.50.329 N052.27.42.239 E020.46.32.322
N052.27.42.239 E020.46.32.322 N052.27.49.158 E020.46.56.523
N052.27.49.158 E020.46.56.523 N052.27.58.548 E020.47.18.112
N052.27.58.548 E020.47.18.112 N052.28.10.753 E020.47.39.187
N052.28.10.753 E020.47.39.187 N052.28.26.712 E020.47.57.692
N052.28.26.712 E020.47.57.692 N052.28.44.548 E020.48.13.627
N052.28.44.548 E020.48.13.627 N052.29.04.258 E020.48.24.936
N052.29.04.258 E020.48.24.936 N052.29.17.767 E020.48.26.689
N052.29.17.767 E020.48.26.689 N052.30.57.574 E020.48.04.719
N052.30.57.574 E020.48.04.719 N052.31.44.684 E020.47.49.428
N052.31.44.684 E020.47.49.428 N052.32.18.955 E020.47.19.228
N052.32.18.955 E020.47.19.228 N052.32.43.926 E020.46.44.879
N052.32.43.926 E020.46.44.879 N052.33.10.021 E020.46.04.838
N052.33.10.021 E020.46.04.838 N052.33.38.521 E020.45.20.793
N052.33.38.521 E020.45.20.793 N052.34.06.669 E020.44.27.595
N052.34.06.669 E020.44.27.595 N052.34.27.515 E020.43.31.537
N052.34.27.515 E020.43.31.537 N052.36.27.700 E020.37.26.200
N052.36.27.700 E020.37.26.200 N052.42.16.000 E020.19.42.000
N052.30.16.427 E020.48.13.778 N052.30.53.038 E020.48.13.932
N052.30.53.038 E020.48.13.932 N052.31.25.648 E020.48.23.955
N052.31.25.648 E020.48.23.955 N052.32.04.344 E020.48.48.010
N052.32.04.344 E020.48.48.010 N052.32.38.767 E020.49.26.599
N052.32.38.767 E020.49.26.599 N052.32.59.873 E020.50.02.208
N052.32.59.873 E020.50.02.208 N052.34.36.868 E020.53.51.322
N052.34.36.868 E020.53.51.322 N052.34.59.614 E020.54.52.211
N052.34.59.614 E020.54.52.211 N052.35.08.494 E020.55.40.580
N052.35.08.494 E020.55.40.580 N052.35.13.275 E020.56.35.135
N052.35.13.275 E020.56.35.135 N052.35.11.909 E020.57.34.752
N052.35.11.909 E020.57.34.752 N052.35.07.469 E020.58.29.308
N052.35.07.469 E020.58.29.308 N052.34.57.223 E020.59.09.240
N052.34.57.223 E020.59.09.240 N052.33.42.400 E021.02.52.800
N052.33.42.400 E021.02.52.800 N052.22.58.300 E021.16.40.300
N052.22.58.300 E021.16.40.300 N052.19.49.000 E021.20.42.000
N052.02.38.000 E019.56.06.000 N052.02.01.700 E020.18.33.600
N052.02.01.700 E020.18.33.600 N052.01.37.000 E020.32.52.000
N052.01.37.000 E020.32.52.000 N052.09.48.500 E020.49.39.600
N052.09.48.500 E020.49.39.600 N052.15.34.700 E021.01.26.600
N052.10.39.000 E019.52.17.000 N052.04.44.300 E020.18.58.000
N052.04.44.300 E020.18.58.000 N052.01.37.000 E020.32.52.000
N052.25.55.483 E021.12.53.001 N052.25.13.509 E021.13.32.432
N052.25.13.509 E021.13.32.432 N052.24.34.980 E021.13.51.825
N052.24.34.980 E021.13.51.825 N052.23.56.381 E021.14.03.322
N052.23.56.381 E021.14.03.322 N052.23.19.148 E021.14.04.759
N052.23.19.148 E021.14.04.759 N052.22.42.297 E021.13.57.570
N052.22.42.297 E021.13.57.570 N052.22.08.944 E021.13.41.744
N052.22.08.944 E021.13.41.744 N052.21.32.524 E021.13.10.143
N052.21.32.524 E021.13.10.143 N052.20.48.620 E021.12.11.189
N052.20.48.620 E021.12.11.189 N052.15.34.700 E021.01.26.600
N052.16.59.100 E021.04.19.779 N052.16.33.000 E021.03.32.569
N052.16.33.000 E021.03.32.569 N052.15.59.677 E021.02.58.097
N052.15.59.677 E021.02.58.097 N052.15.30.725 E021.02.34.712
N052.15.30.725 E021.02.34.712 N052.14.56.670 E021.02.14.122
N052.14.56.670 E021.02.14.122 N052.14.21.934 E021.01.58.524
N052.14.21.934 E021.01.58.524 N052.13.47.854 E021.01.56.855
N052.13.47.854 E021.01.56.855 N052.12.36.315 E021.02.07.913
N052.12.36.315 E021.02.07.913 N052.01.13.200 E021.04.47.700
N052.01.13.200 E021.04.47.700 N051.39.21.000 E021.25.40.000
N052.09.48.500 E020.49.39.600 N051.56.56.000 E020.34.20.000
N051.56.56.000 E020.34.20.000 N051.48.22.000 E020.29.20.000
N051.48.22.000 E020.29.20.000 N051.39.11.000 E020.24.00.000
N051.39.11.000 E020.24.00.000 N051.23.16.000 E020.21.36.000
N052.19.49.000 E021.20.42.000 N052.15.49.976 E021.38.52.740
N052.15.49.976 E021.38.52.740 N052.15.41.920 E021.39.42.604
N052.15.41.920 E021.39.42.604 N052.15.41.344 E021.40.29.646
N052.15.41.344 E021.40.29.646 N052.15.43.646 E021.41.32.682
N052.15.43.646 E021.41.32.682 N052.15.50.552 E021.42.43.245
N052.15.50.552 E021.42.43.245 N052.16.04.938 E021.43.48.162
N052.16.04.938 E021.43.48.162 N052.16.20.473 E021.44.34.263
N052.16.20.473 E021.44.34.263 N052.20.09.000 E021.54.35.000

EPMO 08 BRAVO MOL MOL MO866 MO866
MO866 MO866 MO822 MO822
MO822 MO822 MO864 MO864
MO864 MO864 MOL MOL
MOL MOL MO946 MO946
MO946 MO946 MO947 MO947
MO947 MO947 BITVA BITVA
BITVA BITVA WA571 WA571
WA571 WA571 BAMSO BAMSO


MO822 MO822 RODEV RODEV
RODEV RODEV OLILA OLILA

MO947 MO947 MO362 MO362
MO362 MO362 WA708 WA708
WA708 WA708 MAKUS MAKUS
MAKUS MAKUS WA754 WA754
WA754 WA754 LOLSI LOLSI

MAKUS MAKUS WA756 WA756
WA756 WA756 SOXER SOXER

MAKUS MAKUS EVDEX EVDEX
EVDEX EVDEX NIPUS NIPUS
NIPUS NIPUS EVINA EVINA

EVDEX EVDEX EREDA EREDA
EREDA EREDA XENOM XENOM
XENOM XENOM TISTA TISTA
TISTA TISTA XIMBA XIMBA

EPMO 08 ECHO MOL MOL MO866 MO866
MO866 MO866 MO822 MO822
MO822 MO822 MO864 MO864
MO864 MO864 MOL MOL
MOL MOL MO946 MO946
MO946 MO946 MO947 MO947
MO947 MO947 BITVA BITVA
BITVA BITVA WA571 WA571
WA571 WA571 BAMSO BAMSO

MO822 MO822 RODEV RODEV
RODEV RODEV OLILA OLILA

MO947 MO947 MO362 MO362
MO362 MO362 WA708 WA708
WA708 WA708 MAKUS MAKUS
MAKUS MAKUS WA754 WA754
WA754 WA754 LOLSI LOLSI

MAKUS MAKUS WA756 WA756
WA756 WA756 SOXER SOXER

MAKUS MAKUS EVDEX EVDEX
EVDEX EVDEX NIPUS NIPUS
NIPUS NIPUS EVINA EVINA

BITVA BITVA MO956 MO956
MO956 MO956 MO948 MO948
MO948 MO948 XIMBA XIMBA

EPMO 26 JULIETT N052.26.56.809 E020.37.41.716 N052.26.46.375 E020.35.38.499
N052.26.46.375 E020.35.38.499 N052.26.45.313 E020.34.58.375
N052.26.45.313 E020.34.58.375 N052.26.47.438 E020.34.25.229
N052.26.47.438 E020.34.25.229 N052.26.53.814 E020.33.53.828
N052.26.53.814 E020.33.53.828 N052.27.03.731 E020.33.20.682
N052.27.03.731 E020.33.20.682 N052.27.21.793 E020.32.41.139
N052.27.21.793 E020.32.41.139 N052.27.52.280 E020.32.07.944
N052.27.52.280 E020.32.07.944 N052.28.19.926 E020.31.49.315
N052.28.19.926 E020.31.49.315 N052.28.51.475 E020.31.42.917
N052.28.51.475 E020.31.42.917 N052.29.31.516 E020.31.53.968
N052.29.31.516 E020.31.53.968 N052.29.56.991 E020.32.13.739
N052.29.56.991 E020.32.13.739 N052.30.17.156 E020.32.41.651
N052.30.17.156 E020.32.41.651 N052.30.38.025 E020.33.25.264
N052.30.38.025 E020.33.25.264 N052.30.48.636 E020.34.00.155
N052.30.48.636 E020.34.00.155 N052.30.54.648 E020.34.45.512
N052.30.54.648 E020.34.45.512 N052.30.55.002 E020.35.48.315
N052.30.55.002 E020.35.48.315 N052.30.48.282 E020.36.29.602
N052.30.48.282 E020.36.29.602 N052.30.32.720 E020.37.10.889
N052.30.32.720 E020.37.10.889 N052.30.10.072 E020.37.52.249
N052.30.10.072 E020.37.52.249 N052.29.28.290 E020.38.31.255
N052.29.28.290 E020.38.31.255 N052.27.08.793 E020.40.36.794
N052.27.08.793 E020.40.36.794 N052.25.06.400 E020.48.20.100
N052.29.46.770 E020.32.05.806 N052.30.39.584 E020.32.37.275
N052.30.39.584 E020.32.37.275 N052.33.21.320 E020.34.15.618
N052.33.21.320 E020.34.15.618 N052.36.12.000 E020.33.27.000
N052.36.12.000 E020.33.27.000 N052.42.16.000 E020.19.42.000
N052.26.46.339 E020.35.37.113 N052.26.39.277 E020.34.53.737
N052.26.39.277 E020.34.53.737 N052.26.28.446 E020.34.23.028
N052.26.28.446 E020.34.23.028 N052.26.12.198 E020.33.49.086
N052.26.12.198 E020.33.49.086 N052.25.52.502 E020.33.16.760
N052.25.52.502 E020.33.16.760 N052.24.18.100 E020.24.34.600
N052.24.18.100 E020.24.34.600 N052.23.27.100 E020.19.48.500
N052.23.27.100 E020.19.48.500 N052.14.09.600 E020.11.35.100
N052.14.09.600 E020.11.35.100 N052.02.38.000 E019.56.06.000
N052.15.09.559 E020.12.28.083 N052.14.45.999 E020.12.00.238
N052.14.45.999 E020.12.00.238 N052.14.29.663 E020.11.36.281
N052.14.29.663 E020.11.36.281 N052.14.12.907 E020.11.02.741
N052.14.12.907 E020.11.02.741 N052.13.56.150 E020.10.00.453
N052.13.56.150 E020.10.00.453 N052.10.39.000 E019.52.17.000
N052.15.13.326 E020.12.31.412 N052.14.44.835 E020.12.24.031
N052.14.44.835 E020.12.24.031 N052.14.11.191 E020.12.20.637
N052.14.11.191 E020.12.20.637 N052.13.44.107 E020.12.20.633
N052.13.44.107 E020.12.20.633 N052.13.16.269 E020.12.28.778
N052.13.16.269 E020.12.28.778 N052.12.35.483 E020.12.54.589
N052.12.35.483 E020.12.54.589 N051.56.47.000 E020.26.41.000
N051.56.47.000 E020.26.41.000 N051.55.36.000 E020.31.32.000
N051.55.36.000 E020.31.32.000 N051.50.54.000 E020.38.04.000
N051.56.47.000 E020.26.41.000 N051.39.11.000 E020.24.00.000
N051.39.11.000 E020.24.00.000 N051.23.16.000 E020.21.36.000
N051.50.54.000 E020.38.04.000 N051.47.01.622 E020.43.39.312
N051.47.01.622 E020.43.39.312 N051.46.35.632 E020.44.25.416
N051.46.35.632 E020.44.25.416 N051.46.14.669 E020.45.15.587
N051.46.14.669 E020.45.15.587 N051.45.58.735 E020.46.24.742
N051.45.58.735 E020.46.24.742 N051.45.49.509 E020.47.59.660
N051.45.49.509 E020.47.59.660 N051.44.56.000 E021.08.50.500
N051.44.56.000 E021.08.50.500 N051.39.21.000 E021.25.40.000
N052.25.06.400 E020.48.20.100 N052.25.24.506 E020.55.07.194
N052.25.24.506 E020.55.07.194 N052.25.20.198 E020.55.54.314
N052.25.20.198 E020.55.54.314 N052.25.09.429 E020.56.42.612
N052.25.09.429 E020.56.42.612 N052.24.48.606 E020.57.46.223
N052.24.48.606 E020.57.46.223 N052.20.46.000 E021.05.11.000
N052.20.46.000 E021.05.11.000 N052.19.44.000 E021.26.32.000
N052.19.44.000 E021.26.32.000 N052.20.09.000 E021.54.35.000

EPMO 26 MIKE N052.26.54.087 E020.37.15.957 N052.26.45.209 E020.35.49.894
N052.26.45.209 E020.35.49.894 N052.26.45.209 E020.34.59.922
N052.26.45.209 E020.34.59.922 N052.26.48.591 E020.34.10.644
N052.26.48.591 E020.34.10.644 N052.27.01.697 E020.33.24.142
N052.27.01.697 E020.33.24.142 N052.27.27.058 E020.32.33.475
N052.27.27.058 E020.32.33.475 N052.28.02.136 E020.32.01.549
N052.28.02.136 E020.32.01.549 N052.28.27.183 E020.31.49.002
N052.28.27.183 E020.31.49.002 N052.28.56.334 E020.31.45.532
N052.28.56.334 E020.31.45.532 N052.29.27.679 E020.31.55.266
N052.29.27.679 E020.31.55.266 N052.30.01.040 E020.32.20.947
N052.30.01.040 E020.32.20.947 N052.30.23.840 E020.32.54.261
N052.30.23.840 E020.32.54.261 N052.30.41.603 E020.33.44.961
N052.30.41.603 E020.33.44.961 N052.30.51.734 E020.34.33.545
N052.30.51.734 E020.34.33.545 N052.30.53.422 E020.35.25.599
N052.30.53.422 E020.35.25.599 N052.30.48.779 E020.36.14.183
N052.30.48.779 E020.36.14.183 N052.30.32.737 E020.37.05.544
N052.30.32.737 E020.37.05.544 N052.30.08.672 E020.37.50.657
N052.30.08.672 E020.37.50.657 N052.29.20.530 E020.38.39.936
N052.29.20.530 E020.38.39.936 N052.27.09.838 E020.40.39.450
N052.27.09.838 E020.40.39.450 N052.25.06.400 E020.48.20.100
N052.26.45.209 E020.35.49.894 N052.26.36.634 E020.34.47.988
N052.26.36.634 E020.34.47.988 N052.26.26.547 E020.34.24.071
N052.26.26.547 E020.34.24.071 N052.26.15.712 E020.33.57.702
N052.26.15.712 E020.33.57.702 N052.25.51.425 E020.33.19.068
N052.25.51.425 E020.33.19.068 N052.24.50.469 E020.27.41.621
N052.30.02.877 E020.32.23.631 N052.33.20.613 E020.34.17.168
N052.33.20.613 E020.34.17.168 N052.35.39.781 E020.33.31.333
N052.35.39.781 E020.33.31.333 N052.35.55.192 E020.33.24.251
N052.35.55.192 E020.33.24.251 N052.36.16.448 E020.33.04.796
N052.36.16.448 E020.33.04.796 N052.36.36.521 E020.32.25.886
N052.36.36.521 E020.32.25.886 N052.37.41.564 E020.29.54.982
N052.37.41.564 E020.29.54.982 N052.42.16.000 E020.19.42.000
N052.24.50.469 E020.27.41.621 N052.24.18.100 E020.24.34.600
N052.24.18.100 E020.24.34.600 N052.23.37.076 E020.20.59.286
N052.23.37.076 E020.20.59.286 N052.23.28.067 E020.20.25.688
N052.23.28.067 E020.20.25.688 N052.23.20.550 E020.20.08.174
N052.23.20.550 E020.20.08.174 N052.23.06.702 E020.19.38.335
N052.23.06.702 E020.19.38.335 N052.22.49.292 E020.19.17.578
N052.22.49.292 E020.19.17.578 N052.22.32.275 E020.18.58.767
N052.22.32.275 E020.18.58.767 N052.14.09.600 E020.11.35.100
N052.14.09.600 E020.11.35.100 N052.02.38.000 E019.56.06.000
N052.15.25.074 E020.12.41.625 N052.14.50.807 E020.12.26.538
N052.14.50.807 E020.12.26.538 N052.14.20.500 E020.12.22.678
N052.14.20.500 E020.12.22.678 N052.13.42.313 E020.12.25.251
N052.13.42.313 E020.12.25.251 N052.13.11.882 E020.12.33.688
N052.13.11.882 E020.12.33.688 N052.12.34.860 E020.12.57.486
N052.12.34.860 E020.12.57.486 N051.56.47.000 E020.26.41.000
N051.56.47.000 E020.26.41.000 N051.39.11.000 E020.24.00.000
N051.39.11.000 E020.24.00.000 N051.23.16.000 E020.21.36.000
N052.15.22.515 E020.12.39.369 N052.14.55.010 E020.12.07.734
N052.14.55.010 E020.12.07.734 N052.14.34.049 E020.11.41.591
N052.14.34.049 E020.11.41.591 N052.14.15.843 E020.11.02.827
N052.14.15.843 E020.11.02.827 N052.13.58.187 E020.10.07.837
N052.13.58.187 E020.10.07.837 N052.10.39.000 E019.52.17.000
N052.25.06.400 E020.48.20.100 N052.25.22.239 E020.54.38.284
N052.25.22.239 E020.54.38.284 N052.25.20.132 E020.55.32.726
N052.25.20.132 E020.55.32.726 N052.25.13.812 E020.56.18.527
N052.25.13.812 E020.56.18.527 N052.25.00.644 E020.57.09.513
N052.25.00.644 E020.57.09.513 N052.24.43.787 E020.57.49.264
N052.24.43.787 E020.57.49.264 N052.20.46.000 E021.05.11.000
N052.20.46.000 E021.05.11.000 N052.12.12.300 E021.14.29.200
N052.12.12.300 E021.14.29.200 N051.54.21.460 E021.29.59.054
N051.54.21.460 E021.29.59.054 N051.53.26.804 E021.30.31.373
N051.53.26.804 E021.30.31.373 N051.52.50.638 E021.30.38.702
N051.52.50.638 E021.30.38.702 N051.52.00.143 E021.30.41.145
N051.52.00.143 E021.30.41.145 N051.51.10.386 E021.30.28.930
N051.51.10.386 E021.30.28.930 N051.39.21.000 E021.25.40.000
N052.21.35.980 E021.03.38.207 N052.21.03.959 E021.04.47.852
N052.21.03.959 E021.04.47.852 N052.20.49.023 E021.05.42.222
N052.20.49.023 E021.05.42.222 N052.20.38.235 E021.07.29.601
N052.20.38.235 E021.07.29.601 N052.19.44.000 E021.26.32.000
N052.19.44.000 E021.26.32.000 N052.20.09.000 E021.54.35.000

EPWA 29 N052.10.17.348 E020.56.48.003 N052.10.49.500 E020.54.53.200
N052.10.49.500 E020.54.53.200 N052.10.58.952 E020.54.20.266
N052.10.49.500 E020.54.53.200 N052.10.57.812 E020.54.24.231
N052.10.57.812 E020.54.24.231 N052.11.06.967 E020.53.58.473
N052.11.06.967 E020.53.58.473 N052.11.19.812 E020.53.36.929
N052.11.19.812 E020.53.36.929 N052.11.36.492 E020.53.18.427
N052.11.36.492 E020.53.18.427 N052.11.51.499 E020.53.03.553
N052.11.51.499 E020.53.03.553 N052.12.08.517 E020.52.53.763
N052.12.08.517 E020.52.53.763 N052.12.25.240 E020.52.47.986
N052.12.25.240 E020.52.47.986 N052.12.44.265 E020.52.46.315
N052.12.44.265 E020.52.46.315 N052.13.07.209 E020.52.42.990
N052.13.07.209 E020.52.42.990 N052.15.54.600 E020.47.57.000
N052.15.54.600 E020.47.57.000 N052.16.26.497 E020.47.04.642
N052.16.26.497 E020.47.04.642 N052.16.54.689 E020.46.35.436
N052.16.54.689 E020.46.35.436 N052.17.27.601 E020.46.17.566
N052.17.27.601 E020.46.17.566 N052.18.04.911 E020.46.18.705
N052.18.04.911 E020.46.18.705 N052.18.39.519 E020.46.32.446
N052.18.39.519 E020.46.32.446 N052.19.07.123 E020.46.47.928
N052.19.07.123 E020.46.47.928 N052.19.34.217 E020.47.10.932
N052.19.34.217 E020.47.10.932 N052.19.50.277 E020.47.29.672
N052.19.50.277 E020.47.29.672 N052.20.07.711 E020.47.56.643
N052.20.07.711 E020.47.56.643 N052.20.20.734 E020.48.26.893
N052.20.20.734 E020.48.26.893 N052.20.30.702 E020.49.00.918
N052.20.30.702 E020.49.00.918 N052.20.38.594 E020.49.47.052
N052.20.38.594 E020.49.47.052 N052.20.41.927 E020.50.38.562
N052.20.41.927 E020.50.38.562 N052.20.44.672 E020.51.41.223
N052.20.44.672 E020.51.41.223 N052.20.46.769 E020.53.26.950
N052.20.46.769 E020.53.26.950 N052.20.47.612 E020.55.11.422
N052.20.47.612 E020.55.11.422 N052.20.46.000 E021.05.11.300
N052.20.46.000 E021.05.11.300 N052.19.44.000 E021.26.32.000
N052.19.44.000 E021.26.32.000 N052.20.09.100 E021.54.34.500
N052.17.27.601 E020.46.17.566 N052.18.03.744 E020.46.15.266
N052.18.03.744 E020.46.15.266 N052.20.48.400 E020.46.26.000
N051.45.58.000 E020.44.55.000 N051.44.56.000 E021.08.50.500
N051.44.56.000 E021.08.50.500 N051.39.21.000 E021.25.40.000
N051.56.47.000 E020.26.41.000 N051.39.11.000 E020.24.00.000
N051.39.11.000 E020.24.00.000 N051.23.16.000 E020.21.36.000
N052.09.10.000 E020.30.03.000 N052.02.38.000 E019.56.06.000
N052.09.10.000 E020.30.03.000 N052.10.39.000 E019.52.17.000
N052.10.58.952 E020.54.20.266 N052.11.05.262 E020.53.46.126
N052.11.05.262 E020.53.46.126 N052.11.06.499 E020.53.24.255
N052.11.06.499 E020.53.24.255 N052.11.05.468 E020.52.54.644
N052.11.05.468 E020.52.54.644 N052.11.01.963 E020.52.25.033
N052.11.01.963 E020.52.25.033 N052.10.45.600 E020.50.06.400
N052.10.45.600 E020.50.06.400 N052.11.51.900 E020.42.14.400
N052.11.51.900 E020.42.14.400 N052.09.10.000 E020.30.03.000
N052.20.48.400 E020.46.26.000 N052.28.41.550 E020.47.19.265
N052.28.41.550 E020.47.19.265 N052.29.19.813 E020.47.15.052
N052.29.19.813 E020.47.15.052 N052.29.44.727 E020.47.01.025
N052.29.44.727 E020.47.01.025 N052.30.17.897 E020.46.30.649
N052.30.17.897 E020.46.30.649 N052.30.44.643 E020.45.40.357
N052.30.44.643 E020.45.40.357 N052.36.12.000 E020.33.27.000
N052.36.12.000 E020.33.27.000 N052.42.16.000 E020.19.42.000
N052.10.49.500 E020.54.53.200 N052.10.54.548 E020.54.19.433
N052.10.54.548 E020.54.19.433 N052.10.53.917 E020.53.43.273
N052.10.53.917 E020.53.43.273 N052.10.49.477 E020.53.10.399
N052.10.49.477 E020.53.10.399 N052.10.40.697 E020.52.34.756
N052.10.40.697 E020.52.34.756 N052.10.29.384 E020.51.56.803
N052.10.29.384 E020.51.56.803 N052.09.25.100 E020.42.37.800
N052.09.25.100 E020.42.37.800 N051.56.46.500 E020.26.40.600
N051.57.53.802 E020.28.05.527 N051.57.29.596 E020.27.48.098
N051.57.29.596 E020.27.48.098 N051.57.15.811 E020.27.40.961
N051.57.15.811 E020.27.40.961 N051.57.00.488 E020.27.37.189
N051.57.00.488 E020.27.37.189 N051.56.45.289 E020.27.37.729
N051.56.45.289 E020.27.37.729 N051.56.30.514 E020.27.42.869
N051.56.30.514 E020.27.42.869 N051.56.16.555 E020.27.50.631
N051.56.16.555 E020.27.50.631 N051.56.02.467 E020.28.01.413
N051.56.02.467 E020.28.01.413 N051.55.47.213 E020.28.20.499
N051.55.47.213 E020.28.20.499 N051.45.57.500 E020.44.54.500

EPWA 15 N052.08.57.619 E020.58.53.282 N052.07.36.000 E021.00.04.500
N052.07.36.000 E021.00.04.500 N052.07.28.238 E021.00.02.816
N052.07.28.238 E021.00.02.816 N052.07.25.663 E021.00.01.977
N052.07.25.663 E021.00.01.977 N052.07.17.489 E020.59.56.323
N052.07.17.489 E020.59.56.323 N052.02.08.800 E020.55.28.400
N052.07.36.000 E021.00.04.500 N052.07.32.643 E021.00.13.757
N052.07.32.643 E021.00.13.757 N052.07.30.674 E021.00.20.951
N052.07.30.674 E021.00.20.951 N052.07.28.671 E021.00.32.517
N052.07.28.671 E021.00.32.517 N052.06.00.822 E021.08.33.956
N052.06.00.822 E021.08.33.956 N052.05.59.410 E021.08.55.301
N052.05.59.410 E021.08.55.301 N052.06.00.636 E021.09.08.726
N052.06.00.636 E021.09.08.726 N052.06.02.724 E021.09.15.137
N052.06.02.724 E021.09.15.137 N052.06.06.627 E021.09.23.300
N052.06.06.627 E021.09.23.300 N052.06.12.783 E021.09.34.035
N052.06.12.783 E021.09.34.035 N052.06.19.509 E021.09.42.520
N052.06.19.509 E021.09.42.520 N052.06.27.527 E021.09.46.800
N052.06.27.527 E021.09.46.800 N052.06.33.417 E021.09.48.737
N052.06.33.417 E021.09.48.737 N052.06.48.326 E021.09.49.055
N052.06.00.822 E021.08.33.956 N052.05.55.356 E021.09.07.943
N052.05.55.356 E021.09.07.943 N052.05.53.010 E021.09.31.068
N052.05.53.010 E021.09.31.068 N052.05.55.025 E021.09.51.844
N052.05.55.025 E021.09.51.844 N052.06.03.382 E021.10.13.660
N052.06.03.382 E021.10.13.660 N052.06.13.629 E021.10.27.473
N052.06.13.629 E021.10.27.473 N052.06.30.788 E021.10.44.995
N052.06.30.788 E021.10.44.995 N052.11.14.200 E021.14.51.900
N052.06.48.326 E021.09.49.055 N052.17.11.831 E021.07.19.649
N052.17.11.831 E021.07.19.649 N052.17.18.191 E021.07.18.677
N052.17.18.191 E021.07.18.677 N052.17.23.561 E021.07.18.876
N052.17.23.561 E021.07.18.876 N052.17.27.438 E021.07.19.567
N052.17.27.438 E021.07.19.567 N052.17.31.190 E021.07.20.824
N052.17.31.190 E021.07.20.824 N052.17.36.978 E021.07.23.770
N052.17.36.978 E021.07.23.770 N052.20.19.502 E021.09.07.225 
N052.20.19.502 E021.09.07.225 N052.20.24.687 E021.09.09.772
N052.20.24.687 E021.09.09.772 N052.20.30.655 E021.09.11.587
N052.20.30.655 E021.09.11.587 N052.20.36.094 E021.09.11.884
N052.20.36.094 E021.09.11.884 N052.20.41.896 E021.09.10.605
N052.20.41.896 E021.09.10.605 N052.20.48.717 E021.09.05.190
N052.20.48.717 E021.09.05.190 N052.29.49.000 E020.57.29.000
N052.11.09.648 E021.14.47.934 N052.11.11.339 E021.14.49.675
N052.11.11.339 E021.14.49.675 N052.11.12.698 E021.14.51.425
N052.11.12.698 E021.14.51.425 N052.11.13.776 E021.14.53.415
N052.11.13.776 E021.14.53.415 N052.11.14.476 E021.14.55.532
N052.11.14.200 E021.14.51.900 N052.15.12.900 E021.41.42.600
N052.15.12.900 E021.41.42.600 N052.20.09.100 E021.54.34.500
N052.29.49.000 E020.57.29.000 N052.42.16.000 E020.19.42.000
N052.02.08.800 E020.55.28.400 N052.01.36.500 E020.32.52.400
N052.01.36.500 E020.32.52.400 N052.10.38.900 E019.52.17.000
N052.01.36.500 E020.32.52.400 N052.02.37.800 E019.56.05.900
N052.02.08.800 E020.55.28.400 N051.56.56.100 E020.34.20.300
N051.56.56.100 E020.34.20.300 N051.39.10.800 E020.23.59.800
N051.39.10.800 E020.23.59.800 N051.23.16.000 E020.21.36.000
N052.07.36.000 E021.00.04.500 N052.00.50.300 E021.02.28.600
N052.00.50.300 E021.02.28.600 N051.39.21.000 E021.25.40.000

EPWA 11 N052.09.39.504 E020.59.02.221 N052.09.06.173 E021.01.02.701
N052.29.49.000 E020.57.29.000 N052.36.27.700 E020.37.26.200
N052.36.27.700 E020.37.26.200 N052.42.16.000 E020.19.42.000
N052.15.12.900 E021.41.42.600 N052.20.09.000 E021.54.35.000
N051.59.54.400 E021.05.43.400 N051.39.21.000 E021.25.40.000
N052.09.06.173 E021.01.02.701 N052.08.59.585 E021.01.22.415
N052.02.13.900 E020.55.55.800 N051.56.56.000 E020.34.20.000
N051.56.56.000 E020.34.20.000 N051.39.11.000 E020.24.00.000
N051.39.11.000 E020.24.00.000 N051.23.16.000 E020.21.36.000
N052.02.13.900 E020.55.55.800 N052.01.37.000 E020.32.52.000
N052.01.37.000 E020.32.52.000 N052.02.38.000 E019.56.06.000
N052.01.37.000 E020.32.52.000 N052.10.39.000 E019.52.17.000
N052.08.58.210 E021.01.26.806 N052.08.43.939 E021.02.14.952
N052.08.43.939 E021.02.14.952 N052.08.42.083 E021.02.28.790
N052.08.42.083 E021.02.28.790 N052.08.40.226 E021.02.55.600
N052.08.40.226 E021.02.55.600 N052.08.39.166 E021.03.33.654
N052.08.39.166 E021.03.33.654 N052.08.41.552 E021.04.00.032
N052.08.41.552 E021.04.00.032 N052.08.45.796 E021.04.24.681
N052.08.45.796 E021.04.24.681 N052.09.16.291 E021.06.38.301
N052.09.16.291 E021.06.38.301 N052.08.45.300 E021.12.08.200
N052.08.45.300 E021.12.08.200 N052.08.44.182 E021.13.05.454
N052.08.44.182 E021.13.05.454 N052.08.48.646 E021.13.44.763
N052.08.48.646 E021.13.44.763 N052.08.58.765 E021.14.32.807
N052.08.58.765 E021.14.32.807 N052.09.12.454 E021.15.02.896
N052.09.12.454 E021.15.02.896 N052.09.32.731 E021.15.33.499
N052.09.32.731 E021.15.33.499 N052.09.50.931 E021.15.55.857
N052.09.50.931 E021.15.55.857 N052.10.13.583 E021.16.11.883
N052.10.13.583 E021.16.11.883 N052.10.42.455 E021.16.22.081
N052.10.42.455 E021.16.22.081 N052.11.10.144 E021.16.22.566
N052.11.10.144 E021.16.22.566 N052.11.39.913 E021.16.14.800
N052.11.39.913 E021.16.14.800 N052.12.02.234 E021.15.57.326
N052.12.02.234 E021.15.57.326 N052.12.26.339 E021.15.31.113
N052.12.26.339 E021.15.31.113 N052.12.46.569 E021.14.55.184
N052.12.46.569 E021.14.55.184 N052.16.37.566 E021.08.36.457
N052.16.37.566 E021.08.36.457 N052.16.54.387 E021.08.20.627
N052.16.54.387 E021.08.20.627 N052.17.24.616 E021.08.06.040
N052.17.24.616 E021.08.06.040 N052.17.52.135 E021.07.57.464
N052.17.52.135 E021.07.57.464 N052.18.14.978 E021.07.54.461
N052.18.14.978 E021.07.54.461 N052.18.38.559 E021.08.01.322
N052.18.38.559 E021.08.01.322 N052.19.19.522 E021.08.28.730
N052.19.19.522 E021.08.28.730 N052.19.50.181 E021.08.43.137
N052.19.50.181 E021.08.43.137 N052.20.07.644 E021.08.44.328
N052.20.07.644 E021.08.44.328 N052.20.34.029 E021.08.41.290
N052.20.34.029 E021.08.41.290 N052.20.58.588 E021.08.30.483
N052.20.58.588 E021.08.30.483 N052.21.25.824 E021.08.13.254
N052.21.25.824 E021.08.13.254 N052.21.59.244 E021.07.31.712
N052.21.59.244 E021.07.31.712 N052.29.49.000 E020.57.29.000
N052.08.58.526 E021.14.31.674 N052.15.12.900 E021.41.42.600
N052.08.59.585 E021.01.22.415 N052.08.58.210 E021.01.26.806
N052.08.46.867 E021.02.05.075 N052.08.28.152 E021.02.47.440
N052.08.28.152 E021.02.47.440 N052.08.11.950 E021.03.10.566
N052.08.11.950 E021.03.10.566 N052.07.51.052 E021.03.33.367
N052.07.51.052 E021.03.33.367 N052.07.29.165 E021.03.46.846
N052.07.29.165 E021.03.46.846 N052.07.03.131 E021.03.57.760
N052.07.03.131 E021.03.57.760 N052.06.31.995 E021.03.58.401
N052.06.31.995 E021.03.58.401 N052.06.06.081 E021.03.48.831
N052.06.06.081 E021.03.48.831 N052.05.38.158 E021.03.32.039
N052.05.38.158 E021.03.32.039 N052.05.21.129 E021.03.14.773
N052.05.21.129 E021.03.14.773 N052.02.54.448 E020.59.33.801
N052.02.54.448 E020.59.33.801 N052.02.13.900 E020.55.55.800
N052.06.31.601 E021.03.58.255 N052.02.41.323 E021.03.29.727
N052.02.41.323 E021.03.29.727 N051.59.54.400 E021.05.43.400

EPWA 33 N052.10.42.886 E020.57.21.113 N052.12.47.100 E020.55.32.500
N052.20.48.400 E020.46.26.000 N052.29.56.000 E020.47.32.000
N052.29.56.000 E020.47.32.000 N052.42.16.000 E020.19.42.000
N051.45.58.000 E020.44.55.000 N051.44.56.000 E021.08.50.500
N051.44.56.000 E021.08.50.500 N051.39.21.000 E021.25.40.000
N051.56.47.000 E020.26.41.000 N051.39.11.000 E020.24.00.000
N051.39.11.000 E020.24.00.000 N051.23.16.000 E020.21.36.000
N052.09.10.000 E020.30.03.000 N052.02.38.000 E019.56.06.000
N052.09.10.000 E020.30.03.000 N052.10.39.000 E019.52.17.000
N052.20.46.000 E021.05.11.000 N052.19.44.000 E021.26.32.000
N052.19.44.000 E021.26.32.000 N052.20.09.000 E021.54.35.000

N052.12.47.100 E020.55.32.500 N052.13.06.800 E020.55.02.218
N052.13.06.800 E020.55.02.218 N052.13.19.617 E020.54.32.874
N052.13.19.617 E020.54.32.874 N052.13.26.422 E020.54.01.852
N052.13.26.422 E020.54.01.852 N052.14.31.682 E020.48.00.291
N052.14.31.682 E020.48.00.291 N052.14.36.936 E020.47.38.915
N052.14.36.936 E020.47.38.915 N052.14.42.968 E020.47.20.128
N052.14.42.968 E020.47.20.128 N052.14.50.215 E020.47.05.751
N052.14.50.215 E020.47.05.751 N052.14.59.585 E020.46.57.028
N052.14.59.585 E020.46.57.028 N052.15.08.675 E020.46.52.908
N052.15.08.675 E020.46.52.908 N052.15.24.942 E020.46.49.245 
N052.15.24.942 E020.46.49.245 N052.20.48.400 E020.46.26.000
N052.20.17.498 E020.46.28.220 N052.20.23.511 E020.46.29.583
N052.20.23.511 E020.46.29.583 N052.20.27.362 E020.46.32.791
N052.20.27.362 E020.46.32.791 N052.20.30.158 E020.46.37.343
N052.20.30.158 E020.46.37.343 N052.20.31.907 E020.46.43.079
N052.20.31.907 E020.46.43.079 N052.20.32.397 E020.46.50.509
N052.20.32.397 E020.46.50.509 N052.20.46.000 E021.05.11.300
N052.12.47.100 E020.55.32.500 N052.13.04.427 E020.55.03.322
N052.13.04.472 E020.55.03.322 N052.13.15.169 E020.54.32.748
N052.13.15.169 E020.54.32.748 N052.13.21.044 E020.54.02.117
N052.13.21.044 E020.54.02.117 N052.13.22.533 E020.53.34.462
N052.13.22.533 E020.53.34.462 N052.13.16.301 E020.52.48.539 
N052.13.16.301 E020.52.48.539 N052.11.16.800 E020.41.21.300
N052.11.16.800 E020.41.21.300 N052.09.10.000 E020.30.03.000
N052.11.16.800 E020.41.21.300 N051.56.46.500 E020.26.40.600
N051.57.11.018 E020.27.05.407 N051.57.02.153 E020.27.00.319
N051.57.02.153 E020.27.00.319 N051.56.55.189 E020.26.59.524
N051.56.55.189 E020.26.59.524 N051.56.47.212 E020.27.01.097
N051.56.47.212 E020.27.01.097 N051.56.39.773 E020.27.04.220
N051.56.39.773 E020.27.04.220 N051.56.31.868 E020.27.11.270
N051.56.31.868 E020.27.11.270 N051.56.24.962 E020.27.21.362
N051.56.24.962 E020.27.21.362 N051.45.57.500 E020.44.54.500


EPLL 25   N051.42.58.400 E019.22.19.900 N051.42.18.630 E019.19.18.090
	N051.42.18.630 E019.19.18.090 N051.42.12.110 E019.18.03.740
	N051.42.12.110 E019.18.03.740 N051.42.23.460 E019.16.50.400
	N051.42.23.460 E019.16.50.400	N051.42.50.090 E019.15.52.340
	N051.42.50.090 E019.15.52.340 N051.43.32.560 E019.15.11.420

	N051.43.32.560 E019.15.11.420 N051.44.28.240 E019.14.39.800
	N051.44.28.240 E019.14.39.800 N051.45.14.530 E019.14.29.040
	N051.45.14.530 E019.14.29.040 N051.45.59.810 E019.14.47.140
	N051.45.59.810 E019.14.47.140 N051.46.37.490 E019.15.32.240
	N051.46.37.490 E019.15.32.240 N051.47.00.090 E019.16.37.180

	N051.47.00.090 E019.16.37.180 N051.47.41.100 E019.19.39.600
	N051.47.41.100 E019.19.39.600 N051.46.45.900 E019.32.31.700
	N051.46.45.900 E019.32.31.700 N051.31.19.400 E019.48.09.100

	N051.42.58.400 E019.22.19.900 N051.41.58.510 E019.17.29.040
	N051.41.58.510 E019.17.29.040 N051.41.52.630 E019.16.55.700
	N051.41.52.630 E019.16.55.700 N051.41.59.350 E019.15.45.990
	N051.41.59.350 E019.15.45.990 N051.42.16.520 E019.15.01.290
	N051.42.16.520 E019.15.01.290 N051.47.17.400 E019.05.05.000

	N051.44.28.240 E019.14.39.800 N051.46.21.300 E019.13.35.200	

	LL603 LL603 UTOLU UTOLU

	LL602 LL602 LL604 LL604
	LL604 LL604 ADOXO ADOXO
	
	LL606 LL606 LL608 LL608
	LL608 LL608 VIDEV VIDEV

	LL603 LL603 BAXIS BAXIS

EPLL 07   N051.43.25.200 E019.24.22.800 N051.44.58.000 E019.31.53.000
	N051.44.58.000 E019.31.53.000 N051.45.03.000 E019.32.08.000
	N051.45.03.000 E019.32.08.000 N051.45.10.000 E019.32.23.000
	N051.45.10.000 E019.32.23.000 N051.45.19.000 E019.32.35.000
	N051.45.19.000 E019.32.35.000 N051.45.29.000 E019.32.44.000
	N051.45.29.000 E019.32.44.000 N051.45.39.000 E019.32.51.000
	N051.45.39.000 E019.32.51.000 N051.45.50.000 E019.32.54.000
	N051.45.50.000 E019.32.54.000 N051.46.02.000 E019.32.54.000
	N051.46.02.000 E019.32.54.000	N051.46.13.000 E019.32.51.000
	N051.46.13.000 E019.32.51.000 N051.49.57.000 E019.31.09.000
	N051.49.57.000 E019.31.09.000 N051.50.14.000 E019.31.07.000
	N051.50.14.000 E019.31.07.000 N051.50.32.000 E019.30.60.000
	N051.50.32.000 E019.30.60.000 N051.50.48.000 E019.30.48.000
	N051.50.48.000 E019.30.48.000 N051.51.01.000 E019.30.32.000
	N051.51.01.000 E019.30.32.000 N051.51.14.000 E019.30.11.000
	N051.51.14.000 E019.30.11.000 N051.51.25.000 E019.29.46.000
	N051.51.25.000 E019.29.46.000 N051.51.32.000 E019.29.18.000
	N051.51.32.000 E019.29.18.000	N051.51.35.000 E019.28.51.000
	N051.51.35.000 E019.28.51.000 N051.51.36.000 E019.28.24.000
	N051.51.36.000 E019.28.24.000 LL803 LL803
	LL803 LL803 UTOLU UTOLU

	N051.44.58.000 E019.31.53.000 N051.45.01.000 E019.32.11.000
	N051.45.01.000 E019.32.11.000 N051.45.02.000 E019.32.29.000
	N051.45.02.000 E019.32.29.000	N051.45.01.000 E019.32.49.000
	N051.45.01.000 E019.32.49.000 N051.44.57.000 E019.33.08.000
	N051.44.57.000 E019.33.08.000 N051.44.51.000 E019.33.26.000
	N051.44.51.000 E019.33.26.000 N051.44.44.000 E019.33.42.000
	N051.44.44.000 E019.33.42.000 LL804 LL804
	LL804 LL804 VIDEV VIDEV

	LL802 LL802 ADOXO ADOXO

	LL803 LL803 BAXIS BAXIS
	


EPGD 11 DER11GD DER11GD GD421 GD421
		GD421 GD421 GD422 GD422
		GD422 GD422 UGNUR UGNUR
		UGNUR UGNUR GD423 GD423
		GD423 GD423 VAPOS VAPOS

	DER11GD DR11GD GD411 GD411
	GD411 GD411 GD412 GD412
	GD412 GD412 EVNOB EVNOB
	EVNOB EVNOB GD413 GD413

	GD421 GD421 GD431 GD431
	GD431 GD431 IRLUN IRLUN

	GD421 GD421 NIKMI NIKMI

EPGD 29 DER29GD DER29GD GD511 GD511
		GD511 GD511 GD521 GD521
		GD521 GD521 VAPOS VAPOS

	GD511 GD511 GD512 GD512
	GD512 GD512 DEXIR DEXIR

	GD512 GD512 GD531 GD531
	GD531 GD531 GD532 GD532
	GD532 GD532 IRLUN IRLUN

	GD512 GD512 GD513 GD513
	GD513 GD513 GD514 GD514
	GD514 GD514 NIKMI NIKMI


EPPO 10 N052.25.05.380 E016.50.27.038 N052.22.34.140 E017.03.51.155
                          N052.22.34.140 E017.03.51.155 N052.13.54.000 E017.46.27.000
                          N052.22.34.140 E017.03.51.012 N052.22.31.548 E017.04.03.287  ;
                          N052.22.31.548 E017.04.03.287 N052.22.28.703 E017.04.15.455  ;
                          N052.22.28.703 E017.04.15.455 N052.22.25.607 E017.04.27.444  ;
                          N052.22.25.607 E017.04.27.444 N052.22.22.223 E017.04.39.252  ;
                          N052.22.22.223 E017.04.39.252 N052.22.18.623 E017.04.50.844  ;
                          N052.22.18.623 E017.04.50.844 N052.22.14.772 E017.05.02.220  ;
                          N052.22.14.772 E017.05.02.220 N052.22.10.668 E017.05.13.380  ;
                          N052.22.10.668 E017.05.13.380 N052.22.06.347 E017.05.24.288  ;
                          N052.22.06.347 E017.05.24.288 N052.22.01.775 E017.05.34.980  ;
                          N052.22.01.775 E017.05.34.980 N052.21.56.988 E017.05.45.347  ;
                          N052.21.56.988 E017.05.45.347 N052.21.51.984 E017.05.55.463  ;
                          N052.21.51.984 E017.05.55.463 N052.21.46.764 E017.06.05.291  ;
                          N052.21.46.764 E017.06.05.291 N052.21.41.328 E017.06.14.832  ;
                          N052.21.41.328 E017.06.14.832 N052.21.35.712 E017.06.24.048  ;
                          N052.21.35.712 E017.06.24.048 N052.21.29.879 E017.06.32.904  ;
                          N052.21.29.879 E017.06.32.904 N052.21.23.868 E017.06.41.435  ;
                          N052.21.23.868 E017.06.41.435 N052.21.17.675 E017.06.49.644  ;
                          N052.21.17.675 E017.06.49.644 N052.21.11.339 E017.06.57.492  ;
                          N052.21.11.339 E017.06.57.492 N052.21.04.824 E017.07.04.944  ;
                          N052.21.04.824 E017.07.04.944 N052.20.58.127 E017.07.12.036  ;
                          N052.20.58.127 E017.07.12.036 N052.20.51.323 E017.07.18.732  ;
                          N052.20.51.323 E017.07.18.732 N052.20.44.339 E017.07.25.067  ;
                          N052.20.44.339 E017.07.25.067 N052.20.37.247 E017.07.30.972  ;
                          N052.20.37.247 E017.07.30.972 N052.20.30.047 E017.07.36.479  ;
                          N052.20.30.047 E017.07.36.479 N052.20.22.739 E017.07.41.555  ;
                          N052.20.22.739 E017.07.41.555 N052.20.15.288 E017.07.46.235  ;
                          N052.20.15.288 E017.07.46.235 N052.20.07.764 E017.07.50.448  ;
                          N052.20.07.764 E017.07.50.448 N052.20.00.167 E017.07.54.264  ;
                          N052.20.00.167 E017.07.54.264 N052.19.52.464 E017.07.57.648  ;
                          N052.19.52.464 E017.07.57.648 N052.19.44.724 E017.08.00.563  ;
                          N052.19.44.724 E017.08.00.563 N052.19.36.912 E017.08.03.048  ;
                          N052.19.36.912 E017.08.03.048 N052.19.29.028 E017.08.05.064  ;
                          N052.19.29.028 E017.08.05.064 N052.19.21.143 E017.08.06.684  ;
                          N052.19.21.143 E017.08.06.684 N052.19.13.224 E017.08.07.800  ;
                          N052.19.13.224 E017.08.07.800 N052.19.05.267 E017.08.08.484  ;
                          N052.19.05.267 E017.08.08.484 N052.18.57.311 E017.08.08.700  ;
                          N052.18.57.311 E017.08.08.700 N052.18.49.356 E017.08.08.484  ;
                          N052.18.49.356 E017.08.08.484 N052.18.41.400 E017.08.07.800  ;
                          N052.18.41.400 E017.08.07.800 N052.18.33.480 E017.08.06.684  ;
                          N052.18.33.480 E017.08.06.684 N052.18.25.596 E017.08.05.064  ;
                          N052.18.25.596 E017.08.05.064 N052.18.17.712 E017.08.03.048  ;
                          N052.18.17.712 E017.08.03.048 N052.18.09.900 E017.08.00.563  ;
                          N052.18.09.900 E017.08.00.563 N052.18.02.160 E017.07.57.648  ;
                          N052.18.02.160 E017.07.57.648 N052.17.54.455 E017.07.54.264  ;
                          N052.17.54.455 E017.07.54.264 N052.17.46.859 E017.07.50.448  ;
                          N052.17.46.859 E017.07.50.448 N052.17.39.336 E017.07.46.235  ;
                          N052.17.39.336 E017.07.46.235 N052.17.31.883 E017.07.41.555  ;
                          N052.17.31.883 E017.07.41.555 N052.17.24.576 E017.07.36.479  ;
                          N052.17.24.576 E017.07.36.479 N052.17.17.375 E017.07.30.972  ;
                          N052.17.17.375 E017.07.30.972 N052.17.10.283 E017.07.25.067  ;
                          N052.17.10.283 E017.07.25.067 N052.17.03.300 E017.07.18.732  ;
                          N052.17.03.300 E017.07.18.732 N052.16.56.495 E017.07.12.036  ;
                          N052.16.56.495 E017.07.12.036 N052.16.49.800 E017.07.04.944  ;
                          N052.16.49.800 E017.07.04.944 N052.16.43.283 E017.06.57.492  ;
                          N052.16.43.283 E017.06.57.492 N052.16.36.948 E017.06.49.644  ;
                          N052.16.36.948 E017.06.49.644 N052.16.30.756 E017.06.41.435  ;
                          N052.16.30.756 E017.06.41.435 N052.16.24.743 E017.06.32.904  ;
                          N052.16.24.743 E017.06.32.904 N052.16.18.912 E017.06.24.048  ;
                          N052.16.18.912 E017.06.24.048 N052.16.13.295 E017.06.14.832  ;
                          N052.16.13.295 E017.06.14.832 N052.16.07.860 E017.06.05.291  ;
                          N052.16.07.860 E017.06.05.291 N052.16.02.640 E017.05.55.463  ;
                          N052.16.02.640 E017.05.55.463 N052.15.57.636 E017.05.45.347  ;
                          N052.15.57.636 E017.05.45.347 N052.15.52.847 E017.05.34.980  ;
                          N052.15.52.847 E017.05.34.980 N052.15.48.276 E017.05.24.288  ;
                          N052.15.48.276 E017.05.24.288 N052.15.43.956 E017.05.13.380  ;
                          N052.15.43.956 E017.05.13.380 N052.15.39.851 E017.05.02.220  ;
                          N052.15.39.851 E017.05.02.220 N052.15.35.999 E017.04.50.844  ;
                          N052.15.35.999 E017.04.50.844 N052.15.32.400 E017.04.39.252  ;
                          N052.15.32.400 E017.04.39.252 N052.15.29.016 E017.04.27.444  ;
                          N052.15.29.016 E017.04.27.444 N052.15.25.919 E017.04.15.455  ;
                          N052.15.25.919 E017.04.15.455 N052.15.23.076 E017.04.03.287  ;
                          N052.15.23.076 E017.04.03.287 N052.15.20.484 E017.03.51.012  ;
                          N052.15.20.484 E017.03.51.012 N052.15.18.144 E017.03.38.556  ;
                          N052.15.18.144 E017.03.38.556 N052.15.16.091 E017.03.25.956  ;
                          N052.15.16.091 E017.03.25.956 N052.15.14.292 E017.03.13.283  ;
                          N052.15.14.292 E017.03.13.283 N052.15.12.779 E017.03.00.503  ;
                          N052.15.12.779 E017.03.00.503 N052.15.11.519 E017.02.47.651  ;
                          N052.15.11.519 E017.02.47.651 N052.15.10.547 E017.02.34.728  ;
                          N052.15.10.547 E017.02.34.728 N052.15.09.864 E017.02.21.768  ;
                          N052.15.09.864 E017.02.21.768 N052.15.09.468 E017.02.08.771  ;
                          N052.15.09.468 E017.02.08.771 N052.15.09.323 E017.01.55.740  ;
                          N052.15.09.323 E017.01.55.740 N052.15.09.468 E017.01.42.707  ;
                          N052.15.09.468 E017.01.42.707 N052.15.09.864 E017.01.29.712  ;
                          N052.15.09.864 E017.01.29.712 N052.15.10.547 E017.01.16.751  ;
                          N052.15.10.547 E017.01.16.751 N052.15.11.519 E017.01.03.828  ;
                          N052.15.11.519 E017.01.03.828 N052.15.12.779 E017.00.50.976  ;
                          N052.15.12.779 E017.00.50.976 N052.15.14.292 E017.00.38.195  ;
                          N052.15.14.292 E017.00.38.195 N052.15.16.091 E017.00.25.524  ;
                          N052.15.16.091 E017.00.25.524 N052.15.18.144 E017.00.12.923  ;
                          N052.15.18.144 E017.00.12.923 N052.15.20.484 E017.00.00.467  ;
                          N052.15.20.484 E017.00.00.467 N052.15.23.076 E016.59.48.191  ;
                          N052.15.23.076 E016.59.48.191 N052.15.25.919 E016.59.36.023  ;
                          N052.15.25.919 E016.59.36.023 N052.15.29.016 E016.59.24.036  ;
                          N052.15.29.016 E016.59.24.036 N052.15.32.400 E016.59.12.228  ;
                          N052.15.32.400 E016.59.12.228 N052.15.35.999 E016.59.00.635  ;
                          N052.15.35.999 E016.59.00.635 N052.15.39.851 E016.58.49.260  ;
                          N052.15.39.851 E016.58.49.260 N052.15.43.956 E016.58.38.100  ;
                          N052.15.43.956 E016.58.38.100 N052.15.48.276 E016.58.27.191  ;
                          N052.15.48.276 E016.58.27.191 N052.15.52.847 E016.58.16.500  ;
                          N052.15.52.847 E016.58.16.500 N052.15.57.636 E016.58.06.132  ;
                          N052.15.57.636 E016.58.06.132 N052.16.02.640 E016.57.56.015  ;
                          N052.16.02.640 E016.57.56.015 N052.16.07.860 E016.57.46.188  ;
                          N052.16.07.860 E016.57.46.188 N052.16.13.295 E016.57.36.648  ;
                          N052.16.13.295 E016.57.36.648 N052.16.18.947 E016.57.27.431  ;
                          N052.16.18.947 E016.57.27.431 N052.16.24.743 E016.57.18.575  ;
                          N052.16.24.743 E016.57.18.575 N052.16.30.756 E016.57.10.044  ;
                          N052.16.30.756 E016.57.10.044 N052.16.36.948 E016.57.01.836  ;
                          N052.16.36.948 E016.57.01.836 N052.16.43.283 E016.56.53.987  ;
                          N052.16.43.283 E016.56.53.987 N052.16.49.800 E016.56.46.535  ;
                          N052.16.49.800 E016.56.46.535 N052.16.56.495 E016.56.39.443  ;
                          N052.16.56.495 E016.56.39.443 N052.17.03.300 E016.56.32.748  ;
                          N052.17.03.300 E016.56.32.748 N052.17.10.283 E016.56.26.412  ;
                          N052.17.10.283 E016.56.26.412 N052.17.17.375 E016.56.20.507  ;
                          N052.17.17.375 E016.56.20.507 LAW            LAW            
                          CMP            CMP            N052.15.43.956 E017.05.13.380
                          N052.26.12.192 E016.39.21.599 UBOMI          UBOMI
                          N052.26.12.192 E016.39.21.599 N052.26.55.283 E016.41.53.267
                          N052.26.55.283 E016.41.53.267 N052.26.58.380 E016.42.05.256  ;
                          N052.26.58.380 E016.42.05.256 N052.27.01.223 E016.42.17.460  ;
                          N052.27.01.223 E016.42.17.460 N052.27.03.815 E016.42.29.771  ;
                          N052.27.03.815 E016.42.29.771 N052.27.06.155 E016.42.42.227  ;
                          N052.27.06.155 E016.42.42.227 N052.27.08.208 E016.42.54.827  ;
                          N052.27.08.208 E016.42.54.827 N052.27.10.007 E016.43.07.535  ;
                          N052.27.10.007 E016.43.07.535 N052.27.11.520 E016.43.20.351  ;
                          N052.27.11.520 E016.43.20.351 N052.27.12.779 E016.43.33.239  ;
                          N052.27.12.779 E016.43.33.239 N052.27.13.752 E016.43.46.163  ;
                          N052.27.13.752 E016.43.46.163 N052.27.14.435 E016.43.59.160  ;
                          N052.27.14.435 E016.43.59.160 N052.27.14.832 E016.44.12.191  ;
                          N052.27.14.832 E016.44.12.191 N052.27.14.976 E016.44.25.223  ;
                          N052.27.14.976 E016.44.25.223 N052.27.14.832 E016.44.38.256  ;
                          N052.27.14.832 E016.44.38.256 N052.27.14.435 E016.44.51.287  ;
                          N052.27.14.435 E016.44.51.287 N052.27.13.752 E016.45.04.284  ;
                          N052.27.13.752 E016.45.04.284 N052.27.12.779 E016.45.17.208  ;
                          N052.27.12.779 E016.45.17.208 N052.27.11.520 E016.45.30.095  ;
                          N052.27.11.520 E016.45.30.095 N052.27.10.007 E016.45.42.911  ;
                          N052.27.10.007 E016.45.42.911 N052.27.08.208 E016.45.55.620  ;
                          N052.27.08.208 E016.45.55.620 N052.27.06.155 E016.46.08.220  ;
                          N052.27.06.155 E016.46.08.220 N052.27.03.815 E016.46.20.676  ;
                          N052.27.03.815 E016.46.20.676 N052.27.01.223 E016.46.32.987  ;
                          N052.27.01.223 E016.46.32.987 N052.26.58.380 E016.46.45.191  ;
                          N052.26.58.380 E016.46.45.191 N052.26.55.283 E016.46.57.180  ;
                          N052.26.55.283 E016.46.57.180 N052.26.51.899 E016.47.08.988  ;
                          N052.26.51.899 E016.47.08.988 N052.26.48.300 E016.47.20.615  ;
                          N052.26.48.300 E016.47.20.615 N052.26.44.448 E016.47.32.027  ;
                          N052.26.44.448 E016.47.32.027 N052.26.40.344 E016.47.43.187  ;
                          N052.26.40.344 E016.47.43.187 N052.26.36.023 E016.47.54.131  ;
                          N052.26.36.023 E016.47.54.131 N052.26.31.452 E016.48.04.823  ;
                          N052.26.31.452 E016.48.04.823 N052.26.26.663 E016.48.15.228  ;
                          N052.26.26.663 E016.48.15.228 N052.26.21.659 E016.48.25.380  ;
                          N052.26.21.659 E016.48.25.380 N052.26.16.439 E016.48.35.207  ;
                          N052.26.16.439 E016.48.35.207 N052.26.11.004 E016.48.44.747  ;
                          N052.26.11.004 E016.48.44.747 N052.26.05.352 E016.48.53.964  ;
                          N052.26.05.352 E016.48.53.964 N052.25.59.556 E016.49.02.856  ;
                          N052.25.59.556 E016.49.02.856 N052.25.53.543 E016.49.11.423  ;
                          N052.25.53.543 E016.49.11.423 N052.25.47.351 E016.49.19.632  ;
                          N052.25.47.351 E016.49.19.632 N052.25.41.016 E016.49.27.480  ;
                          N052.25.41.016 E016.49.27.480 N052.25.34.500 E016.49.34.968  ;
                          N052.25.34.500 E016.49.34.968 N052.25.27.804 E016.49.42.060  ;
                          N052.25.27.804 E016.49.42.060 N052.25.20.999 E016.49.48.792  ;                          
                          N052.07.50.160 E016.43.37.560 N052.01.36.000 E016.01.14.000
                          N052.07.50.160 E016.43.37.667 N052.07.48.575 E016.43.24.276
                          N052.07.48.575 E016.43.24.276 N052.07.47.243 E016.43.10.776
                          N052.07.47.243 E016.43.10.776 N052.07.46.236 E016.42.57.204
                          N052.07.46.236 E016.42.57.204 N052.07.45.515 E016.42.43.595
                          N052.07.45.515 E016.42.43.595 N052.07.45.047 E016.42.29.952
                          N052.07.45.047 E016.42.29.952 N052.07.44.903 E016.42.16.271
                          N052.07.44.903 E016.42.16.271 N052.07.45.047 E016.42.02.592
                          N052.07.45.047 E016.42.02.592 N052.07.45.515 E016.41.48.947
                          N052.07.45.515 E016.41.48.947 N052.07.46.236 E016.41.35.339
                          N052.07.46.236 E016.41.35.339 N052.07.47.243 E016.41.21.767
                          N052.07.47.243 E016.41.21.767 N052.07.48.575 E016.41.08.267
                          N052.07.48.575 E016.41.08.267 N052.07.50.160 E016.40.54.875
                          N052.07.50.160 E016.40.54.875 N052.07.52.032 E016.40.41.555
                          N052.07.52.032 E016.40.41.555 N052.07.54.227 E016.40.28.344
                          N052.07.54.227 E016.40.28.344 N052.07.56.676 E016.40.15.275
                          N052.07.56.676 E016.40.15.275 N052.07.59.375 E016.40.02.352
                          N052.07.59.375 E016.40.02.352 N052.08.02.400 E016.39.49.607
                          N052.08.02.400 E016.39.49.607 N052.08.05.675 E016.39.37.008
                          N052.08.05.675 E016.39.37.008 N052.08.09.204 E016.39.24.623
                          N052.08.09.204 E016.39.24.623 N052.08.13.019 E016.39.12.455
                          N052.08.13.019 E016.39.12.455 N052.08.17.088 E016.39.00.504
                          N052.08.17.088 E016.39.00.504 N052.08.21.372 E016.38.48.803
                          N052.08.21.372 E016.38.48.803 N052.08.25.944 E016.38.37.319
                          N052.08.25.944 E016.38.37.319 N052.08.30.768 E016.38.26.123
                          N052.08.30.768 E016.38.26.123 N052.08.35.807 E016.38.15.216
                          N052.08.35.807 E016.38.15.216 N052.08.41.063 E016.38.04.595
                          N052.08.41.063 E016.38.04.595 N052.08.46.572 E016.37.54.264
                          N052.08.46.572 E016.37.54.264 N052.08.52.259 E016.37.44.291
                          N052.08.52.259 E016.37.44.291 N052.08.58.200 E016.37.34.608
                          N052.08.58.200 E016.37.34.608 N052.09.04.320 E016.37.25.283
                          N052.09.04.320 E016.37.25.283 N052.09.10.656 E016.37.16.320
                          N052.09.10.656 E016.37.16.320 N052.09.17.171 E016.37.07.751
                          N052.09.17.171 E016.37.07.751 N052.09.23.831 E016.36.59.508
                          N052.09.23.831 E016.36.59.508 N052.09.30.707 E016.36.51.660
                          N052.09.30.707 E016.36.51.660 N052.09.37.727 E016.36.44.244
                          N052.09.37.727 E016.36.44.244 N052.09.44.928 E016.36.37.188
                          N052.09.44.928 E016.36.37.188 N052.09.52.235 E016.36.30.563
                          N052.09.52.235 E016.36.30.563 N052.09.59.723 E016.36.24.372
                          N052.09.59.723 E016.36.24.372 N052.10.07.283 E016.36.18.576
                          N052.10.07.283 E016.36.18.576 N052.10.15.023 E016.36.13.248
                          N052.10.15.023 E016.36.13.248 N052.10.22.835 E016.36.08.351
                          N052.10.22.835 E016.36.08.351 N052.10.30.755 E016.36.03.887
                          N052.10.30.755 E016.36.03.887 N052.10.38.748 E016.35.59.891
                          N052.10.38.748 E016.35.59.891 N052.10.46.847 E016.35.56.364
                          N052.10.46.847 E016.35.56.364 N052.10.55.020 E016.35.53.304
                          N052.10.55.020 E016.35.53.304 N052.14.25.403 E016.34.58.944
                          N052.14.25.403 E016.34.58.944 N052.49.01.000 E015.49.57.000
                          N052.16.16.000 E015.33.52.000 N052.08.25.944 E016.38.37.319
                          N052.01.00.300 E016.42.39.563 N052.01.05.339 E016.42.28.691
                          N052.01.05.339 E016.42.28.691 N052.01.10.596 E016.42.18.108
                          N052.01.10.596 E016.42.18.108 N052.01.16.104 E016.42.07.811
                          N052.01.16.104 E016.42.07.811 N052.01.21.791 E016.41.57.840
                          N052.01.21.791 E016.41.57.840 N052.01.27.731 E016.41.48.191
                          N052.01.27.731 E016.41.48.191 N052.01.33.851 E016.41.38.904
                          N052.01.33.851 E016.41.38.904 N052.01.40.188 E016.41.29.975
                          N052.01.40.188 E016.41.29.975 N052.01.46.704 E016.41.21.408
                          N052.01.46.704 E016.41.21.408 N052.01.53.363 E016.41.13.200
                          N052.01.53.363 E016.41.13.200 N052.02.00.240 E016.41.05.388
                          N052.02.00.240 E016.41.05.388 N052.02.07.260 E016.40.57.935
                          N052.02.07.260 E016.40.57.935 N052.02.14.460 E016.40.50.916
                          N052.02.14.460 E016.40.50.916 N052.02.21.768 E016.40.44.327
                          N052.02.21.768 E016.40.44.327 N052.02.29.256 E016.40.38.136
                          N052.02.29.256 E016.40.38.136 N052.02.36.815 E016.40.32.376
                          N052.02.36.815 E016.40.32.376 N052.02.44.555 E016.40.27.047
                          N052.02.44.555 E016.40.27.047 N052.02.52.367 E016.40.22.152
                          N052.02.52.367 E016.40.22.152 N052.03.00.288 E016.40.17.723
                          N052.03.00.288 E016.40.17.723 N052.03.08.280 E016.40.13.764
                          N052.03.08.280 E016.40.13.764 N052.03.16.379 E016.40.10.235
                          N052.03.16.379 E016.40.10.235 N052.03.24.552 E016.40.07.139
                          N052.03.24.552 E016.40.07.139 N052.03.32.760 E016.40.04.547
                          N052.03.32.760 E016.40.04.547 N052.03.41.039 E016.40.02.423
                          N052.03.41.039 E016.40.02.423 N052.03.49.356 E016.40.00.767
                          N052.03.49.356 E016.40.00.767 N052.03.57.707 E016.39.59.580
                          N052.03.57.707 E016.39.59.580 N052.04.06.060 E016.39.58.860
                          N052.04.06.060 E016.39.58.860 N052.04.14.448 E016.39.58.608
                          N052.04.14.448 E016.39.58.608 N052.04.22.835 E016.39.58.860
                          N052.04.22.835 E016.39.58.860 N052.04.31.188 E016.39.59.580
                          N052.04.31.188 E016.39.59.580 N052.04.39.539 E016.40.00.767
                          N052.04.39.539 E016.40.00.767 N052.04.47.855 E016.40.02.423
                          N052.04.47.855 E016.40.02.423 N052.04.56.135 E016.40.04.547
                          N052.04.56.135 E016.40.04.547 N052.05.04.343 E016.40.07.139
                          N052.05.04.343 E016.40.07.139 N052.05.12.515 E016.40.10.235
                          N052.05.12.515 E016.40.10.235 N052.05.20.616 E016.40.13.764
                          N052.05.20.616 E016.40.13.764 N052.05.28.607 E016.40.17.723
                          N052.05.28.607 E016.40.17.723 N052.05.36.527 E016.40.22.152
                          N052.05.36.527 E016.40.22.152 N052.05.44.339 E016.40.27.047
                          N052.05.44.339 E016.40.27.047 N052.05.52.079 E016.40.32.376
                          N052.05.52.079 E016.40.32.376 N052.05.59.639 E016.40.38.136
                          N052.05.59.639 E016.40.38.136 N052.06.07.127 E016.40.44.327
                          N052.06.07.127 E016.40.44.327 N052.06.14.436 E016.40.50.916
                          N052.06.14.436 E016.40.50.916 N052.06.21.635 E016.40.57.935
                          N052.06.21.635 E016.40.57.935 N052.06.28.655 E016.41.05.388
                          N052.06.28.655 E016.41.05.388 N052.06.35.532 E016.41.13.200
                          N052.06.35.532 E016.41.13.200 N052.06.42.191 E016.41.21.408
                          N052.06.42.191 E016.41.21.408 N052.06.48.707 E016.41.29.975
                          N052.06.48.707 E016.41.29.975 N052.06.55.044 E016.41.38.904
                          N052.06.55.044 E016.41.38.904 N052.07.01.164 E016.41.48.191
                          N052.07.01.164 E016.41.48.191 N052.07.07.103 E016.41.57.840
                          N052.07.07.103 E016.41.57.840 N052.07.12.792 E016.42.07.811
                          N052.07.12.792 E016.42.07.811 N052.07.18.299 E016.42.18.108
                          N052.07.18.299 E016.42.18.108 N052.07.23.556 E016.42.28.691
                          N052.07.23.556 E016.42.28.691 N052.07.28.595 E016.42.39.563
                          N052.07.28.595 E016.42.39.563 N052.07.33.420 E016.42.50.723
                          N052.07.33.420 E016.42.50.723 N052.07.37.992 E016.43.02.171
                          N052.07.37.992 E016.43.02.171 N052.07.42.311 E016.43.13.836
                          N052.07.42.311 E016.43.13.836 N052.07.46.343 E016.43.25.751
                          N052.07.46.343 E016.43.25.751 N052.07.50.160 E016.43.37.919
                          N052.01.00.300 E016.42.39.563 N051.57.34.488 E016.50.03.372
                          N051.57.34.488 E016.50.03.372 N051.42.00.039 E016.59.50.999
 
EPPO 28 N052.27.45.575 E016.32.11.107 N052.27.08.747 E016.28.21.359
                          N052.27.08.747 E016.28.21.359 UBOMI          UBOMI
                          N052.25.27.880 E016.48.18.506 N052.26.20.508 E016.43.36.227
                          N052.26.20.508 E016.43.36.227 N052.27.13.140 E016.38.53.951
                          N052.27.13.140 E016.38.53.951 N052.27.21.888 E016.38.06.899
                          N052.27.21.888 E016.38.06.899 N052.27.48.203 E016.35.45.780
                          N052.17.21.983 E016.33.18.864 N052.17.14.495 E016.33.22.139
                          N052.17.14.495 E016.33.22.139 N052.17.06.936 E016.33.25.020
                          N052.17.06.936 E016.33.25.020 N052.16.59.339 E016.33.27.432
                          N052.16.59.339 E016.33.27.432 N052.16.51.671 E016.33.29.412
                          N052.16.51.671 E016.33.29.412 N052.16.44.003 E016.33.30.959
                          N052.16.44.003 E016.33.30.959 N052.16.36.263 E016.33.32.040
                          N052.16.36.263 E016.33.32.040 N052.16.28.524 E016.33.32.724
                          N052.16.28.524 E016.33.32.724 N052.16.20.784 E016.33.32.939
                          N052.16.20.784 E016.33.32.939 N052.16.13.044 E016.33.32.724
                          N052.16.13.044 E016.33.32.724 N052.16.05.304 E016.33.32.040
                          N052.16.05.304 E016.33.32.040 N052.15.57.564 E016.33.30.959
                          N052.15.57.564 E016.33.30.959 N052.15.49.896 E016.33.29.412
                          N052.15.49.896 E016.33.29.412 N052.15.42.228 E016.33.27.432
                          N052.15.42.228 E016.33.27.432 N052.15.34.631 E016.33.25.020
                          N052.15.34.631 E016.33.25.020 N052.15.27.071 E016.33.22.139
                          N052.15.27.071 E016.33.22.139 N052.15.19.584 E016.33.18.864
                          N052.15.19.584 E016.33.18.864 N052.15.12.167 E016.33.15.192
                          N052.15.12.167 E016.33.15.192 N052.15.04.860 E016.33.11.052
                          N052.15.04.860 E016.33.11.052 N052.14.57.623 E016.33.06.515
                          N052.14.57.623 E016.33.06.515 N052.14.50.496 E016.33.01.583
                          N052.14.50.496 E016.33.01.583 N052.14.43.475 E016.32.56.220
                          N052.14.43.475 E016.32.56.220 N052.14.36.564 E016.32.50.460
                          N052.14.36.564 E016.32.50.460 N052.14.29.796 E016.32.44.339
                          N052.14.29.796 E016.32.44.339 N052.14.23.135 E016.32.37.787
                          N052.14.23.135 E016.32.37.787 N052.14.16.656 E016.32.30.912
                          N052.14.16.656 E016.32.30.912 N052.14.10.284 E016.32.23.639
                          N052.14.10.284 E016.32.23.639 N052.14.04.092 E016.32.16.008
                          N052.14.04.092 E016.32.16.008 N052.13.58.079 E016.32.08.051
                          N052.13.58.079 E016.32.08.051 N052.13.52.248 E016.31.59.735
                          N052.13.52.248 E016.31.59.735 N052.13.46.559 E016.31.51.096
                          N052.13.46.559 E016.31.51.096 N052.13.41.087 E016.31.42.167
                          N052.13.41.087 E016.31.42.167 N052.13.35.796 E016.31.32.880
                          N052.13.35.796 E016.31.32.880 N052.13.30.720 E016.31.23.340
                          N052.13.30.720 E016.31.23.340 N052.13.25.859 E016.31.13.475
                          N052.13.25.859 E016.31.13.475 N052.13.21.179 E016.31.03.396
                          N052.13.21.179 E016.31.03.396 N052.13.16.751 E016.30.52.992
                          N052.13.16.751 E016.30.52.992 N052.13.12.504 E016.30.42.371
                          N052.13.12.504 E016.30.42.371 N052.13.08.543 E016.30.31.535
                          N052.13.08.543 E016.30.31.535 N052.13.04.764 E016.30.20.448
                          N052.13.04.764 E016.30.20.448 N052.13.01.236 E016.30.09.179
                          N052.13.01.236 E016.30.09.179 N052.12.57.959 E016.29.57.695
                          N052.12.57.959 E016.29.57.695 N052.12.54.936 E016.29.46.032
                          N052.12.54.936 E016.29.46.032 N052.12.52.163 E016.29.34.224
                          N052.12.52.163 E016.29.34.224 N052.12.49.644 E016.29.22.235
                          N052.12.49.644 E016.29.22.235 N052.12.47.376 E016.29.10.139
                          N052.12.47.376 E016.29.10.139 N052.12.45.395 E016.28.57.899
                          N052.12.45.395 E016.28.57.899 N052.12.43.631 E016.28.45.552
                          N052.12.43.631 E016.28.45.552 N052.12.42.155 E016.28.33.132
                          N052.12.42.155 E016.28.33.132 N052.12.40.932 E016.28.20.640
                          N052.12.40.932 E016.28.20.640 N052.12.39.995 E016.28.08.040
                          N052.12.34.127 E016.23.34.044 N052.12.39.995 E016.28.08.040
                          N052.12.34.127 E016.23.34.044 N052.01.36.000 E016.01.14.000
                          N052.17.22.000 E016.33.19.000 N052.07.50.160 E016.43.37.560
                          N052.07.50.160 E016.43.37.560 N051.42.00.039 E016.59.50.999
                          N052.21.52.019 E016.28.41.339 EMPIM          EMPIM                         
                          N052.25.20.999 E016.49.49.259 N052.25.24.995 E016.50.01.031  ;
                          N052.25.24.995 E016.50.01.031 N052.25.28.739 E016.50.13.056  ;
                          N052.25.28.739 E016.50.13.056 N052.25.32.232 E016.50.25.260  ;
                          N052.25.32.232 E016.50.25.260 N052.25.35.436 E016.50.37.680  ;
                          N052.25.35.436 E016.50.37.680 N052.25.38.387 E016.50.50.244  ;
                          N052.25.38.387 E016.50.50.244 N052.25.41.051 E016.51.02.987  ;
                          N052.25.41.051 E016.51.02.987 N052.25.43.463 E016.51.15.876  ;
                          N052.25.43.463 E016.51.15.876 N052.25.45.588 E016.51.28.907  ;
                          N052.25.45.588 E016.51.28.907 N052.25.47.460 E016.51.42.047  ;
                          N052.25.47.460 E016.51.42.047 N052.25.49.008 E016.51.55.259  ;
                          N052.25.49.008 E016.51.55.259 N052.25.50.303 E016.52.08.580  ;
                          N052.25.50.303 E016.52.08.580 N052.25.51.312 E016.52.21.971  ;
                          N052.25.51.312 E016.52.21.971 N052.25.52.031 E016.52.35.400  ;
                          N052.25.52.031 E016.52.35.400 N052.25.52.464 E016.52.48.864  ;
                          N052.25.52.464 E016.52.48.864 N052.25.52.608 E016.53.02.328  ;
                          N052.25.52.608 E016.53.02.328 N052.25.52.464 E016.53.15.792  ;
                          N052.25.52.464 E016.53.15.792 N052.25.52.031 E016.53.29.255  ;
                          N052.25.52.031 E016.53.29.255 N052.25.51.312 E016.53.42.683  ;
                          N052.25.51.312 E016.53.42.683 N052.25.50.303 E016.53.56.076  ;
                          N052.25.50.303 E016.53.56.076 N052.25.49.008 E016.54.09.395  ;
                          N052.25.49.008 E016.54.09.395 N052.25.47.460 E016.54.22.607  ;
                          N052.25.47.460 E016.54.22.607 N052.25.45.588 E016.54.35.747  ;
                          N052.25.45.588 E016.54.35.747 N052.25.43.463 E016.54.48.780  ;
                          N052.25.43.463 E016.54.48.780 N052.25.41.051 E016.55.01.668  ;
                          N052.25.41.051 E016.55.01.668 N052.25.38.387 E016.55.14.412  ;
                          N052.25.38.387 E016.55.14.412 N052.25.35.436 E016.55.26.976  ;
                          N052.25.35.436 E016.55.26.976 N052.25.32.232 E016.55.39.396  ;
                          N052.25.32.232 E016.55.39.396 N052.25.28.739 E016.55.51.600  ;
                          N052.25.28.739 E016.55.51.600 N052.25.24.995 E016.56.03.623  ;
                          N052.25.24.995 E016.56.03.623 N052.25.20.999 E016.56.15.395  ;
                          N052.25.20.999 E016.56.15.395 N052.25.16.787 E016.56.26.951  ;
                          N052.25.16.787 E016.56.26.951 N052.25.12.287 E016.56.38.256  ;
                          N052.25.12.287 E016.56.38.256 N052.25.07.572 E016.56.49.308  ;
                          N052.25.07.572 E016.56.49.308 N052.25.02.603 E016.57.00.071  ;
                          N052.25.02.603 E016.57.00.071 N052.24.57.455 E016.57.10.547  ;
                          N052.24.57.455 E016.57.10.547 N052.24.52.055 E016.57.20.736  ;
                          N052.24.52.055 E016.57.20.736 N052.24.46.440 E016.57.30.564  ;
                          N052.24.46.440 E016.57.30.564 N052.23.18.924 E016.59.59.172
                          N052.23.18.924 E016.59.59.172 TENVO          TENVO
                          N052.20.12.659 E016.32.25.440 N052.20.14.927 E016.32.12.443  ;
                          N052.20.14.927 E016.32.12.443 N052.20.17.483 E016.31.59.627  ;
                          N052.20.17.483 E016.31.59.627 N052.20.20.292 E016.31.46.956  ;
                          N052.20.20.292 E016.31.46.956 N052.20.23.387 E016.31.34.428  ;
                          N052.20.23.387 E016.31.34.428 N052.20.26.736 E016.31.22.115  ;
                          N052.20.26.736 E016.31.22.115 N052.20.30.336 E016.31.09.983  ;
                          N052.20.30.336 E016.31.09.983 N052.20.34.187 E016.30.58.068  ;
                          N052.20.34.187 E016.30.58.068 N052.20.38.328 E016.30.46.403  ;
                          N052.20.38.328 E016.30.46.403 N052.20.42.684 E016.30.34.955  ;
                          N052.20.42.684 E016.30.34.955 N052.20.47.291 E016.30.23.795  ;
                          N052.20.47.291 E016.30.23.795 N052.20.52.116 E016.30.12.851  ;
                          N052.20.52.116 E016.30.12.851 N052.20.57.192 E016.30.02.232  ;
                          N052.20.57.192 E016.30.02.232 N052.21.02.484 E016.29.51.899  ;
                          N052.21.02.484 E016.29.51.899 N052.21.07.992 E016.29.41.891  ;
                          N052.21.07.992 E016.29.41.891 N052.21.13.679 E016.29.32.172  ;
                          N052.21.13.679 E016.29.32.172 N052.21.19.619 E016.29.22.812  ;                          
                          N052.21.19.619 E016.29.22.812 N052.21.25.739 E016.29.13.775  ;
                          N052.21.25.739 E016.29.13.775 N052.21.32.039 E016.29.05.099  ;
                          N052.21.32.039 E016.29.05.099 N052.21.38.520 E016.28.56.784  ;
                          N052.21.38.520 E016.28.56.784 N052.21.45.179 E016.28.48.863  ;
                          N052.21.45.179 E016.28.48.863 N052.21.52.019 E016.28.41.339  ;
                          N052.21.52.019 E016.28.41.339 N052.21.59.004 E016.28.34.176  ;
                          N052.21.59.004 E016.28.34.176 N052.22.06.131 E016.28.27.443  ;
                          N052.22.06.131 E016.28.27.443 N052.22.13.367 E016.28.21.107  ;
                          N052.22.13.367 E016.28.21.107 N052.22.20.783 E016.28.15.204  ;
                          N052.22.20.783 E016.28.15.204 N052.22.28.308 E016.28.09.696  ;
                          N052.22.28.308 E016.28.09.696 N052.22.35.939 E016.28.04.656  ;
                          N052.22.35.939 E016.28.04.656 N052.22.43.679 E016.28.00.048  ;
                          N052.22.43.679 E016.28.00.048 N052.22.51.491 E016.27.55.872  ;
                          N052.22.51.491 E016.27.55.872 N052.22.59.411 E016.27.52.164  ;
                          N052.22.59.411 E016.27.52.164 N052.23.07.404 E016.27.48.888  ;
                          N052.23.07.404 E016.27.48.888 N052.23.15.431 E016.27.46.080  ;
                          N052.23.15.431 E016.27.46.080 N052.23.23.532 E016.27.43.740  ;
                          N052.23.23.532 E016.27.43.740 N052.23.31.703 E016.27.41.867  ;
                          N052.23.31.703 E016.27.41.867 N052.23.39.876 E016.27.40.464  ;
                          N052.23.39.876 E016.27.40.464 N052.23.48.083 E016.27.39.527  ;
                          N052.23.48.083 E016.27.39.527 N052.23.56.328 E016.27.39.024  ;
                          N052.23.56.328 E016.27.39.024 N052.24.04.536 E016.27.39.024  ;
                          N052.24.04.536 E016.27.39.024 N052.24.12.780 E016.27.39.527  ;
                          N052.24.12.780 E016.27.39.527 N052.24.20.988 E016.27.40.464  ;
                          N052.24.20.988 E016.27.40.464 N052.24.29.159 E016.27.41.867  ;
                          N052.24.29.159 E016.27.41.867 N052.24.37.332 E016.27.43.740  ;
                          N052.24.37.332 E016.27.43.740 N052.24.45.431 E016.27.46.080  ;
                          N052.24.45.431 E016.27.46.080 N052.24.53.460 E016.27.48.888  ;
                          N052.24.53.460 E016.27.48.888 N052.25.01.452 E016.27.52.164  ;
                          N052.25.01.452 E016.27.52.164 N052.25.09.371 E016.27.55.872  ;
                          N052.25.09.371 E016.27.55.872 N052.25.17.183 E016.28.00.048  ;
                          N052.25.17.183 E016.28.00.048 N052.25.24.923 E016.28.04.656  ;
                          N052.25.24.923 E016.28.04.656 N052.25.32.556 E016.28.09.696  ;
                          N052.25.32.556 E016.28.09.696 N052.25.40.079 E016.28.15.204  ;
                          N052.25.40.079 E016.28.15.204 N052.25.47.495 E016.28.21.107  ;
                          N052.25.47.495 E016.28.21.107 N052.25.54.767 E016.28.27.443  ;
                          N052.25.54.767 E016.28.27.443 N052.26.01.896 E016.28.34.176  ;
                          N052.26.01.896 E016.28.34.176 N052.26.08.843 E016.28.41.339  ;
                          N052.26.08.843 E016.28.41.339 N052.26.15.684 E016.28.48.863  ;
                          N052.26.15.684 E016.28.48.863 N052.26.22.344 E016.28.56.820  ;
                          N052.26.22.344 E016.28.56.820 N052.26.28.823 E016.29.05.099  ;
                          N052.26.28.823 E016.29.05.099 N052.26.35.123 E016.29.13.775  ;
                          N052.26.35.123 E016.29.13.775 N052.26.41.243 E016.29.22.812  ;
                          N052.26.41.243 E016.29.22.812 N052.26.47.184 E016.29.32.172  ;
                          N052.26.47.184 E016.29.32.172 N052.26.52.871 E016.29.41.891  ;
                          N052.26.52.871 E016.29.41.891 N052.26.58.380 E016.29.51.899  ;
                          N052.26.58.380 E016.29.51.899 N052.27.03.671 E016.30.02.232  ;
                          N052.27.03.671 E016.30.02.232 N052.27.08.747 E016.30.12.851  ;
                          N052.27.08.747 E016.30.12.851 N052.27.13.571 E016.30.23.795  ;
                          N052.27.13.571 E016.30.23.795 N052.27.18.179 E016.30.34.955  ;
                          N052.27.18.179 E016.30.34.955 N052.27.22.536 E016.30.46.403  ;
                          N052.27.22.536 E016.30.46.403 N052.27.26.676 E016.30.58.068  ;
                          N052.27.26.676 E016.30.58.068 N052.27.30.528 E016.31.09.983  ;
                          N052.27.30.528 E016.31.09.983 N052.27.34.127 E016.31.22.115  ;
                          N052.27.34.127 E016.31.22.115 N052.27.37.476 E016.31.34.428  ;
                          N052.27.37.476 E016.31.34.428 N052.27.40.571 E016.31.46.956  ;
                          N052.27.40.571 E016.31.46.956 N052.27.43.379 E016.31.59.627  ;
                          N052.27.43.379 E016.31.59.627 N052.27.45.936 E016.32.12.443  ;
                          N052.27.45.936 E016.32.12.443 N052.27.48.203 E016.32.25.440  ;
                          N052.27.48.203 E016.32.25.440 N052.27.50.184 E016.32.38.507  ;
                          N052.27.50.184 E016.32.38.507 N052.27.51.911 E016.32.51.719  ;
                          N052.27.51.911 E016.32.51.719 N052.27.53.315 E016.33.05.004  ;
                          N052.27.53.315 E016.33.05.004 N052.27.54.468 E016.33.18.359  ;
                          N052.27.54.468 E016.33.18.359 N052.27.55.332 E016.33.31.752  ;
                          N052.27.55.332 E016.33.31.752 N052.27.55.908 E016.33.45.216  ;
                          N052.27.55.908 E016.33.45.216 N052.27.56.195 E016.33.58.716  ;
                          N052.27.56.195 E016.33.58.716 N052.27.56.195 E016.34.12.179  ;
                          N052.27.56.195 E016.34.12.179 N052.27.55.908 E016.34.25.679  ;
                          N052.27.55.908 E016.34.25.679 N052.27.55.332 E016.34.39.143  ;
                          N052.27.55.332 E016.34.39.143 N052.27.54.468 E016.34.52.536  ;
                          N052.27.54.468 E016.34.52.536 N052.27.53.315 E016.35.05.891  ;
                          N052.27.53.315 E016.35.05.891 N052.27.51.911 E016.35.19.176  ;
                          N052.27.51.911 E016.35.19.176 N052.27.50.184 E016.35.32.388  ;
                          N052.27.50.184 E016.35.32.388 N052.27.48.203 E016.35.45.456  ;
                          N052.20.30.336 E016.37.00.912 N052.20.26.736 E016.36.48.780  ;
                          N052.20.26.736 E016.36.48.780 N052.20.23.387 E016.36.36.468  ;
                          N052.20.23.387 E016.36.36.468 N052.20.20.292 E016.36.23.939  ;
                          N052.20.20.292 E016.36.23.939 N052.20.17.483 E016.36.11.268  ;
                          N052.20.17.483 E016.36.11.268 N052.20.14.927 E016.35.58.451  ;
                          N052.20.14.927 E016.35.58.451 N052.20.12.659 E016.35.45.456  ;
                          N052.20.12.659 E016.35.45.456 N052.20.10.680 E016.35.32.388  ;
                          N052.20.10.680 E016.35.32.388 N052.20.08.951 E016.35.19.176  ;
                          N052.20.08.951 E016.35.19.176 N052.20.07.548 E016.35.05.891  ;
                          N052.20.07.548 E016.35.05.891 N052.20.06.396 E016.34.52.536  ;
                          N052.20.06.396 E016.34.52.536 N052.20.05.532 E016.34.39.143  ;
                          N052.20.05.532 E016.34.39.143 N052.20.04.956 E016.34.25.679  ;
                          N052.20.04.956 E016.34.25.679 N052.20.04.667 E016.34.12.179  ;
                          N052.20.04.667 E016.34.12.179 N052.20.04.667 E016.33.58.716  ;
                          N052.20.04.667 E016.33.58.716 N052.20.04.956 E016.33.45.216  ;
                          N052.20.04.956 E016.33.45.216 N052.20.05.532 E016.33.31.752  ;
                          N052.20.05.532 E016.33.31.752 N052.20.06.396 E016.33.18.359  ;
                          N052.20.06.396 E016.33.18.359 N052.20.07.548 E016.33.05.004  ;
                          N052.20.07.548 E016.33.05.004 N052.20.08.951 E016.32.51.719  ;
                          N052.20.08.951 E016.32.51.719 N052.20.10.680 E016.32.38.507  ;
                          N052.20.10.680 E016.32.38.507 N052.20.12.659 E016.32.25.403  ;
                          N052.20.30.336 E016.37.00.912 LAW            LAW
                          N052.27.21.888 E016.38.06.756 N052.27.24.371 E016.37.54.803
                          N052.27.24.371 E016.37.54.803 N052.27.27.144 E016.37.43.032
                          N052.27.27.144 E016.37.43.032 N052.27.30.132 E016.37.31.403
                          N052.27.30.132 E016.37.31.403 N052.27.33.371 E016.37.19.955
                          N052.27.33.371 E016.37.19.955 N052.27.36.863 E016.37.08.688
                          N052.27.36.863 E016.37.08.688 N052.27.40.608 E016.36.57.635
                          N052.27.40.608 E016.36.57.635 N052.27.44.568 E016.36.46.835
                          N052.27.44.568 E016.36.46.835 N052.27.48.744 E016.36.36.252
                          N052.27.48.744 E016.36.36.252 N052.27.53.172 E016.36.25.883
                          N052.27.53.172 E016.36.25.883 N052.27.57.780 E016.36.15.803
                          N052.27.57.780 E016.36.15.803 N052.28.02.604 E016.36.05.975
                          N052.28.02.604 E016.36.05.975 N052.28.07.643 E016.35.56.471
                          N052.28.07.643 E016.35.56.471 N052.28.12.900 E016.35.47.220
                          N052.28.12.900 E016.35.47.220 N052.28.18.336 E016.35.38.291
                          N052.28.18.336 E016.35.38.291 N052.28.23.952 E016.35.29.688
                          N052.28.23.952 E016.35.29.688 N052.28.29.748 E016.35.21.371
                          N052.28.29.748 E016.35.21.371 N052.28.35.724 E016.35.13.452
                          N052.28.35.724 E016.35.13.452 N052.28.41.879 E016.35.05.855
                          N052.28.41.879 E016.35.05.855 N052.28.48.179 E016.34.58.584
                          N052.28.48.179 E016.34.58.584 N052.28.54.623 E016.34.51.707
                          N052.28.54.623 E016.34.51.707 N052.29.01.211 E016.34.45.227
                          N052.29.01.211 E016.34.45.227 N052.29.07.907 E016.34.39.107
                          N052.32.24.756 E016.32.01.464 DENKO          DENKO
                          N052.29.07.907 E016.34.39.107 N052.32.24.756 E016.32.01.464                         
                          N052.23.28.823 E016.34.07.643 N052.25.24.527 E016.37.53.759
                          N052.25.24.527 E016.37.53.759 N052.25.29.712 E016.38.02.255
                          N052.25.29.712 E016.38.02.255 N052.25.34.716 E016.38.11.039
                          N052.25.34.716 E016.38.11.039 N052.25.39.539 E016.38.20.111
                          N052.25.39.539 E016.38.20.111 N052.25.44.148 E016.38.29.436
                          N052.25.44.148 E016.38.29.436 N052.25.48.539 E016.38.39.047
                          N052.25.48.539 E016.38.39.047 N052.25.52.751 E016.38.48.875
                          N052.25.52.751 E016.38.48.875 N052.25.56.747 E016.38.58.955
                          N052.25.56.747 E016.38.58.955 N052.26.00.528 E016.39.09.252
                          N052.26.00.528 E016.39.09.252 N052.26.04.091 E016.39.19.728
                          N052.26.04.091 E016.39.19.728 N052.26.07.403 E016.39.30.456
                          N052.26.07.403 E016.39.30.456 N052.26.10.500 E016.39.41.328
                          N052.26.10.500 E016.39.41.328 N052.26.13.379 E016.39.52.379
                          N052.26.13.379 E016.39.52.379 N052.26.16.007 E016.40.03.576
                          N052.26.16.007 E016.40.03.576 N052.26.18.383 E016.40.14.951
                          N052.26.18.383 E016.40.14.951 N052.26.20.508 E016.40.26.435
                          N052.26.20.508 E016.40.26.435 N052.26.22.416 E016.40.38.028
                          N052.26.22.416 E016.40.38.028 N052.26.24.071 E016.40.49.727
                          N052.26.24.071 E016.40.49.727 N052.26.25.475 E016.41.01.499
                          N052.26.25.475 E016.41.01.499 N052.26.26.628 E016.41.13.379
                          N052.26.26.628 E016.41.13.379 N052.26.27.492 E016.41.25.295
                          N052.26.27.492 E016.41.25.295 N052.26.28.140 E016.41.37.248
                          N052.26.28.140 E016.41.37.248 N052.26.28.535 E016.41.49.235
                          N052.26.28.535 E016.41.49.235 N052.26.28.644 E016.42.01.260
                          N052.26.28.644 E016.42.01.260 N052.26.28.535 E016.42.13.284
                          N052.26.28.535 E016.42.13.284 N052.26.28.140 E016.42.25.271
                          N052.26.28.140 E016.42.25.271 N052.26.27.492 E016.42.37.223
                          N052.26.27.492 E016.42.37.223 N052.26.26.628 E016.42.49.140
                          N052.26.26.628 E016.42.49.140 N052.26.25.475 E016.43.01.020
                          N052.26.25.475 E016.43.01.020 N052.26.24.071 E016.43.12.792
                          N052.26.24.071 E016.43.12.792 N052.26.22.416 E016.43.24.491
                          N052.26.22.416 E016.43.24.491 N052.26.20.508 E016.43.36.084
                          N052.23.28.823 E016.34.07.643 BAREP BAREP


EPWR 11 THR11WR THR11WR WR802 WR802
	WR802 WR802 NUDRO NUDRO
	NUDRO NUDRO WR803 WR803
	WR803 WR803 XIDNA XIDNA

	WR802 WR802 NUDRO NUDRO
	NUDRO NUDRO WR811 WR811
	WR811 WR811 LUNUK LUNUK

	WR802 WR802 WR841 WR841
	WR841 WR841 MAPIK MAPIK

	WR801 WR801 WR821 WR821
	WR821 WR821 WR822 WR822
	WR822 WR822 OBOVI OBOVI
	OBOVI OBOVI WR832 WR832
	WR832 WR832 ULGIL ULGIL

	WR822 WR822 WR823 WR823
	WR823 WR823 WR824 WR824
	WR824 WR824 PEKOT PEKOT

	

EPWR 29 THR29WR THR29WR WR902 WR902
	WR902 WR902 WR903 WR903
	WR903 WR903 GATPO GATPO
	GATPO GATPO XIDNA XIDNA

	WR903 WR930 WR904 WR904
	WR904 WR904 LUNUK LUNUK

	WR904 WR904 MAPIK MAPIK
	WR904 WR904 PEKOT PEKOT

	WR901 WR901 GODLO GODLO
	GODLO GODLO ULGIL ULGIL







EPBY 08 N053.05.54.090 E017.59.46.150 N053.06.09.000 E018.03.000
;arc dla LUXUD1A
N053.06.09.000 E018.03.000 N053.06.11.904	E018.04.29.000
N053.06.11.904	E018.04.29.000	N053.06.09.216	E018.05.22.095
N053.06.09.216	E018.05.22.095	N053.06.01.235	E018.06.12.607
N053.06.01.235	E018.06.12.607	N053.05.48.203	E018.07.00.001
N053.05.48.203	E018.07.00.001	N053.05.30.516	E018.07.42.837
N053.05.30.516	E018.07.42.837	N053.05.08.712	E018.08.19.815
N053.05.08.712	E018.08.19.815	N053.04.43.452	E018.08.49.809
N053.04.43.452	E018.08.49.809	N053.04.15.505	E018.09.11.909
N053.04.15.505	E018.09.11.909	N053.03.45.719	E018.09.25.444
N053.03.45.719	E018.09.25.444	N053.03.15.000	E018.09.30.002
N053.03.15.000	E018.09.30.002	N053.02.44.281	E018.09.25.444
N053.02.44.281	E018.09.25.444	N053.02.14.495	E018.09.11.909
N053.02.14.495	E018.09.11.909	N053.01.46.548	E018.08.49.809
N053.01.46.548	E018.08.49.809	N053.01.21.288	E018.08.19.815
N053.01.21.288	E018.08.19.815	N053.00.59.484	E018.07.42.837
N053.00.59.484	E018.07.42.837	N053.00.41.797	E018.07.00.001
N053.00.41.797	E018.07.00.001	N053.00.28.765	E018.06.12.607
N053.00.28.765	E018.06.12.607	N053.00.20.784	E018.05.22.095
N053.00.20.784	E018.05.22.095	N053.00.18.096	E018.04.29.000
N053.00.18.096	E018.04.29.000	N053.00.20.784	E018.03.37.905
N053.00.20.784	E018.03.37.905	N053.00.28.765	E018.02.47.393
N053.00.28.765	E018.02.47.393	N053.00.41.797	E018.01.59.999
N053.00.41.797	E018.01.59.999	N053.00.59.484	E018.01.17.163
N053.00.59.484	E018.01.17.163	N053.01.21.288	E018.00.40.185
N053.01.21.288	E018.00.40.185	N053.01.46.548	E018.00.10.191
N053.01.46.548	E018.00.10.191	N053.02.14.495	E017.59.48.091
N053.02.14.495	E017.59.48.091 BYZ BYZ

BYZ BYZ N053.06.28.452	E017.57.49.809	
N053.06.28.452	E017.57.49.809	N053.06.53.712	E017.57.19.815
N053.06.53.712	E017.57.19.815	N053.07.15.516	E017.56.42.837
N053.07.15.516	E017.56.42.837	N053.07.33.203	E017.56.00.001
N053.07.33.203	E017.56.00.001	N053.07.46.235	E017.55.12.607
N053.07.46.235	E017.55.12.607	N053.07.54.216	E017.54.22.095
N053.07.54.216	E017.54.22.095	N053.07.56.904	E017.53.29.000
N053.07.56.904	E017.53.29.000	N053.07.54.216	E017.52.37.905
N053.07.54.216	E017.52.37.905	N053.07.46.235	E017.51.47.393
N053.07.46.235	E017.51.47.393	N053.07.33.203	E017.50.59.999
N053.07.33.203	E017.50.59.999 N053.06.10.000 E017.47.00.000
N053.06.10.000 E017.47.00.000 LUXUD LUXUD

;arc dla GOBNI1A
N053.06.09.000 E018.03.000	N053.06.13.765	E018.03.42.607
N053.06.13.765	E018.03.42.607	N053.06.26.797	E018.04.30.001
N053.06.26.797	E018.04.30.001	N053.06.44.484	E018.05.12.837
N053.06.44.484	E018.05.12.837	N053.07.06.288	E018.05.49.815
N053.07.06.288	E018.05.49.815	N053.07.31.548	E018.06.19.809
N053.07.31.548	E018.06.19.809	N053.07.59.495	E018.06.41.909
N053.07.59.495	E018.06.41.909	N053.08.29.281	E018.06.55.444
N053.08.29.281	E018.06.55.444 N053.11.00.000 E018.08.00.000
N053.11.00.000 E018.08.00.000 GOBNI GOBNI

N053.06.26.797	E018.04.30.001 INTUN INTUN

EPBY 26 N053.05.42.890 E017.57.33.070 N053.05.20.000 E017.52.30.000
;arc dla INTUN1G
N053.05.20.000 E017.52.30.000	N053.05.01.235	E017.50.47.393
N053.05.01.235	E017.50.47.393	N053.04.48.203	E017.49.59.999
N053.04.48.203	E017.49.59.999	N053.04.30.516	E017.49.17.163
N053.04.30.516	E017.49.17.163	N053.04.08.712	E017.48.40.185
N053.04.08.712	E017.48.40.185	N053.03.43.452	E017.48.10.191
N053.03.43.452	E017.48.10.191	N053.03.15.505	E017.47.48.091
N053.03.15.505	E017.47.48.091	N053.02.45.719	E017.47.34.556
N053.02.45.719	E017.47.34.556	N053.02.15.000	E017.47.29.998
N053.02.15.000	E017.47.29.998	N053.01.44.281	E017.47.34.556
N053.01.44.281	E017.47.34.556	N053.01.14.495	E017.47.48.091
N053.01.14.495	E017.47.48.091	N053.00.46.548	E017.48.10.191
N053.00.46.548	E017.48.10.191	N053.00.21.288	E017.48.40.185
N053.00.21.288	E017.48.40.185	N052.59.59.484	E017.49.17.163
N052.59.59.484	E017.49.17.163	N052.59.41.797	E017.49.59.999
N052.59.41.797	E017.49.59.999	N052.59.28.765	E017.50.47.393
N052.59.28.765	E017.50.47.393	N052.59.20.784	E017.51.37.905
N052.59.20.784	E017.51.37.905	N052.59.18.096	E017.52.30.000
N052.59.18.096	E017.52.30.000	N052.59.20.784	E017.53.22.095
N052.59.20.784	E017.53.22.095	N052.59.28.765	E017.54.12.607
N052.59.28.765	E017.54.12.607	N052.59.41.797	E017.55.00.001
N052.59.41.797	E017.55.00.001	N052.59.59.484	E017.55.42.837
N052.59.59.484	E017.55.42.837	N053.00.21.288	E017.56.19.815
N053.00.21.288	E017.56.19.815	N053.00.46.548	E017.56.49.809
N053.00.46.548	E017.56.49.809	N053.01.14.495	E017.57.11.909
N053.01.14.495	E017.57.11.909	N053.01.44.281	E017.57.25.444
N053.01.44.281	E017.57.25.444	BYZ BYZ

;drugi zakret
BYZ BYZ	N053.06.10.505	E017.58.28.091
N053.06.10.505	E017.58.28.091	N053.06.38.452	E017.58.50.191
N053.06.38.452	E017.58.50.191	N053.07.03.712	E017.59.20.185
N053.07.03.712	E017.59.20.185	N053.07.25.516	E017.59.57.163
N053.07.25.516	E017.59.57.163	N053.07.43.203	E018.00.39.999
N053.07.43.203	E018.00.39.999	N053.07.56.235	E018.01.27.393
N053.07.56.235	E018.01.27.393	N053.08.04.216	E018.02.17.905
N053.08.04.216	E018.02.17.905	N053.08.06.904	E018.03.09.000
N053.08.06.904	E018.03.09.000	N053.08.04.216	E018.04.02.095
N053.08.04.216	E018.04.02.095	N053.07.56.235	E018.04.52.607
N053.07.56.235	E018.04.52.607 N053.06.55.000 E018.09.00.000
N053.06.55.000 E018.09.00.000 INTUN INTUN

N053.08.04.216	E018.02.17.905 GOBNI GOBNI

N053.05.20.000 E017.52.30.000 N053.06.10.000 E017.47.00.000
N053.06.10.000 E017.47.00.000 LUXUD LUXUD

[LOW AIRWAY]
L23 GORAT GORAT OTPES OTPES
L23 OTPES OTPES GONTU GONTU
L23 GONTU GONTU GRUDA GRUDA 
L23 GRUDA GRUDA UNDUK UNDUK
L23 UNDUK UNDUK ASGUL ASGUL
L23 ASGUL ASGUL TOMKO TOMKO
L23 TOMKO TOMKO BINKA BINKA

L29 ALUKA ALUKA TUPUR TUPUR
L29 TUPUR TUPUR PEPOX PEPOX
L29 PEPOX PEPOX TADAK TADAK
L29 TADAK TADAK GRUDA GRUDA
L29 GRUDA GRUDA IXIXI IXIXI
L29 IXIXI IXIXI OLKIN OLKIN
L29 OLKIN OLKIN SUW SUW
L29 SUW SUW VABER VABER

L32 SOTET SOTET SUW SUW
L32 SUW SUW GOLAD GOLAD

L87 PESEL PESEL XELOL XELOL
L87 XELOL XELOL TILAV TILAV
L87 TILAV TILAV LUSID LUSID

L132 BODLA BODLA DEMUR DEMUR

L616 DESEN DESEN PEKOT PEKOT
L616 PEKOT PEKOT ETNEL ETNEL
L616 ETNEL ETNEL MISKA MISKA
L616 MISKA MISKA VELAB VELAB
L616 VELAB VELAB BINPO BINPO
L616 BINPO BINPO DENKO DENKO

L617 REGLI REGLI EPOPA EPOPA 
L617 EPOPA EPOPA SOGPI SOGPI
L617 SOGPI SOGPI DEVEG DEVEG
L617 DEVEG DEVEG NUDRO NUDRO
L617 NUDRO NUDRO ARMEX ARMEX
L617 ARMEX ARMEX XIDNA XIDNA
L617 XIDNA XIDNA ADVAB ADVAB
L617 ADVAB ADVAB GINOK GINOK
L617 GINOK GINOK RONEX RONEX
L617 RONEX RONEX MIRVO MIRVO
L617 MIRVO MIRVO VIBUL VIBUL
L617 VIBUL VIBUL BABEN BABEN
L617 BABEN BABEN KOLOB KOLOB

L619 LENOV LENOV SUDOL SUDOL
L619 SUDOL SUDOL NUDRO NUDRO
L619 NUDRO NUDRO ARMEX ARMEX
L619 ARMEX ARMEX XIDNA XIDNA
L619 XIDNA XIDNA ADVAB ADVAB
L619 ADVAB ADVAB VABAT VABAT
L619 VABAT VABAT DENKO DENKO
L619 DENKO DENKO EKBUT EKBUT
L619 EKBUT EKBUT ALUKA ALUKA
L619 ALUKA ALUKA ERGON ERGON

L621 GOTIX GOTIX OSMAT OSMAT
L621 OSMAT OSMAT UREKO UREKO
L621 UREKO UREKO NEVAP NEVAP
L621 NEVAP NEVAP OGVET OGVET
L621 OGVET OGVET MONOV MONOV
L621 MONOV MONOV VADOL VADOL
L621 VADOL VADOL EGLON EGLON
L621 EGLON EGLON NETAB NETAB
L621 NETAB NETAB LIMVI LIMVI
L621 LIMVI LIMVI ADURU ADURU
L621 ADURU ADURU OLILA OLILA
L621 OLILA OLILA MEBIV MEBIV
L621 MEBIV MEBIV RILAB RILAB
L621 RILAB RILAB SOMOR SOMOR
L621 SOMOR SOMOR GRUDA GRUDA
L621 GRUDA GRUDA MALOX MALOX
L621 MALOX MALOX DEVEL DEVEL 
L621 DEVEL DEVEL LUSID LUSID

L623 LENOV LENOV EKVAT EKVAT
L623 EKVAT EKVAT VAVEL VAVEL
L623 VAVEL VAVEL BALOS BALOS
L623 BALOS BALOS MYSKO MYSKO 
L623 MYSKO MYSKO BAREX BAREX 
L623 BAREX BAREX BESTO BESTO
L623 BESTO BESTO MAVOT MAVOT
L623 MAVOT MAVOT ADVAB ADVAB

L730 ALUKA ALUKA VAVUN VAVUN
L730 VAVUN VAVUN UNVOX UNVOX
L730 UNVOX UNVOX GOBRA GOBRA
L730 GOBRA GOBRA LUXAL LUXAL
L730 LUXAL LUXAL VEKON VEKON
L730 VEKON VEKON KOSEX KOSEX

L733 BODLA BODLA ELTUB ELTUB
L733 ELTUB ELTUB AGODU AGODU
L733 AGODU AGODU BEZMI BEZMI
L733 BEZMI BEZMI RANOK RANOK 

L735 GOVEN GOVEN IDEXU IDEXU
L735 IDEXU IDEXU MAGAN MAGAN
L735 MAGAN MAGAN KULEK KULEK
L735 KULEK KULEK SUW SUW
L735 SUW SUW VABER VABER

L856 BABKO BABKO EKRUL EKRUL
L856 EKRUL EKRUL LODBO LODBO
L856 LODBO LODBO IXOGA IXOGA
L856 IXOGA IXOGA TOSPO TOSPO

L867 AMTEK AMTEK PEKOT PEKOT 
L867 PEKOT PEKOT SUBIX SUBIX

L979 GOVEN GOVEN BAPAS BAPAS 
L979 BAPAS BAPAS KELOD KELOD
L979 KELOD KELOD UVNUL UVNUL
L979 UVNUL UVNUL ATKUN ATKUN
L979 ATKUN ATKUN BAVNU BAVNU
L979 BAVNU BAVNU ENOBI ENOBI

L980 USTIL USTIL OMAVA OMAVA 
L980 OMAVA OMAVA ASVEM ASVEM
L980 ASVEM ASVEM POLON POLON
L980 POLON POLON DERAM DERAM 
L980 DERAM DERAM VAMPU VAMPU
L980 VAMPU VAMPU UTOLU UTOLU 
L980 UTOLU UTOLU INDIG INDIG 
L980 INDIG INDIG MASIV MASIV
L980 MASIV MASIV BADUP BADUP 
L980 BADUP BADUP ADVAB ADVAB
L980 ADVAB ADVAB OBOLA OBOLA 
L980 OBOLA OBOLA KELOD KELOD 
L980 KELOD KELOD BAREP BAREP 
L980 BAREP BAREP SUBIX SUBIX

L981 DIBED DIBED ARSOG ARSOG
L981 ARSOG ARSOG NIDIP NIDIP
L981 NIDIP NIDIP ETITI ETITI
L981 ETITI ETITI KOTEK KOTEK
L981 KOTEK KOTEK OBALU OBALU 
L981 OBALU OBALU ROGAL ROGAL 
L981 ROGAL ROGAL MAKOV MAKOV
L981 MAKOV MAKOV BADNO BADNO
L981 BADNO BADNO NILPU NILPU
L981 NILPU NILPU ADVAB ADVAB

L983 RANOK RANOK DOMAG DOMAG
L983 DOMAG DOMAG GIVAR GIVAR
L983 GIVAR GIVAR RUMAR RUMAR 

L984 DIBED DIBED VAREN VAREN 
L984 VAREN VAREN ATKEK ATKEK
L984 ATKEK ATKEK NATIX NATIX 
L984 NATIX NATIX LUXAR LUXAR 
L984 LUXAR LUXAR GEVNA GEVNA
L984 GEVNA GEVNA MOKMU MOKMU
L984 MOKMU MOKMU XEVBA XEVBA
L984 XEVBA XEVBA SKAVI SKAVI
L984 SKAVI SKAVI USALO USALO
L984 USALO USALO NOMIX NOMIX 
L984 NOMIX NOMIX LAVPI LAVPI
L984 LAVPI LAVPI PADKA PADKA

L986 TEPNA TEPNA ODRAP ODRAP
L986 ODRAP ODRAP LUXAR LUXAR
L986 LUXAR LUXAR SUDOL SUDOL
L986 SUDOL SUDOL SABAB SABAB
L986 SABAB SABAB GIGAL GIGAL 
L986 GIGAL GIGAL LASIS LASIS

L996 DENKO DENKO XERBI XERBI
L996 XERBI XERBI PIXOR PIXOR
L996 PIXOR PIXOR DOSAL DOSAL
L996 DOSAL DOSAL VAVUN VAVUN
L996 VAVUN VAVUN MASUN MASUN
L996 MASUN MASUN GOMEX GOMEX 
L996 GOMEX GOMEX ROBOV ROBOV
L996 ROBOV ROBOV TILAV TILAV 
L996 TILAV TILAV GOSOT GOSOT

L999 SUPAK SUPAK GEVNA GEVNA
L999 GEVNA GEVNA OSBUG OSBUG
L999 OSBUG OSBUG OBOSO OBOSO
L999 OBOSO OBOSO DOGIG DOGIG
L999 DOGIG DOGIG BIGLU BIGLU

M66 BABKO BABKO KUKAM KUKAM
M66 KUKAM KUKAM NEGUV NEGUV
M66 NEGUV NEGUV EVINA EVINA

M70 TOLPA TOLPA SOMOX SOMOX 
M70 SOMOX SOMOX POLON POLON
M70 POLON POLON ERPAB ERPAB
M70 ERPAB ERPAB ARKUG ARKUG
M70 ARKUG ARKUG BABEN BABEN

M602 VAVUN VAVUN IRGET IRGET
M602 IRGET IRGET BINKA BINKA

M607 MALOX MALOX RIVDI RIVDI
M607 RIVDI RIVDI PENOR PENOR

M857 PODAN PODAN OBOSO OBOSO
M857 OBOSO OBOSO LODBO LODBO
M857 LODBO LODBO VENES VENES 
M857 VENES VENES EGLON EGLON
M857 EGLON EGLON SUMAM SUMAM
M857 SUMAM SUMAM VAXUR VAXUR
M857 VAXUR VAXUR GERVI GERVI
M857 GERVI GERVI XESNA XESNA
M857 XESNA XESNA BULEP BULEP 
M857 BULEP BULEP UNPEG UNPEG
M857 UNPEG UNPEG NORNO NORNO
M857 NORNO NORNO SUW SUW
M857 SUW SUW BOKSU BOKSU

M860 ROLKA ROLKA EGLON EGLON
M860 EGLON EGLON XIMBA XIMBA

M863 POLON POLON ASLUX ASLUX
M863 ASLUX ASLUX ETUBO ETUBO
M863 ETUBO ETUBO RUDKA RUDKA

M865 LARMA LARMA LATMI LATMI

M866 BABKO BABKO XEVLU XEVLU
M866 XEVLU XEVLU LUKOR LUKOR 
M866 LUKOR LUKOR KOTEK KOTEK
M866 KOTEK KOTEK LOGDA LOGDA
M866 LOGDA LOGDA KURAV KURAV
M866 KURAV KURAV GERVI GERVI
M866 GERVI GERVI ETUBO ETUBO

M977 DIBED DIBED OSMAT OSMAT 
M977 OSMAT OSMAT BALBA BALBA 
M977 BALBA BALBA LUGUG LUGUG
M977 LUGUG LUGUG DISBI DISBI
M977 DISBI DISBI ETUBO ETUBO 
M977 ETUBO ETUBO BESOT BESOT 
M977 BESOT BESOT EVODO EVODO
M977 EVODO EVODO SUW SUW

M984 TUSIN TUSIN IBEKA IBEKA 
M984 IBEKA IBEKA RODAK RODAK 
M984 RODAK RODAK KOTEK KOTEK
M984 KOTEK KOTEK ULGOS ULGOS
M984 ULGOS ULGOS LETKI LETKI

M985 MEBAN MEBAN NAXAR NAXAR
M985 NAXAR NAXAR SKAVI SKAVI
M985 SKAVI SKAVI VAVEL VAVEL
M985 VAVEL VAVEL POBOK POBOK 
M985 POBOK POBOK KOTEK KOTEK
M985 KOTEK KOTEK EVINA EVINA
M985 EVINA EVINA ERMIV ERMIV
M985 ERMIV ERMIV XATOG XATOG
M985 XATOG XATOG TITUV TITUV
M985 TITUV TITUV SUW SUW
M985 SUW SUW BOKSU BOKSU

M992 ADADO ADADO EMBIK EMBIK
M992 EMBIK EMBIK ORSOX ORSOX
M992 ORSOX ORSOX VAKNU VAKNU

M994 GILAS GILAS DENKO DENKO
M994 DENKO DENKO OLNED OLNED
M994 OLNED OLNED TADAK TADAK
M994 TADAK TADAK ODLOT ODLOT
M994 ODLOT ODLOT NIKMI NIKMI 
M994 NIKMI NIKMI GOMED GOMED

N5 VENES VENES LIMVI LIMVI
N5 LIMVI LIMVI BASRI BASRI
N5 BASRI BASRI OTMAX OTMAX
N5 OTMAX OTMAX GITOV GITOV

N133 LENOV LENOV GOSAK GOSAK 
N133 GOSAK GOSAK KOTEK KOTEK
N133 KOTEK KOTEK NEGUV NEGUV
N133 NEGUV NEGUV OVBOR OVBOR
N133 OVBOR OVBOR LUBEN LUBEN
N133 LUBEN LUBEN NUBLI NUBLI
N133 NUBLI NUBLI IRBOS IRBOS
N133 IRBOS IRBOS VIDEV VIDEV
N133 VIDEV VIDEV GIPOS GIPOS
N133 GIPOS GIPOS POLON POLON
N133 POLON POLON ADOXO ADOXO
N133 ADOXO ADOXO PENEX PENEX
N133 PENEX PENEX NASOK NASOK
N133 NASOK NASOK BIBKA BIBKA
N133 BIBKA BIBKA GRUDA GRUDA
N133 GRUDA GRUDA IRLUN IRLUN
N133 IRLUN IRLUN KARTI KARTI
N133 KARTI KARTI VAPOS VAPOS 
N133 VAPOS VAPOS DOMAG DOMAG 
N133 DOMAG DOMAG MOTAD MOTAD 
N133 MOTAD MOTAD PENOR PENOR

N191 USTIL USTIL GIMAP GIMAP
N191 GIMAP GIMAP SOMOX SOMOX
N191 SOMOX SOMOX RUTUK RUTUK 
N191 RUTUK RUTUK SUMAM SUMAM
N191 SUMAM SUMAM LIMVI LIMVI
N191 LIMVI LIMVI SORIX SORIX
N191 SORIX SORIX UNELO UNELO
N191 UNELO UNELO LASGU LASGU
N191 LASGU LASGU GRUDA GRUDA
N191 GRUDA GRUDA NIKMI NIKMI

N195 DIBED DIBED MOSIR MOSIR
N195 MOSIR MOSIR TELDU TELDU
N195 TELDU TELDU VELAX VELAX
N195 VELAX VELAX LIBGA LIBGA
N195 LIBGA LIBGA NATEV NATEV
N195 NATEV NATEV VENES VENES
N195 VENES VENES DOTEX DOTEX
N195 DOTEX DOTEX OMAVA OMAVA
N195 OMAVA OMAVA NAKER NAKER
N195 NAKER NAKER XIMBA XIMBA
N195 XIMBA XIMBA ODRUX ODRUX
N195 ODRUX ODRUX SORIX SORIX
N195 SORIX SORIX NASOK NASOK
N195 NASOK NASOK UNDUK UNDUK
N195 UNDUK UNDUK OGRES OGRES
N195 OGRES OGRES ELPOL ELPOL
N195 ELPOL ELPOL KOLOB KOLOB

N744 TUSIN TUSIN NAVUR NAVUR
N744 NAVUR NAVUR OVBOR OVBOR
N744 OVBOR OVBOR EVINA EVINA
N744 EVINA EVINA GESDU GESDU
N744 GESDU GESDU WAR WAR

N746 BINKA BINKA DEMUR DEMUR 
N746 DEMUR DEMUR BABEN BABEN 
N746 BABEN BABEN GORPI GORPI

N858 SUBIX SUBIX DENKO DENKO
N858 DENKO DENKO DEKUT DEKUT 
N858 DEKUT DEKUT EBOGU EBOGU 
N858 EBOGU EBOGU GRUDA GRUDA
N858 GRUDA GRUDA OSKUD OSKUD
N858 OSKUD OSKUD TUROL TUROL
N858 TUROL TUROL BARGU BARGU
N858 BARGU BARGU OTRIV OTRIV
N858 OTRIV OTRIV BOKSU BOKSU

N869 TOMTI TOMTI IXURO IXURO
N869 IXURO IXURO AGALU AGALU
N869 AGALU AGALU UVIVI UVIVI
N869 UVIVI UVIVI BAXIS BAXIS
N869 BAXIS BAXIS VAMPU VAMPU
N869 VAMPU VAMPU OTPOP OTPOP
N869 OTPOP OTPOP SOXER SOXER
N869 SOXER SOXER KUKOP KUKOP
N869 KUKOP KUKOP WAR WAR
N869 WAR WAR XATOG XATOG
N869 XATOG XATOG BULEP BULEP
N869 BULEP BULEP BESOT BESOT
N869 BESOT BESOT GORAT GORAT

N871 LAGAR LAGAR RUDUB RUDUB
N871 RUDUB RUDUB MISKA MISKA 
N871 MISKA MISKA VAGSA VAGSA 
N871 VAGSA VAGSA LUNUK LUNUK
N871 LUNUK LUNUK OKENO OKENO
N871 OKENO OKENO ABAKU ABAKU
N871 ABAKU ABAKU POLON POLON
N871 POLON POLON KUKOP KUKOP
N871 KUKOP KUKOP WAR WAR
N871 WAR WAR UVROB UVROB
N871 UVROB UVROB ASBIM ASBIM
N871 ASBIM ASBIM SUW SUW

N983 DIBED DIBED VAGDU VAGDU
N983 VAGDU VAGDU ORVOG ORVOG
N983 ORVOG ORVOG POLON POLON
N983 POLON POLON AMUTO AMUTO
N983 AMUTO AMUTO EMGIP EMGIP
N983 EMGIP EMGIP MAPEX MAPEX
N983 MAPEX MAPEX ELPOL ELPOL
N983 ELPOL ELPOL AMROR AMROR

P31 GOVEN GOVEN XERBI XERBI
P31 XERBI XERBI LUXAL LUXAL
P31 LUXAL LUXAL BEZMI BEZMI
P31 BEZMI BEZMI KUNER KUNER

P96 ODERA ODERA GUDON GUDON

P139 SUPAK SUPAK ULGOS ULGOS 
P139 ULGOS ULGOS LEGNO LEGNO
P139 LEGNO LEGNO IRDEB IRDEB
P139 IRDEB IRDEB GERVI GERVI

P150 ADVAB ADVAB DIPKI DIPKI 
P150 DIPKI DIPKI TENVO TENVO
P150 TENVO TENVO OBOKU OBOKU
P150 OBOKU OBOKU PEVUM PEVUM
P150 PEVUM PEVUM AMUTO AMUTO 
P150 AMUTO AMUTO DOSIX DOSIX
P150 DOSIX DOSIX BIMPA BIMPA

P159 ROLKA ROLKA GITOV GITOV

P193 KELEL KELEL ELGOX ELGOX
P193 ELGOX ELGOX VAGON VAGON

P733 TOMTI TOMTI DIMEX DIMEX
P733 DIMEX DIMEX AKAPI AKAPI
P733 AKAPI AKAPI ADVAB ADVAB
P733 ADVAB ADVAB ATMIR ATMIR 
P733 ATMIR ATMIR EBOGU EBOGU
P733 EBOGU EBOGU GODMA GODMA 
P733 GODMA GODMA IRLUN IRLUN
P733 IRLUN IRLUN NIKMI NIKMI
P733 NIKMI NIKMI IPLIT IPLIT

P746 LUGOL LUGOL ODRAP ODRAP
P746 ODRAP ODRAP INDAD INDAD
P746 INDAD INDAD KOTEK KOTEK

P851 ABERO ABERO GERVI GERVI
P851 GERVI GERVI NEPOX NEPOX
P851 NEPOX NEPOX WAR WAR
P851 WAR WAR BIMPA BIMPA
P851 BIMPA BIMPA VEMAL VEMAL
P851 VEMAL VEMAL MOLIL MOLIL 
P851 MOLIL MOLIL IDEXU IDEXU 
P851 IDEXU IDEXU DENKO DENKO

P861 RASAN RASAN REMVU REMVU
P861 REMVU REMVU LATAG LATAG
P861 LATAG LATAG ERNOX ERNOX
P861 ERNOX ERNOX GINOK GINOK 
P861 GINOK GINOK DEKUT DEKUT 
P861 DEKUT DEKUT ODLOT ODLOT
P861 ODLOT ODLOT KARTI KARTI
P861 KARTI KARTI RANOK RANOK

Q10 PADKA PADKA LUVOD LUVOD
Q10 LUVOD LUVOD DODOD DODOD
Q10 DODOD DODOD KOTEK KOTEK

Q34 SUPAK SUPAK IVNER IVNER

Q35 BABKO BABKO TOLPA TOLPA

Q99 NAKER NAKER ADIKA ADIKA
Q99 ADIKA ADIKA ABEXA ABEXA 
Q99 ABEXA ABEXA POLON POLON

Q258 LUXAR LUXAR MAXAM MAXAM
Q258 MAXAM MAXAM DEMIN DEMIN 
Q258 DEMIN DEMIN RZE RZE
Q258 RZE RZE AKETU AKETU
Q258 AKETU AKETU VELAX VELAX
Q258 VELAX VELAX UREKO UREKO

Q277 OKENO OKENO GOGUS GOGUS
Q277 GOGUS GOGUS AGAVA AGAVA

Q316 BODLA BODLA ARKUG ARKUG
Q316 ARKUG ARKUG OSKUD OSKUD
Q316 OSKUD OSKUD SUW SUW

Q800 BILRA BILRA POKEN POKEN

T174 KORUP KORUP LATAG LATAG
T174 LATAG LATAG INDIG INDIG
T174 INDIG INDIG DIBLO DIBLO
T174 DIBLO DIBLO LOLSI LOLSI
T174 LOLSI LOLSI WAR WAR
T174 WAR WAR TEVGU TEVGU
T174 TEVGU TEVGU TOXAR TOXAR
T174 TOXAR TOXAR RUDKA RUDKA

T205 BAREX BAREX GOMOR GOMOR
T205 GOMOR GOMOR VAGON VAGON
T205 VAGON VAGON SOVAM SOVAM
T205 SOVAM SOVAM DIMEX DIMEX
T205 DIMEX DIMEX LOLKO LOLKO
T205 LOLKO LOLKO EVGAG EVGAG
T205 EVGAG EVGAG GOVEN GOVEN

T224 KUNER KUNER BUNOS BUNOS
T224 BUNOS BUNOS OGDAV OGDAV

T240 OGDAV OGDAV DOMAG DOMAG

T265 ADURU ADURU LOLSI LOLSI

T266 XIMBA XIMBA POLON POLON

T267 BALBA BALBA NATEV NATEV

T269 ROLKA ROLKA NATEV NATEV

T270 VADOL VADOL TIMSO TIMSO
T270 TIMSO TIMSO SUMAM SUMAM
T270 SUMAM SUMAM IRDEB IRDEB
T270 IRDEB IRDEB SUPID SUPID
T270 SUPID SUPID OLILA OLILA
T270 OLILA OLILA MEBIV MEBIV
T270 MEBIV MEBIV RILAB RILAB
T270 RILAB RILAB OSLOG OSLOG

T282 POBIG POBIG GAVDU GAVDU

T353 KURAV KURAV EVINA EVINA
T353 EVINA EVINA IRBOS IRBOS

T354 OMAVA OMAVA SUMAM SUMAM

T355 KURAV KURAV AGAVA AGAVA
T355 AGAVA AGAVA POLON POLON

T356 ROMEG ROMEG LEGNO LEGNO

T357 NETAB NETAB ROMEG ROMEG

T375 MEBAN MEBAN ROXUG ROXUG
T375 ROXUG ROXUG LULIN LULIN
T375 LULIN LULIN IRGAM IRGAM
T375 IRGAM IRGAM GAVDU GAVDU

T425 USTIL USTIL BALBA BALBA
T425 BALBA BALBA MONOV MONOV

T670 VAPOS VAPOS GIVAR GIVAR

T671 AGODU AGODU VEKON VEKON
T671 VEKON VEKON DEXIR DEXIR

T672 GOBRA GOBRA RAVAG RAVAG
T672 RAVAG RAVAG OSMOV OSMOV 
T672 OSMOV OSMOV RATOR RATOR
T672 RATOR RATOR NIKMI NIKMI

T707 TOMTI TOMTI ULGIL ULGIL
T707 ULGIL ULGIL RASUT RASUT
T707 RASUT RASUT VAGON VAGON

T709 BAVOK BAVOK LURAD LURAD
T709 LURAD LURAD VAKNU VAKNU
T709 VAKNU VAKNU MOKOS MOKOS
T709 MOKOS MOKOS KURON KURON
T709 KURON KURON KOTEK KOTEK
T709 KOTEK KOTEK LULIN LULIN
T709 LULIN LULIN POBIG POBIG
T709 POBIG POBIG ARGIX ARGIX
T709 ARGIX ARGIX LUKOX LUKOX

T710 LOLKA LOLKA IBEKA IBEKA
T710 IBEKA IBEKA ORSOX ORSOX
T710 ORSOX ORSOX MAPIK MAPIK
T710 MAPIK MAPIK SABAB SABAB 
T710 SABAB SABAB APTAS APTAS
T710 APTAS APTAS NUDRO NUDRO 
T710 NUDRO NUDRO VAGON VAGON
T710 VAGON VAGON VELAB VELAB 
T710 VELAB VELAB KULUV KULUV 
T710 KULUV KULUV OLUMA OLUMA 
T710 OLUMA OLUMA SUBIX SUBIX

T714 BALOS BALOS MAPIK MAPIK
T714 MAPIK MAPIK OSNON OSNON
T714 OSNON OSNON ATMEV ATMEV
T714 ATMEV ATMEV XELET XELET 
T714 XELET XELET GODLO GODLO 
T714 GODLO GODLO NOSKU NOSKU 
T714 NOSKU NOSKU LASIS LASIS

T720 REGLI REGLI UPKIS UPKIS
T720 UPKIS UPKIS MIXAT MIXAT
T720 MIXAT MIXAT MOLIL MOLIL
T720 MOLIL MOLIL ATKUN ATKUN
T720 ATKUN ATKUN GRUDA GRUDA

T727 DENKO DENKO DELIR DELIR
T727 DELIR DELIR GONTU GONTU
T727 GONTU GONTU ELKAR ELKAR
T727 ELKAR ELKAR LUSUL LUSUL
T727 LUSUL LUSUL SUW SUW

T738 GOVRI GOVRI ORTEB ORTEB
T738 ORTEB ORTEB XEVLU XEVLU
T738 XEVLU XEVLU LUVOD LUVOD
T738 LUVOD LUVOD ORSOX ORSOX
T738 ORSOX ORSOX NUMBA NUMBA
T738 NUMBA NUMBA OLMUK OLMUK
T738 OLMUK OLMUK DINOV DINOV 
T738 DINOV DINOV EKSEK EKSEK 
T738 EKSEK EKSEK LASIS LASIS

T871 LAGAR LAGAR DINOV DINOV
T871 DINOV DINOV ROTOL ROTOL
T871 ROTOL ROTOL GODLO GODLO

Y41 KARTI KARTI BABOT BABOT
Y41 BABOT BABOT LARMA LARMA

Y100 NIKMI NIKMI KARTI KARTI
Y100 KARTI KARTI DEXIR DEXIR
Y100 DEXIR DEXIR MALOX MALOX
Y100 MALOX MALOX URORA URORA
Y100 URORA URORA ELPOL ELPOL

Y209 KELOD KELOD ARSAP ARSAP

Y210 PEKOT PEKOT OLUMA OLUMA
Y210 OLUMA OLUMA ARSAP ARSAP

Y564 NIVON NIVON IXIXI IXIXI

Y565 OLILA OLILA UDROV UDROV

Y566 XESNA XESNA OTMAX OTMAX
Y566 OTMAX OTMAX UDROV UDROV

Z72 KARTI KARTI KUNER KUNER

Z73 VAKNU VAKNU MAPIK MAPIK

Z80 TILAV TILAV GORPI GORPI

Z95 SUSER SUSER BAVGO BAVGO
Z95 BAVGO BAVGO GOBNI GOBNI
Z95 GOBNI GOBNI GRUDA GRUDA
Z95 GRUDA GRUDA OSLOG OSLOG

Z96 DEKUT DEKUT LUXUD LUXUD
Z96 LUXUD LUXUD ABIBO ABIBO
Z96 ABIBO ABIBO SUSER SUSER
Z96 SUSER SUSER NUDMO NUDMO
Z96 NUDMO NUDMO INTUN INTUN
Z96 INTUN INTUN BIBKA BIBKA 
Z96 BIBKA BIBKA LASGU LASGU 
Z96 LASGU LASGU SOMOR SOMOR 

Z121 NETIR NETIR GIXOL GIXOL
Z121 GIXOL GIXOL SKAVI SKAVI

Z126 TUSIN TUSIN VAKNU VAKNU

Z127 TUSIN TUSIN USALO USALO
Z127 USALO USALO XEVLU XEVLU

Z131 BANUB BANUB GOSOT GOSOT

Z159 REGLI REGLI ADVEX ADVEX
Z159 ADVEX ADVEX OSKEX OSKEX
Z159 OSKEX OSKEX MAVOT MAVOT
Z159 MAVOT MAVOT NILPU NILPU

Z169 BABKO BABKO EVGUR EVGUR
Z169 EVGUR EVGUR POLON POLON
Z169 POLON POLON XALUR XALUR
Z169 XALUR XALUR GERVI GERVI

Z181 XIGRI XIGRI NAVDI NAVDI
Z181 NAVDI NAVDI ELSUP ELSUP
Z181 ELSUP ELSUP UBOMI UBOMI

Z182 ABERO ABERO ASLUX ASLUX
Z182 ASLUX ASLUX BAMSO BAMSO

Z212 BANUB BANUB POKEN POKEN 

Z225 LASIS LASIS REPTU REPTU
Z225 REPTU REPTU ROPIK ROPIK
Z225 ROPIK ROPIK VELAB VELAB 

Z348 ULGIL ULGIL EKSEK EKSEK
Z348 EKSEK EKSEK NAROX NAROX

Z349 TOMTI TOMTI EKSEK EKSEK

Z419 VAGNI VAGNI LASIS LASIS

Z460 ASLUX ASLUX XESNA XESNA
Z460 XESNA XESNA TOXAR TOXAR 
Z460 TOXAR TOXAR BESOT BESOT

Z491 BODLA BODLA ROVEK ROVEK
Z491 ROVEK ROVEK VAVUN VAVUN
Z491 VAVUN VAVUN BEDAM BEDAM 
Z491 BEDAM BEDAM DEMUR DEMUR 
Z491 DEMUR DEMUR XELOL XELOL
Z491 XELOL XELOL EKRON EKRON
Z491 EKRON EKRON POKEN POKEN

Z493 XELOL XELOL BILRA BILRA

Z717 BODLA BODLA EMGAR EMGAR
Z727 EMGAR EMGAR KUNER KUNER

[HIGH AIRWAY]

[GEO]
; - droga
N051.43.25.841 E019.24.21.425 N051.43.26.127 E019.24.21.449 0
N051.43.26.127 E019.24.21.449 N051.43.26.462 E019.24.21.344 0
N051.43.26.462 E019.24.21.344 N051.43.26.933 E019.24.21.050 0
N051.43.26.933 E019.24.21.050 N051.43.29.271 E019.24.19.620 0
N051.43.29.271 E019.24.19.620 N051.43.30.093 E019.24.19.116 0
N051.43.30.093 E019.24.19.116 N051.43.30.472 E019.24.18.717 0
N051.43.30.472 E019.24.18.717 N051.43.30.814 E019.24.18.136 0
N051.43.30.814 E019.24.18.136 N051.43.31.173 E019.24.17.475 0
N051.43.31.173 E019.24.17.475 N051.43.31.605 E019.24.16.657 0
; - droga1
N051.43.29.264 E019.24.19.604 N051.43.29.428 E019.24.19.448 0
N051.43.29.428 E019.24.19.448 N051.43.29.629 E019.24.19.175 0
N051.43.29.629 E019.24.19.175 N051.43.29.799 E019.24.18.824 0
N051.43.29.799 E019.24.18.824 N051.43.29.915 E019.24.18.431 0
N051.43.29.915 E019.24.18.431 N051.43.29.990 E019.24.18.084 0
N051.43.29.990 E019.24.18.084 N051.43.30.027 E019.24.17.699 0
N051.43.30.027 E019.24.17.699 N051.43.30.000 E019.24.17.177 0
N051.43.30.000 E019.24.17.177 N051.43.29.943 E019.24.16.792 0
N051.43.29.943 E019.24.16.792 N051.43.29.665 E019.24.15.494 0
N051.43.29.665 E019.24.15.494 N051.43.28.796 E019.24.11.538 0
N051.43.28.796 E019.24.11.538 N051.43.28.126 E019.24.08.409 0
N051.43.28.126 E019.24.08.409 N051.43.28.108 E019.24.08.172 0
N051.43.28.108 E019.24.08.172 N051.43.28.112 E019.24.07.890 0
N051.43.28.112 E019.24.07.890 N051.43.28.142 E019.24.07.585 0
N051.43.28.142 E019.24.07.585 N051.43.28.211 E019.24.07.324 0
N051.43.28.211 E019.24.07.324 N051.43.28.313 E019.24.07.102 0
N051.43.28.313 E019.24.07.102 N051.43.28.418 E019.24.06.926 0
N051.43.28.418 E019.24.06.926 N051.43.28.544 E019.24.06.771 0
N051.43.28.544 E019.24.06.771 N051.43.28.697 E019.24.06.634 0
N051.43.28.697 E019.24.06.634 N051.43.28.777 E019.24.06.579 0
N051.43.28.777 E019.24.06.579 N051.43.29.050 E019.24.06.428 0
; - 1
N051.43.29.049 E019.24.06.424 N051.43.29.665 E019.24.06.090 0
N051.43.29.665 E019.24.06.090 N051.43.30.003 E019.24.05.857 0
N051.43.30.003 E019.24.05.857 N051.43.30.123 E019.24.05.674 0
N051.43.30.123 E019.24.05.674 N051.43.30.227 E019.24.05.441 0
N051.43.30.227 E019.24.05.441 N051.43.30.276 E019.24.05.191 0
N051.43.30.276 E019.24.05.191 N051.43.30.288 E019.24.04.888 0
N051.43.30.288 E019.24.04.888 N051.43.30.230 E019.24.04.503 0
N051.43.30.230 E019.24.04.503 N051.43.30.040 E019.24.03.631 0
N051.43.30.040 E019.24.03.631 N051.43.29.870 E019.24.02.894 0
N051.43.29.870 E019.24.02.894 N051.43.29.680 E019.24.02.052 0
; - 2
N051.43.30.000 E019.24.05.863 N051.43.30.132 E019.24.05.753 0
N051.43.30.132 E019.24.05.753 N051.43.30.330 E019.24.05.497 0
N051.43.30.330 E019.24.05.497 N051.43.30.645 E019.24.04.984 0
N051.43.30.645 E019.24.04.984 N051.43.30.684 E019.24.04.948 0
N051.43.30.684 E019.24.04.948 N051.43.30.751 E019.24.04.884 0
N051.43.30.751 E019.24.04.884 N051.43.30.906 E019.24.04.765 0
N051.43.30.906 E019.24.04.765 N051.43.31.174 E019.24.04.624 0
N051.43.31.174 E019.24.04.624 N051.43.34.346 E019.24.02.872 0
; - 3
N051.43.30.647 E019.24.04.979 N051.43.30.776 E019.24.04.752 0
N051.43.30.776 E019.24.04.752 N051.43.31.031 E019.24.04.339 0
N051.43.31.031 E019.24.04.339 N051.43.31.380 E019.24.03.770 0
N051.43.31.380 E019.24.03.770 N051.43.31.499 E019.24.03.479 0
N051.43.31.499 E019.24.03.479 N051.43.31.577 E019.24.03.158 0
N051.43.31.577 E019.24.03.158 N051.43.31.609 E019.24.02.874 0
N051.43.31.609 E019.24.02.874 N051.43.31.597 E019.24.02.548 0
N051.43.31.597 E019.24.02.548 N051.43.31.551 E019.24.02.230 0
N051.43.31.551 E019.24.02.230 N051.43.31.437 E019.24.01.700 0
N051.43.31.437 E019.24.01.700 N051.43.30.860 E019.23.59.053 0
N051.43.30.860 E019.23.59.053 N051.43.30.718 E019.23.59.058 0
N051.43.30.718 E019.23.59.058 N051.43.30.632 E019.23.59.089 0
N051.43.30.632 E019.23.59.089 N051.43.30.542 E019.23.59.153 0
N051.43.30.542 E019.23.59.153 N051.43.30.468 E019.23.59.231 0
N051.43.30.468 E019.23.59.231 N051.43.30.383 E019.23.59.342 0
N051.43.30.383 E019.23.59.342 N051.43.30.345 E019.23.59.426 0
N051.43.30.345 E019.23.59.426 N051.43.30.307 E019.23.59.517 0
N051.43.30.307 E019.23.59.517 N051.43.30.288 E019.23.59.581 0
N051.43.30.288 E019.23.59.581 N051.43.28.467 E019.23.59.569 0
; - 4
N051.43.31.277 E019.24.00.977 N051.43.31.402 E019.24.00.842 0
N051.43.31.402 E019.24.00.842 N051.43.31.497 E019.24.00.755 0
N051.43.31.497 E019.24.00.755 N051.43.31.617 E019.24.00.728 0
N051.43.31.617 E019.24.00.728 N051.43.31.730 E019.24.00.712 0
N051.43.31.730 E019.24.00.712 N051.43.31.881 E019.24.00.780 0
N051.43.31.881 E019.24.00.780 N051.43.31.976 E019.24.00.864 0
N051.43.31.976 E019.24.00.864 N051.43.32.078 E019.24.01.000 0
N051.43.32.078 E019.24.01.000 N051.43.33.737 E019.24.00.084 0
; - 5
N051.43.31.595 E019.24.16.685 N051.43.31.933 E019.24.16.050 0
N051.43.31.933 E019.24.16.050 N051.43.32.446 E019.24.15.200 0
N051.43.32.446 E019.24.15.200 N051.43.32.691 E019.24.15.001 0
N051.43.32.691 E019.24.15.001 N051.43.33.707 E019.24.14.375 0
N051.43.33.707 E019.24.14.375 N051.43.36.651 E019.24.12.768 0
N051.43.36.651 E019.24.12.768 N051.43.36.645 E019.24.12.483 0
N051.43.36.645 E019.24.12.483 N051.43.36.611 E019.24.12.275 0
N051.43.36.611 E019.24.12.275 N051.43.36.560 E019.24.12.153 0
N051.43.36.560 E019.24.12.153 N051.43.36.463 E019.24.12.010 0
N051.43.36.463 E019.24.12.010 N051.43.36.345 E019.24.11.957 0
N051.43.36.345 E019.24.11.957 N051.43.36.000 E019.24.10.344 0
; - 6
N051.43.36.451 E019.24.12.876 N051.43.36.589 E019.24.12.929 0
N051.43.36.589 E019.24.12.929 N051.43.36.667 E019.24.13.029 0
N051.43.36.667 E019.24.13.029 N051.43.36.743 E019.24.13.262 0
N051.43.36.743 E019.24.13.262 N051.43.36.983 E019.24.14.406 0
; - 7
N051.43.36.183 E019.24.13.025 N051.43.36.193 E019.24.12.819 0
N051.43.36.193 E019.24.12.819 N051.43.36.173 E019.24.12.494 0
N051.43.36.173 E019.24.12.494 N051.43.36.124 E019.24.12.365 0
N051.43.36.124 E019.24.12.365 N051.43.36.013 E019.24.12.118 0
N051.43.36.013 E019.24.12.118 N051.43.35.877 E019.24.11.953 0
N051.43.35.877 E019.24.11.953 N051.43.35.733 E019.24.11.880 0
N051.43.35.733 E019.24.11.880 N051.43.35.381 E019.24.10.168 0
; - 8
N051.43.35.937 E019.24.13.151 N051.43.36.094 E019.24.13.229 0
N051.43.36.094 E019.24.13.229 N051.43.36.176 E019.24.13.356 0
N051.43.36.176 E019.24.13.356 N051.43.36.223 E019.24.13.539 0
N051.43.36.223 E019.24.13.539 N051.43.36.473 E019.24.14.698 0
; - 9
N051.43.35.588 E019.24.13.350 N051.43.35.590 E019.24.13.151 0
N051.43.35.590 E019.24.13.151 N051.43.35.580 E019.24.12.965 0
N051.43.35.580 E019.24.12.965 N051.43.35.513 E019.24.12.777 0
N051.43.35.513 E019.24.12.777 N051.43.35.410 E019.24.12.617 0
N051.43.35.410 E019.24.12.617 N051.43.35.284 E019.24.12.527 0
N051.43.35.284 E019.24.12.527 N051.43.34.949 E019.24.10.934 0
; - 10
N051.43.35.423 E019.24.13.447 N051.43.35.586 E019.24.13.499 0
N051.43.35.586 E019.24.13.499 N051.43.35.653 E019.24.13.613 0
N051.43.35.653 E019.24.13.613 N051.43.35.719 E019.24.13.833 0
N051.43.35.719 E019.24.13.833 N051.43.35.791 E019.24.14.215 0
N051.43.35.791 E019.24.14.215 N051.43.35.958 E019.24.14.965 0
; - 11
N051.43.34.722 E019.24.13.823 N051.43.34.825 E019.24.13.833 0
N051.43.34.825 E019.24.13.833 N051.43.34.918 E019.24.13.871 0
N051.43.34.918 E019.24.13.871 N051.43.34.990 E019.24.13.955 0
N051.43.34.990 E019.24.13.955 N051.43.35.076 E019.24.14.154 0
N051.43.35.076 E019.24.14.154 N051.43.35.335 E019.24.15.380 0
; - 12
N051.43.34.470 E019.24.13.948 N051.43.34.498 E019.24.13.760 0
N051.43.34.498 E019.24.13.760 N051.43.34.481 E019.24.13.593 0
N051.43.34.481 E019.24.13.593 N051.43.34.450 E019.24.13.350 0
N051.43.34.450 E019.24.13.350 N051.43.34.343 E019.24.13.084 0
N051.43.34.343 E019.24.13.084 N051.43.34.186 E019.24.12.884 0
N051.43.34.186 E019.24.12.884 N051.43.34.040 E019.24.12.806 0
N051.43.34.040 E019.24.12.806 N051.43.33.679 E019.24.11.106 0
; - 13
N051.43.33.943 E019.24.14.255 N051.43.34.085 E019.24.14.257 0
N051.43.34.085 E019.24.14.257 N051.43.34.168 E019.24.14.282 0
N051.43.34.168 E019.24.14.282 N051.43.34.245 E019.24.14.389 0
N051.43.34.245 E019.24.14.389 N051.43.34.329 E019.24.14.559 0
N051.43.34.329 E019.24.14.559 N051.43.34.603 E019.24.15.804 0
; - 14
N051.43.33.336 E019.24.14.606 N051.43.33.407 E019.24.14.619 0
N051.43.33.407 E019.24.14.619 N051.43.33.489 E019.24.14.667 0
N051.43.33.489 E019.24.14.667 N051.43.33.567 E019.24.14.778 0
N051.43.33.567 E019.24.14.778 N051.43.33.626 E019.24.14.995 0
N051.43.33.626 E019.24.14.995 N051.43.33.884 E019.24.16.202 0
; - 15
N051.43.32.737 E019.24.14.959 N051.43.32.858 E019.24.15.013 0
N051.43.32.858 E019.24.15.013 N051.43.32.943 E019.24.15.100 0
N051.43.32.943 E019.24.15.100 N051.43.33.009 E019.24.15.296 0
N051.43.33.009 E019.24.15.296 N051.43.33.319 E019.24.16.754 0
; - 16
N051.43.31.948 E019.24.16.022 N051.43.32.002 E019.24.15.774 0
N051.43.32.002 E019.24.15.774 N051.43.32.016 E019.24.15.619 0
N051.43.32.016 E019.24.15.619 N051.43.32.000 E019.24.15.389 0
N051.43.32.000 E019.24.15.389 N051.43.31.811 E019.24.12.556 0
; - 17
N051.43.29.020 E019.24.18.697 N051.43.29.432 E019.24.20.245 65535
; - 18
N051.43.24.237 E019.24.22.933 N051.43.22.733 E019.24.24.753 0
N051.43.22.733 E019.24.24.753 N051.43.21.830 E019.24.25.839 0
N051.43.21.830 E019.24.25.839 N051.43.19.392 E019.24.28.791 0
N051.43.19.392 E019.24.28.791 N051.43.19.023 E019.24.29.215 0
N051.43.19.023 E019.24.29.215 N051.43.18.792 E019.24.29.442 0
N051.43.18.792 E019.24.29.442 N051.43.18.586 E019.24.29.609 0
N051.43.18.586 E019.24.29.609 N051.43.18.353 E019.24.29.755 0
N051.43.18.353 E019.24.29.755 N051.43.18.120 E019.24.29.875 0
N051.43.18.120 E019.24.29.875 N051.43.17.845 E019.24.29.979 0
N051.43.17.845 E019.24.29.979 N051.43.17.464 E019.24.30.054 0
N051.43.17.464 E019.24.30.054 N051.43.16.835 E019.24.30.141 0
N051.43.16.835 E019.24.30.141 N051.43.15.742 E019.24.30.344 0
N051.43.15.742 E019.24.30.344 N051.43.15.212 E019.24.30.419 0
N051.43.15.212 E019.24.30.419 N051.43.14.025 E019.24.30.617 0
N051.43.14.025 E019.24.30.617 N051.43.12.435 E019.24.30.885 0
N051.43.12.435 E019.24.30.885 N051.43.13.104 E019.24.30.768 0
N051.43.13.104 E019.24.30.768 N051.43.12.468 E019.24.27.799 0
; - 19
N051.43.22.605 E019.24.24.495 N051.43.22.852 E019.24.25.025 65535

;CTR EPBY
CTR_ALL N053.08.46.000 E017.40.46.000 N053.10.42.000 E017.53.47.000 cctr
N053.10.42.000 E017.53.47.000 N053.12.57.000 E018.14.27.000 cctr
N053.12.57.000 E018.14.27.000 N053.11.56.000 E018.18.58.000 cctr
N053.11.56.000 E018.18.58.000 N053.09.37.000 E018.21.57.000 cctr
N053.09.37.000 E018.21.57.000 N053.06.05.000 E018.22.39.000 cctr
N053.06.05.000 E018.22.39.000 N053.03.44.000 E018.21.15.000 cctr
N053.03.44.000 E018.21.15.000 N053.00.10.000 E018.14.42.000 cctr
N053.00.10.000 E018.14.42.000 N052.56.35.000 E017.53.57.000 cctr
N052.56.35.000 E017.53.57.000 N052.56.36.000 E017.48.15.000 cctr
N052.56.36.000 E017.48.15.000 N052.57.44.000 E017.44.10.000 cctr
N052.57.44.000 E017.44.10.000 N052.58.44.000 E017.41.30.000 cctr
N052.58.44.000 E017.41.30.000 N053.03.47.000 E017.39.38.000 cctr
N053.03.47.000 E017.39.38.000 N053.08.11.000 E017.40.03.000 cctr
N053.08.11.000 E017.40.03.000 N053.08.46.000 E017.40.46.000 cctr

;CTR EPSY
N053.38.46.000 E020.57.22.000 N053.36.21.000 E021.06.45.000 cctr
N053.36.21.000 E021.06.45.000 N053.29.21.000 E021.05.37.000 cctr
N053.29.21.000 E021.05.37.000 N053.25.31.000 E021.03.48.000 cctr
N053.25.31.000 E021.03.48.000 N053.17.57.000 E020.56.02.000 cctr
N053.17.57.000 E020.56.02.000 N053.19.49.000 E020.46.46.000 cctr
N053.19.49.000 E020.46.46.000 N053.28.21.000 E020.46.35.000 cctr
N053.28.21.000 E020.46.35.000 N053.32.40.000 E020.49.13.000 cctr
N053.32.40.000 E020.49.13.000 N053.38.46.000 E020.57.22.000 cctr


;CTR EPLB
N051.15.40.000 E022.33.48.000 N051.16.13.000 E022.37.54.000 cctr
N051.16.13.000 E022.37.54.000 N051.18.09.000 E022.52.17.000 cctr
N051.18.09.000 E022.52.17.000 N051.17.24.000 E022.56.14.000 cctr
N051.17.24.000 E022.56.14.000 N051.10.55.000 E022.58.37.000 cctr
N051.10.55.000 E022.58.37.000 N051.08.25.000 E022.54.16.000 cctr
N051.08.25.000 E022.54.16.000 N051.07.18.000 E022.49.16.000 cctr
N051.07.18.000 E022.49.16.000 N051.04.14.000 E022.35.26.000 cctr
N051.04.14.000 E022.35.26.000 N051.06.05.000 E022.30.39.000 cctr
N051.06.05.000 E022.30.39.000 N051.07.22.000 E022.30.13.000 cctr
N051.07.22.000 E022.30.13.000 N051.09.22.000 E022.29.33.000 cctr
N051.09.22.000 E022.29.33.000 N051.14.11.000 E022.27.56.000 cctr
N051.14.11.000 E022.27.56.000 N051.15.40.000 E022.33.48.000 cctr

;CTR EPWA
N052.12.28.000 E020.42.01.000 N052.15.32.000 E020.46.15.000 cctr
N052.15.32.000 E020.46.15.000 N052.15.47.000 E020.50.10.000 cctr
N052.15.47.000 E020.50.10.000 N052.15.48.000 E020.55.56.000 cctr
N052.15.48.000 E020.55.56.000 N052.15.38.000 E020.57.05.000 cctr
N052.15.38.000 E020.57.05.000 N052.15.30.000 E020.57.30.000 cctr
N052.15.30.000 E020.57.30.000 N052.15.08.000 E021.00.53.000 cctr
N052.15.08.000 E021.00.53.000 N052.11.03.000 E021.06.13.000 cctr
N052.11.03.000 E021.06.13.000 N052.07.57.000 E021.10.36.000 cctr
N052.07.57.000 E021.10.36.000 N052.02.23.000 E021.07.19.000 cctr
N052.02.23.000 E021.07.19.000 N052.00.43.000 E021.00.38.000 cctr
N052.00.43.000 E021.00.38.000 N052.08.52.000 E020.45.47.000 cctr
N052.08.52.000 E020.45.47.000 N052.12.28.000 E020.42.01.000 cctr


;CTR EPGD
N054.29.00.000 E018.13.07.000 N054.27.47.000 E018.20.02.000 cctr
N054.27.47.000 E018.20.02.000 N054.23.13.000 E018.38.26.000 cctr
N054.23.13.000 E018.38.26.000 N054.20.13.000 E018.45.29.000 cctr
N054.20.13.000 E018.45.29.000 N054.15.24.000 E018.41.58.000 cctr
N054.15.24.000 E018.41.58.000 N054.16.00.000 E018.35.08.000 cctr
N054.16.00.000 E018.35.08.000 N054.19.56.000 E018.11.15.000 cctr
N054.19.56.000 E018.11.15.000 N054.24.24.000 E018.09.47.000 cctr
N054.24.24.000 E018.09.47.000 N054.29.00.000 E018.13.07.000 cctr

;CTR EPKK
N050.09.03.000 E019.40.16.000 N050.10.42.000 E019.49.43.000 cctr
N050.10.42.000 E019.49.43.000 N050.09.26.000 E020.03.13.000 cctr
N050.09.26.000 E020.03.13.000 N050.04.17.000 E020.04.52.000 cctr
N050.04.17.000 E020.04.52.000 N049.58.23.000 E019.29.23.000 cctr
N049.58.23.000 E019.29.23.000 N050.05.13.000 E019.26.31.000 cctr
N050.05.13.000 E019.26.31.000 N050.09.03.000 E019.40.16.000 cctr

;CTR EPKT
N050.31.40.000 E018.46.07.000 N050.34.08.000 E019.01.17.000 cctr
N050.34.08.000 E019.01.17.000 N050.34.11.000 E019.10.21.000 cctr
N050.34.11.000 E019.10.21.000 N050.31.31.000 E019.21.46.000 cctr
N050.31.31.000 E019.21.46.000 N050.25.50.000 E019.22.02.000 cctr
N050.25.50.000 E019.22.02.000 N050.24.14.000 E019.06.17.000 cctr
N050.24.14.000 E019.06.17.000 N050.24.10.000 E019.00.41.000 cctr
N050.24.10.000 E019.00.41.000 N050.25.24.000 E018.46.27.000 cctr
N050.25.24.000 E018.46.27.000 N050.31.40.000 E018.46.07.000 cctr

;CTR EPLL
N051.39.28.000 E019.09.31.000 N051.42.28.000 E019.07.54.000 cctr
N051.42.28.000 E019.07.54.000 N051.45.17.000 E019.08.10.000 cctr
N051.45.17.000 E019.08.10.000 N051.48.18.000 E019.18.48.000 cctr
N051.48.18.000 E019.18.48.000 N051.49.22.000 E019.24.51.000 cctr
N051.49.22.000 E019.24.51.000 N051.50.13.000 E019.36.07.000 cctr
N051.50.13.000 E019.36.07.000 N051.44.15.000 E019.39.23.000 cctr
N051.44.15.000 E019.39.23.000 N051.39.39.000 E019.23.52.000 cctr
N051.39.39.000 E019.23.52.000 N051.38.01.000 E019.17.21.000 cctr
N051.38.01.000 E019.17.21.000 N051.37.54.000 E019.15.47.000 cctr
N051.37.54.000 E019.15.47.000 N051.39.28.000 E019.09.31.000 cctr



;CTR EPPO
N052.33.21.000 E016.31.18.000 N052.26.13.000 E016.59.20.000 cctr
N052.26.13.000 E016.59.20.000 N052.24.29.000 E017.06.02.000 cctr
N052.24.29.000 E017.06.02.000 N052.20.13.000 E017.04.15.000 cctr
N052.20.13.000 E017.04.15.000 N052.21.12.000 E016.55.25.000 cctr
N052.21.12.000 E016.55.25.000 N052.23.33.000 E016.42.47.000 cctr
N052.23.33.000 E016.42.47.000 N052.26.17.000 E016.28.09.000 cctr
N052.26.17.000 E016.28.09.000 N052.33.21.000 E016.31.18.000 cctr

;CTR POZNAN KRZESINY
N052.23.33.000 E016.42.47.000 N052.21.12.000 E016.55.25.000 cctr
N052.21.12.000 E016.55.25.000 N052.20.46.000 E016.59.08.000 cctr
N052.20.46.000 E016.59.08.000 N052.20.14.000 E017.04.05.000 cctr
N052.20.14.000 E017.04.05.000 N052.18.21.000 E017.20.45.000 cctr
N052.18.21.000 E017.20.45.000 N052.08.45.000 E017.16.09.000 cctr
N052.08.45.000 E017.16.09.000 N052.16.10.000 E016.39.41.000 cctr
N052.16.10.000 E016.39.41.000 N052.23.33.000 E016.42.47.000 cctr

;CTR EPRA
N051.30.41.000 E021.23.45.000 N051.24.25.000 E021.28.12.000 cctr
N051.24.25.000 E021.28.12.000 N051.18.36.000 E021.28.25.000 cctr
N051.18.36.000 E021.28.25.000 N051.14.25.000 E021.03.22.000 cctr
N051.14.25.000 E021.03.22.000 N051.24.07.000 E020.59.34.000 cctr
N051.24.07.000 E020.59.34.000 N051.27.03.000 E021.10.18.000 cctr
N051.27.03.000 E021.10.18.000 N051.30.41.000 E021.23.45.000 cctr
N051.30.41.000 E021.23.45.000 N051.30.41.000 E021.23.45.000 cctr

;CTR EPRZ
N050.14.08.000 E021.45.03.000 N050.14.02.000 E022.17.04.000 cctr
N050.14.02.000 E022.17.04.000 N050.01.00.000 E022.17.00.000 cctr
N050.01.00.000 E022.17.00.000 N050.01.00.000 E021.45.00.000 cctr
N050.01.00.000 E021.45.00.000 N050.04.26.000 E021.43.40.000 cctr
N050.04.26.000 E021.43.40.000 N050.10.39.000 E021.43.31.000 cctr
N050.10.39.000 E021.43.31.000 N050.14.08.000 E021.45.03.000 cctr

;CTR EPSC
N053.36.10.000 E015.10.05.000 N053.32.00.000 E015.13.41.000 cctr
N053.32.00.000 E015.13.41.000 N053.32.00.000 E015.13.43.000 cctr
N053.32.00.000 E015.13.43.000 N053.31.02.000 E015.14.19.000 cctr
N053.31.02.000 E015.14.19.000 N053.30.01.000 E015.14.37.000 cctr
N053.30.01.000 E015.14.37.000 N053.28.59.000 E015.14.36.000 cctr
N053.28.59.000 E015.14.36.000 N053.27.57.000 E015.14.18.000 cctr
N053.27.57.000 E015.14.18.000 N053.26.59.000 E015.13.42.000 cctr
N053.26.59.000 E015.13.42.000 N053.26.05.000 E015.12.50.000 cctr
N053.26.05.000 E015.12.50.000 N053.25.18.000 E015.11.43.000 cctr
N053.25.18.000 E015.11.43.000 N053.24.38.000 E015.10.23.000 cctr
N053.24.38.000 E015.10.23.000 N053.24.07.000 E015.08.52.000 cctr
N053.24.07.000 E015.08.52.000 N053.23.46.000 E015.07.15.000 cctr
N053.23.46.000 E015.07.15.000 N053.23.35.000 E015.05.32.000 cctr
N053.23.35.000 E015.05.32.000 N053.23.35.000 E015.03.48.000 cctr
N053.23.35.000 E015.03.48.000 N053.23.40.000 E015.02.57.000 cctr
N053.23.40.000 E015.02.57.000 N053.24.14.000 E014.58.15.000 cctr
N053.24.14.000 E014.58.15.000 N053.25.01.000 E014.56.50.000 cctr
N053.25.01.000 E014.56.50.000 N053.37.56.000 E014.39.33.000 cctr
N053.37.56.000 E014.39.33.000 N053.41.09.000 E014.36.56.000 cctr
N053.41.09.000 E014.36.56.000 N053.42.00.000 E014.37.03.000 cctr
N053.42.00.000 E014.37.03.000 N053.42.47.000 E014.37.32.000 cctr
N053.42.47.000 E014.37.32.000 N053.44.34.000 E014.41.31.000 cctr
N053.44.34.000 E014.41.31.000 N053.45.24.000 E014.44.47.000 cctr
N053.45.24.000 E014.44.47.000 N053.45.57.000 E014.54.46.000 cctr 
N053.45.57.000 E014.54.46.000 N053.36.10.000 E015.10.05.000 cctr
N053.36.10.000 E015.10.05.000 N053.36.10.000 E015.10.05.000 cctr



;CTR EPMO
N052.29.01.000 E020.21.30.000 N052.34.53.000 E020.38.04.000 cctr
N052.34.53.000 E020.38.04.000 N052.35.18.000 E020.39.16.000 cctr
N052.35.18.000 E020.39.16.000 N052.34.22.000 E020.46.55.000 cctr
N052.34.22.000 E020.46.55.000 N052.29.57.000 E020.51.26.000 cctr
N052.29.57.000 E020.51.26.000 N052.27.06.000 E020.52.20.000 cctr
N052.27.06.000 E020.52.20.000 N052.22.54.000 E020.36.00.000 cctr
N052.22.54.000 E020.36.00.000 N052.22.56.000 E020.30.27.000 cctr
N052.22.56.000 E020.30.27.000 N052.26.00.000 E020.21.45.000 cctr
N052.26.00.000 E020.21.45.000 N052.29.01.000 E020.21.30.000 cctr
N052.29.01.000 E020.21.30.000 N052.29.01.000 E020.21.30.000 cctr

;ATZ_A EPBC
N052.16.50.000 E020.50.19.000 N052.16.47.000 E020.56.21.000 cctr
N052.16.47.000 E020.56.21.000 N052.15.38.000 E020.57.05.000 cctr
N052.15.38.000 E020.57.05.000 N052.15.48.000 E020.55.56.000 cctr
N052.15.48.000 E020.55.56.000 N052.15.47.000 E020.52.43.000 cctr
N052.15.47.000 E020.52.43.000 N052.16.35.000 E020.50.04.000 cctr
N052.16.35.000 E020.50.04.000 N052.16.50.000 E020.50.19.000 cctr

;ATZ_B EPBC
N052.16.50.000 E020.50.19.000 N052.19.50.000 E020.53.09.000 cctr
N052.19.50.000 E020.53.09.000 N052.18.43.000 E020.56.31.000 cctr
N052.18.43.000 E020.56.31.000 N052.17.36.000 E020.59.39.000 cctr
N052.17.36.000 E020.59.39.000 N052.16.51.000 E020.59.55.000 cctr
N052.16.51.000 E020.59.55.000 N052.15.31.000 E020.57.53.000 cctr
N052.15.31.000 E020.57.53.000 N052.15.38.000 E020.57.05.000 cctr
N052.15.38.000 E020.57.05.000 N052.16.47.000 E020.56.21.000 cctr 
N052.16.47.000 E020.56.21.000 N052.16.50.000 E020.50.19.000 cctr

;ATZ_A1 EPBC
N052.16.31.000 E020.56.19.000 N052.15.42.000 E020.56.36.000 cctr
N052.15.42.000 E020.56.36.000 N052.15.48.000 E020.55.56.000 cctr
N052.15.48.000 E020.55.56.000 N052.15.47.000 E020.53.44.000 cctr
N052.15.47.000 E020.53.44.000 N052.16.31.000 E020.56.19.000 cctr

;CTR EPWR
N051.06.01.000 E016.33.52.000 N051.14.11.000 E016.39.28.000 cctr
N051.14.11.000 E016.39.28.000 N051.05.33.000 E017.08.42.000 cctr
N051.05.33.000 E017.08.42.000 N050.57.38.000 E017.02.40.000 cctr
N050.57.38.000 E017.02.40.000 N051.06.01.000 E016.33.52.000 cctr

;CTR EPZG
N052.05.48.000 E015.32.06.000 N052.08.38.000 E015.38.18.000 cctr
N052.08.38.000 E015.38.18.000 N052.09.20.000 E015.38.23.000 cctr
;luk
N052.09.20.000 E015.38.23.000 N052.10.20.000 E015.38.49.000 cctr
N052.10.20.000 E015.38.49.000 N052.11.17.000 E015.39.32.000 cctr
N052.11.17.000 E015.39.32.000 N052.12.08.000 E015.40.30.000 cctr
N052.12.08.000 E015.40.30.000 N052.12.52.000 E015.41.41.000 cctr
N052.12.52.000 E015.41.41.000 N052.13.27.000 E015.43.04.000 cctr
N052.13.27.000 E015.43.04.000 N052.13.54.000 E015.44.36.000 cctr
N052.13.54.000 E015.44.36.000 N052.14.10.000 E015.46.14.000 cctr
N052.14.10.000 E015.46.14.000 N052.14.15.000 E015.47.55.000 cctr
N052.14.15.000 E015.47.55.000 N052.14.10.000 E015.49.36.000 cctr
N052.14.10.000 E015.49.36.000 N052.13.54.000 E015.51.14.000 cctr
N052.13.54.000 E015.51.14.000 N052.13.27.000 E015.52.46.000 cctr
N052.13.27.000 E015.52.46.000 N052.13.11.000 E015.53.26.000 cctr
;koniec luku
N052.13.11.000 E015.53.26.000 N052.13.52.000 E015.58.52.000 cctr
N052.13.52.000 E015.58.52.000 N052.11.08.000 E016.01.16.000 cctr
N052.11.08.000 E016.01.16.000 N052.09.08.000 E015.57.27.000 cctr
N052.09.08.000 E015.57.27.000 N052.08.19.000 E015.57.35.000 cctr
;luk
N052.08.19.000 E015.57.35.000 N052.07.17.000 E015.57.26.000 cctr
N052.07.17.000 E015.57.26.000 N052.06.17.000 E015.56.60.000 cctr
N052.06.17.000 E015.56.60.000 N052.05.21.000 E015.56.17.000 cctr
N052.05.21.000 E015.56.17.000 N052.04.30.000 E015.55.19.000 cctr
N052.04.30.000 E015.55.19.000 N052.03.46.000 E015.54.07.000 cctr
N052.03.46.000 E015.54.07.000 N052.03.10.000 E015.52.45.000 cctr
N052.03.10.000 E015.52.45.000 N052.02.44.000 E015.51.13.000 cctr
N052.02.44.000 E015.51.13.000 N052.02.28.000 E015.49.36.000 cctr
N052.02.28.000 E015.49.36.000 N052.02.23.000 E015.47.55.000 cctr
N052.02.23.000 E015.47.55.000 N052.02.28.000 E015.46.14.000 cctr
N052.02.28.000 E015.46.14.000 N052.02.44.000 E015.44.37.000 cctr
N052.02.44.000 E015.44.37.000 N052.03.10.000 E015.43.05.000 cctr
N052.03.10.000 E015.43.05.000 N052.03.46.000 E015.41.43.000 cctr
N052.03.46.000 E015.41.43.000 N052.04.09.000 E015.41.03.000 cctr
;koniec luku
N052.04.09.000 E015.41.03.000 N052.03.05.000 E015.34.45.000 cctr
N052.03.05.000 E015.34.45.000 N052.05.48.000 E015.32.06.000 cctr

;EPWA_MRVA
MRVA_ADDITIONAL_LINES N052.09.35.855 E020.56.17.051 N052.08.18.276 E020.53.22.920 mrva
N052.08.18.276 E020.53.22.920 N052.05.21.863 E020.46.41.847 mrva
N052.09.35.855 E020.56.17.051 N052.09.37.584 E020.56.15.071 mrva
N052.09.37.584 E020.56.15.071 N052.09.39.348 E020.56.13.200 mrva
N052.09.39.348 E020.56.13.200 N052.09.41.148 E020.56.11.472 mrva
N052.09.41.148 E020.56.11.472 N052.09.42.984 E020.56.09.816 mrva
N052.09.42.984 E020.56.09.816 N052.09.44.819 E020.56.08.267 mrva
N052.09.44.819 E020.56.08.267 N052.09.46.727 E020.56.06.828 mrva
N052.09.46.727 E020.56.06.828 N052.09.48.671 E020.56.05.460 mrva
N052.09.48.671 E020.56.05.460 N052.09.50.615 E020.56.04.235 mrva
N052.09.50.615 E020.56.04.235 N052.09.52.596 E020.56.03.156 mrva
N052.09.52.596 E020.56.03.156 N052.09.54.612 E020.56.02.148 mrva
N052.09.54.612 E020.56.02.148 N052.09.56.628 E020.56.01.247 mrva
N052.09.56.628 E020.56.01.247 N052.09.58.643 E020.56.00.491 mrva
N052.09.58.643 E020.56.00.491 N052.10.00.732 E020.55.59.843 mrva
N052.10.00.732 E020.55.59.843 N052.10.02.783 E020.55.59.304 mrva
N052.10.02.783 E020.55.59.304 N052.10.04.871 E020.55.58.871 mrva
N052.10.04.871 E020.55.58.871 N052.10.06.959 E020.55.58.583 mrva
N052.10.06.959 E020.55.58.583 N052.10.09.047 E020.55.58.404 mrva
N052.10.09.047 E020.55.58.404 N052.10.11.135 E020.55.58.368 mrva
N052.10.11.135 E020.55.58.368 N052.10.13.224 E020.55.58.404 mrva
N052.10.13.224 E020.55.58.404 N052.10.15.312 E020.55.58.583 mrva
N052.10.15.312 E020.55.58.583 N052.10.17.400 E020.55.58.871 mrva
N052.10.17.400 E020.55.58.871 N052.10.19.488 E020.55.59.304 mrva
N052.10.19.488 E020.55.59.304 N052.10.21.539 E020.55.59.843 mrva
N052.10.21.539 E020.55.59.843 N052.10.23.627 E020.56.00.491 mrva
N052.10.23.627 E020.56.00.491 N052.10.25.643 E020.56.01.247 mrva
N052.10.25.643 E020.56.01.247 N052.10.27.659 E020.56.02.148 mrva
N052.10.27.659 E020.56.02.148 N052.10.29.675 E020.56.03.156 mrva
N052.10.29.675 E020.56.03.156 N052.10.31.656 E020.56.04.235 mrva
N052.10.31.656 E020.56.04.235 N052.10.33.600 E020.56.05.460 mrva
N052.10.33.600 E020.56.05.460 N052.10.35.544 E020.56.06.828 mrva
N052.10.35.544 E020.56.06.828 N052.10.37.452 E020.56.08.267 mrva
N052.10.37.452 E020.56.08.267 N052.10.39.287 E020.56.09.816 mrva
N052.10.39.287 E020.56.09.816 N052.10.41.123 E020.56.11.472 mrva
N052.10.41.123 E020.56.11.472 N052.10.42.923 E020.56.13.200 mrva
N052.10.42.923 E020.56.13.200 N052.10.44.687 E020.56.15.071 mrva
N052.10.44.687 E020.56.15.071 N052.10.46.416 E020.56.17.051 mrva
N052.10.46.416 E020.56.17.051 N052.10.48.071 E020.56.19.103 mrva
N052.10.48.071 E020.56.19.103 N052.10.49.691 E020.56.21.227 mrva
N052.10.49.691 E020.56.21.227 N052.10.51.275 E020.56.23.495 mrva
N052.10.51.275 E020.56.23.495 N052.10.52.823 E020.56.25.800 mrva
N052.10.52.823 E020.56.25.800 N052.10.54.300 E020.56.28.211 mrva
N052.10.54.300 E020.56.28.211 N052.10.55.740 E020.56.30.732 mrva
N052.10.55.740 E020.56.30.732 N052.10.57.107 E020.56.33.287 mrva
N052.10.57.107 E020.56.33.287 N052.10.58.404 E020.56.35.951 mrva
N052.10.58.404 E020.56.35.951 N052.10.59.663 E020.56.38.687 mrva
N052.10.59.663 E020.56.38.687 N052.11.00.887 E020.56.41.459 mrva
N052.11.00.887 E020.56.41.459 N052.11.02.003 E020.56.44.340 mrva
N052.11.02.003 E020.56.44.340 N052.11.03.084 E020.56.47.255 mrva
N052.11.03.084 E020.56.47.255 N052.11.04.128 E020.56.50.243 mrva
N052.11.04.128 E020.56.50.243 N052.11.05.063 E020.56.53.303 mrva
N052.11.05.063 E020.56.53.303 N052.11.05.963 E020.56.56.400 mrva
N052.11.05.963 E020.56.56.400 N052.11.06.755 E020.56.59.532 mrva
N052.11.06.755 E020.56.59.532 N052.11.07.512 E020.57.02.735 mrva
N052.11.07.512 E020.57.02.735 N052.11.08.195 E020.57.05.940 mrva
N052.11.08.195 E020.57.05.940 N052.11.08.808 E020.57.09.215 mrva
N052.11.08.808 E020.57.09.215 N052.11.09.347 E020.57.12.527 mrva
N052.11.09.347 E020.57.12.527 N052.11.09.815 E020.57.15.839 mrva
N052.11.09.815 E020.57.15.839 N052.11.10.211 E020.57.19.188 mrva
N052.11.10.211 E020.57.19.188 N052.11.10.535 E020.57.22.571 mrva
N052.11.10.535 E020.57.22.571 N052.11.10.824 E020.57.25.955 mrva
N052.11.10.824 E020.57.25.955 N052.11.11.004 E020.57.29.339 mrva
N052.11.11.004 E020.57.29.339 N052.11.11.111 E020.57.32.759 mrva
N052.11.11.111 E020.57.32.759 N052.11.11.148 E020.57.36.179 mrva
N052.11.11.148 E020.57.36.179 N052.11.11.111 E020.57.39.599 mrva
N052.11.11.111 E020.57.39.599 N052.11.11.004 E020.57.43.020 mrva
N052.11.11.004 E020.57.43.020 N052.11.10.824 E020.57.46.404 mrva
N052.11.10.824 E020.57.46.404 N052.11.10.535 E020.57.49.788 mrva
N052.11.10.535 E020.57.49.788 N052.11.10.211 E020.57.53.172 mrva
N052.11.10.211 E020.57.53.172 N052.11.09.815 E020.57.56.519 mrva
N052.11.09.815 E020.57.56.519 N052.11.09.347 E020.57.59.831 mrva
N052.11.09.347 E020.57.59.831 N052.11.08.808 E020.58.03.143 mrva
N052.11.08.808 E020.58.03.143 N052.11.08.195 E020.58.06.420 mrva
N052.11.08.195 E020.58.06.420 N052.11.07.512 E020.58.09.623 mrva
N052.11.07.512 E020.58.09.623 N052.11.06.755 E020.58.12.828 mrva
N052.11.06.755 E020.58.12.828 N052.11.05.963 E020.58.15.959 mrva
N052.11.05.963 E020.58.15.959 N052.11.05.063 E020.58.19.055 mrva
N052.11.05.063 E020.58.19.055 N052.11.04.128 E020.58.22.115 mrva
N052.11.04.128 E020.58.22.115 N052.11.03.084 E020.58.25.103 mrva
N052.11.03.084 E020.58.25.103 N052.11.02.003 E020.58.28.020 mrva
N052.11.02.003 E020.58.28.020 N052.11.00.887 E020.58.30.899 mrva
N052.11.00.887 E020.58.30.899 N052.10.59.663 E020.58.33.671 mrva
N052.10.59.663 E020.58.33.671 N052.10.58.404 E020.58.36.408 mrva
N052.10.58.404 E020.58.36.408 N052.10.57.107 E020.58.39.071 mrva
N052.10.57.107 E020.58.39.071 N052.10.55.740 E020.58.41.627 mrva
N052.10.55.740 E020.58.41.627 N052.10.54.300 E020.58.44.147 mrva
N052.10.54.300 E020.58.44.147 N052.10.52.823 E020.58.46.560 mrva
N052.10.52.823 E020.58.46.560 N052.10.51.275 E020.58.48.863 mrva
N052.10.51.275 E020.58.48.863 N052.10.49.691 E020.58.51.131 mrva
N052.10.49.691 E020.58.51.131 N052.10.48.071 E020.58.53.255 mrva
N052.10.48.071 E020.58.53.255 N052.10.46.416 E020.58.55.308 mrva
N052.10.46.416 E020.58.55.308 N052.10.44.687 E020.58.57.287 mrva
N052.10.44.687 E020.58.57.287 N052.10.42.923 E020.58.59.160 mrva
N052.10.42.923 E020.58.59.160 N052.10.41.123 E020.59.00.887 mrva
N052.10.41.123 E020.59.00.887 N052.10.39.287 E020.59.02.544 mrva
N052.10.39.287 E020.59.02.544 N052.10.37.452 E020.59.04.092 mrva
N052.10.37.452 E020.59.04.092 N052.10.35.544 E020.59.05.532 mrva
N052.10.35.544 E020.59.05.532 N052.10.33.600 E020.59.06.900 mrva
N052.10.33.600 E020.59.06.900 N052.10.31.656 E020.59.08.123 mrva
N052.10.31.656 E020.59.08.123 N052.10.29.675 E020.59.09.204 mrva
N052.10.29.675 E020.59.09.204 N052.10.27.659 E020.59.10.212 mrva
N052.10.27.659 E020.59.10.212 N052.10.25.643 E020.59.11.111 mrva
N052.10.25.643 E020.59.11.111 N052.10.23.627 E020.59.11.868 mrva
N052.10.23.627 E020.59.11.868 N052.10.21.539 E020.59.12.515 mrva
N052.10.21.539 E020.59.12.515 N052.10.19.488 E020.59.13.055 mrva
N052.10.19.488 E020.59.13.055 N052.10.17.400 E020.59.13.487 mrva
N052.10.17.400 E020.59.13.487 N052.10.15.312 E020.59.13.775 mrva
N052.10.15.312 E020.59.13.775 N052.10.13.224 E020.59.13.956 mrva
N052.10.13.224 E020.59.13.956 N052.10.11.135 E020.59.13.992 mrva
N052.10.11.135 E020.59.13.992 N052.10.09.047 E020.59.13.956 mrva
N052.10.09.047 E020.59.13.956 N052.10.06.959 E020.59.13.775 mrva
N052.10.06.959 E020.59.13.775 N052.10.04.871 E020.59.13.487 mrva
N052.10.04.871 E020.59.13.487 N052.10.02.783 E020.59.13.055 mrva
N052.10.02.783 E020.59.13.055 N052.10.00.732 E020.59.12.515 mrva
N052.10.00.732 E020.59.12.515 N052.09.58.643 E020.59.11.868 mrva
N052.09.58.643 E020.59.11.868 N052.09.56.628 E020.59.11.111 mrva
N052.09.56.628 E020.59.11.111 N052.09.54.612 E020.59.10.212 mrva
N052.09.54.612 E020.59.10.212 N052.09.52.596 E020.59.09.204 mrva
N052.09.52.596 E020.59.09.204 N052.09.50.615 E020.59.08.123 mrva
N052.09.50.615 E020.59.08.123 N052.09.48.671 E020.59.06.900 mrva
N052.09.48.671 E020.59.06.900 N052.06.25.000 E021.11.15.000 mrva
N052.06.25.000 E021.11.15.000 N051.59.39.300 E021.10.04.403 mrva
N052.11.00.887 E020.58.30.899 N052.14.07.760 E021.02.10.703 mrva
N052.06.59.255 E020.57.47.088 N052.06.59.148 E020.57.36.179 mrva
N052.06.59.148 E020.57.36.179 N052.06.59.255 E020.57.25.271 mrva
N052.06.59.255 E020.57.25.271 N052.06.59.615 E020.57.14.328 mrva
N052.06.59.615 E020.57.14.328 N052.07.00.192 E020.57.03.455 mrva
N052.07.00.192 E020.57.03.455 N052.07.01.020 E020.56.52.619 mrva
N052.07.01.020 E020.56.52.619 N052.07.02.064 E020.56.41.819 mrva
N052.07.02.064 E020.56.41.819 N052.07.03.323 E020.56.31.092 mrva
N052.07.03.323 E020.56.31.092 N052.07.04.835 E020.56.20.435 mrva
N052.07.04.835 E020.56.20.435 N052.07.06.564 E020.56.09.888 mrva
N052.07.06.564 E020.56.09.888 N052.07.08.543 E020.55.59.448 mrva
N052.07.08.543 E020.55.59.448 N052.07.10.703 E020.55.49.115 mrva
N052.07.10.703 E020.55.49.115 N052.07.13.116 E020.55.38.891 mrva
N052.07.13.116 E020.55.38.891 N052.07.15.744 E020.55.28.847 mrva
N052.07.15.744 E020.55.28.847 N052.07.18.551 E020.55.18.947 mrva
N052.07.18.551 E020.55.18.947 N052.07.21.611 E020.55.09.227 mrva
N052.07.21.611 E020.55.09.227 N052.07.24.852 E020.54.59.652 mrva
N052.07.24.852 E020.54.59.652 N052.07.28.308 E020.54.50.291 mrva
N052.07.28.308 E020.54.50.291 N052.07.31.944 E020.54.41.111 mrva
N052.07.31.944 E020.54.41.111 N052.07.35.795 E020.54.32.184 mrva
N052.07.35.795 E020.54.32.184 N052.07.39.827 E020.54.23.436 mrva
N052.07.39.827 E020.54.23.436 N052.07.44.040 E020.54.14.940 mrva
N052.07.44.040 E020.54.14.940 N052.07.48.468 E020.54.06.695 mrva
N052.07.48.468 E020.54.06.695 N052.07.53.039 E020.53.58.704 mrva
N052.07.53.039 E020.53.58.704 N052.07.57.756 E020.53.51.000 mrva
N052.07.57.756 E020.53.51.000 N052.08.02.652 E020.53.43.548 mrva
N052.08.02.652 E020.53.43.548 N052.08.07.728 E020.53.36.383 mrva
N052.08.07.728 E020.53.36.383 N052.08.12.912 E020.53.29.507 mrva
N052.08.12.912 E020.53.29.507 N052.08.18.276 E020.53.22.920 mrva
N052.06.59.255 E020.57.47.088 N051.58.40.000 E020.58.15.000 mrva

;EPKK_MRVA
;EPKK LTMA A SECTOR [950] 1050
N050.21.21.039 E020.02.11.163 N050.21.07.424 E020.02.02.693 mrva
N050.21.07.424 E020.02.02.693 N050.06.39.851 E019.51.24.696 mrva ;
N050.06.39.851 E019.51.24.696 N050.06.55.836 E019.50.31.775 mrva ;
N050.06.55.836 E019.50.31.775 N050.07.12.432 E019.49.39.288 mrva ;
N050.07.12.432 E019.49.39.288 N050.07.29.604 E019.48.47.304 mrva ;
N050.07.29.604 E019.48.47.304 N050.07.47.352 E019.47.55.787 mrva ;
N050.07.47.352 E019.47.55.787 N050.08.05.640 E019.47.04.739 mrva ;
N050.08.05.640 E019.47.04.739 N050.08.24.504 E019.46.14.232 mrva ;
N050.08.24.504 E019.46.14.232 N050.05.50.207 E019.43.48.036 mrva ;
N050.05.50.207 E019.43.48.036 N050.06.11.304 E019.42.53.820 mrva ;
N050.06.11.304 E019.42.53.820 N050.06.32.939 E019.42.00.180 mrva ;
N050.06.32.939 E019.42.00.180 N050.06.55.188 E019.41.07.188 mrva ;
N050.06.55.188 E019.41.07.188 N050.07.18.047 E019.40.14.772 mrva ;
N050.07.18.047 E019.40.14.772 N050.07.41.448 E019.39.23.003 mrva ;
N050.07.41.448 E019.39.23.003 N050.08.05.423 E019.38.31.919 mrva ;
N050.08.05.423 E019.38.31.919 N050.08.29.976 E019.37.41.448 mrva ;
N050.08.29.976 E019.37.41.448 N050.08.55.067 E019.36.51.696 mrva ;
N050.08.55.067 E019.36.51.696 N050.05.25.260 E019.32.23.747 mrva ;
N050.05.25.260 E019.32.23.747 N050.05.53.880 E019.31.28.919 mrva ;
N050.05.53.880 E019.31.28.919 N050.06.23.148 E019.30.34.919 mrva ;
N050.06.23.148 E019.30.34.919 N050.06.52.956 E019.29.41.748 mrva ;
N050.06.52.956 E019.29.41.748 N050.07.23.375 E019.28.49.403 mrva ;
N050.07.23.375 E019.28.49.403 N050.07.54.372 E019.27.57.888 mrva ;
N050.07.54.372 E019.27.57.888 N050.08.25.944 E019.27.07.236 mrva ;
N050.08.25.944 E019.27.07.236 N050.08.58.055 E019.26.17.447 mrva ;
N050.08.58.055 E019.26.17.447 N050.09.30.744 E019.25.28.560 mrva ;
N050.09.30.744 E019.25.28.560 N050.10.03.936 E019.24.40.608 mrva ;
N050.10.03.936 E019.24.40.608 N050.10.33.608 E019.23.59.222 mrva ;

;[FL130] FL150
N049.22.09.228 E019.51.58.391 N049.13.17.712 E020.06.35.720 mrva ;
N049.22.09.228 E019.51.58.391 N049.22.01.631 E019.51.47.304 mrva ;
N049.22.01.631 E019.51.47.304 N049.21.54.179 E019.51.35.999 mrva ;
N049.21.54.179 E019.51.35.999 N049.21.46.836 E019.51.24.515 mrva ;
N049.21.46.836 E019.51.24.515 N049.21.39.636 E019.51.12.816 mrva ;
N049.21.39.636 E019.51.12.816 N049.21.32.544 E019.51.00.935 mrva ;
N049.21.32.544 E019.51.00.935 N049.21.25.595 E019.50.48.840 mrva ;
N049.21.25.595 E019.50.48.840 N049.21.18.827 E019.50.36.599 mrva ;
N049.21.18.827 E019.50.36.599 N049.21.12.168 E019.50.24.143 mrva ;
N049.21.12.168 E019.50.24.143 N049.21.05.615 E019.50.11.543 mrva ;
N049.21.05.615 E019.50.11.543 N049.20.59.243 E019.49.58.763 mrva ;
N049.20.59.243 E019.49.58.763 N049.20.53.015 E019.49.45.804 mrva ;
N049.20.53.015 E019.49.45.804 N049.20.46.932 E019.49.32.663 mrva ;
N049.20.46.932 E019.49.32.663 N049.20.41.027 E019.49.19.380 mrva ;
N049.20.41.027 E019.49.19.380 N049.20.35.231 E019.49.05.951 mrva ;
N049.20.35.231 E019.49.05.951 N049.20.29.616 E019.48.52.344 mrva ;
N049.20.29.616 E019.48.52.344 N049.20.24.144 E019.48.38.627 mrva ;
N049.20.24.144 E019.48.38.627 N049.20.18.816 E019.48.24.731 mrva ;
N049.20.18.816 E019.48.24.731 N049.20.13.668 E019.48.10.691 mrva ;
N049.20.13.668 E019.48.10.691 N049.20.08.664 E019.47.56.544 mrva ;
N049.20.08.664 E019.47.56.544 N049.20.03.840 E019.47.42.251 mrva ;
N049.20.03.840 E019.47.42.251 N049.20.03.146 E019.47.40.111 mrva ;

;arc near TUSIN
N049.42.13.332 E018.40.58.993 N049.42.59.796 E018.41.24.792 mrva ;
N049.42.59.796 E018.41.24.792 N049.43.40.043 E018.41.47.940 mrva ;
N049.43.40.043 E018.41.47.940 N049.44.19.968 E018.42.12.167 mrva ;
N049.44.19.968 E018.42.12.167 N049.44.59.639 E018.42.37.475 mrva ;
N049.44.59.639 E018.42.37.475 N049.45.39.024 E018.43.03.827 mrva ;
N049.45.39.024 E018.43.03.827 N049.46.18.083 E018.43.31.223 mrva ;
N049.46.18.083 E018.43.31.223 N049.46.56.819 E018.43.59.663 mrva ;
N049.46.56.819 E018.43.59.663 N049.47.35.267 E018.44.29.148 mrva ;
N049.47.35.267 E018.44.29.148 N049.48.13.356 E018.44.59.675 mrva ;
N049.48.13.356 E018.44.59.675 N049.48.51.084 E018.45.31.211 mrva ;
N049.48.51.084 E018.45.31.211 N049.49.28.452 E018.46.03.756 mrva ;
N049.49.28.452 E018.46.03.756 N049.50.05.423 E018.46.37.307 mrva ;
N049.50.05.423 E018.46.37.307 N049.50.42.036 E018.47.11.831 mrva ;
N049.50.42.036 E018.47.11.831 N049.51.18.251 E018.47.47.327 mrva ;
N049.51.18.251 E018.47.47.327 N049.51.54.072 E018.48.23.795 mrva ;
N049.51.54.072 E018.48.23.795 N049.52.29.423 E018.49.01.235 mrva ;
N049.52.29.423 E018.49.01.235 N049.53.04.379 E018.49.39.612 mrva ;
N049.53.04.379 E018.49.39.612 N049.53.38.904 E018.50.18.923 mrva ;
N049.53.38.904 E018.50.18.923 N049.54.12.959 E018.50.59.135 mrva ;
N049.54.12.959 E018.50.59.135 N049.54.46.583 E018.51.40.284 mrva ;
N049.54.46.583 E018.51.40.284 N049.55.19.703 E018.52.22.331 mrva ;
N049.55.19.703 E018.52.22.331 N049.55.52.356 E018.53.05.243 mrva ;
N049.55.52.356 E018.53.05.243 N049.56.24.503 E018.53.49.055 mrva ;
N049.56.24.503 E018.53.49.055 N049.56.56.792 E018.54.34.743 mrva ;

;sector EPKT A
N050.19.52.960 E019.03.48.955 N050.20.29.003 E019.03.25.415 mrva
N050.20.29.003 E019.03.25.415 N050.21.16.739 E019.02.55.751 mrva
N050.21.16.739 E019.02.55.751 N050.22.04.800 E019.02.27.419 mrva
N050.22.04.800 E019.02.27.419 N050.22.53.183 E019.02.00.419 mrva
N050.22.53.183 E019.02.00.419 N050.27.22.751 E019.22.35.075 mrva
N050.27.22.751 E019.22.35.075 N050.27.57.708 E019.22.16.607 mrva
N050.27.57.708 E019.22.16.607 N050.28.32.879 E019.21.59.148 mrva
N050.28.32.879 E019.21.59.148 N050.29.08.196 E019.21.42.624 mrva
N050.29.08.196 E019.21.42.624 N050.29.43.728 E019.21.27.108 mrva
N050.29.43.728 E019.21.27.108 N050.30.19.403 E019.21.12.528 mrva
N050.30.19.403 E019.21.12.528 N050.30.55.259 E019.20.58.992 mrva
N050.30.55.259 E019.20.58.992 N050.31.31.260 E019.20.46.391 mrva
N050.31.31.260 E019.20.46.391 N050.32.07.368 E019.20.34.799 mrva
N050.32.07.368 E019.20.34.799 N050.32.43.620 E019.20.24.216 mrva
N050.32.43.620 E019.20.24.216 N050.33.19.979 E019.20.14.603 mrva
N050.33.19.979 E019.20.14.603 N050.33.56.411 E019.20.06.036 mrva
N050.33.56.411 E019.20.06.036 N050.34.32.952 E019.19.58.439 mrva
N050.34.32.952 E019.19.58.439 N050.35.09.599 E019.19.51.852 mrva
N050.35.09.599 E019.19.51.852 N050.35.46.283 E019.19.46.271 mrva
N050.35.46.283 E019.19.46.271 N050.35.32.171 E019.15.31.787 mrva
N050.35.32.171 E019.15.31.787 N050.36.11.735 E019.15.26.855 mrva
N050.36.11.735 E019.15.26.855 N050.36.51.336 E019.15.23.039 mrva
N050.36.51.336 E019.15.23.039 N050.37.31.007 E019.15.20.303 mrva
N050.37.31.007 E019.15.20.303 N050.38.10.679 E019.15.18.683 mrva
N050.38.10.679 E019.15.18.683 N050.38.50.352 E019.15.18.108 mrva
N050.38.50.352 E019.15.18.108 N050.39.30.059 E019.15.18.683 mrva
N050.39.30.059 E019.15.18.683 N050.40.09.732 E019.15.20.303 mrva
N050.40.09.732 E019.15.20.303 N050.40.49.367 E019.15.23.039 mrva
N050.40.49.367 E019.15.23.039 N050.41.34.796 E019.15.26.958 mrva

;south of EPKK CTR
N049.53.47.114 E019.15.35.869 N049.54.09.647 E019.16.29.496 mrva ;
N049.54.09.647 E019.16.29.496 N049.54.41.688 E019.17.51.540 mrva ;
N049.54.41.688 E019.17.51.540 N049.55.11.856 E019.19.15.276 mrva ;
N049.55.11.856 E019.19.15.276 N049.55.40.079 E019.20.40.595 mrva ;
N049.55.40.079 E019.20.40.595 N049.56.06.396 E019.22.07.356 mrva ;
N049.56.06.396 E019.22.07.356 N049.56.30.695 E019.23.35.484 mrva ;
N049.56.30.695 E019.23.35.484 N049.56.52.980 E019.25.04.871 mrva ;
N049.56.52.980 E019.25.04.871 N049.57.13.212 E019.26.35.411 mrva ;
N049.57.13.212 E019.26.35.411 N049.57.31.391 E019.28.06.959 mrva ;
N049.57.31.391 E019.28.06.959 N049.57.47.520 E019.29.39.443 mrva ;
N049.57.47.520 E019.29.39.443 N049.58.01.488 E019.31.12.719 mrva ;
N049.58.01.488 E019.31.12.719 N049.58.13.367 E019.32.46.715 mrva ;
N049.58.13.367 E019.32.46.715 N049.58.23.088 E019.34.21.251 mrva ;
N049.58.23.088 E019.34.21.251 N049.58.30.683 E019.35.56.292 mrva ;
N049.58.30.683 E019.35.56.292 N049.58.36.083 E019.37.31.656 mrva ;
N049.58.36.083 E019.37.31.656 N049.58.39.360 E019.39.07.272 mrva ;
N049.58.39.360 E019.39.07.272 N049.58.40.439 E019.40.42.995 mrva ;
N049.58.40.439 E019.40.42.995 N049.58.39.360 E019.42.18.720 mrva ;
N049.58.39.360 E019.42.18.720 N049.58.36.083 E019.43.54.336 mrva ;
N049.58.36.083 E019.43.54.336 N049.58.30.683 E019.45.29.700 mrva ;
N049.58.30.683 E019.45.29.700 N049.58.23.088 E019.47.04.739 mrva ;
N049.58.23.088 E019.47.04.739 N049.58.13.367 E019.48.39.311 mrva ;
N049.58.13.367 E019.48.39.311 N050.00.17.459 E019.49.12.972 mrva ;
N050.00.17.459 E019.49.12.972 N050.00.04.751 E019.50.53.592 mrva ;
N050.00.04.751 E019.50.53.592 N049.59.49.776 E019.52.33.491 mrva ;
N049.59.49.776 E019.52.33.491 N049.59.32.532 E019.54.12.491 mrva ;
N049.55.23.676 E019.52.22.499 N049.59.32.532 E019.54.12.491 mrva ; 
N049.59.32.532 E019.54.12.491 N050.03.11.699 E019.55.49.224 mrva ;
N050.03.11.699 E019.55.49.224 N050.02.49.884 E019.57.38.988 mrva ;
N050.02.49.884 E019.57.38.988 N050.02.25.619 E019.59.27.492 mrva ;
N050.02.25.619 E019.59.27.492 N050.01.58.907 E020.01.14.628 mrva ;
N050.01.58.907 E020.01.14.628 N050.01.29.784 E020.03.00.252 mrva ;
N050.01.29.784 E020.03.00.252 N050.00.58.247 E020.04.44.255 mrva ;
N050.00.58.247 E020.04.44.255 N050.04.28.595 E020.07.22.152 mrva ;
N050.04.28.595 E020.07.22.152 N050.03.51.011 E020.09.15.624 mrva ;
N050.03.51.011 E020.09.15.624 N050.03.10.907 E020.11.06.971 mrva ;
N050.03.10.907 E020.11.06.971 N050.02.28.320 E020.12.56.123 mrva ;
N050.02.28.320 E020.12.56.123 N050.01.43.248 E020.14.42.935 mrva ;
N050.01.43.248 E020.14.42.935 N050.00.55.800 E020.16.27.227 mrva ;
N050.00.55.800 E020.16.27.227 N050.00.06.011 E020.18.08.927 mrva ;
N050.00.06.011 E020.18.08.927 N049.59.13.955 E020.19.47.855 mrva ;
N049.59.13.955 E020.19.47.855 N049.58.19.704 E020.21.23.976 mrva ;
N049.58.19.704 E020.21.23.976 N049.57.23.292 E020.22.57.107 mrva ;
N049.57.23.292 E020.22.57.107 N049.56.24.791 E020.24.27.144 mrva ;
N049.56.24.791 E020.24.27.144 N049.55.24.275 E020.25.53.976 mrva ;
N049.55.24.275 E020.25.53.976 N049.54.21.851 E020.27.17.496 mrva ;

;EPPO_MRVA
N052.25.20.510 E016.49.48.610 N052.22.42.010 E016.47.12.428 mrva ;
N052.25.20.510 E016.49.48.610 N052.29.05.737 E016.48.30.093 mrva ;
N052.10.57.647 E017.01.18.696 N052.10.50.448 E017.00.53.892 mrva ;
N052.10.50.448 E017.00.53.892 N052.10.43.500 E017.00.28.908 mrva ;
N052.10.43.500 E017.00.28.908 N052.10.36.804 E017.00.03.708 mrva ;
N052.10.36.804 E017.00.03.708 N052.10.30.395 E016.59.38.328 mrva ;
N052.10.30.395 E016.59.38.328 N052.10.24.275 E016.59.12.767 mrva ;
N052.10.24.275 E016.59.12.767 N052.10.18.407 E016.58.47.027 mrva ;
N052.10.18.407 E016.58.47.027 N052.10.12.792 E016.58.21.107 mrva ;
N052.10.12.792 E016.58.21.107 N052.10.07.463 E016.57.55.079 mrva ;
N052.10.07.463 E016.57.55.079 N052.10.02.459 E016.57.28.872 mrva ;
N052.10.02.459 E016.57.28.872 N052.09.57.672 E016.57.02.520 mrva ;
N052.09.57.672 E016.57.02.520 N052.09.53.208 E016.56.36.059 mrva ;
N052.09.53.208 E016.56.36.059 N052.09.48.995 E016.56.09.456 mrva ;
N052.09.48.995 E016.56.09.456 N052.09.45.107 E016.55.42.744 mrva ;
N052.09.45.107 E016.55.42.744 N052.09.41.472 E016.55.15.887 mrva ;
N052.09.41.472 E016.55.15.887 N052.09.38.123 E016.54.48.995 mrva ;
N052.09.38.123 E016.54.48.995 N052.09.35.063 E016.54.21.959 mrva ;
N052.09.35.063 E016.54.21.959 N052.09.32.327 E016.53.54.851 mrva ;
N052.10.57.647 E017.01.18.696 N052.06.30.333 E017.04.52.476 mrva ;
N052.09.32.327 E016.53.54.851 N052.07.32.168 E016.54.26.064 mrva ;

;EPGD_MRVA
N054.17.58.920 E018.12.28.799 N054.14.46.677 E017.50.27.325 mrva ;
N054.17.58.920 E018.12.28.799 N054.26.46.102 E018.33.12.161 mrva ;
N054.25.16.352 E018.18.02.538 N054.30.52.546 E018.22.18.997 mrva ;
N054.23.23.748 E018.25.14.909 N054.25.16.352 E018.18.02.538 mrva ;


;prohibited ares - wyjatkowo najpierw strefa, potem jej nazwa (przygotowal Karol Dziedzic)
PROHIBITED  	  	  N051.30.11.015 E021.25.41.987 N051.30.01.224 E021.27.10.907 PROHI 
                          N051.30.01.224 E021.27.10.907 N051.29.33.108 E021.28.29.100 PROHI 
                          N051.29.33.108 E021.28.29.100 N051.28.50.015 E021.29.27.132 PROHI 
                          N051.28.50.015 E021.29.27.132 N051.27.57.132 E021.29.58.019 PROHI 
                          N051.27.57.132 E021.29.58.019 N051.27.00.899 E021.29.58.019 PROHI 
                          N051.27.00.899 E021.29.58.019 N051.26.08.016 E021.29.27.132 PROHI 
                          N051.26.08.016 E021.29.27.132 N051.25.24.923 E021.28.29.100 PROHI 
                          N051.25.24.923 E021.28.29.100 N051.24.56.807 E021.27.10.907 PROHI 
                          N051.24.56.807 E021.27.10.907 N051.24.47.016 E021.25.41.987 PROHI 
                          N051.24.47.016 E021.25.41.987 N051.24.56.807 E021.24.13.067 PROHI 
                          N051.24.56.807 E021.24.13.067 N051.25.24.923 E021.22.54.876 PROHI 
                          N051.25.24.923 E021.22.54.876 N051.26.08.016 E021.21.56.844 PROHI 
                          N051.26.08.016 E021.21.56.844 N051.27.00.899 E021.21.25.955 PROHI 
                          N051.27.00.899 E021.21.25.955 N051.27.57.132 E021.21.25.955 PROHI 
                          N051.27.57.132 E021.21.25.955 N051.28.50.015 E021.21.56.844 PROHI 
                          N051.28.50.015 E021.21.56.844 N051.29.33.108 E021.22.54.876 PROHI 
                          N051.29.33.108 E021.22.54.876 N051.30.01.224 E021.24.13.067 PROHI 
                          N051.30.01.224 E021.24.13.067 N051.30.11.015 E021.25.41.987 PROHI 
;EP P1 PIONKI 1500m AMSL

		          N052.08.03.804 E021.20.18.492 N052.07.59.879 E021.20.54.564 PROHI 
                          N052.07.59.879 E021.20.54.564 N052.07.48.648 E021.21.26.315 PROHI 
                          N052.07.48.648 E021.21.26.315 N052.07.31.404 E021.21.49.859 PROHI 
                          N052.07.31.404 E021.21.49.859 N052.07.10.272 E021.22.02.423 PROHI 
                          N052.07.10.272 E021.22.02.423 N052.06.47.735 E021.22.02.423 PROHI 
                          N052.06.47.735 E021.22.02.423 N052.06.26.604 E021.21.49.859 PROHI 
                          N052.06.26.604 E021.21.49.859 N052.06.09.360 E021.21.26.315 PROHI 
                          N052.06.09.360 E021.21.26.315 N052.05.58.127 E021.20.54.564 PROHI 
                          N052.05.58.127 E021.20.54.564 N052.05.54.204 E021.20.18.492 PROHI 
                          N052.05.54.204 E021.20.18.492 N052.05.58.127 E021.19.42.420 PROHI 
                          N052.05.58.127 E021.19.42.420 N052.06.09.360 E021.19.10.668 PROHI 
                          N052.06.09.360 E021.19.10.668 N052.06.26.604 E021.18.47.123 PROHI 
                          N052.06.26.604 E021.18.47.123 N052.06.47.735 E021.18.34.559 PROHI 
                          N052.06.47.735 E021.18.34.559 N052.07.10.272 E021.18.34.559 PROHI 
                          N052.07.10.272 E021.18.34.559 N052.07.31.404 E021.18.47.123 PROHI 
                          N052.07.31.404 E021.18.47.123 N052.07.48.648 E021.19.10.668 PROHI 
                          N052.07.48.648 E021.19.10.668 N052.07.59.879 E021.19.42.420 PROHI 
                          N052.07.59.879 E021.19.42.420 N052.08.03.804 E021.20.18.492 PROHI  
;EP P10 SWIERK 800m AMSL

			  N051.19.40.692 E016.43.53.507 N051.19.30.899 E016.45.22.067 PROHI 
                          N051.19.30.899 E016.45.22.067 N051.19.02.783 E016.46.39.972 PROHI 
                          N051.19.02.783 E016.46.39.972 N051.18.19.691 E016.47.37.787 PROHI 
                          N051.18.19.691 E016.47.37.787 N051.17.26.807 E016.48.08.567 PROHI 
                          N051.17.26.807 E016.48.08.567 N051.16.30.575 E016.48.08.567 PROHI 
                          N051.16.30.575 E016.48.08.567 N051.15.37.691 E016.47.37.787 PROHI 
                          N051.15.37.691 E016.47.37.787 N051.14.54.599 E016.46.39.972 PROHI 
                          N051.14.54.599 E016.46.39.972 N051.14.26.484 E016.45.22.067 PROHI 
                          N051.14.26.484 E016.45.22.067 N051.14.16.691 E016.43.53.507 PROHI 
                          N051.14.16.691 E016.43.53.507 N051.14.26.484 E016.42.24.947 PROHI 
                          N051.14.26.484 E016.42.24.947 N051.14.54.599 E016.41.07.043 PROHI 
                          N051.14.54.599 E016.41.07.043 N051.15.37.691 E016.40.09.227 PROHI 
                          N051.15.37.691 E016.40.09.227 N051.16.30.575 E016.39.38.447 PROHI 
                          N051.16.30.575 E016.39.38.447 N051.17.26.807 E016.39.38.447 PROHI 
                          N051.17.26.807 E016.39.38.447 N051.18.19.691 E016.40.09.227 PROHI 
                          N051.18.19.691 E016.40.09.227 N051.19.02.783 E016.41.07.043 PROHI 
                          N051.19.02.783 E016.41.07.043 N051.19.30.899 E016.42.24.947 PROHI 
                          N051.19.30.899 E016.42.24.947 N051.19.40.692 E016.43.53.507 PROHI 
;EP P11 BRZEG D 1500m AMSL

			N050.52.58.800 E018.25.53.600 N050.47.34.500 E018.34.08.900 PROHI
			N050.47.34.500 E018.34.08.900 N050.43.56.800 E018.27.56.700 PROHI
			N050.43.56.800 E018.27.56.700 N050.40.58.800 E018.12.53.600 PROHI
			N050.40.58.800 E018.12.53.600 N050.48.58.800 E018.09.53.600 PROHI
			N050.48.58.800 E018.09.53.600 N050.51.58.800 E018.12.53.600 PROHI
			N050.51.58.800 E018.12.53.600 N050.52.58.800 E018.25.53.600 PROHI
;EP P13 OLESNO FL105


			  N051.07.50.808 E020.54.55.295 N051.07.44.940 E020.55.48.252 PROHI 
                          N051.07.44.940 E020.55.48.252 N051.07.28.055 E020.56.34.800 PROHI 
                          N051.07.28.055 E020.56.34.800 N051.07.02.208 E020.57.09.360 PROHI 
                          N051.07.02.208 E020.57.09.360 N051.06.30.491 E020.57.27.719 PROHI 
                          N051.06.30.491 E020.57.27.719 N051.05.56.723 E020.57.27.719 PROHI 
                          N051.05.56.723 E020.57.27.719 N051.05.25.007 E020.57.09.360 PROHI 
                          N051.05.25.007 E020.57.09.360 N051.04.59.160 E020.56.34.800 PROHI 
                          N051.04.59.160 E020.56.34.800 N051.04.42.275 E020.55.48.252 PROHI 
                          N051.04.42.275 E020.55.48.252 N051.04.36.407 E020.54.55.295 PROHI 
                          N051.04.36.407 E020.54.55.295 N051.04.42.275 E020.54.02.339 PROHI 
                          N051.04.42.275 E020.54.02.339 N051.04.59.160 E020.53.15.792 PROHI 
                          N051.04.59.160 E020.53.15.792 N051.05.25.007 E020.52.41.231 PROHI 
                          N051.05.25.007 E020.52.41.231 N051.05.56.723 E020.52.22.872 PROHI 
                          N051.05.56.723 E020.52.22.872 N051.06.30.491 E020.52.22.872 PROHI 
                          N051.06.30.491 E020.52.22.872 N051.07.02.208 E020.52.41.231 PROHI 
                          N051.07.02.208 E020.52.41.231 N051.07.28.055 E020.53.15.792 PROHI 
                          N051.07.28.055 E020.53.15.792 N051.07.44.940 E020.54.02.339 PROHI 
                          N051.07.44.940 E020.54.02.339 N051.07.50.808 E020.54.55.295 PROHI 
;EP P14 SKARZYSKO KAMIENNA FL100

			  N054.21.16.100 E018.43.23.700 N054.21.01.200 E018.45.38.700 PROHI 
                          N054.21.01.200 E018.45.38.700 N054.20.14.500 E018.45.22.900 PROHI 
                          N054.20.14.500 E018.45.22.900 N054.20.29.300 E018.43.10.700 PROHI 
                          N054.20.29.300 E018.43.10.700 N054.21.16.100 E018.43.23.700 PROHI 
;EP P15 GDANSK 800m AMSL

			  N050.35.35.988 E018.36.53.712 N050.35.30.120 E018.37.46.056 PROHI 
                          N050.35.30.120 E018.37.46.056 N050.35.13.235 E018.38.32.064 PROHI 
                          N050.35.13.235 E018.38.32.064 N050.34.47.388 E018.39.06.228 PROHI 
                          N050.34.47.388 E018.39.06.228 N050.34.15.671 E018.39.24.408 PROHI 
                          N050.34.15.671 E018.39.24.408 N050.33.41.903 E018.39.24.408 PROHI 
                          N050.33.41.903 E018.39.24.408 N050.33.10.188 E018.39.06.228 PROHI 
                          N050.33.10.188 E018.39.06.228 N050.32.44.340 E018.38.32.064 PROHI 
                          N050.32.44.340 E018.38.32.064 N050.32.27.455 E018.37.46.056 PROHI 
                          N050.32.27.455 E018.37.46.056 N050.32.21.587 E018.36.53.712 PROHI 
                          N050.32.21.587 E018.36.53.712 N050.32.27.455 E018.36.01.368 PROHI 
                          N050.32.27.455 E018.36.01.368 N050.32.44.340 E018.35.15.359 PROHI 
                          N050.32.44.340 E018.35.15.359 N050.33.10.188 E018.34.41.195 PROHI 
                          N050.33.10.188 E018.34.41.195 N050.33.41.903 E018.34.23.016 PROHI 
                          N050.33.41.903 E018.34.23.016 N050.34.15.671 E018.34.23.016 PROHI 
                          N050.34.15.671 E018.34.23.016 N050.34.47.388 E018.34.41.195 PROHI 
                          N050.34.47.388 E018.34.41.195 N050.35.13.235 E018.35.15.359 PROHI 
                          N050.35.13.235 E018.35.15.359 N050.35.30.120 E018.36.01.368 PROHI 
                          N050.35.30.120 E018.36.01.368 N050.35.35.988 E018.36.53.712 PROHI 
;EP P2 KRUPSKI MLYN FL100

			  N051.30.07.992 E021.58.25.787 N051.29.58.199 E021.59.54.707 PROHI 
                          N051.29.58.199 E021.59.54.707 N051.29.30.083 E022.01.12.900 PROHI 
                          N051.29.30.083 E022.01.12.900 N051.28.46.992 E022.02.10.932 PROHI 
                          N051.28.46.992 E022.02.10.932 N051.27.54.107 E022.02.41.820 PROHI 
                          N051.27.54.107 E022.02.41.820 N051.26.57.876 E022.02.41.820 PROHI 
                          N051.26.57.876 E022.02.41.820 N051.26.04.991 E022.02.10.932 PROHI 
                          N051.26.04.991 E022.02.10.932 N051.25.21.900 E022.01.12.900 PROHI 
                          N051.25.21.900 E022.01.12.900 N051.24.53.784 E021.59.54.707 PROHI 
                          N051.24.53.784 E021.59.54.707 N051.24.43.991 E021.58.25.787 PROHI 
                          N051.24.43.991 E021.58.25.787 N051.24.53.784 E021.56.56.868 PROHI 
                          N051.24.53.784 E021.56.56.868 N051.25.21.900 E021.55.38.675 PROHI 
                          N051.25.21.900 E021.55.38.675 N051.26.04.991 E021.54.40.644 PROHI 
                          N051.26.04.991 E021.54.40.644 N051.26.57.876 E021.54.09.755 PROHI 
                          N051.26.57.876 E021.54.09.755 N051.27.54.107 E021.54.09.755 PROHI 
                          N051.27.54.107 E021.54.09.755 N051.28.46.992 E021.54.40.644 PROHI 
                          N051.28.46.992 E021.54.40.644 N051.29.30.083 E021.55.38.675 PROHI 
                          N051.29.30.083 E021.55.38.675 N051.29.58.199 E021.56.56.868 PROHI 
                          N051.29.58.199 E021.56.56.868 N051.30.07.992 E021.58.25.787 PROHI 
;EP P3 PULAWY 1500m AMSL
			
			  N050.07.40.008 E019.05.53.700 N050.07.30.215 E019.07.20.027 PROHI 
                          N050.07.30.215 E019.07.20.027 N050.07.02.099 E019.08.35.951 PROHI 
                          N050.07.02.099 E019.08.35.951 N050.06.19.008 E019.09.32.327 PROHI 
                          N050.06.19.008 E019.09.32.327 N050.05.26.123 E019.10.02.316 PROHI 
                          N050.05.26.123 E019.10.02.316 N050.04.29.892 E019.10.02.316 PROHI 
                          N050.04.29.892 E019.10.02.316 N050.03.37.007 E019.09.32.327 PROHI 
                          N050.03.37.007 E019.09.32.327 N050.02.53.916 E019.08.35.951 PROHI 
                          N050.02.53.916 E019.08.35.951 N050.02.25.800 E019.07.20.027 PROHI 
                          N050.02.25.800 E019.07.20.027 N050.02.16.007 E019.05.53.700 PROHI 
                          N050.02.16.007 E019.05.53.700 N050.02.25.800 E019.04.27.371 PROHI 
                          N050.02.25.800 E019.04.27.371 N050.02.53.916 E019.03.11.448 PROHI 
                          N050.02.53.916 E019.03.11.448 N050.03.37.007 E019.02.15.072 PROHI 
                          N050.03.37.007 E019.02.15.072 N050.04.29.892 E019.01.45.083 PROHI 
                          N050.04.29.892 E019.01.45.083 N050.05.26.123 E019.01.45.083 PROHI 
                          N050.05.26.123 E019.01.45.083 N050.06.19.008 E019.02.15.072 PROHI 
                          N050.06.19.008 E019.02.15.072 N050.07.02.099 E019.03.11.448 PROHI 
                          N050.07.02.099 E019.03.11.448 N050.07.30.215 E019.04.27.371 PROHI 
                          N050.07.30.215 E019.04.27.371 N050.07.40.008 E019.05.53.700 PROHI 
;EP P4 BIERUN 1500m AMSL


			  N050.04.40.800 E019.15.53.783 N050.04.31.007 E019.17.20.040 PROHI 
                          N050.04.31.007 E019.17.20.040 N050.04.02.892 E019.18.35.891 PROHI 
                          N050.04.02.892 E019.18.35.891 N050.03.19.800 E019.19.32.196 PROHI 
                          N050.03.19.800 E019.19.32.196 N050.02.26.916 E019.20.02.147 PROHI 
                          N050.02.26.916 E019.20.02.147 N050.01.30.684 E019.20.02.147 PROHI 
                          N050.01.30.684 E019.20.02.147 N050.00.37.800 E019.19.32.196 PROHI 
                          N050.00.37.800 E019.19.32.196 N049.59.54.708 E019.18.35.891 PROHI 
                          N049.59.54.708 E019.18.35.891 N049.59.26.592 E019.17.20.040 PROHI 
                          N049.59.26.592 E019.17.20.040 N049.59.16.799 E019.15.53.783 PROHI 
                          N049.59.16.799 E019.15.53.783 N049.59.26.592 E019.14.27.528 PROHI 
                          N049.59.26.592 E019.14.27.528 N049.59.54.708 E019.13.11.675 PROHI 
                          N049.59.54.708 E019.13.11.675 N050.00.37.800 E019.12.15.372 PROHI 
                          N050.00.37.800 E019.12.15.372 N050.01.30.684 E019.11.45.419 PROHI 
                          N050.01.30.684 E019.11.45.419 N050.02.26.916 E019.11.45.419 PROHI 
                          N050.02.26.916 E019.11.45.419 N050.03.19.800 E019.12.15.372 PROHI 
                          N050.03.19.800 E019.12.15.372 N050.04.02.892 E019.13.11.675 PROHI 
                          N050.04.02.892 E019.13.11.675 N050.04.31.007 E019.14.27.528 PROHI 
                          N050.04.31.007 E019.14.27.528 N050.04.40.800 E019.15.53.783 PROHI 
;EP P5 OSWIECIM 1500m AMSL

			  N050.02.36.204 E020.57.53.783 N050.02.30.335 E020.58.45.516 PROHI 
                          N050.02.30.335 E020.58.45.516 N050.02.13.451 E020.59.31.019 PROHI 
                          N050.02.13.451 E020.59.31.019 N050.01.47.604 E021.00.04.787 PROHI 
                          N050.01.47.604 E021.00.04.787 N050.01.15.887 E021.00.22.751 PROHI 
                          N050.01.15.887 E021.00.22.751 N050.00.42.119 E021.00.22.751 PROHI 
                          N050.00.42.119 E021.00.22.751 N050.00.10.404 E021.00.04.787 PROHI 
                          N050.00.10.404 E021.00.04.787 N049.59.44.556 E020.59.31.019 PROHI 
                          N049.59.44.556 E020.59.31.019 N049.59.27.671 E020.58.45.516 PROHI 
                          N049.59.27.671 E020.58.45.516 N049.59.21.804 E020.57.53.783 PROHI 
                          N049.59.21.804 E020.57.53.783 N049.59.27.671 E020.57.02.051 PROHI 
                          N049.59.27.671 E020.57.02.051 N049.59.44.556 E020.56.16.548 PROHI 
                          N049.59.44.556 E020.56.16.548 N050.00.10.404 E020.55.42.780 PROHI 
                          N050.00.10.404 E020.55.42.780 N050.00.42.119 E020.55.24.815 PROHI 
                          N050.00.42.119 E020.55.24.815 N050.01.15.887 E020.55.24.815 PROHI 
                          N050.01.15.887 E020.55.24.815 N050.01.47.604 E020.55.42.780 PROHI 
                          N050.01.47.604 E020.55.42.780 N050.02.13.451 E020.56.16.548 PROHI 
                          N050.02.13.451 E020.56.16.548 N050.02.30.335 E020.57.02.051 PROHI
                          N050.02.30.335 E020.57.02.051 N050.02.36.204 E020.57.53.783 PROHI  
;EP P6 TARNOW 1500m AMSL

			  N052.34.21.000 E019.38.47.000 N052.36.08.000 E019.39.05.000 PROHI 
                          N052.36.08.000 E019.39.05.000 N052.36.06.000 E019.42.40.000 PROHI 
                          N052.36.06.000 E019.42.40.000 N052.35.37.000 E019.43.04.000 PROHI 
                          N052.35.37.000 E019.43.04.000 N052.34.16.000 E019.41.13.000 PROHI
                          N052.34.16.000 E019.41.13.000 N052.34.21.000 E019.38.47.000 PROHI  
;EP P7 PLOCK 1500m AMSL	

                          N053.06.01.800 E018.03.13.200 N053.06.08.900 E018.09.53.300 PROHI 
                          N053.06.08.900 E018.09.53.300 N053.01.58.900 E018.06.53.300 PROHI 
                          N053.01.58.900 E018.06.53.300 N053.04.00.300 E018.03.41.200 PROHI
                          N053.04.00.300 E018.03.41.200 N053.06.01.800 E018.03.13.200 PROHI  
;EP P8 BYDGOSZCZ 175m AMSL

;EPMO
ILS N052.26.58.240 E020.38.01.300 N052.26.50.000 E020.36.37.000 ILSRED
N052.26.43.000 E020.35.12.000 N052.26.35.000 E020.33.48.000 ILSRED
N052.26.27.000 E020.32.23.000 N052.26.19.000 E020.30.59.000 ILSRED
N052.26.11.000 E020.29.34.000 N052.26.03.000 E020.28.10.000 ILSRED
N052.25.55.000 E020.26.45.000 N052.25.47.000 E020.25.21.000 ILSRED
N052.25.39.000 E020.23.56.000 N052.25.32.000 E020.22.32.000 ILSRED
N052.25.24.000 E020.21.07.000 N052.25.16.000 E020.19.43.000 ILSRED
N052.25.08.000 E020.18.19.000 N052.24.59.000 E020.16.54.000 ILSRED
N052.24.51.000 E020.15.30.000 N052.24.43.000 E020.14.05.000 ILSRED

;EPSY
N053.28.16.306 E020.55.54.114 N053.27.27.000 E020.55.26.000 ILSRED	
N053.26.37.000 E020.54.59.000 N053.25.48.000 E020.54.31.000 ILSRED
N053.24.59.000 E020.54.03.000 N053.24.09.000 E020.53.36.000 ILSRED
N053.23.20.000 E020.53.08.000 N053.22.30.000 E020.52.40.000 ILSRED
N053.21.41.000 E020.52.13.000 N053.20.51.000 E020.51.45.000 ILSRED
N053.20.02.000 E020.51.18.000 N053.19.13.000 E020.50.50.000 ILSRED
N053.18.23.000 E020.50.23.000 N053.17.34.000 E020.49.55.000 ILSRED	

;EPWA ILS33
N052.08.05.000 E020.59.38.000 N052.07.12.000 E021.00.23.000 ILSRED
N052.06.20.000 E021.01.08.000 N052.05.26.000 E021.01.53.000 ILSRED
N052.04.33.000 E021.02.38.000 N052.03.40.000 E021.03.24.000 ILSRED
N052.02.47.000 E021.04.08.000 N052.01.54.000 E021.04.53.000 ILSRED
N052.01.00.000 E021.05.38.000 N052.00.08.000 E021.06.23.000 ILSRED
N051.59.15.000 E021.07.08.000 N051.58.22.000 E021.07.53.000 ILSRED
N051.57.30.000 E021.08.38.000 N051.56.36.000 E021.09.23.000 ILSRED
N051.55.43.000 E021.10.08.000 N051.54.50.000 E021.10.53.000 ILSRED
;EPLL
N051.43.46.000 E019.25.54.000 N051.44.06.000 E019.27.25.000 ILSRED
N051.44.26.000 E019.28.56.000 N051.44.46.000 E019.30.27.000 ILSRED
N051.45.07.000 E019.31.58.000 N051.45.27.000 E019.33.29.000 ILSRED
N051.45.47.000 E019.35.00.000 N051.46.08.000 E019.36.31.000 ILSRED
N051.46.28.000 E019.38.02.000 N051.46.49.000 E019.39.33.000 ILSRED
N051.47.09.000 E019.41.04.000 N051.47.30.000 E019.42.35.000 ILSRED
N051.47.50.000 E019.44.06.000 N051.48.10.000 E019.45.37.000 ILSRED
N051.48.30.000 E019.47.08.000 N051.48.50.000 E019.48.39.000 ILSRED
;EPWA ILS11
N052.10.42.000 E020.55.20.000 N052.11.07.000 E020.53.50.000 ILSRED
N052.11.32.000 E020.52.20.000 N052.11.57.000 E020.50.52.000 ILSRED
N052.12.22.000 E020.49.23.000 N052.12.47.000 E020.47.54.000 ILSRED
N052.13.12.000 E020.46.25.000 N052.13.37.000 E020.44.56.000 ILSRED
N052.14.03.000 E020.43.27.000 N052.14.27.000 E020.41.58.000 ILSRED
N052.14.52.000 E020.40.30.000 N052.15.17.000 E020.39.00.000 ILSRED
N052.15.42.000 E020.37.30.000 N052.16.07.000 E020.36.03.000 ILSRED
N052.16.32.000 E020.34.33.000 N052.16.57.000 E020.33.04.000 ILSRED
;EPKT ILS27
N050.28.26.651 E019.07.13.404 N050.28.26.111 E019.08.47.688  ILSRED
N050.28.25.572 E019.10.21.971 N050.28.25.031 E019.11.56.255  ILSRED
N050.28.24.491 E019.13.30.539 N050.28.23.952 E019.15.04.823  ILSRED
N050.28.23.412 E019.16.39.107 N050.28.22.871 E019.18.13.391  ILSRED
N050.28.22.332 E019.19.47.676 N050.28.21.792 E019.21.21.960  ILSRED
N050.28.21.251 E019.22.56.244 N050.28.20.711 E019.24.30.528  ILSRED
N050.28.20.172 E019.26.04.812 N050.28.19.631 E019.27.39.096  ILSRED
N050.28.19.091 E019.29.13.379 N050.28.18.552 E019.30.47.663  ILSRED
;EPKK ILS25
N050.05.02.220 E019.49.41.447 N050.05.15.216 E019.51.12.743 ILSRED
N050.05.28.211 E019.52.44.040 N050.05.41.208 E019.54.15.336 ILSRED
N050.05.54.204 E019.55.46.631 N050.06.07.199 E019.57.17.963 ILSRED
N050.06.20.195 E019.58.49.296 N050.06.33.192 E020.00.20.627 ILSRED
N050.06.46.188 E020.01.51.959 N050.06.59.183 E020.03.23.292 ILSRED
N050.07.12.179 E020.04.54.659 N050.07.25.176 E020.06.26.028 ILSRED
N050.07.38.172 E020.07.57.395 N050.07.51.167 E020.09.28.764 ILSRED
N050.08.04.163 E020.11.00.132 N050.08.17.160 E020.12.31.536 ILSRED
;ILS 27 EPRZ
N050.06.33.000 E022.03.44.000 N050.06.32.000 E022.05.17.000 ILSRED
N050.06.31.000 E022.06.50.000 N050.06.30.000 E022.08.24.000 ILSRED
N050.06.29.000 E022.09.54.000 N050.06.28.000 E022.11.31.000 ILSRED
N050.06.27.000 E022.12.58.000 N050.06.26.000 E022.14.38.000 ILSRED
N050.06.25.000 E022.16.02.000 N050.06.24.000 E022.17.45.000 ILSRED
N050.06.23.000 E022.19.06.000 N050.06.22.000 E022.20.53.000 ILSRED
N050.06.21.000 E022.22.10.000 N050.06.20.000 E022.24.00.000 ILSRED
N050.06.19.000 E022.25.14.000 N050.06.18.000 E022.27.07.000 ILSRED
;EPSC ILS 31
N053.34.01.000 E014.56.10.000 N053.33.21.000 E014.57.24.000 ILSRED
N053.32.40.000 E014.58.41.000 N053.31.59.000 E014.59.58.000 ILSRED
N053.31.19.000 E015.01.12.000 N053.30.37.000 E015.02.32.000 ILSRED
N053.29.58.000 E015.03.43.000 N053.29.15.000 E015.05.06.000 ILSRED
N053.28.37.000 E015.06.14.000 N053.27.53.000 E015.07.40.000 ILSRED
N053.27.16.000 E015.08.45.000 N053.26.31.000 E015.10.14.000 ILSRED
N053.25.55.000 E015.11.16.000 N053.25.09.000 E015.12.48.000 ILSRED
N053.24.34.000 E015.13.47.000 N053.23.47.000 E015.15.22.000 ILSRED
;ILS 26 EPBY
N053.06.03.000 E018.01.24.000 N053.06.12.000 E018.03.02.000 ILSRED
N053.06.22.000 E018.04.40.000 N053.06.31.000 E018.06.18.000 ILSRED
N053.06.40.000 E018.07.56.000 N053.06.49.000 E018.09.34.000 ILSRED
N053.06.58.000 E018.11.12.000 N053.07.07.000 E018.12.50.000 ILSRED
N053.07.16.000 E018.14.28.000 N053.07.26.000 E018.16.06.000 ILSRED
N053.07.34.000 E018.17.44.000 N053.07.44.000 E018.19.22.000 ILSRED
N053.07.52.000 E018.20.50.000 N053.08.02.000 E018.22.38.000 ILSRED
N053.08.10.000 E018.24.06.000 N053.08.20.000 E018.25.54.000 ILSRED
;ILS 29 EPGD
N054.21.54.000 E018.31.05.000 N054.21.31.000 E018.32.41.000 ILSRED
N054.21.09.000 E018.34.16.000 N054.20.46.000 E018.35.52.000 ILSRED
N054.20.24.000 E018.37.27.000 N054.20.01.000 E018.39.03.000 ILSRED
N054.19.38.000 E018.40.38.000 N054.19.16.000 E018.42.14.000 ILSRED
N054.18.52.000 E018.43.49.000 N054.18.30.000 E018.45.25.000 ILSRED
N054.18.08.000 E018.47.00.000 N054.17.45.000 E018.48.36.000 ILSRED
N054.17.23.000 E018.50.11.000 N054.17.00.000 E018.51.47.000 ILSRED
N054.16.38.000 E018.53.22.000 N054.16.15.000 E018.54.58.000 ILSRED
;ILS 29 EPWR
N051.05.30.000 E016.55.20.000 N051.05.03.000 E016.56.46.000 ILSRED
N051.04.36.000 E016.58.12.000 N051.04.09.000 E016.59.38.000 ILSRED
N051.03.42.000 E017.01.04.000 N051.03.15.000 E017.02.30.000 ILSRED
N051.02.48.000 E017.03.57.000 N051.02.21.000 E017.05.23.000 ILSRED
N051.01.54.000 E017.06.49.000 N051.01.27.000 E017.08.16.000 ILSRED
N051.01.00.000 E017.09.42.000 N051.00.33.000 E017.11.08.000 ILSRED
N051.00.06.000 E017.12.34.000 N050.59.39.000 E017.14.00.000 ILSRED
N050.59.12.000 E017.15.26.000 N050.58.45.000 E017.16.52.000 ILSRED
;ILS - EPPO 29
N001.39.20.999 E021.25.40.001 N001.41.44.999 E020.58.09.998 
N052.24.47.844 E016.52.01.091 N052.24.30.311 E016.53.35.160 ILSRED
N052.24.12.780 E016.55.09.227 N052.23.55.247 E016.56.43.260 ILSRED
N052.23.37.716 E016.58.17.292 N052.23.20.183 E016.59.51.323 ILSRED
N052.23.02.652 E017.01.25.356 N052.22.45.119 E017.02.59.352 ILSRED
N052.22.27.588 E017.04.33.347 N052.22.10.055 E017.06.07.343 ILSRED
N052.21.52.523 E017.07.41.303 N052.21.34.992 E017.09.15.264 ILSRED
N052.21.17.459 E017.10.49.224 N052.20.59.928 E017.12.23.184 ILSRED
N052.20.42.395 E017.13.57.108 N052.20.24.864 E017.15.31.032 ILSRED
;EPLB ILS25
ILS N051.14.10.200 E022.41.07.700 N051.14.13.840 E022.41.32.830 ILSRED
N051.14.17.380 E022.41.57.890 N051.14.21.100 E022.42.23.060 ILSRED
N051.14.24.580 E022.42.48.210 N051.14.28.200 E022.43.13.360 ILSRED
N051.14.31.810 E022.43.38.470 N051.14.35.450 E022.44.03.600 ILSRED
N051.14.39.040 E022.44.28.720 N051.14.46.230 E022.45.19.100 ILSRED
N051.14.53.350 E022.46.09.280 N051.15.00.370 E022.46.59.620 ILSRED
N051.15.07.650 E022.47.49.860 N051.15.14.800 E022.48.40.310 ILSRED
N051.15.29.030 E022.50.21.280 N051.15.36.380 E022.51.11.230 ILSRED

;LOTNISKA
;EPLL
;Runway 25/07
LOTNISKA_EPLL N051.43.25.794 E019.24.22.267 N051.42.58.845 E019.22.19.082 runway
N051.42.58.845 E019.22.19.082 N051.42.57.471 E019.22.19.865 runway
N051.42.57.471 E019.22.19.865 N051.43.24.421 E019.24.23.051 runway
N051.43.24.421 E019.24.23.051 N051.43.25.794 E019.24.22.267 runway
;Taxiway borders

;Taxiway center lines
N051.43.29.127 E019.24.19.530 N051.43.29.926 E019.24.19.044 olive
N051.43.18.932 E019.24.29.089 N051.43.18.463 E019.24.29.503 olive
N051.43.18.463 E019.24.29.503 N051.43.17.989 E019.24.29.775 olive
N051.43.17.446 E019.24.29.928 N051.43.17.989 E019.24.29.775 olive
N051.43.16.105 E019.24.30.145 N051.43.17.446 E019.24.29.928 olive
N051.43.22.597 E019.24.24.649 N051.43.18.932 E019.24.29.089 olive
N051.43.22.597 E019.24.24.649 N051.43.24.143 E019.24.22.782 olive
N051.43.26.316 E019.24.21.239 N051.43.25.853 E019.24.21.350 olive
N051.43.24.878 E019.24.20.881 N051.43.24.608 E019.24.20.333 olive
N051.43.24.596 E019.24.21.517 N051.43.24.608 E019.24.20.333 olive
N051.43.24.436 E019.24.22.193 N051.43.24.596 E019.24.21.517 olive
N051.43.24.436 E019.24.22.193 N051.43.24.143 E019.24.22.782 olive
N051.43.29.849 E019.24.18.142 N051.43.29.918 E019.24.17.357 olive
N051.43.29.849 E019.24.18.142 N051.43.29.616 E019.24.18.859 olive
N051.43.29.834 E019.24.16.606 N051.43.29.918 E019.24.17.357 olive
N051.43.32.422 E019.24.14.974 N051.43.30.512 E019.24.18.389 olive
N051.43.30.512 E019.24.18.389 N051.43.30.298 E019.24.18.698 olive
N051.43.30.298 E019.24.18.698 N051.43.29.926 E019.24.19.044 olive
N051.43.27.851 E019.24.20.304 N051.43.26.316 E019.24.21.239 olive
N051.43.25.315 E019.24.21.247 N051.43.25.853 E019.24.21.350 olive
N051.43.25.315 E019.24.21.247 N051.43.24.878 E019.24.20.881 olive
N051.43.29.127 E019.24.19.530 N051.43.27.851 E019.24.20.304 olive
N051.43.29.616 E019.24.18.859 N051.43.29.127 E019.24.19.530 olive
N051.43.32.909 E019.24.13.850 N051.43.33.016 E019.24.13.059 olive
N051.43.32.903 E019.24.09.484 N051.43.32.782 E019.24.08.372 olive
N051.43.32.422 E019.24.14.974 N051.43.32.656 E019.24.14.550 olive
N051.43.32.656 E019.24.14.550 N051.43.32.909 E019.24.13.850 olive
N051.43.29.834 E019.24.16.606 N051.43.28.048 E019.24.08.435 olive
N051.43.28.341 E019.24.06.729 N051.43.28.643 E019.24.06.441 olive
N051.43.28.122 E019.24.07.165 N051.43.28.341 E019.24.06.729 olive
N051.43.28.048 E019.24.08.435 N051.43.28.001 E019.24.07.796 olive
N051.43.28.001 E019.24.07.796 N051.43.28.122 E019.24.07.165 olive
N051.43.31.109 E019.24.05.052 N051.43.31.424 E019.24.04.656 olive
N051.43.31.109 E019.24.05.052 N051.43.31.501 E019.24.05.018 olive
N051.43.31.501 E019.24.05.018 N051.43.31.826 E019.24.05.192 olive
N051.43.31.424 E019.24.04.656 N051.43.31.609 E019.24.04.190 olive
N051.43.31.609 E019.24.04.190 N051.43.31.665 E019.24.03.246 olive
N051.43.31.826 E019.24.05.192 N051.43.32.246 E019.24.05.902 olive
N051.43.32.422 E019.24.14.974 N051.43.32.837 E019.24.14.599 olive
N051.43.31.665 E019.24.03.246 N051.43.31.455 E019.24.02.278 olive
N051.43.31.455 E019.24.02.278 N051.43.33.171 E019.24.01.293 olive
N051.43.32.246 E019.24.05.902 N051.43.31.884 E019.24.04.243 olive
N051.43.31.884 E019.24.04.243 N051.43.33.601 E019.24.03.266 olive
N051.43.31.884 E019.24.04.243 N051.43.31.109 E019.24.05.052 olive
N051.43.31.028 E019.24.00.313 N051.43.30.722 E019.23.58.925 olive
N051.43.31.028 E019.24.00.313 N051.43.32.743 E019.23.59.325 olive
N051.43.32.315 E019.24.06.219 N051.43.32.246 E019.24.05.902 olive
N051.43.32.315 E019.24.06.219 N051.43.34.026 E019.24.05.231 olive
N051.43.32.782 E019.24.08.372 N051.43.32.747 E019.24.08.182 olive
N051.43.32.747 E019.24.08.182 N051.43.34.458 E019.24.07.205 olive
N051.43.32.747 E019.24.08.182 N051.43.32.527 E019.24.07.188 olive
N051.43.32.527 E019.24.07.188 N051.43.32.315 E019.24.06.219 olive
N051.43.32.527 E019.24.07.188 N051.43.30.648 E019.24.08.272 olive
N051.43.33.016 E019.24.13.059 N051.43.32.973 E019.24.11.572 olive
N051.43.32.973 E019.24.11.572 N051.43.35.307 E019.24.10.242 olive
N051.43.32.973 E019.24.11.572 N051.43.32.968 E019.24.11.304 olive
N051.43.32.968 E019.24.11.304 N051.43.32.903 E019.24.09.484 olive
N051.43.30.961 E019.24.10.989 N051.43.32.968 E019.24.11.304 olive
N051.43.30.961 E019.24.10.989 N051.43.31.190 E019.24.12.146 olive
N051.43.31.826 E019.24.12.664 N051.43.31.190 E019.24.12.146 olive
N051.43.31.826 E019.24.12.664 N051.43.32.194 E019.24.12.964 olive
N051.43.32.194 E019.24.12.964 N051.43.32.510 E019.24.13.503 olive
N051.43.32.510 E019.24.13.503 N051.43.32.602 E019.24.14.146 olive
N051.43.32.602 E019.24.14.146 N051.43.32.422 E019.24.14.974 olive
N051.43.36.276 E019.24.12.647 N051.43.36.693 E019.24.12.627 olive
N051.43.35.727 E019.24.12.956 N051.43.36.276 E019.24.12.647 olive
N051.43.35.727 E019.24.12.956 N051.43.35.966 E019.24.14.045 olive
N051.43.35.966 E019.24.14.045 N051.43.35.798 E019.24.14.613 olive
N051.43.34.871 E019.24.13.442 N051.43.35.727 E019.24.12.956 olive
N051.43.35.075 E019.24.14.357 N051.43.34.871 E019.24.13.442 olive
N051.43.35.075 E019.24.14.357 N051.43.34.827 E019.24.15.233 olive
N051.43.32.837 E019.24.14.599 N051.43.33.822 E019.24.14.039 olive
N051.43.33.822 E019.24.14.039 N051.43.34.871 E019.24.13.442 olive
N051.43.34.065 E019.24.15.131 N051.43.33.822 E019.24.14.039 olive
N051.43.34.065 E019.24.15.131 N051.43.33.929 E019.24.15.833 olive
N051.43.30.200 E019.24.07.016 N051.43.30.648 E019.24.08.272 olive
N051.43.31.109 E019.24.05.052 N051.43.29.918 E019.24.05.723 olive
N051.43.29.918 E019.24.05.723 N051.43.28.643 E019.24.06.441 olive
N051.43.30.200 E019.24.07.016 N051.43.29.918 E019.24.05.723 olive
N051.43.30.574 E019.24.03.277 N051.43.29.836 E019.24.03.150 olive
N051.43.30.574 E019.24.03.277 N051.43.31.066 E019.24.03.293 olive
N051.43.31.066 E019.24.03.293 N051.43.31.453 E019.24.03.456 olive
N051.43.31.884 E019.24.04.243 N051.43.31.791 E019.24.03.819 olive
N051.43.31.791 E019.24.03.819 N051.43.31.665 E019.24.03.246 olive
N051.43.31.453 E019.24.03.456 N051.43.31.791 E019.24.03.819 olive
N051.43.31.455 E019.24.02.278 N051.43.31.329 E019.24.01.690 olive
N051.43.30.614 E019.24.02.102 N051.43.31.329 E019.24.01.690 olive
N051.43.30.614 E019.24.02.102 N051.43.29.247 E019.24.02.033 olive
N051.43.29.247 E019.24.02.033 N051.43.29.190 E019.24.02.933 olive
N051.43.29.190 E019.24.02.933 N051.43.29.836 E019.24.03.150 olive
N051.43.29.732 E019.24.00.392 N051.43.29.224 E019.24.00.363 olive
N051.43.29.732 E019.24.00.392 N051.43.30.484 E019.24.00.414 olive
N051.43.30.484 E019.24.00.414 N051.43.30.766 E019.24.00.530 olive
N051.43.31.329 E019.24.01.690 N051.43.31.221 E019.24.01.206 olive
N051.43.31.221 E019.24.01.206 N051.43.31.028 E019.24.00.313 olive
N051.43.30.766 E019.24.00.530 N051.43.31.221 E019.24.01.206 olive
N051.43.30.722 E019.23.58.925 N051.43.30.024 E019.23.59.386 olive
N051.43.30.024 E019.23.59.386 N051.43.28.514 E019.23.59.318 olive
N051.43.28.470 E019.24.00.292 N051.43.29.224 E019.24.00.363 olive
N051.43.28.470 E019.24.00.292 N051.43.28.514 E019.23.59.318 olive
N051.43.16.105 E019.24.30.145 N051.43.12.964 E019.24.30.652 olive
N051.43.11.938 E019.24.25.994 N051.43.12.438 E019.24.25.693 olive
N051.43.12.662 E019.24.29.239 N051.43.13.153 E019.24.28.944 olive
N051.43.12.503 E019.24.28.508 N051.43.12.662 E019.24.29.239 olive
N051.43.12.503 E019.24.28.508 N051.43.12.992 E019.24.28.225 olive
N051.43.11.938 E019.24.25.994 N051.43.12.172 E019.24.27.034 olive
N051.43.12.172 E019.24.27.034 N051.43.12.503 E019.24.28.508 olive
N051.43.12.172 E019.24.27.034 N051.43.12.670 E019.24.26.744 olive
N051.43.12.662 E019.24.29.239 N051.43.12.815 E019.24.29.965 olive
N051.43.12.815 E019.24.29.965 N051.43.12.964 E019.24.30.652 olive
N051.43.37.014 E019.24.09.618 N051.43.33.540 E019.24.11.582 apron
N051.43.32.424 E019.24.12.213 N051.43.30.495 E019.24.13.305 apron
N051.43.30.495 E019.24.13.305 N051.43.30.991 E019.24.15.555 apron
N051.43.30.991 E019.24.15.555 N051.43.31.010 E019.24.15.946 apron
N051.43.31.010 E019.24.15.946 N051.43.30.941 E019.24.16.100 apron
N051.43.30.941 E019.24.16.100 N051.43.30.856 E019.24.16.152 apron
N051.43.30.856 E019.24.16.152 N051.43.30.674 E019.24.16.152 apron
N051.43.30.674 E019.24.16.152 N051.43.30.571 E019.24.15.986 apron
N051.43.30.571 E019.24.15.986 N051.43.29.603 E019.24.12.610 apron
N051.43.29.603 E019.24.12.610 N051.43.29.098 E019.24.10.311 apron
N051.43.29.098 E019.24.10.311 N051.43.28.738 E019.24.08.086 apron
N051.43.28.738 E019.24.08.086 N051.43.28.746 E019.24.07.782 apron
N051.43.28.746 E019.24.07.782 N051.43.28.897 E019.24.07.580 apron
N051.43.28.897 E019.24.07.580 N051.43.29.204 E019.24.07.408 apron
N051.43.29.204 E019.24.07.408 N051.43.30.495 E019.24.13.306 apron
N051.43.30.495 E019.24.13.306 N051.43.32.424 E019.24.12.214 apron
N051.43.33.540 E019.24.11.583 N051.43.37.081 E019.24.09.579 apron
N051.43.37.081 E019.24.09.579 N051.43.34.518 E019.23.57.863 apron
N051.43.34.518 E019.23.57.863 N051.43.27.109 E019.23.57.794 apron
N051.43.27.109 E019.23.57.794 N051.43.28.709 E019.24.05.134 apron
N051.43.28.709 E019.24.05.134 N051.43.28.219 E019.24.05.403 apron
N051.43.28.219 E019.24.05.403 N051.43.28.133 E019.24.05.351 apron
N051.43.28.133 E019.24.05.351 N051.43.28.017 E019.24.04.814 apron
N051.43.28.017 E019.24.04.814 N051.43.26.761 E019.24.05.529 apron
N051.43.26.761 E019.24.05.529 N051.43.28.455 E019.24.13.260 apron
N051.43.28.455 E019.24.13.260 N051.43.29.049 E019.24.17.186 apron
N051.43.29.049 E019.24.17.186 N051.43.29.073 E019.24.17.631 apron
N051.43.29.073 E019.24.17.631 N051.43.28.964 E019.24.18.067 apron
N051.43.28.964 E019.24.18.067 N051.43.28.764 E019.24.18.249 apron
N051.43.28.764 E019.24.18.249 N051.43.27.342 E019.24.19.409 apron
N051.43.27.342 E019.24.19.409 N051.43.26.116 E019.24.20.122 apron
N051.43.26.116 E019.24.20.122 N051.43.25.795 E019.24.20.037 apron
N051.43.25.795 E019.24.20.037 N051.43.25.466 E019.24.19.776 apron
N051.43.25.466 E019.24.19.776 N051.43.25.191 E019.24.19.515 apron
N051.43.25.927 E019.24.22.158 N051.43.26.012 E019.24.22.111 apron
N051.43.26.012 E019.24.22.111 N051.43.26.038 E019.24.22.230 apron
N051.43.26.038 E019.24.22.230 N051.43.26.082 E019.24.22.428 apron
N051.43.26.082 E019.24.22.428 N051.43.32.122 E019.24.18.714 apron
N051.43.32.122 E019.24.18.714 N051.43.32.426 E019.24.19.897 apron
N051.43.32.426 E019.24.19.897 N051.43.32.987 E019.24.19.526 apron
N051.43.32.987 E019.24.19.526 N051.43.32.601 E019.24.18.017 apron
N051.43.32.601 E019.24.18.017 N051.43.35.623 E019.24.16.074 apron
N051.43.35.623 E019.24.16.074 N051.43.38.131 E019.24.14.771 apron
N051.43.38.131 E019.24.14.771 N051.43.37.014 E019.24.09.618 apron
N051.43.11.859 E019.24.30.540 N051.43.11.453 E019.24.28.663 apron
N051.43.11.453 E019.24.28.663 N051.43.11.399 E019.24.28.281 apron
N051.43.11.399 E019.24.28.281 N051.43.11.196 E019.24.27.372 apron
N051.43.11.196 E019.24.27.372 N051.43.11.771 E019.24.27.048 apron
N051.43.11.771 E019.24.27.048 N051.43.11.414 E019.24.25.405 apron
N051.43.11.414 E019.24.25.405 N051.43.10.757 E019.24.25.774 apron
N051.43.10.757 E019.24.25.774 N051.43.10.521 E019.24.24.681 apron
N051.43.10.521 E019.24.24.681 N051.43.11.684 E019.24.24.031 apron
N051.43.11.684 E019.24.24.031 N051.43.11.925 E019.24.25.125 apron
N051.43.11.925 E019.24.25.125 N051.43.11.873 E019.24.25.297 apron
N051.43.11.873 E019.24.25.297 N051.43.12.455 E019.24.27.935 apron
N051.43.12.455 E019.24.27.935 N051.43.12.011 E019.24.28.189 apron
N051.43.12.011 E019.24.28.189 N051.43.12.502 E019.24.30.437 apron
N051.43.12.519 E019.24.30.517 N051.43.11.880 E019.24.30.637 apron
N051.43.12.519 E019.24.30.517 N051.43.12.502 E019.24.30.437 apron
N051.43.11.880 E019.24.30.637 N051.43.11.859 E019.24.30.540 apron
N051.43.13.038 E019.24.30.351 N051.43.17.349 E019.24.29.675 apron
N051.43.17.439 E019.24.29.661 N051.43.17.957 E019.24.29.508 apron
N051.43.17.957 E019.24.29.508 N051.43.18.400 E019.24.29.258 apron
N051.43.18.400 E019.24.29.258 N051.43.18.839 E019.24.28.865 apron
N051.43.18.839 E019.24.28.865 N051.43.24.264 E019.24.22.244 apron
N051.43.17.439 E019.24.29.661 N051.43.17.349 E019.24.29.675 apron
N051.43.11.880 E019.24.30.637 N051.43.11.859 E019.24.30.540 apron
N051.43.12.845 E019.24.30.382 N051.43.12.305 E019.24.28.006 apron
N051.43.12.305 E019.24.28.006 N051.43.12.454 E019.24.27.927 apron
N051.43.12.454 E019.24.27.927 N051.43.12.880 E019.24.29.903 apron
N051.43.12.880 E019.24.29.903 N051.43.13.038 E019.24.30.351 apron
N051.43.25.788 E019.24.22.237 N051.43.25.927 E019.24.22.158 apron
N051.43.12.980 E019.24.30.954 N051.43.12.845 E019.24.30.382 apron
N051.43.12.980 E019.24.30.954 N051.43.17.434 E019.24.30.228 apron
N051.43.17.434 E019.24.30.228 N051.43.18.015 E019.24.30.048 apron
N051.43.18.015 E019.24.30.048 N051.43.18.498 E019.24.29.752 apron
N051.43.18.498 E019.24.29.752 N051.43.19.006 E019.24.29.294 apron
N051.43.19.006 E019.24.29.294 N051.43.24.383 E019.24.22.868 apron
N051.43.22.500 E019.24.24.440 N051.43.22.694 E019.24.24.858 hold_short
N051.43.27.651 E019.24.19.448 N051.43.28.051 E019.24.21.159 hold_short

;EPMO
LOTNISKA_EPMO N052.26.58.722 E020.38.01.766 N052.27.10.168 E020.40.15.182 Color_251ACI
N052.27.10.168 E020.40.15.182 N052.27.07.693 E020.40.15.792 Color_251ACI
N052.27.07.693 E020.40.15.792 N052.26.56.195 E020.38.02.361 Color_251ACI
N052.26.56.195 E020.38.02.361 N052.26.58.722 E020.38.01.766 Color_251ACI
N052.26.56.195 E020.38.02.361 N052.26.53.588 E020.38.03.112 Color_251ACI
N052.26.53.588 E020.38.03.112 N052.26.53.294 E020.38.03.078 Color_251ACI
N052.26.53.294 E020.38.03.078 N052.26.53.010 E020.38.02.878 Color_251ACI
N052.26.53.010 E020.38.02.878 N052.26.52.822 E020.38.02.546 Color_251ACI
N052.26.52.822 E020.38.02.546 N052.26.52.664 E020.38.02.125 Color_251ACI
N052.26.52.664 E020.38.02.125 N052.26.52.634 E020.38.01.139 Color_251ACI
N052.26.52.634 E020.38.01.139 N052.26.48.035 E020.38.02.156 Color_251ACI
N052.26.48.035 E020.38.02.156 N052.26.48.016 E020.38.02.836 Color_251ACI
N052.26.48.016 E020.38.02.836 N052.26.48.053 E020.38.03.600 Color_251ACI
N052.26.48.053 E020.38.03.600 N052.26.47.971 E020.38.03.945 Color_251ACI
N052.26.47.971 E020.38.03.945 N052.26.47.832 E020.38.04.287 Color_251ACI
N052.26.47.832 E020.38.04.287 N052.26.47.658 E020.38.04.567 Color_251ACI
N052.26.47.658 E020.38.04.567 N052.26.47.441 E020.38.04.715 Color_251ACI
N052.26.47.441 E020.38.04.715 N052.26.47.114 E020.38.04.824 Color_251ACI
N052.26.47.114 E020.38.04.824 N052.26.46.837 E020.38.04.754 Color_251ACI
N052.26.46.837 E020.38.04.754 N052.26.46.244 E020.38.05.254 Color_251ACI
N052.26.46.244 E020.38.05.254 N052.26.49.968 E020.38.50.036 Color_251ACI
N052.26.49.968 E020.38.50.036 N052.26.49.991 E020.38.51.104 Color_251ACI
N052.26.49.991 E020.38.51.104 N052.26.49.900 E020.38.51.536 Color_251ACI
N052.26.49.900 E020.38.51.536 N052.26.48.316 E020.38.55.352 Color_251ACI
N052.26.48.316 E020.38.55.352 N052.26.51.620 E020.39.33.176 Color_251ACI
N052.26.51.620 E020.39.33.176 N052.26.53.701 E020.39.36.032 Color_251ACI
N052.26.53.701 E020.39.36.032 N052.26.54.211 E020.39.38.739 Color_251ACI
N052.26.54.211 E020.39.38.739 N052.26.54.610 E020.39.42.936 Color_251ACI
N052.26.54.610 E020.39.42.936 N052.26.55.932 E020.39.58.514 Color_251ACI
N052.26.55.932 E020.39.58.514 N052.26.55.721 E020.39.59.207 Color_251ACI
N052.26.55.721 E020.39.59.207 N052.26.54.736 E020.39.59.457 Color_251ACI
N052.26.54.736 E020.39.59.457 N052.26.55.189 E020.40.04.902 Color_251ACI
N052.26.55.189 E020.40.04.902 N052.26.56.474 E020.40.04.663 Color_251ACI
N052.26.56.474 E020.40.04.663 N052.26.56.695 E020.40.07.970 Color_251ACI
N052.26.56.695 E020.40.07.970 N052.26.56.622 E020.40.08.441 Color_251ACI
N052.26.56.622 E020.40.08.441 N052.26.56.451 E020.40.08.793 Color_251ACI
N052.26.56.451 E020.40.08.793 N052.26.56.245 E020.40.08.956 Color_251ACI
N052.26.56.245 E020.40.08.956 N052.26.54.891 E020.40.09.340 Color_251ACI
N052.26.54.891 E020.40.09.340 N052.26.54.606 E020.40.09.305 Color_251ACI
N052.26.54.606 E020.40.09.305 N052.26.54.396 E020.40.09.096 Color_251ACI
N052.26.54.396 E020.40.09.096 N052.26.54.242 E020.40.08.740 Color_251ACI
N052.26.54.242 E020.40.08.740 N052.26.53.514 E020.40.09.235 Color_251ACI
N052.26.53.514 E020.40.09.235 N052.26.54.101 E020.40.11.370 Color_251ACI
N052.26.54.101 E020.40.11.370 N052.26.54.803 E020.40.10.846 Color_251ACI
N052.26.54.803 E020.40.10.846 N052.26.54.772 E020.40.10.488 Color_251ACI
N052.26.54.772 E020.40.10.488 N052.26.54.865 E020.40.10.178 Color_251ACI
N052.26.54.865 E020.40.10.178 N052.26.55.036 E020.40.09.864 Color_251ACI
N052.26.55.036 E020.40.09.864 N052.26.55.215 E020.40.09.802 Color_251ACI
N052.26.55.215 E020.40.09.802 N052.26.56.445 E020.40.09.496 Color_251ACI
N052.26.56.445 E020.40.09.496 N052.26.56.645 E020.40.09.535 Color_251ACI
N052.26.56.645 E020.40.09.535 N052.26.56.813 E020.40.09.755 Color_251ACI
N052.26.56.813 E020.40.09.755 N052.26.56.927 E020.40.09.995 Color_251ACI
N052.26.56.927 E020.40.09.995 N052.26.57.427 E020.40.16.595 Color_251ACI
N052.26.57.427 E020.40.16.595 N052.26.57.491 E020.40.17.522 Color_251ACI
N052.26.57.491 E020.40.17.522 N052.26.57.443 E020.40.17.939 Color_251ACI
N052.26.57.443 E020.40.17.939 N052.26.57.343 E020.40.18.336 Color_251ACI
N052.26.57.343 E020.40.18.336 N052.26.57.154 E020.40.18.681 Color_251ACI
N052.26.57.154 E020.40.18.681 N052.26.56.926 E020.40.18.984 Color_251ACI
N052.26.56.926 E020.40.18.984 N052.26.56.690 E020.40.19.177 Color_251ACI
N052.26.56.690 E020.40.19.177 N052.26.56.419 E020.40.19.236 Color_251ACI
N052.26.56.419 E020.40.19.236 N052.26.56.168 E020.40.19.141 Color_251ACI
N052.26.56.168 E020.40.19.141 N052.26.55.948 E020.40.18.955 Color_251ACI
N052.26.55.948 E020.40.18.955 N052.26.55.822 E020.40.18.793 Color_251ACI
N052.26.55.822 E020.40.18.793 N052.26.55.519 E020.40.17.722 Color_251ACI
N052.26.55.519 E020.40.17.722 N052.26.53.218 E020.40.19.559 Color_251ACI
N052.26.53.218 E020.40.19.559 N052.26.54.641 E020.40.24.335 Color_251ACI
N052.26.54.641 E020.40.24.335 N052.26.56.459 E020.40.22.985 Color_251ACI
N052.26.56.459 E020.40.22.985 N052.26.57.817 E020.40.27.742 Color_251ACI
N052.26.57.817 E020.40.27.742 N052.26.55.964 E020.40.29.281 Color_251ACI
N052.26.55.964 E020.40.29.281 N052.26.57.372 E020.40.34.165 Color_251ACI
N052.26.57.372 E020.40.34.165 N052.26.59.653 E020.40.32.406 Color_251ACI
N052.26.59.653 E020.40.32.406 N052.26.56.758 E020.40.21.981 Color_251ACI
N052.26.56.758 E020.40.21.981 N052.26.56.609 E020.40.21.468 Color_251ACI
N052.26.56.609 E020.40.21.468 N052.26.56.608 E020.40.20.816 Color_251ACI
N052.26.56.608 E020.40.20.816 N052.26.56.713 E020.40.20.272 Color_251ACI
N052.26.56.713 E020.40.20.272 N052.26.56.903 E020.40.19.957 Color_251ACI
N052.26.56.903 E020.40.19.957 N052.26.58.871 E020.40.18.108 Color_251ACI
N052.26.58.871 E020.40.18.108 N052.26.59.096 E020.40.18.007 Color_251ACI
N052.26.59.096 E020.40.18.007 N052.26.59.315 E020.40.18.080 Color_251ACI
N052.26.59.315 E020.40.18.080 N052.26.59.556 E020.40.18.306 Color_251ACI
N052.26.59.556 E020.40.18.306 N052.26.59.733 E020.40.18.599 Color_251ACI
N052.26.59.733 E020.40.18.599 N052.26.59.830 E020.40.18.957 Color_251ACI
N052.26.59.830 E020.40.18.957 N052.26.59.864 E020.40.19.362 Color_251ACI
N052.26.59.864 E020.40.19.362 N052.26.59.905 E020.40.19.893 Color_251ACI
N052.26.59.905 E020.40.19.893 N052.27.04.428 E020.40.18.813 Color_251ACI
N052.27.04.428 E020.40.18.813 N052.27.04.417 E020.40.17.718 Color_251ACI
N052.27.04.417 E020.40.17.718 N052.27.07.693 E020.40.15.792 Color_251ACI
N052.26.56.478 E020.38.05.639 N052.26.56.296 E020.38.04.911 Color_251ACI
N052.26.56.296 E020.38.04.911 N052.26.55.868 E020.38.04.266 Color_251ACI
N052.26.55.868 E020.38.04.266 N052.26.55.419 E020.38.03.907 Color_251ACI
N052.26.55.419 E020.38.03.907 N052.26.54.919 E020.38.03.660 Color_251ACI
N052.26.54.919 E020.38.03.660 N052.26.47.990 E020.38.05.382 Color_251ACI
N052.26.47.990 E020.38.05.382 N052.26.47.745 E020.38.05.776 Color_251ACI
N052.26.47.745 E020.38.05.776 N052.26.47.344 E020.38.06.346 Color_251ACI
N052.26.47.344 E020.38.06.346 N052.26.46.953 E020.38.07.686 Color_251ACI
N052.26.46.953 E020.38.07.686 N052.26.49.268 E020.38.35.708 Color_251ACI
N052.26.49.268 E020.38.35.708 N052.26.49.840 E020.38.37.320 Color_251ACI
N052.26.49.840 E020.38.37.320 N052.26.50.549 E020.38.38.082 Color_251ACI
N052.26.50.549 E020.38.38.082 N052.26.57.897 E020.38.38.711 Color_251ACI
N052.26.57.897 E020.38.38.711 N052.26.58.572 E020.38.37.792 Color_251ACI
N052.26.58.572 E020.38.37.792 N052.26.59.136 E020.38.36.490 Color_251ACI
N052.26.59.622 E020.38.42.127 N052.26.59.412 E020.38.41.445 Color_251ACI
N052.26.59.412 E020.38.41.445 N052.26.59.208 E020.38.40.960 Color_251ACI
N052.26.59.208 E020.38.40.960 N052.26.58.979 E020.38.40.453 Color_251ACI
N052.26.58.979 E020.38.40.453 N052.26.58.621 E020.38.40.008 Color_251ACI
N052.26.58.621 E020.38.40.008 N052.26.58.223 E020.38.39.662 Color_251ACI
N052.26.58.223 E020.38.39.662 N052.26.50.751 E020.38.38.997 Color_251ACI
N052.26.50.751 E020.38.38.997 N052.26.49.894 E020.38.39.685 Color_251ACI
N052.26.49.894 E020.38.39.685 N052.26.49.748 E020.38.39.938 Color_251ACI
N052.26.49.748 E020.38.39.938 N052.26.49.689 E020.38.40.244 Color_251ACI
N052.26.49.689 E020.38.40.244 N052.26.55.091 E020.39.42.159 Color_251ACI
N052.26.55.091 E020.39.42.159 N052.26.55.260 E020.39.42.660 Color_251ACI
N052.26.55.260 E020.39.42.660 N052.26.55.521 E020.39.43.005 Color_251ACI
N052.26.55.521 E020.39.43.005 N052.26.55.899 E020.39.43.293 Color_251ACI
N052.26.55.899 E020.39.43.293 N052.26.56.301 E020.39.43.275 Color_251ACI
N052.26.56.301 E020.39.43.275 N052.27.03.342 E020.39.39.095 Color_251ACI
N052.27.03.342 E020.39.39.095 N052.27.04.109 E020.39.37.971 Color_251ACI
N052.27.04.109 E020.39.37.971 N052.27.04.316 E020.39.36.603 Color_251ACI
N052.27.04.771 E020.39.41.883 N052.27.04.280 E020.39.40.882 Color_251ACI
N052.27.04.280 E020.39.40.882 N052.27.03.019 E020.39.40.262 Color_251ACI
N052.27.03.019 E020.39.40.262 N052.26.56.326 E020.39.44.277 Color_251ACI
N052.26.56.326 E020.39.44.277 N052.26.55.985 E020.39.44.873 Color_251ACI
N052.26.55.985 E020.39.44.873 N052.26.55.629 E020.39.45.748 Color_251ACI
N052.26.55.629 E020.39.45.748 N052.26.55.517 E020.39.46.716 Color_251ACI
N052.26.55.517 E020.39.46.716 N052.26.55.635 E020.39.48.432 Color_251ACI
N052.26.55.635 E020.39.48.432 N052.26.57.859 E020.40.15.005 Color_251ACI
N052.26.57.859 E020.40.15.005 N052.26.58.456 E020.40.16.237 Color_251ACI
N052.26.58.456 E020.40.16.237 N052.26.59.248 E020.40.16.969 Color_251ACI
N052.26.59.248 E020.40.16.969 N052.27.05.504 E020.40.15.337 Color_251ACI
N052.27.05.504 E020.40.15.337 N052.27.06.926 E020.40.14.479 Color_251ACI
N052.27.06.926 E020.40.14.479 N052.27.07.439 E020.40.12.844 Color_251ACI
N052.26.53.100 E020.40.19.734 N052.26.51.824 E020.40.20.784 Color_16ACI
N052.26.51.824 E020.40.20.784 N052.26.53.198 E020.40.25.519 Color_16ACI
N052.26.53.198 E020.40.25.519 N052.26.54.488 E020.40.24.449 Color_16ACI
N052.26.54.488 E020.40.24.449 N052.26.53.100 E020.40.19.734 Color_16ACI
N052.26.55.811 E020.40.29.434 N052.26.54.568 E020.40.30.475 Color_16ACI
N052.26.54.568 E020.40.30.475 N052.26.55.968 E020.40.35.255 Color_16ACI
N052.26.55.968 E020.40.35.255 N052.26.57.231 E020.40.34.204 Color_16ACI
N052.26.57.231 E020.40.34.204 N052.26.55.811 E020.40.29.434 Color_16ACI
N052.26.53.406 E020.40.09.344 N052.26.52.785 E020.40.09.801 Color_16ACI
N052.26.52.785 E020.40.09.801 N052.26.53.310 E020.40.11.882 Color_16ACI
N052.26.53.310 E020.40.11.882 N052.26.53.946 E020.40.11.425 Color_16ACI
N052.26.53.946 E020.40.11.425 N052.26.53.406 E020.40.09.344 Color_16ACI
N052.26.53.973 E020.40.07.960 N052.26.54.125 E020.40.08.515 Color_16ACI
N052.26.54.125 E020.40.08.515 N052.26.54.423 E020.40.08.270 Color_16ACI
N052.26.54.423 E020.40.08.270 N052.26.54.676 E020.40.09.108 Color_16ACI
N052.26.54.676 E020.40.09.108 N052.26.55.257 E020.40.08.593 Color_16ACI
N052.26.55.257 E020.40.08.593 N052.26.54.845 E020.40.07.240 Color_16ACI
N052.26.54.845 E020.40.07.240 N052.26.53.973 E020.40.07.960 Color_16ACI
;- TWY
N052.26.46.650 E020.38.07.110 N052.26.57.700 E020.40.16.260 olive
N052.26.46.650 E020.38.07.110 N052.26.46.800 E020.38.06.000 olive
N052.26.46.800 E020.38.06.000 N052.26.46.950 E020.38.05.500 olive
N052.26.46.950 E020.38.05.500 N052.26.47.500 E020.38.05.100 olive
N052.26.47.500 E020.38.05.100 N052.26.56.250 E020.38.02.900 olive
N052.26.49.200 E020.38.37.000 N052.26.49.500 E020.38.38.000 olive
N052.26.49.500 E020.38.38.000 N052.26.49.800 E020.38.38.400 olive
N052.26.49.800 E020.38.38.400 N052.26.50.000 E020.38.38.500 olive
N052.26.50.000 E020.38.38.500 N052.26.59.350 E020.38.39.350 olive
N052.26.50.000 E020.38.38.500 N052.26.49.800 E020.38.38.600 olive
N052.26.49.800 E020.38.38.600 N052.26.49.600 E020.38.38.900 olive
N052.26.49.600 E020.38.38.900 N052.26.49.420 E020.38.39.500 olive
N052.26.54.860 E020.39.43.000 N052.26.55.100 E020.39.43.300 olive
N052.26.55.100 E020.39.43.300 N052.26.55.300 E020.39.43.500 olive
N052.26.55.300 E020.39.43.500 N052.26.55.800 E020.39.43.750 olive
N052.26.55.800 E020.39.43.750 N052.26.56.000 E020.39.43.830 olive
N052.26.56.000 E020.39.43.830 N052.26.56.100 E020.39.43.810 olive
N052.26.56.100 E020.39.43.810 N052.27.04.530 E020.39.39.000 olive
N052.26.56.100 E020.39.43.810 N052.26.55.800 E020.39.44.200 olive
N052.26.55.800 E020.39.44.200 N052.26.55.500 E020.39.44.800 olive
N052.26.55.500 E020.39.44.800 N052.26.55.120 E020.39.46.100 olive
N052.26.57.700 E020.40.16.260 N052.26.57.900 E020.40.16.800 olive
N052.26.57.900 E020.40.16.800 N052.26.58.100 E020.40.17.100 olive
N052.26.58.100 E020.40.17.100 N052.26.58.300 E020.40.17.300 olive
N052.26.58.300 E020.40.17.300 N052.26.58.500 E020.40.17.440 olive
N052.26.58.500 E020.40.17.440 N052.26.59.000 E020.40.17.500 olive
N052.26.59.000 E020.40.17.500 N052.27.07.650 E020.40.15.180 olive
N052.26.49.000 E020.38.53.780 N052.26.50.800 E020.38.55.400 olive
N052.26.49.270 E020.38.56.660 N052.26.51.070 E020.38.58.280 olive
N052.26.49.540 E020.38.59.640 N052.26.51.340 E020.39.01.160 olive
N052.26.49.810 E020.39.02.410 N052.26.51.610 E020.39.04.040 olive
N052.26.50.080 E020.39.05.290 N052.26.51.830 E020.39.06.920 olive
N052.26.50.350 E020.39.08.170 N052.26.52.070 E020.39.09.800 olive
N052.26.50.620 E020.39.11.050 N052.26.52.330 E020.39.12.680 olive
N052.26.50.890 E020.39.13.820 N052.26.52.550 E020.39.15.560 olive
N052.26.51.160 E020.39.16.800 N052.26.52.800 E020.39.18.440 olive
N052.26.51.420 E020.39.19.670 N052.26.53.050 E020.39.21.320 olive
N052.26.52.560 E020.39.25.980 N052.26.52.000 E020.39.25.500 olive
N052.26.52.000 E020.39.25.500 N052.26.51.800 E020.39.25.000 olive
N052.26.51.800 E020.39.25.000 N052.26.51.700 E020.39.24.500 olive
N052.26.51.700 E020.39.24.500 N052.26.51.800 E020.39.24.150 olive
N052.26.51.800 E020.39.24.150 N052.26.53.100 E020.39.22.000 olive
N052.26.52.950 E020.39.30.160 N052.26.52.430 E020.39.29.680 olive
N052.26.52.430 E020.39.29.680 N052.26.52.230 E020.39.29.180 olive
N052.26.52.230 E020.39.29.180 N052.26.52.130 E020.39.28.680 olive
N052.26.52.130 E020.39.28.680 N052.26.52.230 E020.39.28.330 olive
N052.26.52.230 E020.39.28.330 N052.26.53.430 E020.39.26.150 olive

;EPSY
LOTNISKA_EPSY N053.31.36.661 E020.56.15.716 N053.31.36.693 E020.56.15.716 runway
N053.31.36.693 E020.56.15.716 N053.31.36.693 E020.56.15.662 runway
N053.31.36.693 E020.56.15.662 N053.31.36.661 E020.56.15.662 runway
N053.31.36.661 E020.56.15.662 N053.31.36.661 E020.56.15.716 runway
;Runway 01/19
N053.28.15.992 E020.55.55.686 N053.29.32.710 E020.56.39.027 runway
N053.29.32.710 E020.56.39.027 N053.29.33.339 E020.56.35.881 runway
N053.29.33.339 E020.56.35.881 N053.28.16.621 E020.55.52.541 runway
N053.28.16.621 E020.55.52.541 N053.28.15.992 E020.55.55.686 runway
;Apron
N053.29.16.947 E020.56.30.078 N053.29.16.449 E020.56.32.247 olive
N053.29.16.449 E020.56.32.247 N053.29.15.368 E020.56.36.954 olive
N053.29.17.823 E020.56.40.287 N053.29.17.038 E020.56.43.828 olive
N053.29.16.727 E020.56.38.367 N053.29.15.682 E020.56.42.964 olive
N053.29.18.125 E020.56.38.863 N053.29.17.823 E020.56.40.287 olive
N053.29.15.368 E020.56.36.954 N053.29.16.809 E020.56.37.991 olive
N053.29.16.809 E020.56.37.991 N053.29.18.125 E020.56.38.863 olive
N053.29.16.809 E020.56.37.991 N053.29.16.727 E020.56.38.367 olive
N053.29.15.368 E020.56.36.954 N053.29.14.162 E020.56.42.120 olive
N053.28.17.348 E020.55.57.925 N053.28.18.581 E020.55.57.149 apron
N053.28.16.168 E020.55.57.257 N053.28.17.348 E020.55.57.925 apron
N053.28.16.191 e020.55.55.798 N053.28.16.003 E020.55.56.691 apron
N053.28.16.003 E020.55.56.691 N053.28.16.168 E020.55.57.257 apron
N053.29.16.155 E020.56.36.396 N053.29.17.023 E020.56.32.619 apron
N053.29.18.904 E020.56.38.268 N053.29.17.043 E020.56.37.035 apron
N053.29.17.023 E020.56.32.619 N053.29.17.521 E020.56.30.450 apron
N053.29.18.402 E020.56.40.634 N053.29.18.904 E020.56.38.268 apron
N053.29.17.043 E020.56.37.035 N053.29.16.155 E020.56.36.396 apron
N053.29.30.980 E020.56.37.984 N053.29.30.673 E020.56.37.847 apron
N053.29.30.673 E020.56.37.847 N053.29.30.548 E020.56.37.794 apron
N053.29.30.548 E020.56.37.794 N053.29.30.511 E020.56.37.783 apron
N053.29.30.511 E020.56.37.783 N053.29.30.498 E020.56.37.780 apron
N053.29.30.498 E020.56.37.780 N053.29.30.497 E020.56.37.784 apron
N053.29.14.411 E020.56.29.130 N053.29.14.543 E020.56.29.334 apron
N053.28.16.482 E020.55.46.919 N053.28.16.990 E020.55.47.323 apron
N053.28.16.990 E020.55.47.323 N053.28.17.310 E020.55.48.840 apron
N053.28.17.310 E020.55.48.840 N053.28.16.564 E020.55.52.679 apron
N053.28.16.564 E020.55.52.679 N053.28.16.591 E020.55.52.692 apron
N053.28.16.862 E020.55.52.699 N053.28.17.544 E020.55.49.318 apron
N053.28.18.562 E020.55.39.822 N053.28.17.985 E020.55.39.545 apron
N053.28.17.985 E020.55.39.545 N053.28.16.482 E020.55.46.919 apron
N053.29.18.902 E020.56.21.780 N053.29.19.957 E020.56.22.359 apron
N053.29.19.957 E020.56.22.359 N053.29.21.143 E020.56.16.614 apron
N053.28.28.390 E020.55.41.074 N053.28.27.925 E020.55.39.458 apron
N053.28.27.925 E020.55.39.458 N053.28.27.486 E020.55.38.678 apron
N053.28.27.486 E020.55.38.678 N053.28.22.119 E020.55.36.191 apron
N053.28.22.119 E020.55.36.191 N053.28.20.801 E020.55.37.318 apron
N053.28.20.801 E020.55.37.318 N053.28.20.410 E020.55.37.356 apron
N053.28.20.410 E020.55.37.356 N053.28.19.707 E020.55.37.028 apron
N053.28.19.707 E020.55.37.028 N053.28.19.534 E020.55.37.337 apron
N053.28.19.534 E020.55.37.337 N053.28.19.338 E020.55.38.652 apron
N053.28.19.338 E020.55.38.652 N053.28.19.223 E020.55.39.173 apron
N053.28.19.223 E020.55.39.173 N053.28.18.935 E020.55.39.907 apron
N053.28.17.544 E020.55.49.318 N053.28.17.689 E020.55.48.953 apron
N053.28.17.689 E020.55.48.953 N053.28.17.781 E020.55.48.572 apron
N053.28.17.781 E020.55.48.572 N053.28.18.008 E020.55.47.490 apron
N053.28.18.008 E020.55.47.490 N053.28.18.144 E020.55.46.911 apron
N053.28.18.144 E020.55.46.911 N053.28.18.217 E020.55.46.394 apron
N053.28.18.217 E020.55.46.394 N053.28.19.007 E020.55.42.646 apron
N053.28.19.007 E020.55.42.646 N053.28.19.941 E020.55.38.175 apron
N053.28.19.941 E020.55.38.175 N053.28.23.048 E020.55.39.770 apron
N053.28.18.936 E020.55.39.906 N053.28.18.562 e020.55.39.822 apron
N053.28.23.296 E020.55.39.101 N053.28.21.339 E020.55.38.024 apron
N053.28.21.339 E020.55.38.024 N053.28.21.206 E020.55.37.751 apron
N053.28.21.206 E020.55.37.751 N053.28.21.227 E020.55.37.529 apron
N053.28.21.227 E020.55.37.529 N053.28.21.319 E020.55.37.374 apron
N053.28.21.319 E020.55.37.374 N053.28.21.482 E020.55.37.255 apron
N053.28.21.482 E020.55.37.255 N053.28.21.604 E020.55.37.203 apron
N053.28.21.604 E020.55.37.203 N053.28.21.736 E020.55.37.170 apron
N053.28.21.736 E020.55.37.170 N053.28.21.991 E020.55.37.152 apron
N053.28.21.991 E020.55.37.152 N053.28.27.402 E020.55.40.060 apron
N053.28.27.402 E020.55.40.060 N053.28.27.702 E020.55.40.272 apron
N053.28.27.702 E020.55.40.272 N053.28.27.762 E020.55.40.419 apron
N053.28.27.762 E020.55.40.419 N053.28.27.877 E020.55.40.680 apron
N053.28.27.877 E020.55.40.680 N053.28.27.966 E020.55.40.908 apron
N053.28.27.966 E020.55.40.908 N053.28.28.014 E020.55.41.022 apron
N053.28.28.390 E020.55.41.074 N053.28.28.518 E020.55.41.584 apron
N053.28.28.518 E020.55.41.584 N053.28.28.704 E020.55.41.924 apron
N053.28.28.704 E020.55.41.924 N053.28.28.954 E020.55.42.207 apron
N053.28.28.954 E020.55.42.207 N053.28.29.292 E020.55.42.424 apron
N053.28.29.292 E020.55.42.424 N053.28.29.692 E020.55.42.609 apron
N053.28.29.692 E020.55.42.609 N053.28.59.585 E020.55.59.507 apron
N053.28.59.585 E020.55.59.507 N053.28.59.834 E020.55.59.600 apron
N053.28.59.834 E020.55.59.600 N053.28.59.999 E020.55.59.531 apron
N053.28.59.999 E020.55.59.531 N053.29.00.103 E020.55.59.415 apron
N053.29.00.103 E020.55.59.415 N053.29.00.192 E020.55.59.253 apron
N053.29.00.324 E020.55.59.473 N053.29.00.344 E020.55.59.658 apron
N053.29.00.344 E020.55.59.658 N053.29.00.428 E020.55.59.821 apron
N053.29.00.428 E020.55.59.821 N053.29.00.496 E020.55.59.948 apron
N053.29.00.496 E020.55.59.948 N053.29.00.606 E020.56.00.040 apron
N053.29.00.606 E020.56.00.040 N053.29.00.807 E020.56.00.133 apron
N053.29.00.807 E020.56.00.133 N053.29.01.163 E020.56.00.326 apron
N053.29.01.163 E020.56.00.326 N053.29.01.344 E020.56.00.337 apron
N053.29.01.344 E020.56.00.337 N053.29.01.519 E020.56.00.214 apron
N053.29.01.519 E020.56.00.214 N053.29.01.679 E020.55.59.956 apron
N053.29.01.679 E020.55.59.956 N053.29.01.787 E020.55.59.629 apron
N053.29.01.787 E020.55.59.629 N053.29.01.834 E020.55.59.314 apron
N053.29.01.834 E020.55.59.314 N053.29.01.921 E020.55.58.965 apron
N053.29.02.082 E020.55.58.480 N053.29.02.290 E020.55.58.604 apron
N053.29.02.290 E020.55.58.604 N053.29.04.528 E020.55.59.861 apron
N053.29.04.528 E020.55.59.861 N053.29.04.766 E020.56.00.309 apron
N053.29.04.766 E020.56.00.309 N053.29.04.909 E020.56.00.514 apron
N053.29.04.909 E020.56.00.514 N053.29.19.065 E020.56.08.239 apron
N053.29.19.065 E020.56.08.239 N053.29.18.720 E020.56.10.143 apron
N053.29.18.720 E020.56.10.143 N053.29.20.716 E020.56.11.329 apron
N053.29.20.716 E020.56.11.329 N053.29.20.785 E020.56.11.516 apron
N053.29.20.785 E020.56.11.516 N053.29.20.836 E020.56.11.788 apron
N053.29.20.836 E020.56.11.788 N053.29.20.871 E020.56.12.031 apron
N053.29.20.871 E020.56.12.031 N053.29.20.844 E020.56.12.246 apron
N053.29.20.844 E020.56.12.246 N053.29.20.802 E020.56.12.518 apron
N053.29.20.802 E020.56.12.518 N053.29.20.588 E020.56.13.650 apron
N053.29.20.588 E020.56.13.650 N053.29.20.657 E020.56.14.022 apron
N053.29.20.657 E020.56.14.022 N053.29.20.760 E020.56.14.281 apron
N053.29.20.760 E020.56.14.281 N053.29.20.871 E020.56.14.466 apron
N053.29.20.871 E020.56.14.466 N053.29.21.024 E020.56.14.681 apron
N053.29.21.024 E020.56.14.681 N053.29.21.177 E020.56.14.839 apron
N053.29.21.177 E020.56.14.839 N053.29.21.374 E020.56.15.039 apron
N053.29.21.374 E020.56.15.039 N053.29.21.450 E020.56.15.126 apron
N053.29.21.450 E020.56.15.126 N053.29.21.143 E020.56.16.614 apron
N053.29.18.902 E020.56.21.780 N053.29.17.889 E020.56.26.764 apron
N053.29.17.889 E020.56.26.764 N053.29.17.819 E020.56.27.114 apron
N053.29.16.902 E020.56.26.596 N053.29.17.182 E020.56.26.529 apron
N053.29.17.182 E020.56.26.529 N053.29.17.316 E020.56.26.468 apron
N053.29.17.316 E020.56.26.468 N053.29.17.432 E020.56.26.294 apron
N053.29.17.432 E020.56.26.294 N053.29.17.524 E020.56.26.079 apron
N053.29.17.524 E020.56.26.079 N053.29.17.627 E020.56.25.771 apron
N053.29.17.627 E020.56.25.771 N053.29.17.737 E020.56.25.330 apron
N053.29.17.737 E020.56.25.330 N053.29.20.216 E020.56.13.165 apron
N053.29.20.216 E020.56.13.165 N053.29.20.210 E020.56.12.842 apron
N053.29.20.210 E020.56.12.842 N053.29.20.178 E020.56.12.441 apron
N053.29.20.178 E020.56.12.441 N053.29.20.120 E020.56.12.160 apron
N053.29.20.120 E020.56.12.160 N053.29.20.049 E020.56.11.910 apron
N053.29.20.049 E020.56.11.910 N053.29.19.927 E020.56.11.738 apron
N053.29.19.927 E020.56.11.738 N053.29.19.823 E020.56.11.553 apron
N053.29.19.823 E020.56.11.553 N053.29.19.701 E020.56.11.381 apron
N053.29.19.701 E020.56.11.381 N053.29.13.789 E020.56.08.149 apron
N053.29.13.789 E020.56.08.149 N053.29.13.521 E020.56.08.193 apron
N053.29.13.521 E020.56.08.193 N053.29.13.203 E020.56.08.352 apron
N053.29.13.203 E020.56.08.352 N053.29.13.047 E020.56.08.584 apron
N053.29.13.047 E020.56.08.584 N053.29.12.943 E020.56.08.801 apron
N053.29.12.943 E020.56.08.801 N053.29.11.754 E020.56.14.356 apron
N053.29.11.754 E020.56.14.356 N053.29.10.265 E020.56.21.503 apron
N053.29.10.265 E020.56.21.503 N053.29.10.265 E020.56.21.835 apron
N053.29.10.265 E020.56.21.835 N053.29.10.298 E020.56.22.076 apron
N053.29.10.298 E020.56.22.076 N053.29.10.347 E020.56.22.305 apron
N053.29.10.347 E020.56.22.305 N053.29.10.395 E020.56.22.488 apron
N053.29.10.395 E020.56.22.488 N053.29.10.449 E020.56.22.707 apron
N053.29.10.449 E020.56.22.707 N053.29.10.558 E020.56.22.866 apron
N053.29.10.558 E020.56.22.866 N053.29.10.640 E020.56.23.059 apron
N053.29.09.345 E020.56.22.328 N053.29.09.554 E020.56.22.168 apron
N053.29.09.554 E020.56.22.168 N053.29.09.684 E020.56.22.054 apron
N053.29.09.684 E020.56.22.054 N053.29.09.779 E020.56.21.846 apron
N053.29.09.779 E020.56.21.846 N053.29.09.895 E020.56.21.560 apron
N053.29.09.895 E020.56.21.560 N053.29.09.944 E020.56.21.354 apron
N053.29.09.944 E020.56.21.354 N053.29.10.018 E020.56.21.125 apron
N053.29.10.018 E020.56.21.125 N053.29.12.434 E020.56.09.021 apron
N053.29.12.434 E020.56.09.021 N053.29.12.471 E020.56.08.688 apron
N053.29.12.471 E020.56.08.688 N053.29.12.478 E020.56.08.416 apron
N053.29.12.478 E020.56.08.416 N053.29.12.464 E020.56.08.181 apron
N053.29.12.464 E020.56.08.181 N053.29.12.434 E020.56.07.935 apron
N053.29.12.434 E020.56.07.935 N053.29.12.360 E020.56.07.724 apron
N053.29.12.360 E020.56.07.724 N053.29.12.308 E020.56.07.600 apron
N053.29.12.308 E020.56.07.600 N053.29.12.257 E020.56.07.476 apron
N053.29.12.257 E020.56.07.476 N053.29.12.198 E020.56.07.354 apron
N053.29.12.198 E020.56.07.354 N053.29.12.102 E020.56.07.193 apron
N053.29.12.102 E020.56.07.193 N053.29.11.963 E020.56.07.069 apron
N053.29.11.963 E020.56.07.069 N053.29.00.264 E020.56.00.563 apron
N053.29.00.264 E020.56.00.563 N053.29.00.180 E020.56.00.675 apron
N053.29.00.180 E020.56.00.675 N053.29.00.124 E020.56.00.815 apron
N053.29.00.124 E020.56.00.815 N053.29.00.076 E020.56.01.017 apron
N053.29.00.076 E020.56.01.017 N053.29.00.009 E020.56.01.269 apron
N053.29.00.009 E020.56.01.269 N053.28.57.251 E020.56.15.498 apron
N053.28.57.149 E020.56.15.441 N053.28.57.198 E020.56.15.196 apron
N053.28.57.198 E020.56.15.196 N053.28.57.322 E020.56.14.553 apron
N053.28.57.322 E020.56.14.553 N053.28.57.408 E020.56.14.117 apron
N053.28.57.408 E020.56.14.117 N053.28.59.901 E020.56.00.989 apron
N053.28.59.901 E020.56.00.989 N053.28.59.951 E020.56.00.780 apron
N053.28.59.951 E020.56.00.780 N053.28.59.971 E020.56.00.606 apron
N053.28.59.971 E020.56.00.606 N053.28.59.947 E020.56.00.461 apron
N053.28.59.947 E020.56.00.461 N053.28.59.888 E020.56.00.362 apron
N053.28.59.888 E020.56.00.362 N053.28.59.790 E020.56.00.289 apron
N053.28.59.790 E020.56.00.289 N053.28.28.959 E020.55.43.020 apron
N053.28.28.959 E020.55.43.020 N053.28.28.650 E020.55.43.044 apron
N053.28.28.650 E020.55.43.044 N053.28.28.471 E020.55.43.102 apron
N053.28.28.471 E020.55.43.102 N053.28.28.313 E020.55.43.227 apron
N053.28.28.313 E020.55.43.227 N053.28.28.246 E020.55.43.366 apron
N053.28.28.246 E020.55.43.366 N053.28.25.474 E020.55.56.684 apron
N053.28.25.474 E020.55.56.684 N053.28.25.483 E020.55.57.098 apron
N053.28.25.483 E020.55.57.098 N053.28.25.527 E020.55.57.409 apron
N053.28.25.527 E020.55.57.409 N053.28.25.578 E020.55.57.618 apron
N053.28.24.699 E020.55.57.122 N053.28.24.858 E020.55.56.966 apron
N053.28.24.858 E020.55.56.966 N053.28.24.999 E020.55.56.789 apron
N053.28.24.999 E020.55.56.789 N053.28.25.104 E020.55.56.596 apron
N053.28.25.104 E020.55.56.596 N053.28.25.210 E020.55.56.242 apron
N053.28.25.210 E020.55.56.242 N053.28.27.637 E020.55.43.934 apron
N053.28.27.637 E020.55.43.934 N053.28.27.642 E020.55.43.596 apron
N053.28.27.642 E020.55.43.596 N053.28.27.642 E020.55.43.269 apron
N053.28.27.642 E020.55.43.269 N053.28.27.595 E020.55.42.846 apron
N053.28.27.595 E020.55.42.846 N053.28.27.533 E020.55.42.612 apron
N053.28.27.533 E020.55.42.612 N053.28.27.431 E020.55.42.379 apron
N053.28.27.431 E020.55.42.379 N053.28.27.313 E020.55.42.250 apron
N053.28.27.313 E020.55.42.250 N053.28.27.163 E020.55.42.068 apron
N053.28.27.163 E020.55.42.068 N053.28.27.045 E020.55.41.957 apron
N053.28.27.045 E020.55.41.957 N053.28.23.048 E020.55.39.770 apron
N053.28.23.296 E020.55.39.101 N053.28.27.786 E020.55.41.582 apron
N053.28.27.786 E020.55.41.582 N053.28.27.875 E020.55.41.631 apron
N053.28.27.875 E020.55.41.631 N053.28.27.973 E020.55.41.648 apron
N053.28.27.973 E020.55.41.648 N053.28.28.032 E020.55.41.582 apron
N053.28.28.032 E020.55.41.582 N053.28.28.072 E020.55.41.491 apron
N053.28.28.072 E020.55.41.491 N053.28.28.086 E020.55.41.351 apron
N053.28.28.086 E020.55.41.351 N053.28.28.072 E020.55.41.235 apron
N053.28.28.072 E020.55.41.235 N053.28.28.042 E020.55.41.087 apron
N053.28.28.042 E020.55.41.087 N053.28.28.014 E020.55.41.022	apron
N053.29.18.921 E020.56.31.252 N053.29.18.597 E020.56.31.166 apron
N053.29.18.597 E020.56.31.166 N053.29.18.290 E020.56.31.127 apron
N053.29.18.290 E020.56.31.127 N053.29.18.082 E020.56.31.153 apron
N053.29.18.082 E020.56.31.153 N053.29.17.871 E020.56.31.227 apron
N053.29.17.871 E020.56.31.227 N053.29.17.667 E020.56.31.388 apron
N053.29.17.667 E020.56.31.388 N053.29.17.490 E020.56.31.579 apron
N053.29.17.490 E020.56.31.579 N053.29.17.367 E020.56.31.695 apron
N053.29.17.367 E020.56.31.695 N053.29.17.263 E020.56.31.853 apron
N053.29.17.263 E020.56.31.853 N053.29.17.163 E020.56.32.011 apron
N053.29.13.640 E020.56.28.266 N053.29.14.319 E020.56.28.990 apron
N053.29.14.319 E020.56.28.990 N053.29.14.411 E020.56.29.131 apron
N053.29.14.543 E020.56.29.334 N053.29.14.822 E020.56.29.973 apron
N053.29.14.822 E020.56.29.973 N053.29.15.019 E020.56.30.430 apron
N053.29.15.019 E020.56.30.430 N053.29.15.234 E020.56.30.994 apron
N053.29.15.234 E020.56.30.994 N053.29.15.368 E020.56.31.441 apron
N053.29.15.369 E020.56.31.447 N053.29.15.411 E020.56.31.674 apron
N053.29.15.411 E020.56.31.674 N053.29.15.450 E020.56.32.004 apron
N053.29.15.450 E020.56.32.004 N053.29.15.475 E020.56.32.302 apron
N053.29.15.475 E020.56.32.302 N053.29.15.495 E020.56.32.590 apron
N053.29.15.495 E020.56.32.590 N053.29.15.495 E020.56.32.867 apron
N053.29.15.495 E020.56.32.867 N053.29.15.487 E020.56.33.164 apron
N053.29.15.487 E020.56.33.164 N053.29.15.460 E020.56.33.683 apron
N053.29.18.402 E020.56.40.634 N053.29.17.508 E020.56.45.102 apron
N053.29.17.508 E020.56.45.102 N053.29.17.661 E020.56.46.532 apron
N053.29.28.255 E020.56.52.266 N053.29.28.202 E020.56.52.541 apron
N053.29.17.661 E020.56.46.532 N053.29.12.846 E020.56.43.670 apron
N053.29.12.846 E020.56.43.670 N053.29.13.098 E020.56.43.398 apron
N053.29.13.098 E020.56.43.398 N053.29.13.283 E020.56.43.018 apron
N053.29.13.283 E020.56.43.018 N053.29.13.701 E020.56.41.269 apron
N053.29.13.701 E020.56.41.269 N053.29.14.336 E020.56.38.429 apron
N053.29.14.336 E020.56.38.429 N053.29.14.658 E020.56.37.141 apron
N053.29.18.519 E020.56.40.082 N053.29.18.521 E020.56.40.083 apron
N053.29.32.803 E020.56.38.636 N053.29.32.584 E020.56.39.755 apron
N053.29.32.584 E020.56.39.755 N053.29.32.540 E020.56.39.937 apron
N053.29.32.540 E020.56.39.937 N053.29.32.450 E020.56.40.028 apron
N053.29.32.450 E020.56.40.028 N053.29.32.325 E020.56.40.036 apron
N053.29.32.325 E020.56.40.036 N053.29.31.007 E020.56.39.230 apron
N053.29.31.007 E020.56.39.230 N053.29.29.878 E020.56.37.448 apron
N053.29.32.790 E020.56.38.625 N053.29.32.803 E020.56.38.636 apron
N053.29.02.082 E020.55.58.480 N053.29.00.973 E020.55.57.849 apron
N053.29.01.940 E020.55.58.863 N053.29.01.921 E020.55.58.965 apron
N053.29.00.973 E020.55.57.849 N053.29.00.890 E020.55.57.695 apron
N053.29.00.890 E020.55.57.695 N053.29.00.834 E020.55.57.492 apron
N053.29.00.834 E020.55.57.492 N053.29.00.839 E020.55.57.252 apron
N053.29.00.839 E020.55.57.252 N053.29.01.782 E020.55.52.787 apron
N053.29.01.782 E020.55.52.787 N053.29.01.623 E020.55.52.500 apron
N053.29.01.623 E020.55.52.500 N053.29.01.515 E020.55.52.651 apron
N053.29.01.515 E020.55.52.651 N053.29.01.451 E020.55.52.741 apron
N053.29.01.451 E020.55.52.741 N053.29.01.361 E020.55.52.724 apron
N053.29.01.361 E020.55.52.724 N053.29.01.238 E020.55.52.634 apron
N053.29.01.238 E020.55.52.634 N053.29.01.158 E020.55.52.563 apron
N053.29.01.158 E020.55.52.563 N053.29.01.110 E020.55.52.375 apron
N053.29.01.110 E020.55.52.375 N053.29.01.287 E020.55.51.285 apron
N053.29.01.287 E020.55.51.285 N053.29.01.378 E020.55.50.701 apron
N053.29.01.378 E020.55.50.701 N053.29.01.436 E020.55.50.200 apron
N053.29.01.436 E020.55.50.200 N053.29.01.096 E020.55.50.020 apron
N053.29.01.096 E020.55.50.020 N053.29.00.715 E020.55.52.189 apron
N053.29.00.715 E020.55.52.189 N053.28.59.804 E020.55.51.620 apron
N053.28.59.804 E020.55.51.620 N053.28.59.646 E020.55.51.522 apron
N053.28.59.646 E020.55.51.522 N053.28.59.514 E020.55.51.934 apron
N053.28.59.514 E020.55.51.934 N053.28.59.767 E020.55.52.146 apron
N053.28.59.767 E020.55.52.146 N053.28.59.767 E020.55.52.331 apron
N053.28.59.767 E020.55.52.331 N053.28.59.767 E020.55.52.412 apron
N053.28.59.767 E020.55.52.412 N053.29.00.305 E020.55.52.822 apron
N053.29.00.305 E020.55.52.822 N053.29.00.518 E020.55.52.901 apron
N053.29.00.518 E020.55.52.901 N053.29.00.645 E020.55.52.928 apron
N053.29.00.645 E020.55.52.928 N053.29.00.786 E020.55.52.901 apron
N053.29.00.786 E020.55.52.901 N053.29.00.993 E020.55.52.875 apron
N053.29.00.993 E020.55.52.875 N053.29.01.111 E020.55.52.915 apron
N053.29.01.111 E020.55.52.915 N053.29.01.238 E020.55.52.981 apron
N053.29.01.238 E020.55.52.981 N053.29.01.316 E020.55.53.060 apron
N053.29.01.316 E020.55.53.060 N053.29.01.387 E020.55.53.141 apron
N053.29.01.387 E020.55.53.141 N053.29.01.419 E020.55.53.273 apron
N053.29.01.419 E020.55.53.273 N053.29.01.419 E020.55.53.366 apron
N053.29.01.419 E020.55.53.366 N053.29.01.411 E020.55.53.578 apron
N053.29.01.411 E020.55.53.578 N053.29.01.379 E020.55.53.736 apron
N053.29.01.379 E020.55.53.736 N053.29.00.265 E020.55.59.079 apron
N053.29.00.265 E020.55.59.079 N053.29.00.192 E020.55.59.253 apron
N053.29.00.324 E020.55.59.473 N053.29.00.376 E020.55.59.279 apron
N053.29.00.376 E020.55.59.279 N053.29.00.510 E020.55.58.656 apron
N053.29.00.510 E020.55.58.656 N053.29.00.589 E020.55.58.377 apron
N053.29.00.589 E020.55.58.377 N053.29.00.661 E020.55.58.218 apron
N053.29.00.661 E020.55.58.218 N053.29.00.739 E020.55.58.138 apron
N053.29.00.739 E020.55.58.138 N053.29.00.889 E020.55.58.112 apron
N053.29.00.889 E020.55.58.112 N053.29.00.968 E020.55.58.138 apron
N053.29.00.968 E020.55.58.138 N053.29.01.577 E020.55.58.484 apron
N053.29.01.577 E020.55.58.484 N053.29.01.819 E020.55.58.646 apron
N053.29.01.819 E020.55.58.646 N053.29.01.914 E020.55.58.770 apron
N053.29.01.914 E020.55.58.770 N053.29.01.940 E020.55.58.863 apron
N053.29.16.993 E020.56.32.600 N053.29.16.993 E020.56.32.599 apron
N053.29.14.340 E020.56.38.409 N053.29.14.797 E020.56.36.584 apron
N053.29.15.460 E020.56.33.683 N053.29.14.797 E020.56.36.584 apron
N053.29.14.411 E020.56.29.131 N053.29.14.411 E020.56.29.131 apron


;EPWAAA;EPWAAA
LOTNISKA_EPWA_NEW[DD] N000.00.00.000 E000.00.00.000 N000.00.00.000 E000.00.00.000
;Runway 15/33
N052.10.42.426 E020.57.19.716 N052.09.58.594 E020.57.58.096 runway
N052.09.56.250 E020.58.00.148 N052.08.57.158 E020.58.51.890 runway
N052.08.57.158 E020.58.51.890 N052.08.58.078 E020.58.54.681 runway
N052.08.58.078 E020.58.54.681 N052.09.54.896 E020.58.04.931 runway
N052.09.57.274 E020.58.02.850 N052.10.43.346 E020.57.22.509 runway
N052.10.43.346 E020.57.22.509 N052.10.42.426 E020.57.19.716 runway
;Runway 11/29
N052.10.16.613 E020.56.47.459 N052.09.56.248 E020.58.00.143 runway
N052.09.54.919 E020.58.04.887 N052.09.38.931 E020.59.01.950 runway
N052.09.38.931 E020.59.01.950 N052.09.40.406 E020.59.03.034 runway
N052.09.40.406 E020.59.03.034 N052.09.57.273 E020.58.02.837 runway
N052.09.58.609 E020.57.58.068 N052.10.18.085 E020.56.48.556 runway
N052.10.18.085 E020.56.48.556 N052.10.16.613 E020.56.47.459 runway
;apron
N052.08.54.693 E020.58.44.837 N052.08.56.396 E020.58.49.983 apron
N052.08.55.636 E020.58.44.298 N052.08.55.464 E020.58.42.755 apron
N052.09.01.626 E020.58.34.447 N052.08.55.588 E020.58.39.706 apron
N052.09.02.140 E020.58.35.822 N052.09.12.143 E020.58.27.091 apron
N052.09.14.969 E020.58.27.095 N052.09.13.840 E020.58.25.509 apron
N052.09.17.319 E020.58.34.233 N052.09.14.969 E020.58.27.095 apron
N052.10.20.174 E020.57.30.251 N052.10.23.545 E020.57.32.900 apron
N052.09.50.562 E020.58.20.437 N052.09.46.782 E020.58.23.761 apron
N052.10.23.545 E020.57.32.900 N052.10.25.559 E020.57.34.485 apron
N052.10.29.472 E020.57.37.563 N052.10.27.724 E020.57.36.188 apron
N052.10.43.846 E020.57.51.366 N052.10.43.697 E020.57.52.011 apron
N052.10.47.048 E020.57.49.541 N052.10.44.876 E020.57.51.475 apron
N052.09.48.179 E020.58.10.817 N052.09.49.113 E020.58.13.637 apron
N052.09.48.868 E020.58.51.138 N052.09.48.392 E020.58.52.519 apron
N052.10.03.926 E020.57.17.471 N052.10.05.646 E020.57.18.814 apron
N052.10.04.474 E020.57.16.116 N052.10.03.961 E020.57.15.382 apron
N052.08.56.558 E020.58.50.492 N052.08.56.898 E020.58.51.454 apron
N052.08.57.424 E020.58.49.719 N052.08.57.308 E020.58.49.358 apron
N052.09.19.200 E020.58.39.926 N052.09.18.624 E020.58.38.189 apron
N052.09.19.243 E020.58.40.061 N052.09.19.200 E020.58.39.926 apron
N052.09.19.163 E020.58.47.844 N052.09.19.004 E020.58.47.981 apron
N052.09.27.471 E020.58.40.552 N052.09.26.461 E020.58.41.035 apron
N052.09.36.928 E020.59.00.479 N052.09.40.518 E020.59.03.116 apron
N052.09.34.794 E020.58.57.116 N052.09.39.341 E020.59.00.487 apron
N052.09.48.133 E020.58.53.193 N052.09.47.565 E020.58.54.367 apron
N052.09.45.528 E020.58.56.750 N052.09.45.226 E020.58.56.529 apron
N052.09.43.971 E020.58.55.628 N052.09.44.088 E020.58.56.740 apron
N052.09.44.953 E020.58.55.442 N052.09.44.867 E020.58.53.179 apron
N052.10.16.272 E020.57.58.004 N052.10.15.677 E020.57.56.201 apron
N052.10.00.347 E020.58.11.813 N052.09.54.874 E020.58.16.684 apron
N052.09.53.894 E020.58.17.524 N052.09.53.272 E020.58.18.070 apron
N052.10.39.408 E020.57.37.817 N052.10.38.850 E020.57.38.358 apron
N052.10.45.215 E020.57.32.757 N052.10.43.129 E020.57.34.606 apron
N052.09.39.417 E020.58.30.164 N052.09.29.537 E020.58.38.755 apron
N052.09.39.882 E020.58.31.583 N052.09.47.248 E020.58.25.179 apron
N052.09.39.882 E020.58.31.583 N052.09.32.212 E020.58.38.259 apron
N052.09.46.782 E020.58.23.761 N052.09.39.417 E020.58.30.164 apron
N052.09.47.248 E020.58.25.179 N052.09.49.883 E020.58.22.862 apron
N052.10.43.129 E020.57.34.606 N052.10.41.958 E020.57.35.639 apron
N052.10.43.616 E020.57.26.047 N052.10.43.806 E020.57.27.043 apron
N052.10.44.501 E020.57.25.333 N052.10.43.889 E020.57.23.542 apron
N052.10.14.551 E020.56.47.645 N052.10.15.137 E020.56.48.087 apron
N052.10.14.964 E020.56.46.184 N052.10.13.110 E020.56.44.802 apron
N052.10.12.825 E020.56.46.358 N052.10.14.551 E020.56.47.645 apron
N052.10.13.110 E020.56.44.802 N052.10.12.068 E020.56.44.540 apron
N052.10.05.646 E020.57.18.814 N052.10.07.433 E020.57.20.223 apron
N052.10.06.073 E020.57.17.364 N052.10.04.474 E020.57.16.116 apron
N052.09.41.305 E020.59.01.773 N052.09.40.957 E020.59.01.635 apron
N052.09.41.341 E020.59.03.443 N052.09.42.205 E020.59.02.992 apron
N052.10.10.845 E020.57.22.914 N052.10.19.247 E020.57.29.520 apron
N052.09.41.760 E020.59.01.535 N052.09.41.305 E020.59.01.773 apron
N052.09.42.205 E020.59.02.992 N052.09.43.775 E020.59.01.190 apron
N052.09.03.668 E020.59.01.303 N052.09.03.167 E020.59.01.515 apron
N052.09.50.607 E020.58.41.706 N052.09.51.000 E020.58.42.414 apron
N052.09.51.020 E020.58.40.243 N052.09.49.351 E020.58.39.005 apron
N052.09.46.011 E020.58.56.618 N052.09.45.528 E020.58.56.750 apron
N052.09.23.268 E020.58.50.275 N052.09.26.114 E020.58.52.421 apron
N052.09.23.745 E020.58.48.862 N052.09.23.327 E020.58.48.268 apron
N052.10.02.848 E020.57.12.380 N052.10.02.659 E020.57.14.400 apron
N052.10.03.802 E020.57.12.845 N052.10.10.897 E020.56.47.614 apron
N052.10.10.053 E020.56.46.753 N052.10.02.848 E020.57.12.380 apron
N052.10.10.897 E020.56.47.614 N052.10.11.385 E020.56.46.646 apron
N052.09.53.272 E020.58.18.071 N052.09.52.918 E020.58.18.380 apron
N052.09.59.096 E020.58.14.794 N052.09.54.927 E020.58.18.459 apron
N052.09.53.736 E020.58.19.491 N052.09.53.975 E020.58.19.282 apron
N052.08.55.588 E020.58.39.706 N052.08.54.856 E020.58.40.838 apron
N052.08.56.171 E020.58.41.022 N052.08.59.800 E020.58.37.861 apron
N052.09.48.939 E020.58.40.468 N052.09.50.607 E020.58.41.706 apron
N052.09.49.351 E020.58.39.005 N052.09.47.954 E020.58.37.949 apron
N052.09.44.088 E020.58.56.740 N052.09.44.591 E020.58.57.827 apron
N052.09.45.020 E020.58.56.084 N052.09.44.953 E020.58.55.442 apron
N052.09.43.884 E020.58.50.623 N052.09.43.867 E020.58.51.040 apron
N052.09.44.917 E020.58.49.528 N052.09.45.083 E020.58.47.335 apron
N052.09.49.113 E020.58.13.637 N052.09.49.693 E020.58.15.389 apron
N052.09.49.740 E020.58.13.085 N052.09.48.807 E020.58.10.268 apron
N052.09.49.693 E020.58.15.389 N052.09.50.917 E020.58.19.105 apron
N052.09.50.320 E020.58.14.838 N052.09.49.740 E020.58.13.085 apron
N052.10.14.708 E020.57.56.647 N052.10.14.768 E020.57.56.837 apron
N052.10.15.560 E020.57.55.831 N052.10.14.105 E020.57.51.424 apron
N052.10.14.105 E020.57.51.424 N052.10.13.557 E020.57.49.774 apron
N052.10.13.557 E020.57.49.774 N052.10.13.112 E020.57.48.982 apron
N052.10.10.987 E020.57.55.211 N052.10.13.389 E020.57.55.332 apron
N052.10.09.676 E020.57.55.157 N052.10.10.987 E020.57.55.211 apron
N052.10.07.294 E020.57.55.334 N052.10.09.676 E020.57.55.157 apron
N052.10.13.389 E020.57.55.332 N052.10.14.117 E020.57.55.677 apron
N052.10.14.117 E020.57.55.677 N052.10.14.708 E020.57.56.647 apron
N052.10.25.983 E020.57.47.150 N052.10.26.104 E020.57.48.106 apron
N052.10.26.812 E020.57.46.268 N052.10.26.247 E020.57.45.075 apron
N052.10.25.600 E020.57.46.341 N052.10.25.983 E020.57.47.150 apron
N052.10.26.247 E020.57.45.075 N052.10.25.297 E020.57.44.275 apron
N052.10.25.007 E020.57.45.841 N052.10.25.600 E020.57.46.341 apron
N052.10.25.297 E020.57.44.275 N052.10.24.512 E020.57.44.134 apron
N052.10.24.445 E020.57.45.741 N052.10.25.007 E020.57.45.841 apron
N052.10.24.512 E020.57.44.134 N052.10.22.343 E020.57.44.041 apron
N052.10.20.400 E020.57.45.567 N052.10.22.317 E020.57.45.650 apron
N052.10.20.393 E020.57.43.957 N052.10.18.724 E020.57.44.068 apron
N052.10.18.578 E020.57.45.687 N052.10.20.400 E020.57.45.567 apron
N052.10.27.369 E020.57.37.622 N052.10.25.914 E020.57.37.773 apron
N052.10.27.430 E020.57.39.230 N052.10.30.974 E020.57.39.130 apron
N052.10.25.773 E020.57.39.402 N052.10.27.430 E020.57.39.230 apron
N052.10.43.108 E020.57.24.560 N052.10.43.616 E020.57.26.047 apron
N052.10.43.889 E020.57.23.542 N052.10.43.244 E020.57.22.598 apron
N052.10.42.519 E020.57.23.699 N052.10.43.108 E020.57.24.560 apron
N052.10.45.434 E020.57.31.152 N052.10.45.531 E020.57.32.000 apron
N052.10.44.501 E020.57.25.333 N052.10.45.807 E020.57.29.063 apron
N052.10.08.404 E020.58.04.895 N052.10.07.394 E020.58.05.787 apron
N052.10.06.374 E020.58.06.657 N052.10.05.361 E020.58.07.554 apron
N052.10.00.912 E020.58.11.423 N052.10.00.347 E020.58.11.814 apron
N052.08.54.856 E020.58.40.838 N052.08.54.443 E020.58.42.601 apron
N052.08.55.698 E020.58.41.753 N052.08.56.171 E020.58.41.022 apron
N052.08.54.443 E020.58.42.601 N052.08.54.693 E020.58.44.837 apron
N052.08.55.464 E020.58.42.755 N052.08.55.698 E020.58.41.753 apron
N052.09.11.791 E020.58.25.574 N052.09.01.626 E020.58.34.447 apron
N052.09.12.143 E020.58.27.091 N052.09.12.826 E020.58.26.828 apron
N052.09.13.395 E020.58.27.007 N052.09.14.187 E020.58.28.119 apron
N052.09.13.840 E020.58.25.509 N052.09.12.805 E020.58.25.183 apron
N052.09.12.826 E020.58.26.828 N052.09.13.395 E020.58.27.007 apron
N052.09.12.805 E020.58.25.183 N052.09.11.791 E020.58.25.574 apron
N052.08.56.486 E020.58.46.490 N052.08.56.438 E020.58.46.723 apron
N052.08.57.384 E020.58.47.183 N052.09.01.078 E020.58.37.563 apron
N052.08.59.800 E020.58.37.861 N052.08.56.486 E020.58.46.490 apron
N052.09.01.078 E020.58.37.563 N052.09.01.430 E020.58.36.827 apron
N052.09.01.430 E020.58.36.827 N052.09.02.140 E020.58.35.822 apron
N052.08.57.199 E020.58.48.082 N052.08.57.384 E020.58.47.183 apron
N052.08.56.396 E020.58.49.983 N052.08.56.558 E020.58.50.492 apron
N052.08.56.438 E020.58.46.723 N052.08.55.636 E020.58.44.298 apron
N052.08.57.308 E020.58.49.358 N052.08.57.199 E020.58.48.082 apron
N052.08.58.350 E020.58.50.846 N052.08.58.066 E020.58.50.744 apron
N052.08.58.066 E020.58.50.744 N052.08.57.629 E020.58.50.302 apron
N052.08.56.898 E020.58.51.454 N052.08.57.249 E020.58.51.810 apron
N052.08.57.629 E020.58.50.302 N052.08.57.424 E020.58.49.719 apron
N052.09.16.451 E020.58.34.996 N052.09.14.187 E020.58.28.119 apron
N052.09.17.371 E020.58.37.788 N052.09.19.672 E020.58.44.762 apron
N052.09.18.624 E020.58.38.189 N052.09.18.240 E020.58.37.025 apron
N052.09.19.672 E020.58.44.762 N052.09.19.808 E020.58.45.941 apron
N052.09.20.466 E020.58.41.205 N052.09.19.800 E020.58.40.884 apron
N052.09.20.326 E020.58.42.815 N052.09.24.933 E020.58.42.766 apron
N052.09.19.800 E020.58.40.884 N052.09.19.243 E020.58.40.061 apron
N052.09.25.828 E020.58.41.148 N052.09.20.466 E020.58.41.205 apron
N052.09.26.461 E020.58.41.035 N052.09.25.828 E020.58.41.148 apron
N052.09.19.657 E020.58.46.873 N052.09.19.163 E020.58.47.844 apron
N052.09.19.808 E020.58.45.941 N052.09.19.657 E020.58.46.873 apron
N052.09.01.236 E020.59.01.406 N052.09.02.099 E020.59.02.789 apron
N052.09.02.035 E020.59.00.430 N052.09.00.647 E020.58.56.217 apron
N052.08.59.138 E020.58.55.038 N052.08.59.778 E020.58.56.978 apron
N052.09.00.079 E020.58.54.494 N052.08.59.942 E020.58.53.317 apron
N052.08.59.002 E020.58.53.872 N052.08.59.138 E020.58.55.038 apron
N052.08.59.942 E020.58.53.317 N052.09.00.010 E020.58.52.990 apron
N052.08.59.778 E020.58.56.978 N052.09.01.236 E020.59.01.406 apron
N052.09.00.647 E020.58.56.217 N052.09.00.079 E020.58.54.494 apron
N052.09.02.099 E020.59.02.789 N052.09.03.189 E020.59.03.167 apron
N052.09.02.586 E020.59.01.314 N052.09.02.035 E020.59.00.430 apron
N052.09.03.167 E020.59.01.515 N052.09.02.586 E020.59.01.314 apron
N052.09.22.435 E020.58.44.943 N052.09.21.728 E020.58.45.142 apron
N052.09.21.728 E020.58.45.142 N052.09.21.098 E020.58.44.839 apron
N052.09.21.098 E020.58.44.839 N052.09.20.478 E020.58.43.901 apron
N052.09.20.478 E020.58.43.901 N052.09.20.129 E020.58.42.818 apron
N052.09.20.326 E020.58.42.815 N052.09.20.134 E020.58.42.832 apron
N052.10.15.137 E020.56.48.087 N052.10.15.670 E020.56.48.674 apron
N052.10.15.623 E020.56.46.682 N052.10.14.964 E020.56.46.184 apron
N052.10.16.023 E020.56.49.512 N052.10.16.024 E020.56.49.563 apron
N052.10.16.510 E020.56.47.827 N052.10.16.377 E020.56.47.511 apron
N052.10.15.670 E020.56.48.674 N052.10.16.023 E020.56.49.512 apron
N052.10.16.377 E020.56.47.511 N052.10.15.623 E020.56.46.682 apron
N052.10.12.165 E020.56.46.192 N052.10.12.825 E020.56.46.358 apron
N052.10.12.068 E020.56.44.540 N052.10.10.796 E020.56.45.281 apron
N052.10.10.796 E020.56.45.281 N052.10.10.053 E020.56.46.753 apron
N052.10.11.385 E020.56.46.646 N052.10.12.165 E020.56.46.192 apron
N052.10.02.659 E020.57.14.400 N052.10.03.133 E020.57.16.337 apron
N052.10.03.675 E020.57.14.210 N052.10.03.802 E020.57.12.845 apron
N052.10.03.133 E020.57.16.337 N052.10.03.926 E020.57.17.471 apron
N052.10.03.961 E020.57.15.382 N052.10.03.675 E020.57.14.210 apron
N052.10.31.745 E020.57.39.379 N052.10.32.162 E020.57.39.940 apron
N052.10.32.178 E020.57.37.904 N052.10.30.730 E020.57.36.766 apron
N052.10.34.558 E020.57.41.546 N052.10.35.004 E020.57.41.723 apron
N052.10.34.841 E020.57.40.003 N052.10.32.178 E020.57.37.904 apron
N052.10.36.861 E020.57.40.088 N052.10.35.790 E020.57.40.378 apron
N052.10.35.790 E020.57.40.378 N052.10.34.841 E020.57.40.003 apron
N052.10.30.974 E020.57.39.130 N052.10.31.745 E020.57.39.379 apron
N052.10.29.472 E020.57.37.563 N052.10.27.369 E020.57.37.622 apron
N052.10.23.939 E020.57.39.897 N052.10.25.773 E020.57.39.402 apron
N052.10.23.009 E020.57.40.316 N052.10.23.939 E020.57.39.897 apron
N052.10.16.520 E020.57.46.253 N052.10.18.578 E020.57.45.687 apron
N052.10.15.902 E020.57.46.539 N052.10.16.520 E020.57.46.253 apron
N052.10.05.739 E020.57.55.755 N052.10.07.294 E020.57.55.334 apron
N052.10.04.969 E020.57.56.112 N052.10.05.739 E020.57.55.755 apron
N052.10.42.519 E020.57.23.699 N052.10.42.321 E020.57.23.404 apron
N052.10.45.472 E020.57.32.307 N052.10.45.215 E020.57.32.757 apron
N052.10.45.531 E020.57.32.000 N052.10.45.472 E020.57.32.307 apron
N052.10.43.806 E020.57.27.043 N052.10.43.672 E020.57.28.426 apron
N052.10.43.672 E020.57.28.426 N052.10.40.756 E020.57.35.696 apron
N052.10.44.614 E020.57.29.016 N052.10.45.435 E020.57.31.154 apron
N052.10.40.756 E020.57.35.696 N052.10.40.343 E020.57.36.563 apron
N052.10.41.958 E020.57.35.639 N052.10.44.614 E020.57.29.017 apron
N052.10.40.343 E020.57.36.563 N052.10.39.408 E020.57.37.817 apron
N052.10.31.660 E020.57.44.619 N052.10.30.228 E020.57.45.868 apron
N052.10.32.289 E020.57.43.459 N052.10.31.660 E020.57.44.619 apron
N052.10.33.427 E020.57.43.085 N052.10.33.535 E020.57.42.616 apron
N052.10.32.518 E020.57.42.457 N052.10.32.289 E020.57.43.459 apron
N052.10.33.535 E020.57.42.616 N052.10.33.339 E020.57.40.665 apron
N052.10.33.339 E020.57.40.665 N052.10.34.558 E020.57.41.546 apron
N052.10.32.305 E020.57.40.389 N052.10.32.518 E020.57.42.457 apron
N052.10.32.162 E020.57.39.940 N052.10.32.305 E020.57.40.389 apron
N052.09.52.242 E020.58.20.792 N052.09.53.735 E020.58.19.491 apron
N052.10.22.317 E020.57.45.650 N052.10.24.445 E020.57.45.741 apron
N052.10.22.343 E020.57.44.041 N052.10.20.393 E020.57.43.957 apron
N052.09.51.016 E020.58.43.492 N052.09.49.109 E020.58.50.423 apron
N052.09.52.119 E020.58.39.575 N052.09.51.596 E020.58.40.275 apron
N052.09.47.350 E020.58.39.267 N052.09.48.939 E020.58.40.468 apron
N052.09.47.954 E020.58.37.949 N052.09.47.613 E020.58.37.317 apron
N052.09.47.163 E020.58.38.920 N052.09.47.350 E020.58.39.267 apron
N052.09.51.596 E020.58.40.275 N052.09.51.020 E020.58.40.243 apron
N052.09.51.000 E020.58.42.414 N052.09.51.016 E020.58.43.492 apron
N052.09.56.606 E020.58.23.659 N052.09.56.289 E020.58.24.081 apron
N052.09.59.096 E020.58.14.796 N052.09.59.001 E020.58.15.141 apron
N052.09.48.392 E020.58.52.519 N052.09.48.133 E020.58.53.193 apron
N052.09.46.935 E020.58.55.383 N052.09.46.419 E020.58.56.124 apron
N052.09.46.419 E020.58.56.124 N052.09.46.011 E020.58.56.618 apron
N052.09.43.210 E020.58.59.871 N052.09.41.760 E020.59.01.535 apron
N052.09.43.775 E020.59.01.190 N052.09.45.180 E020.58.59.601 apron
N052.09.40.518 E020.59.03.116 N052.09.41.341 E020.59.03.443 apron
N052.09.40.957 E020.59.01.635 N052.09.40.855 E020.59.01.433 apron
N052.09.44.591 E020.58.57.827 N052.09.44.849 E020.58.58.017 apron
N052.09.45.226 E020.58.56.529 N052.09.45.020 E020.58.56.084 apron
N052.09.43.881 E020.58.53.237 N052.09.43.971 E020.58.55.628 apron
N052.09.44.867 E020.58.53.179 N052.09.44.854 E020.58.51.085 apron
N052.09.43.867 E020.58.51.040 N052.09.43.881 E020.58.53.237 apron
N052.09.44.854 E020.58.51.085 N052.09.44.917 E020.58.49.528 apron
N052.09.45.083 E020.58.47.335 N052.09.45.301 E020.58.45.566 apron
N052.09.21.585 E020.58.49.033 N052.09.23.268 E020.58.50.275 apron
N052.09.23.111 E020.58.44.360 N052.09.22.435 E020.58.44.943 apron
N052.09.23.161 E020.58.47.567 N052.09.23.195 E020.58.46.718 apron
N052.09.23.195 E020.58.46.718 N052.09.23.671 E020.58.45.695 apron
N052.09.23.327 E020.58.48.268 N052.09.23.161 E020.58.47.567 apron
N052.09.24.735 E020.58.44.765 N052.09.23.671 E020.58.45.695 apron
N052.09.53.975 E020.58.19.282 N052.09.54.048 E020.58.20.726 apron
N052.09.54.927 E020.58.18.459 N052.09.54.960 E020.58.19.185 apron
N052.09.54.867 E020.58.15.927 N052.09.54.874 E020.58.16.684 apron
N052.09.55.263 E020.58.25.602 N052.09.55.681 E020.58.26.361 apron
N052.09.55.661 E020.58.24.129 N052.09.55.553 E020.58.24.047 apron
N052.09.56.289 E020.58.24.081 N052.09.55.661 E020.58.24.129 apron
N052.09.55.681 E020.58.26.361 N052.09.55.714 E020.58.26.837 apron
N052.09.55.714 E020.58.26.837 N052.09.55.230 E020.58.28.555 apron
N052.09.55.012 E020.58.25.411 N052.09.55.263 E020.58.25.602 apron
N052.09.55.553 E020.58.24.047 N052.09.55.385 E020.58.23.811 apron
N052.09.54.649 E020.58.24.901 N052.09.55.012 E020.58.25.411 apron
N052.09.55.385 E020.58.23.811 N052.09.55.264 E020.58.23.532 apron
N052.09.54.365 E020.58.24.244 N052.09.54.649 E020.58.24.901 apron
N052.09.55.264 E020.58.23.532 N052.09.55.159 E020.58.22.957 apron
N052.09.54.185 E020.58.23.261 N052.09.54.365 E020.58.24.244 apron
N052.09.55.159 E020.58.22.957 N052.09.55.031 E020.58.20.589 apron
N052.09.54.048 E020.58.20.726 N052.09.54.185 E020.58.23.261 apron
N052.09.55.031 E020.58.20.589 N052.09.54.960 E020.58.19.185 apron
N052.09.53.880 E020.58.15.907 N052.09.53.894 E020.58.17.524 apron
N052.09.54.867 E020.58.15.927 N052.09.54.898 E020.58.14.679 apron
N052.09.53.906 E020.58.14.856 N052.09.53.880 E020.58.15.907 apron
N052.09.54.898 E020.58.14.679 N052.09.55.018 E020.58.12.577 apron
N052.09.55.018 E020.58.12.577 N052.09.55.278 E020.58.10.164 apron
N052.09.55.278 E020.58.10.164 N052.09.55.340 E020.58.09.737 apron
N052.10.19.917 E020.57.28.030 N052.10.19.808 E020.57.28.175 apron
N052.10.20.498 E020.57.28.496 N052.10.24.748 E020.57.14.224 apron
N052.10.19.247 E020.57.29.520 N052.10.20.174 E020.57.30.251 apron
N052.10.24.166 E020.57.13.762 N052.10.19.917 E020.57.28.030 apron
N052.10.20.492 E020.57.28.715 N052.10.20.498 E020.57.28.496 apron
N052.09.51.286 E020.58.17.769 N052.09.50.320 E020.58.14.838 apron
N052.10.41.592 E020.58.03.820 N052.10.42.579 E020.58.01.777 apron
N052.10.41.705 E020.58.00.984 N052.10.41.030 E020.58.02.384 apron
N052.10.42.579 E020.58.01.777 N052.10.44.623 E020.57.52.569 apron
N052.10.43.697 E020.57.52.011 N052.10.41.705 E020.58.00.985 apron
N052.10.44.623 E020.57.52.569 N052.10.44.876 E020.57.51.475 apron
N052.09.57.403 E020.58.20.836 N052.09.56.723 E020.58.23.239 apron
N052.10.17.496 E020.58.06.439 N052.10.18.074 E020.58.05.953 apron
N052.10.18.074 E020.58.05.953 N052.10.18.074 E020.58.05.953 apron
N052.10.19.030 E020.58.05.108 N052.10.19.815 E020.58.04.425 apron
N052.10.19.815 E020.58.04.425 N052.10.19.815 E020.58.04.425 apron
N052.10.28.481 E020.57.56.866 N052.10.28.116 E020.57.57.177 apron
N052.10.28.481 E020.57.56.866 N052.10.28.811 E020.57.56.272 apron
N052.10.28.811 E020.57.56.272 N052.10.28.811 E020.57.56.272 apron
N052.10.28.695 E020.57.56.674 N052.10.28.481 E020.57.56.866 apron
N052.10.28.481 E020.57.56.866 N052.10.28.481 E020.57.56.866 apron
N052.10.29.408 E020.57.56.445 N052.10.28.695 E020.57.56.674 apron
N052.10.28.695 E020.57.56.674 N052.10.28.695 E020.57.56.674 apron
N052.10.29.408 E020.57.56.445 N052.10.29.408 E020.57.56.445 apron
N052.10.28.811 E020.57.56.272 N052.10.28.481 E020.57.56.866 apron
N052.10.28.481 E020.57.56.866 N052.10.28.481 E020.57.56.866 apron
N052.10.28.811 E020.57.56.272 N052.10.29.011 E020.57.55.385 apron
N052.10.29.011 E020.57.55.385 N052.10.28.811 E020.57.56.272 apron
N052.10.28.811 E020.57.56.272 N052.10.28.811 E020.57.56.272 apron
N052.10.28.916 E020.57.54.292 N052.10.29.011 E020.57.55.385 apron
N052.10.29.011 E020.57.55.385 N052.10.29.011 E020.57.55.385 apron
N052.10.31.537 E020.57.56.921 N052.10.31.842 E020.57.56.417 apron
N052.10.31.543 E020.57.55.765 N052.10.31.203 E020.57.56.013 apron
N052.10.31.203 E020.57.56.013 N052.10.31.203 E020.57.56.013 apron
N052.10.31.842 E020.57.56.417 N052.10.33.286 E020.57.55.158 apron
N052.10.26.104 E020.57.48.106 N052.10.25.974 E020.57.49.029 apron
N052.10.27.301 E020.57.47.038 N052.10.26.812 E020.57.46.268 apron
N052.10.27.810 E020.57.47.369 N052.10.27.301 E020.57.47.038 apron
N052.10.25.974 E020.57.49.029 N052.10.25.437 E020.57.50.056 apron
N052.10.25.437 E020.57.50.056 N052.10.25.257 E020.57.50.206 apron
N052.10.28.723 E020.57.47.183 N052.10.27.810 E020.57.47.369 apron
N052.10.26.776 E020.57.58.353 N052.10.25.731 E020.57.59.257 apron
N052.10.25.731 E020.57.59.257 N052.10.25.731 E020.57.59.257 apron
N052.10.24.339 E020.57.51.006 N052.10.23.029 E020.57.52.143 apron
N052.10.25.457 E020.57.59.503 N052.10.24.346 E020.58.00.482 apron
N052.10.24.346 E020.58.00.482 N052.10.24.346 E020.58.00.482 apron
N052.10.23.029 E020.57.52.143 N052.10.22.009 E020.57.53.026 apron
N052.10.24.346 E020.58.00.482 N052.10.23.414 E020.58.01.277 apron
N052.10.23.414 E020.58.01.277 N052.10.23.414 E020.58.01.277 apron
N052.10.24.780 E020.58.00.099 N052.10.25.214 E020.57.59.718 apron
N052.10.22.009 E020.57.53.026 N052.10.20.994 E020.57.53.917 apron
N052.10.23.414 E020.58.01.277 N052.10.22.581 E020.58.02.011 apron
N052.10.22.581 E020.58.02.011 N052.10.22.581 E020.58.02.011 apron
N052.10.23.414 E020.58.01.277 N052.10.23.908 E020.58.00.855 apron
N052.10.20.994 E020.57.53.917 N052.10.19.973 E020.57.54.793 apron
N052.10.22.416 E020.58.02.155 N052.10.21.529 E020.58.02.934 apron
N052.10.19.973 E020.57.54.793 N052.10.18.655 E020.57.55.942 apron
N052.10.18.655 E020.57.55.942 N052.10.17.641 E020.57.56.839 apron
N052.10.20.074 E020.58.04.198 N052.10.20.325 E020.58.03.992 apron
N052.10.20.325 E020.58.03.992 N052.10.20.325 E020.58.03.992 apron
N052.10.17.641 E020.57.56.839 N052.10.16.272 E020.57.58.004 apron
N052.10.27.214 E020.57.57.970 N052.10.26.776 E020.57.58.353 apron
N052.10.26.776 E020.57.58.353 N052.10.26.776 E020.57.58.353 apron
N052.10.27.214 E020.57.57.970 N052.10.27.678 E020.57.57.551 apron
N052.10.27.678 E020.57.57.551 N052.10.27.678 E020.57.57.551 apron
N052.10.25.731 E020.57.59.257 N052.10.25.457 E020.57.59.503 apron
N052.10.25.457 E020.57.59.503 N052.10.25.457 E020.57.59.503 apron
N052.10.26.256 E020.57.58.802 N052.10.26.256 E020.57.58.802 apron
N052.10.18.074 E020.58.05.953 N052.10.19.030 E020.58.05.108 apron
N052.10.19.030 E020.58.05.108 N052.10.19.030 E020.58.05.108 apron
N052.10.20.325 E020.58.03.992 N052.10.20.920 E020.58.03.469 apron
N052.10.20.920 E020.58.03.469 N052.10.20.920 E020.58.03.469 apron
N052.10.21.094 E020.58.03.316 N052.10.22.146 E020.58.02.392 apron
N052.10.22.581 E020.58.02.011 N052.10.22.416 E020.58.02.155 apron
N052.10.22.416 E020.58.02.155 N052.10.22.416 E020.58.02.155 apron
N052.10.22.581 E020.58.02.011 N052.10.23.414 E020.58.01.277 apron
N052.10.23.414 E020.58.01.277 N052.10.23.414 E020.58.01.277 apron
N052.10.19.639 E020.58.04.578 N052.10.19.030 E020.58.05.108 apron
N052.10.19.815 E020.58.04.425 N052.10.20.074 E020.58.04.198 apron
N052.10.20.074 E020.58.04.198 N052.10.20.074 E020.58.04.198 apron
N052.10.20.660 E020.58.03.698 N052.10.20.513 E020.58.03.827 apron
N052.10.20.920 E020.58.03.469 N052.10.21.094 E020.58.03.316 apron
N052.10.21.094 E020.58.03.316 N052.10.21.094 E020.58.03.316 apron
N052.09.55.230 E020.58.28.555 N052.09.52.119 E020.58.39.575 apron
N052.09.56.723 E020.58.23.239 N052.09.56.606 E020.58.23.659 apron
N052.09.59.001 E020.58.15.141 N052.09.58.153 E020.58.18.171 apron
N052.09.58.153 E020.58.18.171 N052.09.57.403 E020.58.20.836 apron
N052.10.05.361 E020.58.07.554 N052.10.00.912 E020.58.11.423 apron
N052.10.07.394 E020.58.05.787 N052.10.06.374 E020.58.06.657 apron
N052.10.09.722 E020.58.03.753 N052.10.08.404 E020.58.04.895 apron
N052.10.10.731 E020.58.02.861 N052.10.09.722 E020.58.03.753 apron
N052.10.11.753 E020.58.01.979 N052.10.10.731 E020.58.02.861 apron
N052.10.13.067 E020.58.00.834 N052.10.11.753 E020.58.01.979 apron
N052.10.14.018 E020.57.59.996 N052.10.13.067 E020.58.00.834 apron
N052.10.14.686 E020.57.58.937 N052.10.14.018 E020.57.59.996 apron
N052.10.14.873 E020.57.57.795 N052.10.14.686 E020.57.58.937 apron
N052.10.14.768 E020.57.56.837 N052.10.14.873 E020.57.57.795 apron
N052.10.15.677 E020.57.56.201 N052.10.15.560 E020.57.55.831 apron
N052.10.25.257 E020.57.50.206 N052.10.24.339 E020.57.51.006 apron
N052.10.27.678 E020.57.57.551 N052.10.27.214 E020.57.57.970 apron
N052.10.27.214 E020.57.57.970 N052.10.27.214 E020.57.57.970 apron
N052.10.27.678 E020.57.57.551 N052.10.28.481 E020.57.56.866 apron
N052.10.28.481 E020.57.56.866 N052.10.28.481 E020.57.56.866 apron
N052.10.41.569 E020.57.37.811 N052.10.44.786 E020.57.34.969 apron
N052.10.38.850 E020.57.38.358 N052.10.37.158 E020.57.39.825 apron
N052.10.41.695 E020.57.47.820 N052.10.42.860 E020.57.48.366 apron
N052.10.42.860 E020.57.48.366 N052.10.43.203 E020.57.49.404 apron
N052.09.44.849 E020.58.58.017 N052.09.43.210 E020.58.59.871 apron
N052.09.47.565 E020.58.54.367 N052.09.46.935 E020.58.55.383 apron
N052.09.49.109 E020.58.50.423 N052.09.48.868 E020.58.51.138 apron
N052.09.55.517 E020.58.31.386 N052.09.50.311 E020.58.49.982 apron
N052.09.04.910 E020.59.00.281 N052.09.03.668 E020.59.01.303 apron
N052.09.06.062 E020.58.59.273 N052.09.04.910 E020.59.00.281 apron
N052.09.07.965 E020.58.57.607 N052.09.06.062 E020.58.59.273 apron
N052.09.09.873 E020.58.55.945 N052.09.07.965 E020.58.57.607 apron
N052.09.11.027 E020.58.54.931 N052.09.09.873 E020.58.55.945 apron
N052.09.15.165 E020.58.51.340 N052.09.11.027 E020.58.54.931 apron
N052.09.16.902 E020.58.49.828 N052.09.15.165 E020.58.51.340 apron
N052.09.19.004 E020.58.47.981 N052.09.16.902 E020.58.49.828 apron
N052.10.43.203 E020.57.49.404 N052.10.43.846 E020.57.51.366 apron
N052.10.40.212 E020.57.49.099 N052.10.41.695 E020.57.47.820 apron
N052.10.37.791 E020.57.51.227 N052.10.40.212 E020.57.49.099 apron
N052.10.35.457 E020.57.53.262 N052.10.37.791 E020.57.51.227 apron
N052.10.33.286 E020.57.55.158 N052.10.35.457 E020.57.53.262 apron
N052.10.30.228 E020.57.45.868 N052.10.28.723 E020.57.47.183 apron
N052.10.35.004 E020.57.41.723 N052.10.33.427 E020.57.43.085 apron
N052.10.37.158 E020.57.39.825 N052.10.36.861 E020.57.40.088 apron
N052.09.21.585 E020.58.49.033 N052.09.20.662 E020.58.48.859 apron
N052.09.26.114 E020.58.52.421 N052.09.27.332 E020.58.53.326 apron
N052.09.24.554 E020.58.49.472 N052.09.23.745 E020.58.48.862 apron
N052.09.27.332 E020.58.53.326 N052.09.28.385 E020.58.54.118 apron
N052.09.28.385 E020.58.54.118 N052.09.30.918 E020.58.55.995 apron
N052.09.30.918 E020.58.55.995 N052.09.32.194 E020.58.56.944 apron
N052.09.32.194 E020.58.56.944 N052.09.36.928 E020.59.00.479 apron
N052.09.24.933 E020.58.42.766 N052.09.23.111 E020.58.44.360 apron
N052.09.29.537 E020.58.38.755 N052.09.27.471 E020.58.40.552 apron
N052.10.08.894 E020.57.21.367 N052.10.10.845 E020.57.22.914 apron
N052.10.07.843 E020.57.18.760 N052.10.06.073 E020.57.17.364 apron
N052.10.09.301 E020.57.19.907 N052.10.19.808 E020.57.28.175 apron
N052.10.20.920 E020.58.03.469 N052.10.20.920 E020.58.03.469 apron
N052.10.19.815 E020.58.04.425 N052.10.19.815 E020.58.04.425 apron
N052.10.18.074 E020.58.05.953 N052.10.18.074 E020.58.05.953 apron
N052.10.26.776 E020.57.58.353 N052.10.26.776 E020.57.58.353 apron
N052.10.25.457 E020.57.59.503 N052.10.25.457 E020.57.59.503 apron
N052.10.24.346 E020.58.00.482 N052.10.24.346 E020.58.00.482 apron
N052.10.23.414 E020.58.01.277 N052.10.23.414 E020.58.01.277 apron
N052.10.22.416 E020.58.02.155 N052.10.22.416 E020.58.02.155 apron
N052.10.23.974 E020.57.31.451 N052.10.20.492 E020.57.28.715 apron
N052.10.23.974 E020.57.31.451 N052.10.26.634 E020.57.33.544 apron
N052.10.30.730 E020.57.36.766 N052.10.28.799 E020.57.35.247 apron
N052.10.13.778 E020.57.53.828 N052.10.13.600 E020.57.53.294 apron
N052.10.13.600 E020.57.53.294 N052.10.12.737 E020.57.50.734 apron
N052.10.12.737 E020.57.50.734 N052.10.12.217 E020.57.49.764 apron
N052.10.13.778 E020.57.53.828 N052.10.13.549 E020.57.53.743 apron
N052.10.13.549 E020.57.53.743 N052.10.09.683 E020.57.53.552 apron
N052.10.09.683 E020.57.53.552 N052.10.07.752 E020.57.53.669 apron
N052.10.21.709 E020.57.11.410 N052.10.23.151 E020.57.12.546 apron
N052.10.23.151 E020.57.12.546 N052.10.22.982 E020.57.13.135 apron
N052.10.22.982 E020.57.13.135 N052.10.23.742 E020.57.13.726 apron
N052.10.23.742 E020.57.13.726 N052.10.22.187 E020.57.18.951 apron
N052.10.22.187 E020.57.18.951 N052.10.22.537 E020.57.19.232 apron
N052.10.22.543 E020.57.19.236 N052.10.23.365 E020.57.16.459 apron
N052.10.23.951 E020.57.16.899 N052.10.24.027 E020.57.16.956 apron
N052.10.24.027 E020.57.16.956 N052.10.24.621 E020.57.16.554 apron
N052.10.24.621 E020.57.16.554 N052.10.24.811 E020.57.15.881 apron
N052.10.24.811 E020.57.15.881 N052.10.24.594 E020.57.14.880 apron
N052.10.24.594 E020.57.14.880 N052.10.26.060 E020.57.09.933 apron
N052.10.26.060 E020.57.09.933 N052.10.22.877 E020.57.07.390 apron
N052.10.22.877 E020.57.07.390 N052.10.21.709 E020.57.11.410 apron
N052.09.13.148 E020.58.55.055 N052.09.12.503 E020.58.55.657 apron
N052.09.12.503 E020.58.55.657 N052.09.12.445 E020.58.56.217 apron
N052.09.12.445 E020.58.56.217 N052.09.14.259 E020.59.01.744 apron
N052.09.14.259 E020.59.01.744 N052.09.06.646 E020.59.08.452 apron
N052.09.06.646 E020.59.08.452 N052.09.04.828 E020.59.02.944 apron
N052.09.04.828 E020.59.02.944 N052.09.04.323 E020.59.02.858 apron
N052.09.04.323 E020.59.02.858 N052.09.03.813 E020.59.02.903 apron
N052.09.05.342 E020.59.01.653 N052.09.05.352 E020.59.01.644 apron
N052.09.20.662 E020.58.48.859 N052.09.22.493 E020.58.54.415 apron
N052.09.22.493 E020.58.54.415 N052.09.16.573 E020.58.59.570 apron
N052.09.16.573 E020.58.59.570 N052.09.14.987 E020.58.54.747 apron
N052.09.14.987 E020.58.54.747 N052.09.14.707 E020.58.54.318 apron
N052.09.14.707 E020.58.54.318 N052.09.13.148 E020.58.55.055 apron
N052.09.15.606 E020.58.52.687 N052.09.15.606 E020.58.52.687 apron
N052.10.32.479 E020.57.59.598 N052.10.31.537 E020.57.56.921 apron
N052.10.31.216 E020.57.56.003 N052.10.31.216 E020.57.56.003 apron
N052.09.03.813 E020.59.02.903 N052.09.03.189 E020.59.03.167 apron
N052.10.26.367 E020.57.51.051 N052.10.26.365 E020.57.51.052 apron
N052.10.24.798 E020.57.52.407 N052.10.24.798 E020.57.52.408 apron
N052.10.14.528 E020.58.01.290 N052.10.14.526 E020.58.01.292 apron
N052.10.13.509 E020.58.02.172 N052.10.13.508 E020.58.02.173 apron
N052.10.12.189 E020.58.03.313 N052.10.12.188 E020.58.03.315 apron
N052.10.10.157 E020.58.05.071 N052.10.10.154 E020.58.05.073 apron
N052.10.33.239 E020.57.55.015 N052.10.33.239 E020.57.55.015 apron
N052.10.37.742 E020.57.51.081 N052.10.37.743 E020.57.51.080 apron
N052.10.42.483 E020.57.45.193 N052.10.42.483 E020.57.45.193 apron
N052.10.41.870 E020.57.43.312 N052.10.41.870 E020.57.43.312 apron
N052.10.41.265 E020.57.41.456 N052.10.41.265 E020.57.41.455 apron
N052.10.37.248 E020.57.41.538 N052.10.37.247 E020.57.41.539 apron
N052.10.35.192 E020.57.43.302 N052.10.35.189 E020.57.43.304 apron
N052.09.58.375 E020.58.15.297 N052.09.58.370 E020.58.15.302 apron
N052.09.58.091 E020.58.15.559 N052.09.58.089 E020.58.15.561 apron
N052.09.55.517 E020.58.31.388 N052.09.57.775 E020.58.32.591 apron
N052.09.57.775 E020.58.32.591 N052.09.58.621 E020.58.32.790 apron
N052.09.58.621 E020.58.32.790 N052.09.59.752 E020.58.32.728 apron
N052.09.59.752 E020.58.32.728 N052.10.02.253 E020.58.27.998 apron
N052.10.02.253 E020.58.27.998 N052.10.06.904 E020.58.23.911 apron
N052.10.06.904 E020.58.23.911 N052.10.06.950 E020.58.24.050 apron
N052.10.05.776 E020.58.08.804 N052.10.05.773 E020.58.08.806 apron
N052.09.45.289 E020.58.59.389 N052.09.45.280 E020.58.59.401 apron
N052.09.45.137 E020.58.59.650 N052.09.48.665 E020.58.59.426 apron
N052.09.48.665 E020.58.59.426 N052.09.50.416 E020.59.00.709 apron
N052.09.50.416 E020.59.00.709 N052.09.52.504 E020.58.53.385 apron
N052.09.52.504 E020.58.53.385 N052.09.50.851 E020.58.52.146 apron
N052.09.50.851 E020.58.52.146 N052.09.50.447 E020.58.51.126 apron
N052.09.50.447 E020.58.51.126 N052.09.50.311 E020.58.49.982 apron
N052.09.49.677 E020.58.51.865 N052.09.49.675 E020.58.51.872 apron
N052.10.32.479 E020.57.59.598 N052.10.35.069 E020.57.57.694 apron
N052.10.35.069 E020.57.57.694 N052.10.38.814 E020.57.56.904 apron
N052.10.38.814 E020.57.56.904 N052.10.41.030 E020.58.02.384 apron
N052.10.41.592 E020.58.03.820 N052.10.42.103 E020.58.05.039 apron
N052.10.42.103 E020.58.05.039 N052.10.41.536 E020.58.07.645 apron
N052.10.41.536 E020.58.07.645 N052.10.39.076 E020.58.11.382 apron
N052.10.39.076 E020.58.11.382 N052.10.37.332 E020.58.13.228 apron
N052.10.24.037 E020.58.20.886 N052.10.24.951 E020.58.22.962 apron
N052.10.24.037 E020.58.20.886 N052.10.22.176 E020.58.15.280 apron
N052.10.22.079 E020.58.14.987 N052.10.21.589 E020.58.13.511 apron
N052.10.24.951 E020.58.22.962 N052.10.26.095 E020.58.25.326 apron
N052.10.26.095 E020.58.25.326 N052.10.37.678 E020.58.22.468 apron
N052.10.37.678 E020.58.22.468 N052.10.40.074 E020.58.19.943 apron
N052.10.40.074 E020.58.19.943 N052.10.37.332 E020.58.13.228 apron
N052.10.41.569 E020.57.37.811 N052.10.42.034 E020.57.39.256 apron
N052.10.42.034 E020.57.39.256 N052.10.45.294 E020.57.36.416 apron
N052.10.45.153 E020.57.35.444 N052.10.45.294 E020.57.36.415 apron
N052.10.43.989 E020.57.48.716 N052.10.43.989 E020.57.48.715 apron
N052.10.43.549 E020.57.47.375 N052.10.43.548 E020.57.47.371 apron
N052.10.42.755 E020.57.44.955 N052.10.42.755 E020.57.44.954 apron
N052.10.42.139 E020.57.43.077 N052.10.42.139 E020.57.43.077 apron
N052.10.41.531 E020.57.41.224 N052.10.41.530 E020.57.41.221 apron
N052.10.45.807 E020.57.29.063 N052.10.47.223 E020.57.27.830 apron
N052.10.47.223 E020.57.27.830 N052.10.47.980 E020.57.30.143 apron
N052.10.47.980 E020.57.30.143 N052.10.47.996 E020.57.31.565 apron
N052.10.47.996 E020.57.31.565 N052.10.48.535 E020.57.35.437 apron
N052.10.48.535 E020.57.35.437 N052.10.49.446 E020.57.35.096 apron
N052.10.49.446 E020.57.35.096 N052.10.50.002 E020.57.39.124 apron
N052.10.50.002 E020.57.39.124 N052.10.50.900 E020.57.46.167 apron
N052.10.50.900 E020.57.46.167 N052.10.49.380 E020.57.46.678 apron
N052.10.49.380 E020.57.46.678 N052.10.47.848 E020.57.50.628 apron
N052.10.47.848 E020.57.50.628 N052.10.47.357 E020.57.51.841 apron
N052.10.47.357 E020.57.51.841 N052.10.47.048 E020.57.49.541 apron
N052.10.45.153 E020.57.35.444 N052.10.44.786 E020.57.34.969 apron
N052.09.34.794 E020.58.57.116 N052.09.33.571 E020.58.55.657 apron
N052.09.33.571 E020.58.55.657 N052.09.34.982 E020.58.50.588 apron
N052.09.34.982 E020.58.50.588 N052.09.35.008 E020.58.49.714 apron
N052.09.35.008 E020.58.49.714 N052.09.34.717 E020.58.48.914 apron
N052.09.34.717 E020.58.48.914 N052.09.32.196 E020.58.45.607 apron
N052.09.32.196 E020.58.45.607 N052.09.30.623 E020.58.42.937 apron
N052.09.30.623 E020.58.42.937 N052.09.30.246 E020.58.41.793 apron
N052.09.30.246 E020.58.41.793 N052.09.30.300 E020.58.40.739 apron
N052.09.30.300 E020.58.40.739 N052.09.32.212 E020.58.38.259 apron
N052.09.24.735 E020.58.44.765 N052.09.24.940 E020.58.45.179 apron
N052.09.24.940 E020.58.45.179 N052.09.26.596 E020.58.44.305 apron
N052.09.26.596 E020.58.44.305 N052.09.26.793 E020.58.44.880 apron
N052.09.26.793 E020.58.44.880 N052.09.24.906 E020.58.46.882 apron
N052.09.24.906 E020.58.46.882 N052.09.25.733 E020.58.48.911 apron
N052.09.25.733 E020.58.48.911 N052.09.25.440 E020.58.49.239 apron
N052.09.25.440 E020.58.49.239 N052.09.24.693 E020.58.48.995 apron
N052.09.24.693 E020.58.48.995 N052.09.24.554 E020.58.49.472 apron
N052.09.27.736 E020.58.51.884 N052.09.27.738 E020.58.51.885 apron
N052.09.31.317 E020.58.54.564 N052.09.31.318 E020.58.54.564 apron
N052.09.32.593 E020.58.55.519 N052.09.32.594 E020.58.55.519 apron
N052.10.42.053 E020.57.20.042 N052.10.41.750 E020.57.19.610 apron
N052.10.41.750 E020.57.19.610 N052.10.33.790 E020.57.10.920 apron
N052.10.33.790 E020.57.10.920 N052.10.33.590 E020.57.11.400 apron
N052.10.33.590 E020.57.11.400 N052.10.41.010 E020.57.19.520 apron
N052.10.41.010 E020.57.19.520 N052.10.41.230 E020.57.19.830 apron
N052.10.41.230 E020.57.19.830 N052.10.41.220 E020.57.20.390 apron
N052.10.41.220 E020.57.20.390 N052.10.41.178 E020.57.20.809 apron
N052.10.34.090 E020.57.11.580 N052.10.41.290 E020.57.19.440 olive
N052.10.41.290 E020.57.19.440 N052.10.41.931 E020.57.20.149 olive
N052.10.41.290 E020.57.19.440 N052.10.41.490 E020.57.19.790 olive
N052.10.41.490 E020.57.19.790 N052.10.41.670 E020.57.20.240 olive
N052.10.41.670 E020.57.20.240 N052.10.41.689 E020.57.20.362 olive
N052.10.48.060 E020.57.47.795 N052.10.47.659 E020.57.48.396 olive
N052.10.48.534 E020.57.46.464 N052.10.48.060 E020.57.47.795 olive
N052.10.48.598 E020.57.45.570 N052.10.48.534 E020.57.46.464 olive
N052.10.45.918 E020.57.31.004 N052.10.47.142 E020.57.34.444 olive
N052.10.16.068 E020.57.59.085 N052.10.17.852 E020.58.04.513 olive
N052.09.39.650 E020.58.30.874 N052.09.47.015 E020.58.24.470 olive
N052.09.50.223 E020.58.21.650 N052.09.47.015 E020.58.24.470 olive
N052.10.43.364 E020.57.35.313 N052.10.45.521 E020.57.33.402 olive
N052.10.14.757 E020.56.46.915 N052.10.12.968 E020.56.45.580 olive
N052.10.44.387 E020.57.51.309 N052.10.47.659 E020.57.48.396 olive
N052.09.41.983 E020.59.02.264 N052.09.41.323 E020.59.02.608 olive
N052.10.10.475 E020.56.47.183 N052.10.03.325 E020.57.12.612 olive
N052.09.53.504 E020.58.18.781 N052.09.55.699 E020.58.16.881 olive
N052.08.55.879 E020.58.40.364 N052.09.01.859 E020.58.35.156 olive
N052.09.55.699 E020.58.16.881 N052.09.57.892 E020.58.14.962 olive
N052.09.44.554 E020.58.56.412 N052.09.44.462 E020.58.55.535 olive
N052.09.45.463 E020.58.57.584 N052.09.46.210 E020.58.57.379 olive
N052.09.48.488 E020.58.10.528 N052.09.49.426 E020.58.13.361 olive
N052.09.49.426 E020.58.13.361 N052.09.50.007 E020.58.15.114 olive
N052.10.15.123 E020.57.56.206 N052.10.13.671 E020.57.51.806 olive
N052.10.13.671 E020.57.51.806 N052.10.13.152 E020.57.50.245 olive
N052.10.11.000 E020.57.54.419 N052.10.09.671 E020.57.54.365 olive
N052.10.09.671 E020.57.54.365 N052.10.07.243 E020.57.54.545 olive
N052.10.11.000 E020.57.54.419 N052.10.13.466 E020.57.54.543 olive
N052.10.13.466 E020.57.54.543 N052.10.14.374 E020.57.54.975 olive
N052.10.26.444 E020.57.46.806 N052.10.25.923 E020.57.45.708 olive
N052.10.25.923 E020.57.45.708 N052.10.25.152 E020.57.45.058 olive
N052.10.25.152 E020.57.45.058 N052.10.24.479 E020.57.44.937 olive
N052.10.20.397 E020.57.44.762 N052.10.18.527 E020.57.44.886 olive
N052.10.23.759 E020.57.32.175 N052.10.20.388 E020.57.29.526 olive
N052.10.27.400 E020.57.38.426 N052.10.25.717 E020.57.38.601 olive
N052.10.44.072 E020.57.25.728 N052.10.43.498 E020.57.24.051 olive
N052.10.43.498 E020.57.24.051 N052.10.42.782 E020.57.23.003 olive
N052.10.44.072 E020.57.25.728 N052.10.45.918 E020.57.31.004 olive
N052.09.58.175 E020.58.14.713 N052.09.57.892 E020.58.14.962 olive
N052.08.55.277 E020.58.41.296 N052.08.55.879 E020.58.40.364 olive
N052.08.55.165 E020.58.44.568 N052.08.54.953 E020.58.42.678 olive
N052.08.54.953 E020.58.42.678 N052.08.55.277 E020.58.41.296 olive
N052.09.01.859 E020.58.35.156 N052.09.11.967 E020.58.26.332 olive
N052.09.13.617 E020.58.26.258 N052.09.14.578 E020.58.27.607 olive
N052.09.11.967 E020.58.26.332 N052.09.12.816 E020.58.26.006 olive
N052.09.12.816 E020.58.26.006 N052.09.13.617 E020.58.26.258 olive
N052.09.14.578 E020.58.27.607 N052.09.16.886 E020.58.34.616 olive
N052.09.00.673 E020.58.37.102 N052.08.56.935 E020.58.46.837 olive
N052.09.01.859 E020.58.35.156 N052.09.01.071 E020.58.36.271 olive
N052.09.01.071 E020.58.36.271 N052.09.00.673 E020.58.37.102 olive
N052.08.56.935 E020.58.46.837 N052.08.56.694 E020.58.48.005 olive
N052.08.55.165 E020.58.44.568 N052.08.56.832 E020.58.49.606 olive
N052.08.56.832 E020.58.49.606 N052.08.56.991 E020.58.50.105 olive
N052.08.56.694 E020.58.48.005 N052.08.56.832 E020.58.49.606 olive
N052.08.56.991 E020.58.50.105 N052.08.57.264 E020.58.50.878 olive
N052.08.57.264 E020.58.50.878 N052.08.57.751 E020.58.51.371 olive
N052.09.18.846 E020.58.40.560 N052.09.18.764 E020.58.40.303 olive
N052.09.17.806 E020.58.37.407 N052.09.18.764 E020.58.40.303 olive
N052.09.18.846 E020.58.40.560 N052.09.20.142 E020.58.44.490 olive
N052.09.20.396 E020.58.42.010 N052.09.19.552 E020.58.41.603 olive
N052.09.19.552 E020.58.41.603 N052.09.18.846 E020.58.40.560 olive
N052.09.25.856 E020.58.41.952 N052.09.20.396 E020.58.42.010 olive
N052.09.27.658 E020.58.41.301 N052.09.26.559 E020.58.41.827 olive
N052.09.26.559 E020.58.41.827 N052.09.25.856 E020.58.41.952 olive
N052.09.20.106 E020.58.47.250 N052.09.19.481 E020.58.48.480 olive
N052.09.20.142 E020.58.44.490 N052.09.20.314 E020.58.45.971 olive
N052.09.20.314 E020.58.45.971 N052.09.20.106 E020.58.47.250 olive
N052.08.59.609 E020.58.54.766 N052.08.59.458 E020.58.53.473 olive
N052.09.01.635 E020.59.00.918 N052.09.00.212 E020.58.56.597 olive
N052.09.00.212 E020.58.56.597 N052.08.59.609 E020.58.54.766 olive
N052.09.02.343 E020.59.02.051 N052.09.01.635 E020.59.00.918 olive
N052.09.03.843 E020.59.02.059 N052.09.03.178 E020.59.02.341 olive
N052.09.03.178 E020.59.02.341 N052.09.02.343 E020.59.02.051 olive
N052.09.21.699 E020.58.45.966 N052.09.22.596 E020.58.45.713 olive
N052.09.20.142 E020.58.44.490 N052.09.20.847 E020.58.45.557 olive
N052.09.20.847 E020.58.45.557 N052.09.21.699 E020.58.45.966 olive
N052.10.15.380 E020.56.47.384 N052.10.14.757 E020.56.46.915 olive
N052.10.16.271 E020.56.48.681 N052.10.16.024 E020.56.48.093 olive
N052.10.16.024 E020.56.48.093 N052.10.15.380 E020.56.47.384 olive
N052.10.12.968 E020.56.45.580 N052.10.12.117 E020.56.45.366 olive
N052.10.12.117 E020.56.45.366 N052.10.11.091 E020.56.45.963 olive
N052.10.11.091 E020.56.45.963 N052.10.10.475 E020.56.47.183 olive
N052.10.03.325 E020.57.12.612 N052.10.03.167 E020.57.14.305 olive
N052.10.03.167 E020.57.14.305 N052.10.03.547 E020.57.15.860 olive
N052.10.03.547 E020.57.15.860 N052.10.04.200 E020.57.16.793 olive
N052.10.31.963 E020.57.38.629 N052.10.30.516 E020.57.37.491 olive
N052.10.30.516 E020.57.37.491 N052.10.28.261 E020.57.35.717 olive
N052.10.23.759 E020.57.32.175 N052.10.26.097 E020.57.34.014 olive
N052.10.34.674 E020.57.40.764 N052.10.35.771 E020.57.41.199 olive
N052.10.35.771 E020.57.41.199 N052.10.37.023 E020.57.40.859 olive
N052.10.31.963 E020.57.38.629 N052.10.31.018 E020.57.38.324 olive
N052.10.31.018 E020.57.38.324 N052.10.27.400 E020.57.38.426 olive
N052.10.25.717 E020.57.38.601 N052.10.24.889 E020.57.38.670 olive
N052.10.18.527 E020.57.44.886 N052.10.17.453 E020.57.45.181 olive
N052.10.13.152 E020.57.50.245 N052.10.12.664 E020.57.49.375 olive
N052.10.14.374 E020.57.54.975 N052.10.15.123 E020.57.56.206 olive
N052.10.07.243 E020.57.54.545 N052.10.06.542 E020.57.54.735 olive
N052.10.34.674 E020.57.40.764 N052.10.31.963 E020.57.38.629 olive
N052.10.45.909 E020.57.32.722 N052.10.45.521 E020.57.33.402 olive
N052.10.45.918 E020.57.31.004 N052.10.46.039 E020.57.32.050 olive
N052.10.46.039 E020.57.32.050 N052.10.45.909 E020.57.32.722 olive
N052.10.44.072 E020.57.25.728 N052.10.44.311 E020.57.26.984 olive
N052.10.44.311 E020.57.26.984 N052.10.44.143 E020.57.28.722 olive
N052.10.44.143 E020.57.28.722 N052.10.41.158 E020.57.36.163 olive
N052.10.41.158 E020.57.36.163 N052.10.40.699 E020.57.37.127 olive
N052.10.40.699 E020.57.37.127 N052.10.39.693 E020.57.38.477 olive
N052.10.31.970 E020.57.45.261 N052.10.32.719 E020.57.43.880 olive
N052.10.32.719 E020.57.43.880 N052.10.33.027 E020.57.42.536 olive
N052.10.33.027 E020.57.42.536 N052.10.32.779 E020.57.40.130 olive
N052.10.32.779 E020.57.40.130 N052.10.32.553 E020.57.39.424 olive
N052.10.32.553 E020.57.39.424 N052.10.31.963 E020.57.38.629 olive
N052.10.24.479 E020.57.44.937 N052.10.22.330 E020.57.44.845 olive
N052.10.22.330 E020.57.44.845 N052.10.20.397 E020.57.44.762 olive
N052.09.50.904 E020.58.41.041 N052.09.49.145 E020.58.39.736 olive
N052.09.49.145 E020.58.39.736 N052.09.47.652 E020.58.38.608 olive
N052.09.47.652 E020.58.38.608 N052.09.47.388 E020.58.38.118 olive
N052.09.52.520 E020.58.40.079 N052.09.51.512 E020.58.43.655 olive
N052.09.52.520 E020.58.40.079 N052.09.51.765 E020.58.41.090 olive
N052.09.51.765 E020.58.41.090 N052.09.50.904 E020.58.41.041 olive
N052.09.50.904 E020.58.41.041 N052.09.51.489 E020.58.42.096 olive
N052.09.51.489 E020.58.42.096 N052.09.51.512 E020.58.43.655 olive
N052.10.01.124 E020.58.12.149 N052.10.00.564 E020.58.12.537 olive
N052.10.00.564 E020.58.12.537 N052.09.58.175 E020.58.14.713 olive
N052.09.59.749 E020.58.14.386 N052.10.00.564 E020.58.12.537 olive
N052.09.49.300 E020.58.51.528 N052.09.48.817 E020.58.52.930 olive
N052.09.48.817 E020.58.52.930 N052.09.48.537 E020.58.53.657 olive
N052.09.47.272 E020.58.55.971 N052.09.46.730 E020.58.56.750 olive
N052.09.46.730 E020.58.56.750 N052.09.46.210 E020.58.57.379 olive
N052.09.43.493 E020.59.00.530 N052.09.41.983 E020.59.02.264 olive
N052.09.40.611 E020.59.02.302 N052.09.40.679 E020.59.02.352 olive
N052.09.39.136 E020.59.01.219 N052.09.37.132 E020.58.59.747 olive
N052.09.40.679 E020.59.02.352 N052.09.41.323 E020.59.02.608 olive
N052.09.45.463 E020.58.57.584 N052.09.44.909 E020.58.57.178 olive
N052.09.44.909 E020.58.57.178 N052.09.44.554 E020.58.56.412 olive
N052.09.44.462 E020.58.55.535 N052.09.44.374 E020.58.53.208 olive
N052.09.44.374 E020.58.53.208 N052.09.44.361 E020.58.51.063 olive
N052.09.44.361 E020.58.51.063 N052.09.44.426 E020.58.49.452 olive
N052.09.44.426 E020.58.49.452 N052.09.44.506 E020.58.48.405 olive
N052.09.23.474 E020.58.49.544 N052.09.21.719 E020.58.48.248 olive
N052.09.21.719 E020.58.48.248 N052.09.21.359 E020.58.47.852 olive
N052.09.21.359 E020.58.47.852 N052.09.21.032 E020.58.47.176 olive
N052.09.21.032 E020.58.47.176 N052.09.20.142 E020.58.44.490 olive
N052.09.22.596 E020.58.45.713 N052.09.23.343 E020.58.45.070 olive
N052.09.22.661 E020.58.47.691 N052.09.22.712 E020.58.46.425 olive
N052.09.22.712 E020.58.46.425 N052.09.23.343 E020.58.45.070 olive
N052.09.23.474 E020.58.49.544 N052.09.22.911 E020.58.48.744 olive
N052.09.22.911 E020.58.48.744 N052.09.22.661 E020.58.47.691 olive
N052.09.57.007 E020.58.24.163 N052.09.56.475 E020.58.24.873 olive
N052.09.56.475 E020.58.24.873 N052.09.55.563 E020.58.24.942 olive
N052.09.55.563 E020.58.24.942 N052.09.56.154 E020.58.26.015 olive
N052.09.57.007 E020.58.24.163 N052.09.56.219 E020.58.26.970 olive
N052.09.56.154 E020.58.26.015 N052.09.56.219 E020.58.26.970 olive
N052.09.55.563 E020.58.24.942 N052.09.55.283 E020.58.24.729 olive
N052.09.55.283 E020.58.24.729 N052.09.55.017 E020.58.24.356 olive
N052.09.55.017 E020.58.24.356 N052.09.54.814 E020.58.23.888 olive
N052.09.54.814 E020.58.23.888 N052.09.54.672 E020.58.23.109 olive
N052.09.54.672 E020.58.23.109 N052.09.54.539 E020.58.20.658 olive
N052.09.54.539 E020.58.20.658 N052.09.54.468 E020.58.19.248 olive
N052.09.54.468 E020.58.19.248 N052.09.54.388 E020.58.17.502 olive
N052.09.54.388 E020.58.17.502 N052.09.54.374 E020.58.15.917 olive
N052.09.54.374 E020.58.15.917 N052.09.54.405 E020.58.14.626 olive
N052.09.54.405 E020.58.14.626 N052.09.54.516 E020.58.12.675 olive
N052.10.11.059 E020.57.22.189 N052.10.19.461 E020.57.28.796 olive
N052.10.19.461 E020.57.28.796 N052.10.20.388 E020.57.29.526 olive
N052.10.20.177 E020.57.28.364 N052.10.24.457 E020.57.13.993 olive
N052.10.20.388 E020.57.29.526 N052.10.20.161 E020.57.28.976 olive
N052.10.20.161 E020.57.28.976 N052.10.20.177 E020.57.28.364 olive
N052.10.20.177 E020.57.28.364 N052.10.19.880 E020.57.28.762 olive
N052.10.19.880 E020.57.28.762 N052.10.19.461 E020.57.28.796 olive
N052.09.50.007 E020.58.15.114 N052.09.51.113 E020.58.18.472 olive
N052.09.53.506 E020.58.18.776 N052.09.52.581 E020.58.19.579 olive
N052.10.41.255 E020.58.03.219 N052.10.42.142 E020.58.01.381 olive
N052.10.42.142 E020.58.01.381 N052.10.44.160 E020.57.52.290 olive
N052.10.44.160 E020.57.52.290 N052.10.44.387 E020.57.51.309 olive
N052.09.57.851 E020.58.21.173 N052.09.58.322 E020.58.20.550 olive
N052.09.58.322 E020.58.20.550 N052.09.58.642 E020.58.20.453 olive
N052.10.02.076 E020.58.20.904 N052.10.02.901 E020.58.20.651 olive
N052.10.07.630 E020.58.16.523 N052.10.08.101 E020.58.15.674 olive
N052.10.08.339 E020.58.14.832 N052.10.08.738 E020.58.14.158 olive
N052.10.17.852 E020.58.04.513 N052.10.17.876 E020.58.05.662 olive
N052.10.17.876 E020.58.05.662 N052.10.17.496 E020.58.06.439 olive
N052.10.17.852 E020.58.04.513 N052.10.18.438 E020.58.05.165 olive
N052.10.18.438 E020.58.05.165 N052.10.19.030 E020.58.05.108 olive
N052.10.28.481 E020.57.56.866 N052.10.28.695 E020.57.56.674 olive
N052.10.28.695 E020.57.56.674 N052.10.29.408 E020.57.56.445 olive
N052.10.29.408 E020.57.56.445 N052.10.30.524 E020.57.56.339 olive
N052.10.30.524 E020.57.56.339 N052.10.31.203 E020.57.56.013 olive
N052.10.30.312 E020.57.56.989 N052.10.29.231 E020.57.55.222 olive
N052.10.30.681 E020.57.57.723 N052.10.30.312 E020.57.56.989 olive
N052.10.31.043 E020.57.58.711 N052.10.30.681 E020.57.57.723 olive
N052.10.35.634 E020.58.10.664 N052.10.34.371 E020.58.07.531 olive
N052.10.34.371 E020.58.07.531 N052.10.33.566 E020.58.05.519 olive
N052.10.33.852 E020.58.10.698 N052.10.35.259 E020.58.09.458 olive
N052.10.34.371 E020.58.07.531 N052.10.34.556 E020.58.08.594 olive
N052.10.34.556 E020.58.08.594 N052.10.34.417 E020.58.09.684 olive
N052.10.34.417 E020.58.09.684 N052.10.33.852 E020.58.10.698 olive
N052.10.35.259 E020.58.09.458 N052.10.35.980 E020.58.08.783 olive
N052.10.35.980 E020.58.08.783 N052.10.35.541 E020.58.09.632 olive
N052.10.35.541 E020.58.09.632 N052.10.35.634 E020.58.10.664 olive
N052.10.30.312 E020.57.56.989 N052.10.29.408 E020.57.56.445 olive
N052.10.28.481 E020.57.56.866 N052.10.28.811 E020.57.56.272 olive
N052.10.28.811 E020.57.56.272 N052.10.29.011 E020.57.55.385 olive
N052.10.28.916 E020.57.54.292 N052.10.29.231 E020.57.55.222 olive
N052.10.29.011 E020.57.55.385 N052.10.28.916 E020.57.54.292 olive
N052.10.31.043 E020.57.58.711 N052.10.30.888 E020.57.57.424 olive
N052.10.30.888 E020.57.57.424 N052.10.31.042 E020.57.56.594 olive
N052.10.31.042 E020.57.56.594 N052.10.31.543 E020.57.55.765 olive
N052.10.31.203 E020.57.56.013 N052.10.31.543 E020.57.55.765 olive
N052.10.27.910 E020.57.51.206 N052.10.28.916 E020.57.54.292 olive
N052.10.27.910 E020.57.51.206 N052.10.27.244 E020.57.50.333 olive
N052.10.27.244 E020.57.50.333 N052.10.26.761 E020.57.50.172 olive
N052.10.26.761 E020.57.50.172 N052.10.26.139 E020.57.50.361 olive
N052.10.27.910 E020.57.51.206 N052.10.27.843 E020.57.49.722 olive
N052.10.27.843 E020.57.49.722 N052.10.28.031 E020.57.49.023 olive
N052.10.28.031 E020.57.49.023 N052.10.28.412 E020.57.48.371 olive
N052.10.28.412 E020.57.48.371 N052.10.26.139 E020.57.50.361 olive
N052.10.26.444 E020.57.46.806 N052.10.27.910 E020.57.51.206 olive
N052.10.26.444 E020.57.46.806 N052.10.26.609 E020.57.48.116 olive
N052.10.27.028 E020.57.47.726 N052.10.26.444 E020.57.46.806 olive
N052.10.27.028 E020.57.47.726 N052.10.27.745 E020.57.48.193 olive
N052.10.26.609 E020.57.48.116 N052.10.26.428 E020.57.49.401 olive
N052.10.26.139 E020.57.50.361 N052.10.25.748 E020.57.50.700 olive
N052.10.26.428 E020.57.49.401 N052.10.25.748 E020.57.50.700 olive
N052.10.28.876 E020.57.47.963 N052.10.28.412 E020.57.48.371 olive
N052.10.27.745 E020.57.48.193 N052.10.28.876 E020.57.47.963 olive
N052.10.24.360 E020.58.19.055 N052.10.23.255 E020.58.15.735 sch
N052.10.25.490 E020.58.18.055 N052.10.24.360 E020.58.19.055 olive
N052.10.25.490 E020.58.18.055 N052.10.24.398 E020.58.14.740 sch
N052.10.26.638 E020.58.17.053 N052.10.25.490 E020.58.18.055 olive
N052.10.26.638 E020.58.17.053 N052.10.25.587 E020.58.13.862 sch
N052.10.27.775 E020.58.16.049 N052.10.26.638 E020.58.17.053 olive
N052.10.27.775 E020.58.16.049 N052.10.26.724 E020.58.12.862 nonsch
N052.10.29.167 E020.58.14.819 N052.10.27.775 E020.58.16.049 olive
N052.10.29.167 E020.58.14.819 N052.10.27.995 E020.58.11.264 nonsch
N052.10.30.353 E020.58.13.784 N052.10.29.167 E020.58.14.819 olive
N052.10.30.353 E020.58.13.784 N052.10.29.024 E020.58.09.761 nonsch
N052.10.31.513 E020.58.12.779 N052.10.30.353 E020.58.13.784 olive
N052.10.31.513 E020.58.12.779 N052.10.30.343 E020.58.09.241 nonsch
N052.10.33.852 E020.58.10.698 N052.10.32.662 E020.58.11.752 olive
N052.10.32.662 E020.58.11.752 N052.10.31.513 E020.58.12.779 olive
N052.10.32.662 E020.58.11.752 N052.10.31.454 E020.58.08.108 olive
N052.10.48.390 E020.57.43.928 N052.10.48.598 E020.57.45.570 olive
N052.10.33.566 E020.58.05.519 N052.10.33.432 E020.58.05.155 olive
N052.10.33.432 E020.58.05.155 N052.10.32.539 E020.58.05.324 olive
N052.10.32.539 E020.58.05.324 N052.10.30.092 E020.58.05.760 nonsch
N052.10.32.539 E020.58.05.324 N052.10.32.829 E020.58.03.528 olive
N052.10.24.572 E020.57.51.716 N052.10.23.261 E020.57.52.853 olive
N052.10.24.346 E020.58.00.482 N052.10.25.457 E020.57.59.503 olive
N052.10.23.261 E020.57.52.853 N052.10.22.242 E020.57.53.735 olive
N052.10.23.414 E020.58.01.277 N052.10.24.346 E020.58.00.482 olive
N052.10.22.242 E020.57.53.735 N052.10.21.226 E020.57.54.627 olive
N052.10.21.226 E020.57.54.627 N052.10.20.205 E020.57.55.504 olive
N052.10.20.205 E020.57.55.504 N052.10.18.889 E020.57.56.650 olive
N052.10.18.889 E020.57.56.650 N052.10.17.873 E020.57.57.549 olive
N052.10.17.873 E020.57.57.549 N052.10.16.068 E020.57.59.085 olive
N052.10.26.788 E020.58.00.182 N052.10.26.634 E020.58.03.300 nonsch
N052.10.26.788 E020.58.00.182 N052.10.26.847 E020.57.58.977 nonsch
N052.10.26.776 E020.57.58.353 N052.10.27.214 E020.57.57.970 olive
N052.10.26.847 E020.57.58.977 N052.10.27.214 E020.57.57.970 nonsch
N052.10.25.457 E020.57.59.503 N052.10.25.731 E020.57.59.257 olive
N052.10.25.731 E020.57.59.257 N052.10.26.776 E020.57.58.353 olive
N052.10.26.788 E020.58.00.182 N052.10.25.731 E020.57.59.257 nonsch
N052.10.17.496 E020.58.06.439 N052.10.18.074 E020.58.05.953 olive
N052.10.18.074 E020.58.05.953 N052.10.19.030 E020.58.05.108 olive
N052.10.20.074 E020.58.04.198 N052.10.20.325 E020.58.03.992 olive
N052.10.21.094 E020.58.03.316 N052.10.22.416 E020.58.02.155 olive
N052.10.22.416 E020.58.02.155 N052.10.22.581 E020.58.02.011 olive
N052.10.22.581 E020.58.02.011 N052.10.23.414 E020.58.01.277 olive
N052.10.22.581 E020.58.02.011 N052.10.23.989 E020.58.06.317 nonsch
N052.10.24.346 E020.58.00.482 N052.10.25.736 E020.58.04.774 nonsch
N052.10.30.727 E020.58.00.276 N052.10.28.907 E020.58.03.089 nonsch
N052.10.30.727 E020.58.00.276 N052.10.31.081 E020.57.59.437 olive
N052.10.31.081 E020.57.59.437 N052.10.31.043 E020.57.58.711 olive
N052.10.30.727 E020.58.00.276 N052.10.31.270 E020.58.00.087 olive
N052.10.32.829 E020.58.03.528 N052.10.31.690 E020.58.00.462 olive
N052.10.31.690 E020.58.00.462 N052.10.31.043 E020.57.58.711 olive
N052.10.31.270 E020.58.00.087 N052.10.31.690 E020.58.00.462 olive
N052.10.19.030 E020.58.05.108 N052.10.19.815 E020.58.04.425 olive
N052.10.19.815 E020.58.04.425 N052.10.20.074 E020.58.04.198 olive
N052.10.19.815 E020.58.04.425 N052.10.21.386 E020.58.09.212 nonsch
N052.10.20.325 E020.58.03.992 N052.10.20.920 E020.58.03.469 olive
N052.10.20.920 E020.58.03.469 N052.10.21.094 E020.58.03.316 olive
N052.10.20.920 E020.58.03.469 N052.10.22.243 E020.58.07.371 nonsch
N052.10.18.074 E020.58.05.953 N052.10.19.483 E020.58.10.231 nonsch
N052.10.14.931 E020.58.11.721 N052.10.15.382 E020.58.14.320 sch
N052.10.04.824 E020.58.18.984 N052.10.05.397 E020.58.23.458 sch
N052.10.04.824 E020.58.18.984 N052.10.05.829 E020.58.18.101 olive
N052.10.05.829 E020.58.18.101 N052.10.06.435 E020.58.22.142 sch
N052.10.05.829 E020.58.18.101 N052.10.06.943 E020.58.17.125 olive
N052.10.06.943 E020.58.17.125 N052.10.07.630 E020.58.16.523 olive
N052.10.06.943 E020.58.17.125 N052.10.07.571 E020.58.20.972 sch
N052.10.08.101 E020.58.15.674 N052.10.08.178 E020.58.15.432 olive
N052.10.08.178 E020.58.15.432 N052.10.08.339 E020.58.14.832 olive
N052.10.08.178 E020.58.15.432 N052.10.08.864 E020.58.20.049 sch
N052.10.09.528 E020.58.15.281 N052.10.10.397 E020.58.18.741 sch
N052.10.08.738 E020.58.14.158 N052.10.09.060 E020.58.13.873 olive
N052.10.09.528 E020.58.15.281 N052.10.09.060 E020.58.13.873 sch
N052.10.11.115 E020.58.13.417 N052.10.12.010 E020.58.17.230 sch
N052.10.10.774 E020.58.12.362 N052.10.11.115 E020.58.13.417 sch
N052.10.12.968 E020.58.12.418 N052.10.13.710 E020.58.15.775 sch
N052.10.12.968 E020.58.12.418 N052.10.12.458 E020.58.10.876 sch
N052.10.14.158 E020.58.09.376 N052.10.15.856 E020.58.07.877 olive
N052.10.14.931 E020.58.11.721 N052.10.14.158 E020.58.09.376 sch
N052.09.56.219 E020.58.26.970 N052.09.55.679 E020.58.28.891 olive
N052.09.55.679 E020.58.28.891 N052.09.52.520 E020.58.40.079 olive
N052.09.55.679 E020.58.28.891 N052.09.58.289 E020.58.30.824 olive
N052.09.56.219 E020.58.26.970 N052.09.58.834 E020.58.28.894 olive
N052.09.57.007 E020.58.24.163 N052.09.57.172 E020.58.23.574 olive
N052.09.57.172 E020.58.23.574 N052.09.57.851 E020.58.21.173 olive
N052.09.57.172 E020.58.23.574 N052.09.59.609 E020.58.25.388 olive
N052.09.59.450 E020.58.15.473 N052.09.59.749 E020.58.14.386 olive
N052.09.59.450 E020.58.15.473 N052.10.02.074 E020.58.16.768 olive
N052.09.58.642 E020.58.20.453 N052.09.59.303 E020.58.20.542 olive
N052.09.59.303 E020.58.20.542 N052.09.58.842 E020.58.20.117 olive
N052.09.58.842 E020.58.20.117 N052.09.58.621 E020.58.19.578 olive
N052.09.57.851 E020.58.21.173 N052.09.58.602 E020.58.18.506 olive
N052.09.58.602 E020.58.18.506 N052.09.59.450 E020.58.15.473 olive
N052.09.58.621 E020.58.19.578 N052.09.58.602 E020.58.18.506 olive
N052.10.01.124 E020.58.12.149 N052.10.05.141 E020.58.14.145 olive
N052.10.06.607 E020.58.07.366 N052.10.05.595 E020.58.08.263 olive
N052.10.05.595 E020.58.08.263 N052.10.01.124 E020.58.12.149 olive
N052.10.05.595 E020.58.08.263 N052.10.06.750 E020.58.11.749 olive
N052.10.06.607 E020.58.07.366 N052.10.07.755 E020.58.10.878 olive
N052.10.08.637 E020.58.05.604 N052.10.07.625 E020.58.06.497 olive
N052.10.07.625 E020.58.06.497 N052.10.06.607 E020.58.07.366 olive
N052.10.07.625 E020.58.06.497 N052.10.08.779 E020.58.09.980 olive
N052.10.08.637 E020.58.05.604 N052.10.09.786 E020.58.09.106 olive
N052.10.09.955 E020.58.04.462 N052.10.08.637 E020.58.05.604 olive
N052.10.09.955 E020.58.04.462 N052.10.11.110 E020.58.07.959 olive
N052.10.10.964 E020.58.03.570 N052.10.09.955 E020.58.04.462 olive
N052.10.10.964 E020.58.03.570 N052.10.12.120 E020.58.07.082 olive
N052.10.11.985 E020.58.02.690 N052.10.10.964 E020.58.03.570 olive
N052.10.11.985 E020.58.02.690 N052.10.13.144 E020.58.06.193 olive
N052.10.13.301 E020.58.01.542 N052.10.11.985 E020.58.02.690 olive
N052.10.13.301 E020.58.01.542 N052.10.14.458 E020.58.05.044 olive
N052.10.16.068 E020.57.59.085 N052.10.14.313 E020.58.00.651 olive
N052.10.14.313 E020.58.00.651 N052.10.13.301 E020.58.01.542 olive
N052.10.14.313 E020.58.00.651 N052.10.15.470 E020.58.04.161 olive
N052.10.14.313 E020.58.00.651 N052.10.15.128 E020.57.59.358 olive
N052.10.15.128 E020.57.59.358 N052.10.15.378 E020.57.57.829 olive
N052.10.16.068 E020.57.59.085 N052.10.15.240 E020.57.56.576 olive
N052.10.15.240 E020.57.56.576 N052.10.15.123 E020.57.56.206 olive
N052.10.15.378 E020.57.57.829 N052.10.15.240 E020.57.56.576 olive
N052.10.18.889 E020.57.56.650 N052.10.19.925 E020.57.59.791 olive
N052.10.20.205 E020.57.55.504 N052.10.21.243 E020.57.58.642 olive
N052.10.17.873 E020.57.57.549 N052.10.18.901 E020.58.00.684 olive
N052.10.21.226 E020.57.54.627 N052.10.22.257 E020.57.57.759 olive
N052.10.22.242 E020.57.53.735 N052.10.23.273 E020.57.56.872 olive
N052.10.23.261 E020.57.52.853 N052.10.24.295 E020.57.55.992 olive
N052.10.24.572 E020.57.51.716 N052.10.25.605 E020.57.54.851 olive
N052.10.25.748 E020.57.50.700 N052.10.25.485 E020.57.50.919 olive
N052.10.25.485 E020.57.50.919 N052.10.24.572 E020.57.51.716 olive
N052.10.25.485 E020.57.50.919 N052.10.26.520 E020.57.54.046 olive
N052.10.27.214 E020.57.57.970 N052.10.27.678 E020.57.57.551 olive
N052.10.27.678 E020.57.57.551 N052.10.28.481 E020.57.56.866 olive
N052.10.27.678 E020.57.57.551 N052.10.26.520 E020.57.54.046 olive
N052.10.26.776 E020.57.58.353 N052.10.25.605 E020.57.54.851 olive
N052.10.25.457 E020.57.59.503 N052.10.24.295 E020.57.55.992 olive
N052.10.23.414 E020.58.01.277 N052.10.22.257 E020.57.57.759 olive
N052.10.24.346 E020.58.00.482 N052.10.23.273 E020.57.56.872 olive
N052.10.22.416 E020.58.02.155 N052.10.21.243 E020.57.58.642 olive
N052.10.20.074 E020.58.04.198 N052.10.18.901 E020.58.00.684 olive
N052.10.21.094 E020.58.03.316 N052.10.19.925 E020.57.59.791 olive
N052.10.15.856 E020.58.07.877 N052.10.16.512 E020.58.07.297 olive
N052.10.16.512 E020.58.07.297 N052.10.17.496 E020.58.06.439 olive
N052.10.16.512 E020.58.07.297 N052.10.15.470 E020.58.04.161 olive
N052.10.15.499 E020.58.08.192 N052.10.14.458 E020.58.05.044 olive
N052.10.14.158 E020.58.09.376 N052.10.13.144 E020.58.06.193 olive
N052.10.12.458 E020.58.10.876 N052.10.13.174 E020.58.10.241 olive
N052.10.13.174 E020.58.10.241 N052.10.14.158 E020.58.09.376 olive
N052.10.13.174 E020.58.10.241 N052.10.12.120 E020.58.07.082 olive
N052.10.10.774 E020.58.12.362 N052.10.12.165 E020.58.11.140 olive
N052.10.12.165 E020.58.11.140 N052.10.12.458 E020.58.10.876 olive
N052.10.12.165 E020.58.11.140 N052.10.11.110 E020.58.07.959 olive
N052.10.10.774 E020.58.12.362 N052.10.09.786 E020.58.09.106 olive
N052.10.09.060 E020.58.13.873 N052.10.09.846 E020.58.13.194 olive
N052.10.09.846 E020.58.13.194 N052.10.10.774 E020.58.12.362 olive
N052.10.09.846 E020.58.13.194 N052.10.08.779 E020.58.09.980 olive
N052.10.08.738 E020.58.14.158 N052.10.07.755 E020.58.10.878 olive
N052.10.06.188 E020.58.14.695 N052.10.05.141 E020.58.14.145 olive
N052.10.06.188 E020.58.14.695 N052.10.06.494 E020.58.15.595 olive
N052.10.06.494 E020.58.15.595 N052.10.06.943 E020.58.17.125 olive
N052.10.03.176 E020.58.17.381 N052.10.02.074 E020.58.16.768 olive
N052.10.03.176 E020.58.17.381 N052.10.03.440 E020.58.18.176 olive
N052.10.02.901 E020.58.20.651 N052.10.03.950 E020.58.19.742 olive
N052.10.03.950 E020.58.19.742 N052.10.04.824 E020.58.18.984 olive
N052.10.03.440 E020.58.18.176 N052.10.03.950 E020.58.19.742 olive
N052.10.03.950 E020.58.19.742 N052.10.03.242 E020.58.20.910 olive
N052.10.03.242 E020.58.20.910 N052.10.02.359 E020.58.24.076 olive
N052.10.02.359 E020.58.24.076 N052.10.01.838 E020.58.25.923 olive
N052.10.01.838 E020.58.25.923 N052.10.00.957 E020.58.26.372 olive
N052.10.00.957 E020.58.26.372 N052.09.59.609 E020.58.25.388 olive
N052.09.59.303 E020.58.20.542 N052.10.01.202 E020.58.20.799 olive
N052.10.01.202 E020.58.20.799 N052.10.02.076 E020.58.20.904 olive
N052.10.01.202 E020.58.20.799 N052.10.02.247 E020.58.21.936 olive
N052.10.02.247 E020.58.21.936 N052.10.02.359 E020.58.24.076 olive
N052.10.35.980 E020.58.08.783 N052.10.36.998 E020.58.07.699 olive
N052.10.40.699 E020.58.03.811 N052.10.41.255 E020.58.03.219 olive
N052.10.38.250 E020.58.17.209 N052.10.38.468 E020.58.18.796 olive
N052.10.38.468 E020.58.18.796 N052.10.38.137 E020.58.20.059 olive
N052.10.38.137 E020.58.20.059 N052.10.37.233 E020.58.20.890 olive
N052.10.30.369 E020.58.22.607 N052.10.30.031 E020.58.21.741 olive
N052.10.30.031 E020.58.21.741 N052.10.30.095 E020.58.20.587 olive
N052.10.30.095 E020.58.20.587 N052.10.30.660 E020.58.19.710 olive
N052.10.30.660 E020.58.19.710 N052.10.31.436 E020.58.19.700 olive
N052.10.36.394 E020.58.15.054 N052.10.36.597 E020.58.14.043 olive
N052.10.38.250 E020.58.17.209 N052.10.36.480 E020.58.12.796 olive
N052.10.36.597 E020.58.14.043 N052.10.36.480 E020.58.12.796 olive
N052.10.30.369 E020.58.22.607 N052.10.28.164 E020.58.23.101 olive
N052.10.39.693 E020.57.38.477 N052.10.40.582 E020.57.37.766 olive
N052.10.40.582 E020.57.37.766 N052.10.43.364 E020.57.35.313 olive
N052.10.40.599 E020.57.39.820 N052.10.40.582 E020.57.37.766 olive
N052.10.40.582 E020.57.37.766 N052.10.40.699 E020.57.37.127 olive
N052.10.39.693 E020.57.38.477 N052.10.39.092 E020.57.39.060 olive
N052.10.40.599 E020.57.39.820 N052.10.39.092 E020.57.39.060 olive
N052.10.42.121 E020.57.44.433 N052.10.41.640 E020.57.46.957 olive
N052.10.41.640 E020.57.46.957 N052.10.43.195 E020.57.47.686 olive
N052.09.46.210 E020.58.57.379 N052.09.45.023 E020.58.58.799 olive
N052.09.45.023 E020.58.58.799 N052.09.43.493 E020.59.00.530 olive
N052.09.45.023 E020.58.58.799 N052.09.49.628 E020.58.58.733 olive
N052.09.48.537 E020.58.53.657 N052.09.47.933 E020.58.54.904 olive
N052.09.47.933 E020.58.54.904 N052.09.47.272 E020.58.55.971 olive
N052.09.47.933 E020.58.54.904 N052.09.50.777 E020.58.54.859 olive
N052.09.48.537 E020.58.53.657 N052.09.48.735 E020.58.55.579 olive
N052.09.48.735 E020.58.55.579 N052.09.50.597 E020.58.58.013 olive
N052.09.50.597 E020.58.58.013 N052.09.49.628 E020.58.58.733 olive
N052.09.51.297 E020.58.53.535 N052.09.50.777 E020.58.54.859 olive
N052.09.51.297 E020.58.53.535 N052.09.50.006 E020.58.52.563 olive
N052.09.51.512 E020.58.43.655 N052.09.49.551 E020.58.50.781 olive
N052.09.49.551 E020.58.50.781 N052.09.49.300 E020.58.51.528 olive
N052.09.50.006 E020.58.52.563 N052.09.49.551 E020.58.50.781 olive
N052.09.05.138 E020.59.00.994 N052.09.03.843 E020.59.02.059 olive
N052.09.05.138 E020.59.00.994 N052.09.06.789 E020.59.06.009 olive
N052.09.06.296 E020.58.59.982 N052.09.05.138 E020.59.00.994 olive
N052.09.06.296 E020.58.59.982 N052.09.07.949 E020.59.04.993 olive
N052.09.08.198 E020.58.58.316 N052.09.06.296 E020.58.59.982 olive
N052.09.08.198 E020.58.58.316 N052.09.09.710 E020.59.02.938 olive
N052.09.10.106 E020.58.56.654 N052.09.08.198 E020.58.58.316 olive
N052.09.10.106 E020.58.56.654 N052.09.11.762 E020.59.01.691 olive
N052.09.11.260 E020.58.55.640 N052.09.10.106 E020.58.56.654 olive
N052.09.11.260 E020.58.55.640 N052.09.12.921 E020.59.00.682 olive
N052.09.15.398 E020.58.52.049 N052.09.11.260 E020.58.55.640 olive
N052.09.15.398 E020.58.52.049 N052.09.16.860 E020.58.56.486 olive
N052.09.17.136 E020.58.50.537 N052.09.15.398 E020.58.52.049 olive
N052.09.17.136 E020.58.50.537 N052.09.18.586 E020.58.54.970 olive
N052.09.19.481 E020.58.48.480 N052.09.19.237 E020.58.48.691 olive
N052.09.19.237 E020.58.48.691 N052.09.17.136 E020.58.50.537 olive
N052.09.19.237 E020.58.48.691 N052.09.20.701 E020.58.53.139 olive
N052.10.44.387 E020.57.51.309 N052.10.43.637 E020.57.49.023 olive
N052.10.43.637 E020.57.49.023 N052.10.43.195 E020.57.47.686 olive
N052.10.43.637 E020.57.49.023 N052.10.45.793 E020.57.47.136 olive
N052.10.43.195 E020.57.47.686 N052.10.43.016 E020.57.47.150 olive
N052.10.43.016 E020.57.47.150 N052.10.45.175 E020.57.45.257 olive
N052.10.43.016 E020.57.47.150 N052.10.42.396 E020.57.45.269 olive
N052.10.42.396 E020.57.45.269 N052.10.42.121 E020.57.44.433 olive
N052.10.42.396 E020.57.45.269 N052.10.44.557 E020.57.43.379 olive
N052.10.42.121 E020.57.44.433 N052.10.41.780 E020.57.43.391 olive
N052.10.41.780 E020.57.43.391 N052.10.43.949 E020.57.41.509 olive
N052.10.41.780 E020.57.43.391 N052.10.41.171 E020.57.41.538 olive
N052.10.41.171 E020.57.41.538 N052.10.40.599 E020.57.39.820 olive
N052.10.41.171 E020.57.41.538 N052.10.43.321 E020.57.39.654 olive
N052.10.41.640 E020.57.46.957 N052.10.39.980 E020.57.48.389 olive
N052.10.39.980 E020.57.48.389 N052.10.38.621 E020.57.44.245 olive
N052.10.39.980 E020.57.48.389 N052.10.37.558 E020.57.50.518 olive
N052.10.37.558 E020.57.50.518 N052.10.36.206 E020.57.46.357 olive
N052.10.37.558 E020.57.50.518 N052.10.35.224 E020.57.52.553 olive
N052.10.35.224 E020.57.52.553 N052.10.33.891 E020.57.48.378 olive
N052.10.35.224 E020.57.52.553 N052.10.33.053 E020.57.54.448 olive
N052.10.33.053 E020.57.54.448 N052.10.31.543 E020.57.55.765 olive
N052.10.33.053 E020.57.54.448 N052.10.31.733 E020.57.50.261 olive
N052.10.31.970 E020.57.45.261 N052.10.30.460 E020.57.46.577 olive
N052.10.30.460 E020.57.46.577 N052.10.28.876 E020.57.47.963 olive
N052.10.30.460 E020.57.46.577 N052.10.31.733 E020.57.50.261 olive
N052.10.32.638 E020.57.44.678 N052.10.31.970 E020.57.45.261 olive
N052.10.32.638 E020.57.44.678 N052.10.33.891 E020.57.48.378 olive
N052.10.37.023 E020.57.40.859 N052.10.34.978 E020.57.42.655 olive
N052.10.34.978 E020.57.42.655 N052.10.32.638 E020.57.44.678 olive
N052.10.34.978 E020.57.42.655 N052.10.36.206 E020.57.46.357 olive
N052.10.39.092 E020.57.39.060 N052.10.37.391 E020.57.40.534 olive
N052.10.37.391 E020.57.40.534 N052.10.37.023 E020.57.40.859 olive
N052.10.37.391 E020.57.40.534 N052.10.38.621 E020.57.44.245 olive
N052.10.48.598 E020.57.45.570 N052.10.48.168 E020.57.45.346 olive
N052.10.48.168 E020.57.45.346 N052.10.47.638 E020.57.45.529 olive
N052.10.47.348 E020.57.36.012 N052.10.46.462 E020.57.36.329 olive
N052.10.47.739 E020.57.39.008 N052.10.46.860 E020.57.39.319 olive
N052.10.48.067 E020.57.41.476 N052.10.47.168 E020.57.41.799 olive
N052.10.48.390 E020.57.43.928 N052.10.47.507 E020.57.44.247 olive
N052.10.48.324 E020.57.43.389 N052.10.49.670 E020.57.42.932 olive
N052.10.48.067 E020.57.41.476 N052.10.48.276 E020.57.43.017 olive
N052.10.48.276 E020.57.43.017 N052.10.48.390 E020.57.43.928 olive
N052.10.48.076 E020.57.41.537 N052.10.49.396 E020.57.41.068 olive
N052.10.48.016 E020.57.41.096 N052.10.48.067 E020.57.41.476 olive
N052.10.47.830 E020.57.39.695 N052.10.49.209 E020.57.39.190 olive
N052.10.47.739 E020.57.39.008 N052.10.48.016 E020.57.41.096 olive
N052.10.47.142 E020.57.34.444 N052.10.47.233 E020.57.35.133 olive
N052.10.47.233 E020.57.35.133 N052.10.47.348 E020.57.36.012 olive
N052.10.47.584 E020.57.37.815 N052.10.49.006 E020.57.37.319 olive
N052.10.47.348 E020.57.36.012 N052.10.47.530 E020.57.37.412 olive
N052.10.47.530 E020.57.37.412 N052.10.47.739 E020.57.39.008 olive
N052.10.36.998 E020.58.07.699 N052.10.36.026 E020.58.05.305 olive
N052.10.38.501 E020.58.06.106 N052.10.37.529 E020.58.03.699 olive
N052.10.39.593 E020.58.04.965 N052.10.38.625 E020.58.02.537 olive
N052.10.40.699 E020.58.03.811 N052.10.39.713 E020.58.01.365 olive
N052.10.33.432 E020.58.05.155 N052.10.33.344 E020.58.04.878 olive
N052.10.33.344 E020.58.04.878 N052.10.32.829 E020.58.03.528 olive
N052.10.33.344 E020.58.04.878 N052.10.34.629 E020.58.03.499 olive
N052.10.34.629 E020.58.03.499 N052.10.35.169 E020.58.02.918 olive
N052.10.35.169 E020.58.02.918 N052.10.34.199 E020.58.00.525 olive
N052.10.35.169 E020.58.02.918 N052.10.36.281 E020.58.01.748 olive
N052.10.36.281 E020.58.01.748 N052.10.35.288 E020.57.59.347 olive
N052.10.36.281 E020.58.01.748 N052.10.37.349 E020.58.00.623 olive
N052.10.37.349 E020.58.00.623 N052.10.37.882 E020.58.00.062 olive
N052.10.37.349 E020.58.00.623 N052.10.36.483 E020.57.58.513 olive
N052.09.19.481 E020.58.48.480 N052.09.20.058 E020.58.47.936 olive
N052.09.20.058 E020.58.47.936 N052.09.22.596 E020.58.45.713 olive
N052.09.26.320 E020.58.51.690 N052.09.23.474 E020.58.49.544 olive
N052.09.26.320 E020.58.51.690 N052.09.27.460 E020.58.47.661 olive
N052.09.27.537 E020.58.52.595 N052.09.26.320 E020.58.51.690 olive
N052.09.27.537 E020.58.52.595 N052.09.28.682 E020.58.48.531 olive
N052.09.28.590 E020.58.53.387 N052.09.27.537 E020.58.52.595 olive
N052.09.28.590 E020.58.53.387 N052.09.29.740 E020.58.49.330 olive
N052.09.31.122 E020.58.55.263 N052.09.28.590 E020.58.53.387 olive
N052.09.31.122 E020.58.55.263 N052.09.32.061 E020.58.51.935 olive
N052.09.37.132 E020.58.59.747 N052.09.32.399 E020.58.56.213 olive
N052.09.32.399 E020.58.56.213 N052.09.31.122 E020.58.55.263 olive
N052.09.32.399 E020.58.56.213 N052.09.33.337 E020.58.52.896 olive
N052.09.34.007 E020.58.50.475 N052.09.33.337 E020.58.52.896 olive
N052.09.34.007 E020.58.50.475 N052.09.34.130 E020.58.49.553 olive
N052.09.34.130 E020.58.49.553 N052.09.33.788 E020.58.48.525 olive
N052.09.23.343 E020.58.45.070 N052.09.26.614 E020.58.42.208 olive
N052.09.26.614 E020.58.42.208 N052.09.27.658 E020.58.41.301 olive
N052.09.26.614 E020.58.42.208 N052.09.27.478 E020.58.42.282 olive
N052.09.27.478 E020.58.42.282 N052.09.29.921 E020.58.44.125 olive
N052.09.29.921 E020.58.44.125 N052.09.30.936 E020.58.45.025 olive
N052.09.30.936 E020.58.45.025 N052.09.33.212 E020.58.47.817 olive
N052.09.33.212 E020.58.47.817 N052.09.33.788 E020.58.48.525 olive
N052.09.33.212 E020.58.47.817 N052.09.32.061 E020.58.51.935 olive
N052.09.30.936 E020.58.45.025 N052.09.29.740 E020.58.49.330 olive
N052.09.29.921 E020.58.44.125 N052.09.28.682 E020.58.48.531 olive
N052.09.29.921 E020.58.44.125 N052.09.29.324 E020.58.42.807 olive
N052.09.29.324 E020.58.42.807 N052.09.29.290 E020.58.41.116 olive
N052.09.27.658 E020.58.41.301 N052.09.29.769 E020.58.39.464 olive
N052.09.29.769 E020.58.39.464 N052.09.39.650 E020.58.30.874 olive
N052.09.29.290 E020.58.41.116 N052.09.29.769 E020.58.39.464 olive
N052.09.29.290 E020.58.41.116 N052.09.27.460 E020.58.47.661 olive
N052.10.36.480 E020.58.12.796 N052.10.37.567 E020.58.11.535 olive
N052.10.36.480 E020.58.12.796 N052.10.35.922 E020.58.11.390 olive
N052.10.35.922 E020.58.11.390 N052.10.35.634 E020.58.10.664 olive
N052.10.35.922 E020.58.11.390 N052.10.37.029 E020.58.10.208 olive
N052.10.39.593 E020.58.04.965 N052.10.40.415 E020.58.04.098 olive
N052.10.40.415 E020.58.04.098 N052.10.40.699 E020.58.03.811 olive
N052.10.40.415 E020.58.04.098 N052.10.41.127 E020.58.05.849 olive
N052.10.38.501 E020.58.06.106 N052.10.38.785 E020.58.05.810 olive
N052.10.38.785 E020.58.05.810 N052.10.39.593 E020.58.04.965 olive
N052.10.38.785 E020.58.05.810 N052.10.39.490 E020.58.07.579 olive
N052.10.37.966 E020.58.06.673 N052.10.38.501 E020.58.06.106 olive
N052.10.37.966 E020.58.06.673 N052.10.38.674 E020.58.08.443 olive
N052.10.39.593 E020.58.04.965 N052.10.40.306 E020.58.06.718 olive
N052.10.36.998 E020.58.07.699 N052.10.37.142 E020.58.07.545 olive
N052.10.37.142 E020.58.07.545 N052.10.37.966 E020.58.06.673 olive
N052.10.37.142 E020.58.07.545 N052.10.37.845 E020.58.09.302 olive
N052.10.37.233 E020.58.20.890 N052.10.36.412 E020.58.21.096 olive
N052.10.36.412 E020.58.21.096 N052.10.36.207 E020.58.18.833 olive
N052.10.35.765 E020.58.15.922 N052.10.35.926 E020.58.15.764 olive
N052.10.35.926 E020.58.15.764 N052.10.36.394 E020.58.15.054 olive
N052.10.35.926 E020.58.15.764 N052.10.36.207 E020.58.18.833 olive
N052.10.34.977 E020.58.16.602 N052.10.35.216 E020.58.19.092 olive
N052.10.36.412 E020.58.21.096 N052.10.35.422 E020.58.21.343 olive
N052.10.35.422 E020.58.21.343 N052.10.35.216 E020.58.19.092 olive
N052.10.34.150 E020.58.17.325 N052.10.34.977 E020.58.16.602 olive
N052.10.34.150 E020.58.17.325 N052.10.34.310 E020.58.19.320 olive
N052.10.35.422 E020.58.21.343 N052.10.34.509 E020.58.21.570 olive
N052.10.34.509 E020.58.21.570 N052.10.30.369 E020.58.22.607 olive
N052.10.34.509 E020.58.21.570 N052.10.34.310 E020.58.19.320 olive
N052.10.28.164 E020.58.23.101 N052.10.27.158 E020.58.22.264 olive
N052.10.27.158 E020.58.22.264 N052.10.26.605 E020.58.20.650 olive
N052.10.29.583 E020.58.21.311 N052.10.28.713 E020.58.20.877 olive
N052.10.28.713 E020.58.20.877 N052.10.28.073 E020.58.18.939 olive
N052.10.29.919 E020.58.21.018 N052.10.29.583 E020.58.21.311 olive
N052.10.29.919 E020.58.21.018 N052.10.28.961 E020.58.18.170 olive
N052.10.31.436 E020.58.19.700 N052.10.31.046 E020.58.20.035 olive
N052.10.31.046 E020.58.20.035 N052.10.29.919 E020.58.21.018 olive
N052.10.31.046 E020.58.20.035 N052.10.30.097 E020.58.17.185 olive
N052.10.31.436 E020.58.19.700 N052.10.31.943 E020.58.19.262 olive
N052.10.31.943 E020.58.19.262 N052.10.30.995 E020.58.16.406 olive
N052.10.31.943 E020.58.19.262 N052.10.33.060 E020.58.18.279 olive
N052.10.33.060 E020.58.18.279 N052.10.32.114 E020.58.15.436 olive
N052.10.33.060 E020.58.18.279 N052.10.33.958 E020.58.17.494 olive
N052.10.33.958 E020.58.17.494 N052.10.34.150 E020.58.17.325 olive
N052.10.33.958 E020.58.17.494 N052.10.33.016 E020.58.14.645 olive
N052.10.34.977 E020.58.16.602 N052.10.35.084 E020.58.16.512 olive
N052.10.35.084 E020.58.16.512 N052.10.35.765 E020.58.15.922 olive
N052.10.35.084 E020.58.16.512 N052.10.34.136 E020.58.13.673 olive
N052.09.21.719 E020.58.48.248 N052.09.20.058 E020.58.47.936 olive
N052.10.09.095 E020.57.20.642 N052.10.09.541 E020.57.20.992 olive
N052.10.09.541 E020.57.20.992 N052.10.11.059 E020.57.22.189 olive
N052.10.04.200 E020.57.16.793 N052.10.07.637 E020.57.19.495 olive
N052.10.16.007 E020.58.07.741 N052.10.17.436 E020.58.12.001 sch
N052.10.19.340 E020.58.11.780 N052.10.17.548 E020.58.06.391 nonsch
N052.10.20.180 E020.58.09.940 N052.10.18.673 E020.58.05.419 nonsch
N052.10.22.120 E020.58.09.420 N052.10.20.324 E020.58.03.989 nonsch
N052.10.23.840 E020.58.07.850 N052.10.22.061 E020.58.02.463 nonsch
N052.10.24.700 E020.58.05.990 N052.10.23.191 E020.58.01.468 nonsch
N052.10.28.170 E020.58.03.340 N052.10.29.542 E020.57.57.409 nonsch
N052.10.29.040 E020.58.04.320 N052.10.31.502 E020.57.59.953 nonsch
N052.10.34.008 E020.58.10.560 N052.10.34.140 E020.58.10.280 blue
N052.10.34.140 E020.58.10.280 N052.10.34.200 E020.58.10.030 blue
N052.10.34.200 E020.58.10.030 N052.10.34.240 E020.58.09.780 blue
N052.10.34.240 E020.58.09.780 N052.10.34.230 E020.58.09.530 blue
N052.10.34.230 E020.58.09.530 N052.10.34.190 E020.58.09.270 blue
N052.10.34.190 E020.58.09.270 N052.10.34.120 E020.58.09.040 blue
N052.10.34.120 E020.58.09.040 N052.10.34.080 E020.58.08.910 blue
N052.10.34.080 E020.58.08.910 N052.10.30.140 E020.57.58.500 blue
N052.10.30.140 E020.57.58.500 N052.10.30.080 E020.57.58.300 blue
N052.10.30.080 E020.57.58.300 N052.10.30.040 E020.57.57.990 blue
N052.10.30.040 E020.57.57.990 N052.10.30.060 E020.57.57.570 blue
N052.10.30.060 E020.57.57.570 N052.10.30.160 E020.57.57.190 blue
N052.10.30.160 E020.57.57.190 N052.10.30.270 E020.57.56.950 blue
N052.10.30.270 E020.57.56.950 N052.10.30.420 E020.57.56.750 blue
N052.10.30.420 E020.57.56.750 N052.10.30.520 E020.57.56.650 blue
N052.10.30.520 E020.57.56.650 N052.10.31.240 E020.57.56.020 blue
N052.10.31.240 E020.57.56.020 N052.10.31.542 E020.57.55.767 blue
N052.10.30.140 E020.57.58.500 N052.10.29.960 E020.57.58.090 blue
N052.10.29.960 E020.57.58.090 N052.10.29.830 E020.57.57.840 blue
N052.10.29.830 E020.57.57.840 N052.10.29.180 E020.57.56.870 blue
N052.10.29.180 E020.57.56.870 N052.10.28.940 E020.57.56.730 blue
N052.10.28.940 E020.57.56.730 N052.10.28.720 E020.57.56.720 blue
N052.10.28.720 E020.57.56.720 N052.10.28.481 E020.57.56.866 blue
N052.10.29.180 E020.57.56.870 N052.10.28.990 E020.57.56.580 blue
N052.10.28.990 E020.57.56.580 N052.10.28.830 E020.57.56.290 blue
N052.10.28.830 E020.57.56.290 N052.10.28.680 E020.57.55.950 blue
N052.10.28.680 E020.57.55.950 N052.10.28.600 E020.57.55.730 blue
N052.10.28.600 E020.57.55.730 N052.10.26.990 E020.57.50.850 blue
N052.10.26.990 E020.57.50.850 N052.10.26.930 E020.57.50.450 blue
N052.10.26.930 E020.57.50.450 N052.10.26.930 E020.57.50.140 blue
N052.10.26.930 E020.57.50.140 N052.10.27.060 E020.57.49.680 blue
N052.10.27.060 E020.57.49.680 N052.10.27.292 E020.57.49.351 blue
N052.10.26.990 E020.57.50.850 N052.10.26.830 E020.57.50.550 blue
N052.10.26.830 E020.57.50.550 N052.10.26.670 E020.57.50.390 blue
N052.10.26.670 E020.57.50.390 N052.10.26.460 E020.57.50.300 blue
N052.10.26.460 E020.57.50.300 N052.10.26.230 E020.57.50.320 blue
N052.10.26.230 E020.57.50.320 N052.10.26.139 E020.57.50.361 blue
N052.10.26.990 E020.57.50.850 N052.10.26.870 E020.57.50.460 blue
N052.10.26.870 E020.57.50.460 N052.10.26.800 E020.57.50.100 blue
N052.10.26.800 E020.57.50.100 N052.10.26.780 E020.57.49.690 blue
N052.10.26.780 E020.57.49.690 N052.10.26.820 E020.57.48.510 blue
N052.10.26.820 E020.57.48.510 N052.10.26.800 E020.57.48.130 blue
N052.10.26.800 E020.57.48.130 N052.10.26.750 E020.57.47.770 blue
N052.10.26.750 E020.57.47.770 N052.10.26.633 E020.57.47.373 blue
N052.10.26.633 E020.57.47.373 N052.10.26.920 E020.57.47.980 oranz
N052.10.26.920 E020.57.47.980 N052.10.27.130 E020.57.48.260 oranz
N052.10.27.130 E020.57.48.260 N052.10.27.760 E020.57.48.890 oranz
N052.10.27.760 E020.57.48.890 N052.10.27.950 E020.57.49.110 oranz
N052.10.27.950 E020.57.49.110 N052.10.28.170 E020.57.49.510 oranz
N052.10.28.170 E020.57.49.510 N052.10.28.250 E020.57.49.750 oranz
N052.10.28.250 E020.57.49.750 N052.10.28.190 E020.57.49.430 oranz
N052.10.28.190 E020.57.49.430 N052.10.28.190 E020.57.49.110 oranz
N052.10.28.190 E020.57.49.110 N052.10.28.250 E020.57.48.750 oranz
N052.10.28.250 E020.57.48.750 N052.10.28.400 E020.57.48.430 oranz
N052.10.28.400 E020.57.48.430 N052.10.28.560 E020.57.48.240 oranz
N052.10.28.250 E020.57.49.750 N052.10.28.110 E020.57.49.470 oranz
N052.10.28.110 E020.57.49.470 N052.10.27.970 E020.57.49.310 oranz
N052.10.27.970 E020.57.49.310 N052.10.27.770 E020.57.49.210 oranz
N052.10.27.770 E020.57.49.210 N052.10.27.580 E020.57.49.200 oranz
N052.10.27.580 E020.57.49.200 N052.10.27.292 E020.57.49.351 oranz
N052.10.28.250 E020.57.49.750 N052.10.29.760 E020.57.54.320 oranz
N052.10.29.760 E020.57.54.320 N052.10.29.910 E020.57.54.700 oranz
N052.10.29.910 E020.57.54.700 N052.10.30.190 E020.57.55.210 oranz
N052.10.30.190 E020.57.55.210 N052.10.30.890 E020.57.56.250 oranz
N052.10.30.890 E020.57.56.250 N052.10.31.070 E020.57.56.570 oranz
N052.10.31.070 E020.57.56.570 N052.10.31.250 E020.57.56.970 oranz
N052.10.31.250 E020.57.56.970 N052.10.31.420 E020.57.57.430 oranz
N052.10.31.420 E020.57.57.430 N052.10.31.330 E020.57.57.080 oranz
N052.10.31.330 E020.57.57.080 N052.10.31.310 E020.57.56.590 oranz
N052.10.31.310 E020.57.56.590 N052.10.31.380 E020.57.56.190 oranz
N052.10.31.380 E020.57.56.190 N052.10.31.550 E020.57.55.810 oranz
N052.10.31.550 E020.57.55.810 N052.10.31.680 E020.57.55.646 oranz
N052.10.31.420 E020.57.57.430 N052.10.31.330 E020.57.57.270 oranz
N052.10.31.330 E020.57.57.270 N052.10.31.140 E020.57.56.950 oranz
N052.10.31.140 E020.57.56.950 N052.10.30.940 E020.57.56.730 oranz
N052.10.30.940 E020.57.56.730 N052.10.30.670 E020.57.56.530 oranz
N052.10.30.670 E020.57.56.530 N052.10.30.410 E020.57.56.420 oranz
N052.10.30.410 E020.57.56.420 N052.10.30.139 E020.57.56.375 oranz
N052.10.31.420 E020.57.57.430 N052.10.33.480 E020.58.03.060 oranz
N052.10.33.480 E020.58.03.060 N052.10.35.340 E020.58.07.850 oranz
N052.10.35.340 E020.58.07.850 N052.10.35.560 E020.58.08.210 oranz
N052.10.35.560 E020.58.08.210 N052.10.35.900 E020.58.08.440 oranz
N052.10.35.900 E020.58.08.440 N052.10.36.250 E020.58.08.410 oranz
N052.10.36.250 E020.58.08.410 N052.10.36.500 E020.58.08.230 oranz
N052.10.35.340 E020.58.07.850 N052.10.35.540 E020.58.08.470 oranz
N052.10.35.540 E020.58.08.470 N052.10.35.580 E020.58.09.010 oranz
N052.10.35.580 E020.58.09.010 N052.10.35.541 E020.58.09.632 oranz
N052.10.35.340 E020.58.07.850 N052.10.35.500 E020.58.08.390 oranz 
N052.10.35.500 E020.58.08.390 N052.10.35.510 E020.58.08.800 oranz
N052.10.35.510 E020.58.08.800 N052.10.35.440 E020.58.09.160 oranz
N052.10.35.440 E020.58.09.160 N052.10.35.324 E020.58.09.397 oranz
N052.10.27.720 E020.58.05.930 N052.10.28.290 E020.58.07.660 build
N052.10.28.290 E020.58.07.660 N052.10.20.720 E020.58.14.270 build
N052.10.20.720 E020.58.14.270 N052.10.22.390 E020.58.19.800 build
N052.10.22.390 E020.58.19.800 N052.10.18.560 E020.58.23.130 build
N052.10.18.560 E020.58.23.130 N052.10.18.410 E020.58.22.690 build
N052.10.18.410 E020.58.22.690 N052.10.16.850 E020.58.24.050 build
N052.10.16.850 E020.58.24.050 N052.10.13.060 E020.58.22.240 build
N052.10.13.060 E020.58.22.240 N052.10.12.120 E020.58.23.030 build
N052.10.12.120 E020.58.23.030 N052.10.11.650 E020.58.21.630 build
N052.10.11.650 E020.58.21.630 N052.10.07.370 E020.58.25.330 build
N052.10.07.370 E020.58.25.330 N052.10.06.950 E020.58.24.050 build
N052.10.06.950 E020.58.24.050 N052.10.27.720 E020.58.05.930 build
N052.10.04.820 E020.58.28.080 N052.10.03.220 E020.58.27.780 build
N052.10.03.220 E020.58.27.780 N052.10.02.970 E020.58.31.180 build
N052.10.02.970 E020.58.31.180 N052.10.04.560 E020.58.31.490 build
N052.10.04.560 E020.58.31.490 N052.10.04.820 E020.58.28.080 build
N052.10.01.790 E020.58.31.480 N052.10.00.970 E020.58.31.240 build
N052.10.00.970 E020.58.31.240 N052.10.00.560 E020.58.35.040 build
N052.10.00.560 E020.58.35.040 N052.09.56.280 E020.58.33.810 build
N052.09.56.280 E020.58.33.810 N052.09.56.140 E020.58.35.100 build
N052.09.56.140 E020.58.35.100 N052.10.00.860 E020.58.36.450 build
N052.10.00.860 E020.58.36.450 N052.10.01.300 E020.58.32.430 build
N052.10.01.300 E020.58.32.430 N052.10.01.690 E020.58.32.530 build
N052.10.01.690 E020.58.32.530 N052.10.01.790 E020.58.31.480 build
N052.09.23.380 E020.58.54.620 N052.09.23.490 E020.58.54.960 build
N052.09.23.490 E020.58.54.960 N052.09.23.010 E020.58.55.370 build
N052.09.23.010 E020.58.55.370 N052.09.22.900 E020.58.55.040 build
N052.09.22.900 E020.58.55.040 N052.09.23.380 E020.58.54.620 build
N052.09.24.890 E020.58.55.100 N052.09.26.330 E020.58.59.460 build
N052.09.26.330 E020.58.59.460 N052.09.25.130 E020.59.00.410 build
N052.09.25.130 E020.59.00.410 N052.09.24.220 E020.58.57.660 build
N052.09.24.220 E020.58.57.660 N052.09.22.910 E020.58.58.730 build
N052.09.22.910 E020.58.58.730 N052.09.23.750 E020.59.01.370 build
N052.09.23.750 E020.59.01.370 N052.09.18.940 E020.59.05.540 build
N052.09.18.940 E020.59.05.540 N052.09.17.660 E020.59.01.590 build
N052.09.17.660 E020.59.01.590 N052.09.19.870 E020.58.59.650 build
N052.09.19.870 E020.58.59.650 N052.09.19.630 E020.58.58.960 build
N052.09.19.630 E020.58.58.960 N052.09.22.230 E020.58.56.710 build
N052.09.22.230 E020.58.56.710 N052.09.22.410 E020.58.57.220 build
N052.09.22.410 E020.58.57.220 N052.09.24.890 E020.58.55.100 build
N052.10.43.790 E020.58.14.710 N052.10.43.870 E020.58.14.840 build
N052.10.43.870 E020.58.14.840 N052.10.43.720 E020.58.15.170 build
N052.10.43.720 E020.58.15.170 N052.10.44.970 E020.58.16.800 build
N052.10.44.970 E020.58.16.800 N052.10.42.990 E020.58.20.880 build
N052.10.42.990 E020.58.20.880 N052.10.41.720 E020.58.19.260 build
N052.10.41.720 E020.58.19.260 N052.10.41.560 E020.58.19.590 build
N052.10.41.560 E020.58.19.590 N052.10.41.460 E020.58.19.460 build
N052.10.41.460 E020.58.19.460 N052.10.43.790 E020.58.14.710 build
N052.10.44.040 E020.58.13.920 N052.10.45.760 E020.58.16.140 build
N052.10.45.760 E020.58.16.140 N052.10.46.940 E020.58.13.720 build
N052.10.46.940 E020.58.13.720 N052.10.45.190 E020.58.11.460 build
N052.10.45.190 E020.58.11.460 N052.10.44.040 E020.58.13.920 build
N052.10.46.240 E020.58.10.150 N052.10.47.550 E020.58.11.860 build
N052.10.47.550 E020.58.11.860 N052.10.48.622 E020.58.09.670 build
N052.10.48.622 E020.58.09.670 N052.10.47.300 E020.58.07.970 build
N052.10.47.300 E020.58.07.970 N052.10.46.240 E020.58.10.150 build
N052.10.47.590 E020.58.05.690 N052.10.49.460 E020.58.06.290 build
N052.10.49.460 E020.58.06.290 N052.10.50.650 E020.57.56.440 build
N052.10.50.650 E020.57.56.440 N052.10.48.800 E020.57.55.850 build
N052.10.48.800 E020.57.55.850 N052.10.47.590 E020.58.05.690 build
N052.10.51.420 E020.57.34.730 N052.10.50.640 E020.57.34.980 build
N052.10.50.640 E020.57.34.980 N052.10.50.980 E020.57.37.810 build
N052.10.50.980 E020.57.37.810 N052.10.49.980 E020.57.38.080 build
N052.10.49.980 E020.57.38.080 N052.10.50.920 E020.57.45.410 build
N052.10.50.920 E020.57.45.410 N052.10.52.390 E020.57.44.930 build
N052.10.52.390 E020.57.44.930 N052.10.51.420 E020.57.34.730 build
N052.10.49.560 E020.57.31.350 N052.10.48.100 E020.57.31.910 build
N052.10.48.100 E020.57.31.910 N052.10.48.600 E020.57.35.510 build
N052.10.48.600 E020.57.35.510 N052.10.50.080 E020.57.34.950 build
N052.10.50.080 E020.57.34.950 N052.10.49.560 E020.57.31.350 build
N052.10.26.970 E020.57.06.940 N052.10.23.830 E020.57.04.520 build
N052.10.23.830 E020.57.04.520 N052.10.22.968 E020.57.07.463 build
N052.10.22.968 E020.57.07.463 N052.10.26.060 E020.57.09.933 build
N052.10.26.060 E020.57.09.933 N052.10.26.970 E020.57.06.940 build
N052.10.27.130 E020.58.26.190 N052.10.27.460 E020.58.30.010 build
N052.10.27.460 E020.58.30.010 N052.10.29.470 E020.58.29.570 build
N052.10.29.470 E020.58.29.570 N052.10.29.240 E020.58.25.650 build
N052.10.29.240 E020.58.25.650 N052.10.27.130 E020.58.26.190 build
N052.10.29.840 E020.58.25.890 N052.10.32.100 E020.58.25.310 build
N052.10.32.100 E020.58.25.310 N052.10.32.420 E020.58.28.840 build
N052.10.32.420 E020.58.28.840 N052.10.30.160 E020.58.29.380 build
N052.10.30.160 E020.58.29.380 N052.10.29.840 E020.58.25.890 build
;GATE1
N052.10.21.794 E020.58.13.331 N052.10.22.010 E020.58.14.000 build
N052.10.22.010 E020.58.14.000 N052.10.22.100 E020.58.15.290 build
N052.10.22.100 E020.58.15.290 N052.10.22.250 E020.58.15.270 build
N052.10.22.250 E020.58.15.270 N052.10.22.180 E020.58.14.280 build
N052.10.22.180 E020.58.14.280 N052.10.22.300 E020.58.14.170 build
N052.10.22.300 E020.58.14.170 N052.10.22.240 E020.58.13.990 build
N052.10.22.240 E020.58.13.990 N052.10.22.270 E020.58.13.970 build
N052.10.22.270 E020.58.13.970 N052.10.22.700 E020.58.15.060 build
N052.10.22.700 E020.58.15.060 N052.10.22.880 E020.58.14.980 build
N052.10.22.880 E020.58.14.980 N052.10.22.850 E020.58.14.800 build
N052.10.22.850 E020.58.14.800 N052.10.22.690 E020.58.14.850 build
N052.10.22.690 E020.58.14.850 N052.10.22.250 E020.58.13.770 build
N052.10.22.250 E020.58.13.770 N052.10.22.190 E020.58.13.810 build
N052.10.22.190 E020.58.13.810 N052.10.21.975 E020.58.13.173 build
;GATE2
N052.10.22.760 E020.58.12.490 N052.10.22.970 E020.58.13.170 build
N052.10.22.970 E020.58.13.170 N052.10.23.060 E020.58.14.460 build
N052.10.23.060 E020.58.14.460 N052.10.23.210 E020.58.14.430 build
N052.10.23.210 E020.58.14.430 N052.10.23.140 E020.58.13.440 build
N052.10.23.140 E020.58.13.440 N052.10.23.260 E020.58.13.330 build
N052.10.23.260 E020.58.13.330 N052.10.23.180 E020.58.13.080 build
N052.10.23.180 E020.58.13.080 N052.10.23.220 E020.58.13.070 build
N052.10.23.220 E020.58.13.070 N052.10.23.790 E020.58.14.100 build
N052.10.23.790 E020.58.14.100 N052.10.23.950 E020.58.13.970 build
N052.10.23.950 E020.58.13.970 N052.10.23.900 E020.58.13.800 build
N052.10.23.900 E020.58.13.800 N052.10.23.760 E020.58.13.880 build
N052.10.23.760 E020.58.13.880 N052.10.23.220 E020.58.12.910 build
N052.10.23.220 E020.58.12.910 N052.10.23.140 E020.58.12.970 build
N052.10.23.140 E020.58.12.970 N052.10.22.938 E020.58.12.333 build
;GATE3
N052.10.23.980 E020.58.11.410 N052.10.24.210 E020.58.12.090 build
N052.10.24.210 E020.58.12.090 N052.10.24.290 E020.58.13.380 build
N052.10.24.290 E020.58.13.380 N052.10.24.440 E020.58.13.360 build
N052.10.24.440 E020.58.13.360 N052.10.24.380 E020.58.12.360 build
N052.10.24.380 E020.58.12.360 N052.10.24.490 E020.58.12.260 build
N052.10.24.490 E020.58.12.260 N052.10.24.430 E020.58.12.070 build
N052.10.24.430 E020.58.12.070 N052.10.24.460 E020.58.12.040 build
N052.10.24.460 E020.58.12.040 N052.10.24.920 E020.58.13.130 build
N052.10.24.920 E020.58.13.130 N052.10.25.100 E020.58.13.030 build
N052.10.25.100 E020.58.13.030 N052.10.25.060 E020.58.12.850 build
N052.10.25.060 E020.58.12.850 N052.10.24.910 E020.58.12.910 build
N052.10.24.910 E020.58.12.910 N052.10.24.430 E020.58.11.850 build
N052.10.24.430 E020.58.11.850 N052.10.24.380 E020.58.11.900 build
N052.10.24.380 E020.58.11.900 N052.10.24.160 E020.58.11.250 build
;GATE4
N052.10.25.320 E020.58.10.240 N052.10.25.540 E020.58.10.890 build
N052.10.25.540 E020.58.10.890 N052.10.25.600 E020.58.10.830 build
N052.10.25.600 E020.58.10.830 N052.10.26.140 E020.58.11.830 build
N052.10.26.140 E020.58.11.830 N052.10.26.270 E020.58.11.710 build
N052.10.26.270 E020.58.11.710 N052.10.26.320 E020.58.11.920 build
N052.10.26.320 E020.58.11.920 N052.10.26.160 E020.58.12.050 build
N052.10.26.160 E020.58.12.050 N052.10.25.620 E020.58.11.030 build
N052.10.25.620 E020.58.11.030 N052.10.25.600 E020.58.11.060 build
N052.10.25.600 E020.58.11.060 N052.10.25.660 E020.58.11.240 build
N052.10.25.660 E020.58.11.240 N052.10.25.540 E020.58.11.350 build
N052.10.25.540 E020.58.11.350 N052.10.25.600 E020.58.12.340 build
N052.10.25.600 E020.58.12.340 N052.10.25.460 E020.58.12.360 build
N052.10.25.460 E020.58.12.360 N052.10.25.370 E020.58.11.070 build
N052.10.25.370 E020.58.11.070 N052.10.25.150 E020.58.10.400 build
;GATE5
N052.10.26.240 E020.58.09.430 N052.10.26.470 E020.58.10.120 build
N052.10.26.470 E020.58.10.120 N052.10.26.550 E020.58.11.410 build
N052.10.26.550 E020.58.11.410 N052.10.26.700 E020.58.11.380 build
N052.10.26.700 E020.58.11.380 N052.10.26.640 E020.58.10.380 build
N052.10.26.640 E020.58.10.380 N052.10.26.750 E020.58.10.280 build
N052.10.26.750 E020.58.10.280 N052.10.26.690 E020.58.10.060 build
N052.10.26.690 E020.58.10.060 N052.10.26.720 E020.58.10.020 build
N052.10.26.720 E020.58.10.020 N052.10.27.430 E020.58.10.800 build
N052.10.27.430 E020.58.10.800 N052.10.27.560 E020.58.10.620 build
N052.10.27.560 E020.58.10.620 N052.10.27.490 E020.58.10.470 build
N052.10.27.490 E020.58.10.470 N052.10.27.370 E020.58.10.620 build
N052.10.27.370 E020.58.10.620 N052.10.26.710 E020.58.09.880 build
N052.10.26.710 E020.58.09.880 N052.10.26.640 E020.58.09.930 build
N052.10.26.640 E020.58.09.930 N052.10.26.420 E020.58.09.280 build
;GATE7
N052.10.27.420 E020.58.08.440 N052.10.28.020 E020.58.10.260 build
N052.10.28.020 E020.58.10.260 N052.10.28.140 E020.58.10.130 build
N052.10.28.140 E020.58.10.130 N052.10.27.810 E020.58.09.060 build
N052.10.27.810 E020.58.09.060 N052.10.27.870 E020.58.09.000 build
N052.10.27.870 E020.58.09.000 N052.10.28.640 E020.58.09.700 build
N052.10.28.640 E020.58.09.700 N052.10.28.760 E020.58.09.510 build
N052.10.28.760 E020.58.09.510 N052.10.28.680 E020.58.09.370 build
N052.10.28.680 E020.58.09.370 N052.10.28.570 E020.58.09.520 build
N052.10.28.570 E020.58.09.520 N052.10.27.880 E020.58.08.860 build
N052.10.27.880 E020.58.08.860 N052.10.27.810 E020.58.08.910 build
N052.10.27.810 E020.58.08.910 N052.10.27.590 E020.58.08.260 build
;GATE8,9
N052.10.28.140 E020.58.07.200 N052.10.28.530 E020.58.06.870 build
N052.10.28.530 E020.58.06.870 N052.10.28.900 E020.58.08.010 build
N052.10.28.900 E020.58.08.010 N052.10.29.100 E020.58.07.840 build
N052.10.29.100 E020.58.07.840 N052.10.29.740 E020.58.08.690 build
N052.10.29.740 E020.58.08.690 N052.10.29.910 E020.58.08.520 build
N052.10.29.910 E020.58.08.520 N052.10.29.840 E020.58.08.360 build
N052.10.29.840 E020.58.08.360 N052.10.29.700 E020.58.08.480 build
N052.10.29.700 E020.58.08.480 N052.10.29.100 E020.58.07.670 build
N052.10.29.100 E020.58.07.670 N052.10.29.020 E020.58.07.720 build
N052.10.29.020 E020.58.07.720 N052.10.28.670 E020.58.06.640 build
N052.10.28.670 E020.58.06.640 N052.10.28.780 E020.58.06.540 build
N052.10.28.780 E020.58.06.540 N052.10.28.860 E020.58.06.490 build
N052.10.28.860 E020.58.06.490 N052.10.29.480 E020.58.06.450 build
N052.10.29.480 E020.58.06.450 N052.10.29.480 E020.58.06.130 build
N052.10.29.480 E020.58.06.130 N052.10.29.370 E020.58.06.130 build
N052.10.29.370 E020.58.06.130 N052.10.29.360 E020.58.06.340 build
N052.10.29.360 E020.58.06.340 N052.10.28.730 E020.58.06.400 build
N052.10.28.730 E020.58.06.400 N052.10.28.710 E020.58.06.330 build
N052.10.28.710 E020.58.06.330 N052.10.28.040 E020.58.06.910 build
;GATE10
N052.10.27.990 E020.58.06.710 N052.10.28.640 E020.58.06.140 build
N052.10.28.640 E020.58.06.140 N052.10.28.610 E020.58.06.040 build
N052.10.28.610 E020.58.06.040 N052.10.29.220 E020.58.05.180 build
N052.10.29.220 E020.58.05.180 N052.10.29.190 E020.58.04.900 build
N052.10.29.190 E020.58.04.900 N052.10.29.080 E020.58.04.920 build
N052.10.29.080 E020.58.04.920 N052.10.29.090 E020.58.05.200 build
N052.10.29.090 E020.58.05.200 N052.10.28.570 E020.58.05.930 build
N052.10.28.570 E020.58.05.930 N052.10.28.460 E020.58.06.020 build
N052.10.28.460 E020.58.06.020 N052.10.28.100 E020.58.04.920 build
N052.10.28.100 E020.58.04.920 N052.10.28.710 E020.58.04.290 build
N052.10.28.710 E020.58.04.290 N052.10.28.630 E020.58.04.020 build
N052.10.28.630 E020.58.04.020 N052.10.28.520 E020.58.04.100 build
N052.10.28.520 E020.58.04.100 N052.10.28.580 E020.58.04.300 build
N052.10.28.580 E020.58.04.300 N052.10.28.070 E020.58.04.830 build
N052.10.28.070 E020.58.04.830 N052.10.28.060 E020.58.04.790 build
N052.10.28.060 E020.58.04.790 N052.10.27.890 E020.58.04.940 build
N052.10.27.890 E020.58.04.940 N052.10.28.270 E020.58.06.090 build
N052.10.28.270 E020.58.06.090 N052.10.27.890 E020.58.06.420 build
;GATE11,12
N052.10.27.400 E020.58.06.180 N052.10.27.200 E020.58.05.570 build
N052.10.27.200 E020.58.05.570 N052.10.27.110 E020.58.04.270 build
N052.10.27.110 E020.58.04.270 N052.10.26.960 E020.58.04.300 build
N052.10.26.960 E020.58.04.300 N052.10.27.030 E020.58.05.290 build
N052.10.27.030 E020.58.05.290 N052.10.27.000 E020.58.05.320 build
N052.10.27.000 E020.58.05.320 N052.10.26.910 E020.58.04.150 build
N052.10.26.910 E020.58.04.150 N052.10.26.720 E020.58.04.160 build
N052.10.26.720 E020.58.04.160 N052.10.26.720 E020.58.04.360 build
N052.10.26.720 E020.58.04.360 N052.10.26.870 E020.58.04.360 build
N052.10.26.870 E020.58.04.360 N052.10.26.950 E020.58.05.360 build
N052.10.26.950 E020.58.05.360 N052.10.26.910 E020.58.05.400 build
N052.10.26.910 E020.58.05.400 N052.10.27.000 E020.58.05.670 build
N052.10.27.000 E020.58.05.670 N052.10.26.230 E020.58.05.290 build
N052.10.26.230 E020.58.05.290 N052.10.26.120 E020.58.05.450 build
N052.10.26.120 E020.58.05.450 N052.10.26.200 E020.58.05.600 build
N052.10.26.200 E020.58.05.600 N052.10.26.330 E020.58.05.440 build
N052.10.26.330 E020.58.05.440 N052.10.27.050 E020.58.05.810 build
N052.10.27.050 E020.58.05.810 N052.10.27.240 E020.58.06.380 build
;GATE13
N052.10.25.570 E020.58.07.830 N052.10.25.350 E020.58.07.180 build
N052.10.25.350 E020.58.07.180 N052.10.25.260 E020.58.05.890 build
N052.10.25.260 E020.58.05.890 N052.10.25.120 E020.58.05.910 build
N052.10.25.120 E020.58.05.910 N052.10.25.180 E020.58.06.910 build
N052.10.25.180 E020.58.06.910 N052.10.25.150 E020.58.06.930 build
N052.10.25.150 E020.58.06.930 N052.10.25.010 E020.58.05.780 build
N052.10.25.010 E020.58.05.780 N052.10.24.810 E020.58.05.810 build
N052.10.24.810 E020.58.05.810 N052.10.24.830 E020.58.06.010 build
N052.10.24.830 E020.58.06.010 N052.10.24.970 E020.58.06.010 build
N052.10.24.970 E020.58.06.010 N052.10.25.100 E020.58.06.970 build
N052.10.25.100 E020.58.06.970 N052.10.25.060 E020.58.07.010 build
N052.10.25.060 E020.58.07.010 N052.10.25.150 E020.58.07.290 build
N052.10.25.150 E020.58.07.290 N052.10.24.510 E020.58.06.600 build
N052.10.24.510 E020.58.06.600 N052.10.24.370 E020.58.06.690 build
N052.10.24.370 E020.58.06.690 N052.10.24.400 E020.58.06.870 build
N052.10.24.400 E020.58.06.870 N052.10.24.570 E020.58.06.780 build
N052.10.24.570 E020.58.06.780 N052.10.25.200 E020.58.07.450 build
N052.10.25.200 E020.58.07.450 N052.10.25.370 E020.58.07.970 build
;GATE14
N052.10.23.370 E020.58.09.740 N052.10.23.150 E020.58.09.090 build
N052.10.23.150 E020.58.09.090 N052.10.23.070 E020.58.07.800 build
N052.10.23.070 E020.58.07.800 N052.10.22.920 E020.58.07.820 build
N052.10.22.920 E020.58.07.820 N052.10.22.990 E020.58.08.820 build
N052.10.22.990 E020.58.08.820 N052.10.22.960 E020.58.08.840 build
N052.10.22.960 E020.58.08.840 N052.10.22.740 E020.58.07.730 build
N052.10.22.740 E020.58.07.730 N052.10.22.550 E020.58.07.810 build
N052.10.22.550 E020.58.07.810 N052.10.22.570 E020.58.07.990 build
N052.10.22.570 E020.58.07.990 N052.10.22.720 E020.58.07.960 build
N052.10.22.720 E020.58.07.960 N052.10.22.930 E020.58.08.880 build
N052.10.22.930 E020.58.08.880 N052.10.22.860 E020.58.08.920 build
N052.10.22.860 E020.58.08.920 N052.10.22.960 E020.58.09.200 build
N052.10.22.960 E020.58.09.200 N052.10.22.120 E020.58.08.570 build
N052.10.22.120 E020.58.08.570 N052.10.22.020 E020.58.08.770 build
N052.10.22.020 E020.58.08.770 N052.10.22.100 E020.58.08.910 build
N052.10.22.100 E020.58.08.910 N052.10.22.210 E020.58.08.730 build
N052.10.22.210 E020.58.08.730 N052.10.23.020 E020.58.09.380 build
N052.10.23.020 E020.58.09.380 N052.10.23.180 E020.58.09.870 build
;GATE15
N052.10.21.160 E020.58.11.630 N052.10.20.960 E020.58.11.000 build
N052.10.20.960 E020.58.11.000 N052.10.20.880 E020.58.09.710 build
N052.10.20.880 E020.58.09.710 N052.10.20.730 E020.58.09.740 build
N052.10.20.730 E020.58.09.740 N052.10.20.790 E020.58.10.720 build
N052.10.20.790 E020.58.10.720 N052.10.20.780 E020.58.10.740 build
N052.10.20.780 E020.58.10.740 N052.10.20.450 E020.58.09.700 build
N052.10.20.450 E020.58.09.700 N052.10.20.270 E020.58.09.820 build
N052.10.20.270 E020.58.09.820 N052.10.20.310 E020.58.09.990 build
N052.10.20.310 E020.58.09.990 N052.10.20.450 E020.58.09.920 build
N052.10.20.450 E020.58.09.920 N052.10.20.720 E020.58.10.790 build
N052.10.20.720 E020.58.10.790 N052.10.20.670 E020.58.10.830 build
N052.10.20.670 E020.58.10.830 N052.10.20.760 E020.58.11.100 build
N052.10.20.760 E020.58.11.100 N052.10.19.980 E020.58.10.720 build
N052.10.19.980 E020.58.10.720 N052.10.19.870 E020.58.10.890 build
N052.10.19.870 E020.58.10.890 N052.10.19.960 E020.58.11.040 build
N052.10.19.960 E020.58.11.040 N052.10.20.080 E020.58.10.860 build
N052.10.20.080 E020.58.10.860 N052.10.20.800 E020.58.11.230 build
N052.10.20.800 E020.58.11.230 N052.10.20.980 E020.58.11.780 build
;GATE16
N052.10.18.700 E020.58.13.770 N052.10.18.490 E020.58.13.150 build
N052.10.18.490 E020.58.13.150 N052.10.18.410 E020.58.11.860 build
N052.10.18.410 E020.58.11.860 N052.10.18.260 E020.58.11.890 build
N052.10.18.260 E020.58.11.890 N052.10.18.320 E020.58.12.870 build
N052.10.18.320 E020.58.12.870 N052.10.18.200 E020.58.12.980 build
N052.10.18.200 E020.58.12.980 N052.10.18.280 E020.58.13.230 build
N052.10.18.280 E020.58.13.230 N052.10.18.260 E020.58.13.250 build
N052.10.18.260 E020.58.13.250 N052.10.17.840 E020.58.12.480 build
N052.10.17.840 E020.58.12.480 N052.10.17.680 E020.58.12.650 build
N052.10.17.680 E020.58.12.650 N052.10.17.740 E020.58.12.810 build
N052.10.17.740 E020.58.12.810 N052.10.17.870 E020.58.12.690 build
N052.10.17.870 E020.58.12.690 N052.10.18.260 E020.58.13.390 build
N052.10.18.260 E020.58.13.390 N052.10.18.320 E020.58.13.340 build
N052.10.18.320 E020.58.13.340 N052.10.18.520 E020.58.13.930 build
;GAT17
N052.10.16.770 E020.58.15.450 N052.10.16.570 E020.58.14.820 build
N052.10.16.570 E020.58.14.820 N052.10.16.490 E020.58.13.530 build
N052.10.16.490 E020.58.13.530 N052.10.16.340 E020.58.13.560 build
N052.10.16.340 E020.58.13.560 N052.10.16.410 E020.58.14.550 build
N052.10.16.410 E020.58.14.550 N052.10.16.290 E020.58.14.650 build
N052.10.16.290 E020.58.14.650 N052.10.16.360 E020.58.14.900 build
N052.10.16.360 E020.58.14.900 N052.10.16.340 E020.58.14.910 build
N052.10.16.340 E020.58.14.910 N052.10.16.020 E020.58.14.040 build
N052.10.16.020 E020.58.14.040 N052.10.15.840 E020.58.14.170 build
N052.10.15.840 E020.58.14.170 N052.10.15.890 E020.58.14.350 build
N052.10.15.890 E020.58.14.350 N052.10.16.020 E020.58.14.260 build
N052.10.16.020 E020.58.14.260 N052.10.16.320 E020.58.15.070 build
N052.10.16.320 E020.58.15.070 N052.10.16.400 E020.58.15.010 build
N052.10.16.400 E020.58.15.010 N052.10.16.600 E020.58.15.600 build
;GATE18
N052.10.15.130 E020.58.16.880 N052.10.14.930 E020.58.16.250 build
N052.10.14.930 E020.58.16.250 N052.10.14.840 E020.58.14.960 build
N052.10.14.840 E020.58.14.960 N052.10.14.690 E020.58.14.990 build
N052.10.14.690 E020.58.14.990 N052.10.14.760 E020.58.15.980 build
N052.10.14.760 E020.58.15.980 N052.10.14.640 E020.58.16.090 build
N052.10.14.640 E020.58.16.090 N052.10.14.720 E020.58.16.340 build
N052.10.14.720 E020.58.16.340 N052.10.14.690 E020.58.16.360 build
N052.10.14.690 E020.58.16.360 N052.10.14.310 E020.58.15.500 build
N052.10.14.310 E020.58.15.500 N052.10.14.160 E020.58.15.660 build
N052.10.14.160 E020.58.15.660 N052.10.14.220 E020.58.15.820 build
N052.10.14.220 E020.58.15.820 N052.10.14.350 E020.58.15.720 build
N052.10.14.350 E020.58.15.720 N052.10.14.670 E020.58.16.490 build
N052.10.14.670 E020.58.16.490 N052.10.14.750 E020.58.16.440 build
N052.10.14.750 E020.58.16.440 N052.10.14.950 E020.58.17.040 build
;GATE19
N052.10.13.420 E020.58.18.410 N052.10.13.220 E020.58.17.750 build
N052.10.13.220 E020.58.17.750 N052.10.13.130 E020.58.16.450 build
N052.10.13.130 E020.58.16.450 N052.10.12.980 E020.58.16.480 build
N052.10.12.980 E020.58.16.480 N052.10.13.050 E020.58.17.470 build
N052.10.13.050 E020.58.17.470 N052.10.12.920 E020.58.17.580 build
N052.10.12.920 E020.58.17.580 N052.10.13.010 E020.58.17.830 build
N052.10.13.010 E020.58.17.830 N052.10.12.980 E020.58.17.860 build
N052.10.12.980 E020.58.17.860 N052.10.12.440 E020.58.17.260 build
N052.10.12.440 E020.58.17.260 N052.10.12.310 E020.58.17.480 build
N052.10.12.310 E020.58.17.480 N052.10.12.400 E020.58.17.610 build
N052.10.12.400 E020.58.17.610 N052.10.12.490 E020.58.17.430 build
N052.10.12.490 E020.58.17.430 N052.10.12.960 E020.58.17.960 build
N052.10.12.960 E020.58.17.960 N052.10.13.040 E020.58.17.910 build
N052.10.13.040 E020.58.17.910 N052.10.13.240 E020.58.18.530 build
;GATE20
N052.10.11.840 E020.58.19.750 N052.10.11.640 E020.58.19.120 build
N052.10.11.640 E020.58.19.120 N052.10.11.550 E020.58.17.830 build
N052.10.11.550 E020.58.17.830 N052.10.11.410 E020.58.17.860 build
N052.10.11.410 E020.58.17.860 N052.10.11.470 E020.58.18.850 build
N052.10.11.470 E020.58.18.850 N052.10.11.350 E020.58.18.960 build
N052.10.11.350 E020.58.18.960 N052.10.11.430 E020.58.19.200 build
N052.10.11.430 E020.58.19.200 N052.10.11.400 E020.58.19.210 build
N052.10.11.400 E020.58.19.210 N052.10.11.050 E020.58.18.360 build
N052.10.11.050 E020.58.18.360 N052.10.10.870 E020.58.18.510 build
N052.10.10.870 E020.58.18.510 N052.10.10.930 E020.58.18.680 build
N052.10.10.930 E020.58.18.680 N052.10.11.060 E020.58.18.590 build
N052.10.11.060 E020.58.18.590 N052.10.11.390 E020.58.19.340 build
N052.10.11.390 E020.58.19.340 N052.10.11.460 E020.58.19.300 build
N052.10.11.460 E020.58.19.300 N052.10.11.660 E020.58.19.910 build
;GATE21
N052.10.10.200 E020.58.21.190 N052.10.09.610 E020.58.19.410 build
N052.10.09.610 E020.58.19.410 N052.10.09.480 E020.58.19.520 build
N052.10.09.480 E020.58.19.520 N052.10.09.760 E020.58.20.340 build
N052.10.09.760 E020.58.20.340 N052.10.09.700 E020.58.20.390 build
N052.10.09.700 E020.58.20.390 N052.10.09.780 E020.58.20.640 build
N052.10.09.780 E020.58.20.640 N052.10.09.760 E020.58.20.650 build
N052.10.09.760 E020.58.20.650 N052.10.09.440 E020.58.19.770 build
N052.10.09.440 E020.58.19.770 N052.10.09.260 E020.58.19.910 build
N052.10.09.260 E020.58.19.910 N052.10.09.310 E020.58.20.090 build
N052.10.09.310 E020.58.20.090 N052.10.09.440 E020.58.20.000 build
N052.10.09.440 E020.58.20.000 N052.10.09.750 E020.58.20.790 build
N052.10.09.750 E020.58.20.790 N052.10.09.820 E020.58.20.750 build
N052.10.09.820 E020.58.20.750 N052.10.10.020 E020.58.21.340 build
;GATE22
N052.10.08.970 E020.58.22.260 N052.10.08.650 E020.58.21.300 build
N052.10.08.650 E020.58.21.300 N052.10.08.220 E020.58.20.700 build
N052.10.08.220 E020.58.20.700 N052.10.08.120 E020.58.20.880 build
N052.10.08.120 E020.58.20.880 N052.10.08.510 E020.58.21.420 build
N052.10.08.510 E020.58.21.420 N052.10.08.470 E020.58.21.470 build
N052.10.08.470 E020.58.21.470 N052.10.08.550 E020.58.21.710 build
N052.10.08.550 E020.58.21.710 N052.10.08.520 E020.58.21.730 build
N052.10.08.520 E020.58.21.730 N052.10.08.130 E020.58.20.920 build
N052.10.08.130 E020.58.20.920 N052.10.07.960 E020.58.21.070 build
N052.10.07.960 E020.58.21.070 N052.10.08.030 E020.58.21.230 build
N052.10.08.030 E020.58.21.230 N052.10.08.160 E020.58.21.130 build
N052.10.08.160 E020.58.21.130 N052.10.08.510 E020.58.21.850 build
N052.10.08.510 E020.58.21.850 N052.10.08.580 E020.58.21.800 build
N052.10.08.580 E020.58.21.800 N052.10.08.790 E020.58.22.420 build
;GATE23
N052.10.07.800 E020.58.23.280 N052.10.07.490 E020.58.22.320 build
N052.10.07.490 E020.58.22.320 N052.10.07.050 E020.58.21.700 build
N052.10.07.050 E020.58.21.700 N052.10.06.950 E020.58.21.890 build
N052.10.06.950 E020.58.21.890 N052.10.07.350 E020.58.22.440 build
N052.10.07.350 E020.58.22.440 N052.10.07.300 E020.58.22.480 build
N052.10.07.300 E020.58.22.480 N052.10.07.380 E020.58.22.720 build
N052.10.07.380 E020.58.22.720 N052.10.07.350 E020.58.22.750 build
N052.10.07.350 E020.58.22.750 N052.10.06.910 E020.58.22.000 build
N052.10.06.910 E020.58.22.000 N052.10.06.760 E020.58.22.190 build
N052.10.06.760 E020.58.22.190 N052.10.06.830 E020.58.22.330 build
N052.10.06.830 E020.58.22.330 N052.10.06.940 E020.58.22.190 build
N052.10.06.940 E020.58.22.190 N052.10.07.340 E020.58.22.840 build
N052.10.07.340 E020.58.22.840 N052.10.07.410 E020.58.22.810 build
N052.10.07.410 E020.58.22.810 N052.10.07.620 E020.58.23.430 build
;GATE24
N052.10.07.090 E020.58.24.500 N052.10.06.870 E020.58.24.690 build
N052.10.06.870 E020.58.24.690 N052.10.06.460 E020.58.23.460 build
N052.10.06.460 E020.58.23.460 N052.10.06.290 E020.58.23.610 build
N052.10.06.290 E020.58.23.610 N052.10.06.310 E020.58.23.670 build
N052.10.06.310 E020.58.23.670 N052.10.06.270 E020.58.23.700 build
N052.10.06.270 E020.58.23.700 N052.10.05.660 E020.58.23.350 build
N052.10.05.660 E020.58.23.350 N052.10.05.570 E020.58.23.620 build
N052.10.05.570 E020.58.23.620 N052.10.05.680 E020.58.23.700 build
N052.10.05.680 E020.58.23.700 N052.10.05.730 E020.58.23.500 build
N052.10.05.730 E020.58.23.500 N052.10.06.280 E020.58.23.800 build
N052.10.06.280 E020.58.23.800 N052.10.06.340 E020.58.23.760 build
N052.10.06.340 E020.58.23.760 N052.10.06.690 E020.58.24.840 build
N052.10.06.690 E020.58.24.840 N052.10.06.370 E020.58.25.130 build
N052.10.06.370 E020.58.25.130 N052.10.06.410 E020.58.25.250 build
N052.10.06.410 E020.58.25.250 N052.10.06.490 E020.58.25.180 build
N052.10.06.490 E020.58.25.180 N052.10.06.520 E020.58.25.270 build
N052.10.06.520 E020.58.25.270 N052.10.07.160 E020.58.24.720 build

LOTNISKA_EPWA_OLD[MAT] N052.08.58.605 E020.58.52.203 N052.08.58.218 E020.58.51.623 Color_44ACI
N052.08.58.218 E020.58.51.623 N052.08.57.957 E020.58.50.935 Color_44ACI
N052.08.57.957 E020.58.50.935 N052.08.57.286 E020.58.49.084 Color_44ACI
N052.08.57.286 E020.58.49.084 N052.08.56.077 E020.58.45.403 Color_44ACI
N052.08.56.077 E020.58.45.403 N052.08.55.921 E020.58.44.749 Color_44ACI
N052.08.55.921 E020.58.44.749 N052.08.55.919 E020.58.44.059 Color_44ACI
N052.08.55.919 E020.58.44.059 N052.08.55.999 E020.58.43.055 Color_44ACI
N052.08.55.999 E020.58.43.055 N052.08.56.273 E020.58.42.301 Color_44ACI
N052.08.56.273 E020.58.42.301 N052.08.56.811 E020.58.41.520 Color_44ACI
N052.08.56.811 E020.58.41.520 N052.09.01.931 E020.58.36.763 Color_44ACI
N052.09.01.931 E020.58.36.763 N052.09.03.388 E020.58.35.439 Color_44ACI
N052.09.03.388 E020.58.35.439 N052.09.13.115 E020.58.26.686 Color_44ACI
N052.09.13.115 E020.58.26.686 N052.09.13.763 E020.58.26.659 Color_44ACI
N052.09.13.763 E020.58.26.659 N052.09.14.197 E020.58.26.799 Color_44ACI
N052.09.14.197 E020.58.26.799 N052.09.14.790 E020.58.27.289 Color_44ACI
N052.09.14.790 E020.58.27.289 N052.09.15.213 E020.58.28.147 Color_44ACI
N052.09.15.213 E020.58.28.147 N052.09.15.387 E020.58.28.558 Color_44ACI
N052.09.15.387 E020.58.28.558 N052.09.17.576 E020.58.34.956 Color_44ACI
N052.09.02.631 E020.58.36.096 N052.09.01.859 E020.58.37.262 Color_44ACI
N052.09.01.859 E020.58.37.262 N052.09.00.323 E020.58.41.324 Color_44ACI
N052.09.00.323 E020.58.41.324 N052.08.57.756 E020.58.48.625 Color_44ACI
N052.08.57.756 E020.58.48.625 N052.08.57.688 E020.58.49.148 Color_44ACI
N052.08.57.688 E020.58.49.148 N052.08.57.827 E020.58.50.548 Color_44ACI
N052.09.18.662 E020.58.38.188 N052.09.19.637 E020.58.40.897 Color_44ACI
N052.09.19.637 E020.58.40.897 N052.09.20.178 E020.58.42.339 Color_44ACI
N052.09.20.178 E020.58.42.339 N052.09.21.950 E020.58.47.494 Color_44ACI
N052.09.19.790 E020.58.41.204 N052.09.20.534 E020.58.42.097 Color_44ACI
N052.09.20.534 E020.58.42.097 N052.09.21.041 E020.58.42.435 Color_44ACI
N052.09.21.041 E020.58.42.435 N052.09.27.634 E020.58.42.341 Color_44ACI
N052.09.27.634 E020.58.42.341 N052.09.30.982 E020.58.51.957 Color_44ACI
N052.09.30.982 E020.58.51.957 N052.09.31.366 E020.58.52.957 Color_44ACI
N052.09.31.366 E020.58.52.957 N052.09.31.818 E020.58.53.808 Color_44ACI
N052.09.31.818 E020.58.53.808 N052.09.32.551 E020.58.54.925 Color_44ACI
N052.09.32.551 E020.58.54.925 N052.09.33.282 E020.58.55.933 Color_44ACI
N052.09.33.282 E020.58.55.933 N052.09.34.367 E020.58.56.941 Color_44ACI
N052.09.34.367 E020.58.56.941 N052.09.36.116 E020.58.58.259 Color_44ACI
N052.09.36.116 E020.58.58.259 N052.09.39.868 E020.59.00.892 Color_44ACI
N052.09.14.354 E020.58.54.391 N052.09.16.665 E020.58.52.281 Color_44ACI
N052.09.16.665 E020.58.52.281 N052.09.19.691 E020.58.49.576 Color_44ACI
N052.09.19.691 E020.58.49.576 N052.09.23.629 E020.58.45.978 Color_44ACI
N052.09.23.629 E020.58.45.978 N052.09.28.092 E020.58.41.909 Color_44ACI
N052.09.28.092 E020.58.41.909 N052.09.50.354 E020.58.21.645 Color_44ACI
N052.09.48.944 E020.58.10.614 N052.09.51.430 E020.58.17.829 Color_44ACI
N052.09.51.132 E020.58.18.798 N052.09.45.918 E020.58.17.329 Color_44ACI
N052.09.45.918 E020.58.17.329 N052.09.44.730 E020.58.17.181 Color_44ACI
N052.09.44.730 E020.58.17.181 N052.09.42.968 E020.58.17.187 Color_44ACI
N052.09.42.968 E020.58.17.187 N052.09.41.478 E020.58.17.456 Color_44ACI
N052.09.16.085 E020.58.52.792 N052.09.17.844 E020.58.57.969 Color_44ACI
N052.09.19.478 E020.58.56.316 N052.09.17.806 E020.58.51.299 Color_44ACI
N052.09.20.125 E020.58.49.172 N052.09.21.870 E020.58.54.215 Color_44ACI
N052.09.57.791 E020.58.22.365 N052.09.58.008 E020.58.15.989 Color_44ACI
N052.09.58.008 E020.58.15.989 N052.09.58.158 E020.58.15.070 Color_44ACI
N052.09.58.158 E020.58.15.070 N052.09.58.694 E020.58.14.137 Color_44ACI
N052.09.41.760 E020.59.02.204 N052.09.42.273 E020.59.02.397 Color_44ACI
N052.09.42.273 E020.59.02.397 N052.09.42.794 E020.59.02.267 Color_44ACI
N052.09.42.794 E020.59.02.267 N052.09.45.881 E020.58.58.629 Color_44ACI
N052.09.45.881 E020.58.58.629 N052.09.46.847 E020.58.57.468 Color_44ACI
N052.09.46.847 E020.58.57.468 N052.09.47.607 E020.58.56.617 Color_44ACI
N052.09.47.607 E020.58.56.617 N052.09.48.279 E020.58.55.417 Color_44ACI
N052.09.48.279 E020.58.55.417 N052.09.49.039 E020.58.54.045 Color_44ACI
N052.09.49.039 E020.58.54.045 N052.09.49.499 E020.58.52.979 Color_44ACI
N052.09.49.499 E020.58.52.979 N052.09.49.954 E020.58.51.465 Color_44ACI
N052.09.49.954 E020.58.51.465 N052.09.50.949 E020.58.47.903 Color_44ACI
N052.09.50.949 E020.58.47.903 N052.09.55.989 E020.58.29.016 Color_44ACI
N052.09.55.989 E020.58.29.016 N052.09.56.637 E020.58.26.631 Color_44ACI
N052.09.56.637 E020.58.26.631 N052.09.57.621 E020.58.23.056 Color_44ACI
N052.09.57.621 E020.58.23.056 N052.09.57.943 E020.58.21.709 Color_44ACI
N052.09.57.943 E020.58.21.709 N052.09.58.289 E020.58.20.506 Color_44ACI
N052.09.58.289 E020.58.20.506 N052.09.58.695 E020.58.19.924 Color_44ACI
N052.09.53.178 E020.58.19.294 N052.09.56.503 E020.58.19.682 Color_44ACI
N052.09.56.503 E020.58.19.682 N052.09.58.274 E020.58.19.884 Color_44ACI
N052.09.58.274 E020.58.19.884 N052.09.59.204 E020.58.19.927 Color_44ACI
N052.09.59.204 E020.58.19.927 N052.10.00.904 E020.58.19.914 Color_44ACI
N052.10.00.904 E020.58.19.914 N052.10.02.632 E020.58.19.665 Color_44ACI
N052.10.02.632 E020.58.19.665 N052.10.03.177 E020.58.19.565 Color_44ACI
N052.10.03.177 E020.58.19.565 N052.10.03.488 E020.58.19.434 Color_44ACI
N052.10.03.488 E020.58.19.434 N052.10.03.831 E020.58.19.237 Color_44ACI
N052.10.03.831 E020.58.19.237 N052.10.03.992 E020.58.19.139 Color_44ACI
N052.10.03.992 E020.58.19.139 N052.10.05.445 E020.58.17.727 Color_44ACI
N052.10.05.445 E020.58.17.727 N052.10.07.886 E020.58.15.542 Color_44ACI
N052.10.07.886 E020.58.15.542 N052.10.09.093 E020.58.14.460 Color_44ACI
N052.10.09.093 E020.58.14.460 N052.10.09.195 E020.58.14.377 Color_44ACI
N052.10.09.195 E020.58.14.377 N052.10.09.249 E020.58.14.223 Color_44ACI
N052.10.09.249 E020.58.14.223 N052.10.09.313 E020.58.14.017 Color_44ACI
N052.10.09.313 E020.58.14.017 N052.10.09.319 E020.58.13.642 Color_44ACI
N052.10.09.319 E020.58.13.642 N052.10.09.351 E020.58.13.433 Color_44ACI
N052.10.09.351 E020.58.13.433 N052.10.09.406 E020.58.13.259 Color_44ACI
N052.10.09.406 E020.58.13.259 N052.10.09.480 E020.58.13.178 Color_44ACI
N052.10.09.480 E020.58.13.178 N052.10.11.540 E020.58.11.210 Color_44ACI
N052.10.11.540 E020.58.11.210 N052.10.13.940 E020.58.09.070 Color_44ACI
N052.10.13.940 E020.58.09.070 N052.10.15.522 E020.58.07.654 Color_44ACI
N052.10.15.522 E020.58.07.654 N052.10.17.087 E020.58.06.280 Color_44ACI
N052.10.17.087 E020.58.06.280 N052.10.19.554 E020.58.04.012 Color_44ACI
N052.10.19.554 E020.58.04.012 N052.10.21.447 E020.58.02.242 Color_44ACI
N052.10.21.447 E020.58.02.242 N052.10.24.225 E020.57.59.730 Color_44ACI
N052.10.24.225 E020.57.59.730 N052.10.29.117 E020.57.55.280 Color_44ACI
N052.10.29.948 E020.57.55.217 N052.10.29.117 E020.57.55.280 Color_44ACI
N052.09.53.139 E020.58.19.116 N052.10.00.190 E020.58.12.729 Color_44ACI
N052.10.00.190 E020.58.12.729 N052.10.04.398 E020.58.08.957 Color_44ACI
N052.10.04.398 E020.58.08.957 N052.10.13.852 E020.58.00.414 Color_44ACI
N052.10.13.852 E020.58.00.414 N052.10.18.060 E020.57.56.577 Color_44ACI
N052.10.18.060 E020.57.56.577 N052.10.25.925 E020.57.49.420 Color_44ACI
N052.10.25.925 E020.57.49.420 N052.10.31.121 E020.57.44.764 Color_44ACI
N052.10.31.121 E020.57.44.764 N052.10.37.219 E020.57.39.131 Color_44ACI
N052.10.37.219 E020.57.39.131 N052.10.40.418 E020.57.36.242 Color_44ACI
N052.10.40.418 E020.57.36.242 N052.10.45.125 E020.57.31.932 Color_44ACI
N052.10.45.125 E020.57.31.932 N052.10.46.233 E020.57.30.851 Color_44ACI
N052.10.07.338 E020.57.53.977 N052.10.09.958 E020.57.53.752 Color_44ACI
N052.10.09.958 E020.57.53.752 N052.10.13.932 E020.57.53.965 Color_44ACI
N052.10.13.932 E020.57.53.965 N052.10.14.554 E020.57.54.326 Color_44ACI
N052.10.14.554 E020.57.54.326 N052.10.15.067 E020.57.55.071 Color_44ACI
N052.10.12.925 E020.57.48.899 N052.10.14.981 E020.57.54.746 Color_44ACI
N052.10.14.981 E020.57.54.746 N052.10.15.940 E020.57.57.574 Color_44ACI
N052.10.15.940 E020.57.57.574 N052.10.18.192 E020.58.04.053 Color_44ACI
N052.10.18.192 E020.58.04.053 N052.10.18.513 E020.58.04.991 Color_44ACI
N052.10.25.480 E020.57.37.506 N052.10.27.642 E020.57.37.298 Color_44ACI
N052.10.27.642 E020.57.37.298 N052.10.30.968 E020.57.37.082 Color_44ACI
N052.10.30.968 E020.57.37.082 N052.10.31.757 E020.57.37.295 Color_44ACI
N052.10.28.476 E020.57.34.798 N052.10.32.857 E020.57.38.116 Color_44ACI
N052.10.32.857 E020.57.38.116 N052.10.35.207 E020.57.39.861 Color_44ACI
N052.10.35.207 E020.57.39.861 N052.10.37.887 E020.57.41.906 Color_44ACI
N052.10.37.887 E020.57.41.906 N052.10.40.499 E020.57.43.879 Color_44ACI
N052.10.40.499 E020.57.43.879 N052.10.44.138 E020.57.46.627 Color_44ACI
N052.10.44.138 E020.57.46.627 N052.10.46.058 E020.57.48.051 Color_44ACI
N052.10.46.058 E020.57.48.051 N052.10.46.476 E020.57.48.327 Color_44ACI
N052.10.46.476 E020.57.48.327 N052.10.46.863 E020.57.48.301 Color_44ACI
N052.10.46.863 E020.57.48.301 N052.10.47.242 E020.57.47.895 Color_44ACI
N052.10.47.242 E020.57.47.895 N052.10.47.504 E020.57.47.470 Color_44ACI
N052.10.47.504 E020.57.47.470 N052.10.48.300 E020.57.45.110 Color_44ACI
N052.10.48.300 E020.57.45.110 N052.10.48.878 E020.57.43.595 Color_44ACI
N052.10.48.878 E020.57.43.595 N052.10.49.777 E020.57.41.016 Color_44ACI
N052.10.49.777 E020.57.41.016 N052.10.49.448 E020.57.40.692 Color_44ACI
N052.10.42.796 E020.57.21.904 N052.10.43.124 E020.57.22.581 Color_44ACI
N052.10.43.124 E020.57.22.581 N052.10.44.339 E020.57.25.733 Color_44ACI
N052.10.44.339 E020.57.25.733 N052.10.45.597 E020.57.29.064 Color_44ACI
N052.10.45.597 E020.57.29.064 N052.10.46.658 E020.57.31.982 Color_44ACI
N052.10.46.658 E020.57.31.982 N052.10.46.957 E020.57.32.835 Color_44ACI
N052.10.46.957 E020.57.32.835 N052.10.47.115 E020.57.33.677 Color_44ACI
N052.10.47.115 E020.57.33.677 N052.10.47.426 E020.57.36.102 Color_44ACI
N052.10.47.426 E020.57.36.102 N052.10.47.815 E020.57.38.875 Color_44ACI
N052.10.47.815 E020.57.38.875 N052.10.48.361 E020.57.42.743 Color_44ACI
N052.10.48.361 E020.57.42.743 N052.10.48.528 E020.57.44.277 Color_44ACI
N052.10.48.528 E020.57.44.277 N052.10.48.546 E020.57.44.548 Color_44ACI
N052.10.44.021 E020.57.25.032 N052.10.44.127 E020.57.25.639 Color_44ACI
N052.10.44.127 E020.57.25.639 N052.10.44.086 E020.57.26.183 Color_44ACI
N052.10.44.086 E020.57.26.183 N052.10.43.933 E020.57.27.010 Color_44ACI
N052.10.43.933 E020.57.27.010 N052.10.41.010 E020.57.34.733 Color_44ACI
N052.10.41.010 E020.57.34.733 N052.10.40.502 E020.57.35.700 Color_44ACI
N052.10.40.502 E020.57.35.700 N052.10.39.870 E020.57.36.734 Color_44ACI
N052.10.44.275 E020.57.46.743 N052.10.44.493 E020.57.47.283 Color_44ACI
N052.10.44.493 E020.57.47.283 N052.10.44.582 E020.57.47.868 Color_44ACI
N052.10.44.582 E020.57.47.868 N052.10.44.564 E020.57.48.765 Color_44ACI
N052.10.44.564 E020.57.48.765 N052.10.43.866 E020.57.51.982 Color_44ACI
N052.10.43.866 E020.57.51.982 N052.10.42.114 E020.58.00.296 Color_44ACI
N052.10.42.114 E020.58.00.296 N052.10.41.859 E020.58.00.989 Color_44ACI
N052.10.41.859 E020.58.00.989 N052.10.41.450 E020.58.01.581 Color_44ACI
N052.10.41.450 E020.58.01.581 N052.10.38.996 E020.58.04.301 Color_44ACI
N052.10.38.996 E020.58.04.301 N052.10.36.626 E020.58.06.876 Color_44ACI
N052.10.36.626 E020.58.06.876 N052.10.35.675 E020.58.07.871 Color_44ACI
N052.10.35.675 E020.58.07.871 N052.10.34.454 E020.58.09.079 Color_44ACI
N052.10.34.454 E020.58.09.079 N052.10.33.479 E020.58.09.953 Color_44ACI
N052.10.33.479 E020.58.09.953 N052.10.31.829 E020.58.11.473 Color_44ACI
N052.10.31.829 E020.58.11.473 N052.10.29.963 E020.58.13.166 Color_44ACI
N052.10.29.963 E020.58.13.166 N052.10.26.368 E020.58.16.485 Color_44ACI
N052.10.26.368 E020.58.16.485 N052.10.26.194 E020.58.16.651 Color_44ACI
N052.10.26.194 E020.58.16.651 N052.10.25.964 E020.58.16.573 Color_44ACI
N052.10.25.964 E020.58.16.573 N052.10.25.692 E020.58.16.253 Color_44ACI
N052.10.25.692 E020.58.16.253 N052.10.25.394 E020.58.15.522 Color_44ACI
N052.10.25.394 E020.58.15.522 N052.10.24.242 E020.58.12.113 Color_44ACI
N052.10.27.262 E020.57.48.329 N052.10.28.406 E020.57.51.731 Color_44ACI
N052.10.28.406 E020.57.51.731 N052.10.29.157 E020.57.53.829 Color_44ACI
N052.10.29.157 E020.57.53.829 N052.10.29.407 E020.57.54.424 Color_44ACI
N052.10.29.407 E020.57.54.424 N052.10.30.611 E020.57.56.255 Color_44ACI
N052.10.30.611 E020.57.56.255 N052.10.32.018 E020.57.59.863 Color_44ACI
N052.10.32.018 E020.57.59.863 N052.10.33.320 E020.58.03.264 Color_44ACI
N052.10.33.320 E020.58.03.264 N052.10.34.665 E020.58.06.678 Color_44ACI
N052.10.34.665 E020.58.06.678 N052.10.35.265 E020.58.08.248 Color_44ACI
N052.10.40.844 E020.58.02.262 N052.10.39.059 E020.57.58.088 Color_44ACI
N052.10.39.059 E020.57.58.088 N052.10.38.851 E020.57.57.994 Color_44ACI
N052.10.38.851 E020.57.57.994 N052.10.38.676 E020.57.57.974 Color_44ACI
N052.10.38.676 E020.57.57.974 N052.10.38.342 E020.57.58.302 Color_44ACI
N052.10.38.342 E020.57.58.302 N052.10.37.340 E020.57.59.407 Color_44ACI
N052.10.37.340 E020.57.59.407 N052.10.35.764 E020.58.01.062 Color_44ACI
N052.10.35.764 E020.58.01.062 N052.10.34.568 E020.58.02.386 Color_44ACI
N052.10.34.568 E020.58.02.386 N052.10.34.013 E020.58.02.967 Color_44ACI
N052.09.50.300 E020.58.50.289 N052.09.50.280 E020.58.50.956 Color_44ACI
N052.09.50.280 E020.58.50.956 N052.09.50.344 E020.58.51.399 Color_44ACI
N052.09.50.344 E020.58.51.399 N052.09.50.695 E020.58.52.241 Color_44ACI
N052.09.50.695 E020.58.52.241 N052.09.51.507 E020.58.53.923 Color_44ACI
N052.09.51.507 E020.58.53.923 N052.09.51.554 E020.58.54.381 Color_44ACI
N052.09.51.554 E020.58.54.381 N052.09.51.591 E020.58.55.095 Color_44ACI
N052.09.51.591 E020.58.55.095 N052.09.51.532 E020.58.55.906 Color_44ACI
N052.09.51.532 E020.58.55.906 N052.09.51.389 E020.58.56.560 Color_44ACI
N052.09.51.389 E020.58.56.560 N052.09.51.182 E020.58.57.185 Color_44ACI
N052.09.51.182 E020.58.57.185 N052.09.50.889 E020.58.57.721 Color_44ACI
N052.09.50.889 E020.58.57.721 N052.09.50.477 E020.58.58.146 Color_44ACI
N052.09.50.477 E020.58.58.146 N052.09.49.989 E020.58.58.567 Color_44ACI
N052.09.49.989 E020.58.58.567 N052.09.49.664 E020.58.58.619 Color_44ACI
N052.09.49.664 E020.58.58.619 N052.09.49.240 E020.58.58.610 Color_44ACI
N052.09.49.240 E020.58.58.610 N052.09.48.633 E020.58.58.404 Color_44ACI
N052.09.50.678 E020.58.52.014 N052.09.50.861 E020.58.52.224 Color_44ACI
N052.09.50.861 E020.58.52.224 N052.09.52.727 E020.58.53.620 Color_44ACI
N052.09.52.727 E020.58.53.620 N052.09.52.731 E020.58.53.998 Color_44ACI
N052.09.52.731 E020.58.53.998 N052.09.52.661 E020.58.54.328 Color_44ACI
N052.09.52.661 E020.58.54.328 N052.09.52.520 E020.58.54.608 Color_44ACI
N052.09.52.520 E020.58.54.608 N052.09.52.368 E020.58.54.859 Color_44ACI
N052.09.52.368 E020.58.54.859 N052.09.52.071 E020.58.55.018 Color_44ACI
N052.09.52.071 E020.58.55.018 N052.09.51.803 E020.58.55.048 Color_44ACI
N052.09.51.803 E020.58.55.048 N052.09.51.601 E020.58.54.990 Color_44ACI
N052.09.51.601 E020.58.54.990 N052.09.51.328 E020.58.54.742 Color_44ACI
N052.09.51.328 E020.58.54.742 N052.09.51.254 E020.58.54.612 Color_44ACI
N052.09.51.254 E020.58.54.612 N052.09.51.160 E020.58.54.425 Color_44ACI
N052.09.51.160 E020.58.54.425 N052.09.50.790 E020.58.54.445 Color_44ACI
N052.09.49.274 E020.58.53.420 N052.09.49.254 E020.58.54.386 Color_44ACI
N052.09.49.254 E020.58.54.386 N052.09.49.356 E020.58.54.715 Color_44ACI
N052.09.49.356 E020.58.54.715 N052.09.49.593 E020.58.55.230 Color_44ACI
N052.09.49.593 E020.58.55.230 N052.09.51.671 E020.58.57.900 Color_44ACI
N052.09.51.671 E020.58.57.900 N052.09.51.632 E020.58.58.216 Color_44ACI
N052.09.51.632 E020.58.58.216 N052.09.51.519 E020.58.58.511 Color_44ACI
N052.09.51.519 E020.58.58.511 N052.09.51.352 E020.58.58.825 Color_44ACI
N052.09.51.352 E020.58.58.825 N052.09.51.264 E020.58.58.871 Color_44ACI
N052.09.51.264 E020.58.58.871 N052.09.51.008 E020.58.59.022 Color_44ACI
N052.09.51.008 E020.58.59.022 N052.09.50.750 E020.58.59.048 Color_44ACI
N052.09.50.750 E020.58.59.048 N052.09.50.461 E020.58.58.906 Color_44ACI
N052.09.50.461 E020.58.58.906 N052.09.50.276 E020.58.58.665 Color_44ACI
N052.09.50.276 E020.58.58.665 N052.09.50.121 E020.58.58.364 Color_44ACI
N052.09.56.271 E020.58.27.989 N052.09.59.353 E020.58.30.189 Color_44ACI
N052.09.59.872 E020.58.28.329 N052.09.56.809 E020.58.26.089 Color_44ACI
N052.09.57.263 E020.58.24.432 N052.10.00.503 E020.58.26.653 Color_44ACI
N052.10.01.171 E020.58.25.637 N052.09.57.628 E020.58.23.015 Color_44ACI
N052.09.57.943 E020.58.21.691 N052.10.01.213 E020.58.23.979 Color_44ACI
N052.09.57.848 E020.58.14.886 N052.10.02.929 E020.58.16.625 Color_44ACI
N052.10.06.180 E020.58.13.708 N052.10.01.080 E020.58.11.921 Color_44ACI
N052.10.05.477 E020.58.08.059 N052.10.08.021 E020.58.15.432 Color_44ACI
N052.10.06.628 E020.58.07.040 N052.10.09.156 E020.58.14.382 Color_44ACI
N052.10.09.971 E020.58.12.657 N052.10.07.617 E020.58.06.015 Color_44ACI
N052.10.08.675 E020.58.05.083 N052.10.10.989 E020.58.11.705 Color_44ACI
N052.10.12.068 E020.58.10.759 N052.10.09.691 E020.58.04.157 Color_44ACI
N052.10.11.112 E020.58.02.897 N052.10.13.467 E020.58.09.493 Color_44ACI
N052.10.14.489 E020.58.08.510 N052.10.12.193 E020.58.01.891 Color_44ACI
N052.10.13.557 E020.58.00.677 N052.10.15.852 E020.58.07.311 Color_44ACI
N052.10.16.749 E020.58.06.519 N052.10.14.416 E020.57.59.882 Color_44ACI
N052.10.16.391 E020.57.58.059 N052.10.15.962 E020.57.59.180 Color_44ACI
N052.10.15.962 E020.57.59.180 N052.10.15.191 E020.58.06.629 Color_44ACI
N052.10.15.191 E020.58.06.629 N052.10.15.545 E020.58.07.608 Color_44ACI
N052.10.15.811 E020.57.58.585 N052.10.16.523 E020.57.58.694 Color_44ACI
N052.10.16.523 E020.57.58.694 N052.10.21.328 E020.58.00.544 Color_44ACI
N052.10.21.328 E020.58.00.544 N052.10.21.811 E020.58.01.930 Color_44ACI
N052.10.17.963 E020.57.56.632 N052.10.20.275 E020.58.03.337 Color_44ACI
N052.10.19.071 E020.57.55.604 N052.10.21.347 E020.58.02.344 Color_44ACI
N052.10.20.294 E020.57.54.514 N052.10.22.577 E020.58.01.237 Color_44ACI
N052.10.21.283 E020.57.53.594 N052.10.23.661 E020.58.00.252 Color_44ACI
N052.10.22.351 E020.57.52.653 N052.10.24.644 E020.57.59.332 Color_44ACI
N052.10.23.393 E020.57.51.675 N052.10.25.657 E020.57.58.379 Color_44ACI
N052.10.24.582 E020.57.50.671 N052.10.26.854 E020.57.57.244 Color_44ACI
N052.10.32.742 E020.57.43.237 N052.10.34.753 E020.57.49.200 Color_44ACI
N052.10.34.753 E020.57.49.200 N052.10.34.828 E020.57.49.789 Color_44ACI
N052.10.34.828 E020.57.49.789 N052.10.34.852 E020.57.50.507 Color_44ACI
N052.10.34.852 E020.57.50.507 N052.10.34.727 E020.57.51.111 Color_44ACI
N052.10.34.727 E020.57.51.111 N052.10.34.491 E020.57.51.829 Color_44ACI
N052.10.34.491 E020.57.51.829 N052.10.34.073 E020.57.52.260 Color_44ACI
N052.10.34.073 E020.57.52.260 N052.10.32.792 E020.57.53.393 Color_44ACI
N052.10.32.792 E020.57.53.393 N052.10.31.616 E020.57.54.464 Color_44ACI
N052.10.31.616 E020.57.54.464 N052.10.31.193 E020.57.54.885 Color_44ACI
N052.10.31.193 E020.57.54.885 N052.10.30.658 E020.57.55.171 Color_44ACI
N052.10.30.658 E020.57.55.171 N052.10.29.948 E020.57.55.217 Color_44ACI
N052.10.32.577 E020.57.43.437 N052.10.34.575 E020.57.49.394 Color_44ACI
N052.10.34.575 E020.57.49.394 N052.10.34.677 E020.57.49.917 Color_44ACI
N052.10.34.677 E020.57.49.917 N052.10.34.694 E020.57.50.557 Color_44ACI
N052.10.34.694 E020.57.50.557 N052.10.34.603 E020.57.51.127 Color_44ACI
N052.10.34.603 E020.57.51.127 N052.10.34.377 E020.57.51.765 Color_44ACI
N052.10.34.377 E020.57.51.765 N052.10.34.083 E020.57.52.215 Color_44ACI
N052.10.31.518 E020.57.44.433 N052.10.33.610 E020.57.50.440 Color_44ACI
N052.10.33.610 E020.57.50.440 N052.10.33.682 E020.57.51.260 Color_44ACI
N052.10.33.682 E020.57.51.260 N052.10.33.645 E020.57.51.890 Color_44ACI
N052.10.33.645 E020.57.51.890 N052.10.33.436 E020.57.52.502 Color_44ACI
N052.10.33.436 E020.57.52.502 N052.10.33.126 E020.57.53.118 Color_44ACI
N052.10.30.534 E020.57.45.290 N052.10.32.551 E020.57.51.225 Color_44ACI
N052.10.32.551 E020.57.51.225 N052.10.32.637 E020.57.51.919 Color_44ACI
N052.10.32.637 E020.57.51.919 N052.10.32.625 E020.57.52.504 Color_44ACI
N052.10.32.625 E020.57.52.504 N052.10.32.538 E020.57.53.188 Color_44ACI
N052.10.32.538 E020.57.53.188 N052.10.32.344 E020.57.53.702 Color_44ACI
N052.10.32.344 E020.57.53.702 N052.10.32.159 E020.57.54.016 Color_44ACI
N052.10.30.329 E020.57.45.397 N052.10.32.365 E020.57.51.392 Color_44ACI
N052.10.32.365 E020.57.51.392 N052.10.32.481 E020.57.52.001 Color_44ACI
N052.10.32.481 E020.57.52.001 N052.10.32.512 E020.57.52.573 Color_44ACI
N052.10.32.512 E020.57.52.573 N052.10.32.367 E020.57.53.265 Color_44ACI
N052.10.32.367 E020.57.53.265 N052.10.32.054 E020.57.53.917 Color_44ACI
N052.10.32.054 E020.57.53.917 N052.10.31.920 E020.57.54.179 Color_44ACI
N052.10.31.803 E020.58.07.250 N052.10.32.908 E020.58.10.487 Color_44ACI
N052.10.31.795 E020.58.11.519 N052.10.30.695 E020.58.08.309 Color_44ACI
N052.10.29.511 E020.58.09.435 N052.10.30.615 E020.58.12.567 Color_44ACI
N052.10.37.486 E020.57.59.227 N052.10.36.465 E020.57.56.751 Color_44ACI
N052.10.36.544 E020.58.00.231 N052.10.35.449 E020.57.57.758 Color_44ACI
N052.10.35.542 E020.58.01.320 N052.10.34.524 E020.57.58.932 Color_44ACI
N052.10.37.915 E020.58.05.433 N052.10.36.029 E020.58.00.826 Color_44ACI
N052.10.39.158 E020.58.04.111 N052.10.37.229 E020.57.59.498 Color_44ACI
N052.10.40.016 E020.58.03.109 N052.10.38.140 E020.57.58.543 Color_44ACI
N052.10.39.933 E020.57.43.483 N052.10.37.191 E020.57.45.119 Color_44ACI
N052.10.41.655 E020.57.44.781 N052.10.38.900 E020.57.46.450 Color_44ACI
N052.10.43.367 E020.57.46.103 N052.10.40.605 E020.57.47.733 Color_44ACI
N052.10.44.521 E020.57.47.560 N052.10.42.128 E020.57.48.954 Color_44ACI
N052.10.43.862 E020.57.46.420 N052.10.44.894 E020.57.42.853 Color_44ACI
N052.10.43.796 E020.57.42.054 N052.10.42.786 E020.57.45.603 Color_44ACI
N052.10.41.648 E020.57.44.732 N052.10.42.674 E020.57.41.157 Color_44ACI
N052.10.40.579 E020.57.43.883 N052.10.41.584 E020.57.40.323 Color_44ACI
N052.10.39.468 E020.57.43.064 N052.10.40.477 E020.57.39.506 Color_44ACI
N052.10.25.868 E020.57.32.889 N052.10.19.103 E020.57.27.783 Color_44ACI
N052.10.19.103 E020.57.27.783 N052.10.09.010 E020.57.20.158 Color_44ACI
N052.10.07.194 E020.57.18.807 N052.10.03.800 E020.57.16.237 Color_44ACI
N052.10.03.800 E020.57.16.237 N052.10.03.425 E020.57.15.811 Color_44ACI
N052.10.03.425 E020.57.15.811 N052.10.03.188 E020.57.15.287 Color_44ACI
N052.10.03.188 E020.57.15.287 N052.10.02.949 E020.57.14.323 Color_44ACI
N052.10.02.949 E020.57.14.323 N052.10.02.890 E020.57.13.356 Color_44ACI
N052.10.02.890 E020.57.13.356 N052.10.02.992 E020.57.12.819 Color_44ACI
N052.10.02.992 E020.57.12.819 N052.10.05.673 E020.57.02.649 Color_44ACI
N052.10.05.673 E020.57.02.649 N052.10.09.949 E020.56.46.650 Color_44ACI
N052.10.09.949 E020.56.46.650 N052.10.10.389 E020.56.45.810 Color_44ACI
N052.10.10.389 E020.56.45.810 N052.10.10.748 E020.56.45.384 Color_44ACI
N052.10.10.748 E020.56.45.384 N052.10.11.161 E020.56.45.025 Color_44ACI
N052.10.11.161 E020.56.45.025 N052.10.11.631 E020.56.44.922 Color_44ACI
N052.10.11.631 E020.56.44.922 N052.10.12.026 E020.56.45.032 Color_44ACI
N052.10.12.026 E020.56.45.032 N052.10.12.362 E020.56.45.123 Color_44ACI
N052.10.12.362 E020.56.45.123 N052.10.12.656 E020.56.45.291 Color_44ACI
N052.10.12.656 E020.56.45.291 N052.10.15.061 E020.56.47.130 Color_44ACI
N052.10.15.061 E020.56.47.130 N052.10.15.580 E020.56.47.717 Color_44ACI
N052.10.19.734 E020.57.28.252 N052.10.24.150 E020.57.12.770 Color_44ACI
N052.10.24.150 E020.57.12.770 N052.10.24.158 E020.57.10.772 Color_44ACI
N052.10.24.158 E020.57.10.772 N052.10.24.591 E020.57.09.106 Color_44ACI
N052.09.47.176 E020.58.57.007 N052.09.46.734 E020.58.57.298 Color_44ACI
N052.09.46.734 E020.58.57.298 N052.09.46.310 E020.58.57.236 Color_44ACI
N052.09.46.310 E020.58.57.236 N052.09.46.006 E020.58.57.117 Color_44ACI
N052.09.46.006 E020.58.57.117 N052.09.45.790 E020.58.56.889 Color_44ACI
N052.09.45.790 E020.58.56.889 N052.09.45.564 E020.58.56.341 Color_44ACI
N052.09.45.564 E020.58.56.341 N052.09.45.465 E020.58.55.935 Color_44ACI
N052.09.45.465 E020.58.55.935 N052.09.45.332 E020.58.54.563 Color_44ACI
N052.09.45.332 E020.58.54.563 N052.09.45.286 E020.58.53.127 Color_44ACI
N052.09.45.286 E020.58.53.127 N052.09.45.243 E020.58.50.673 Color_44ACI
N052.09.45.243 E020.58.50.673 N052.09.45.305 E020.58.48.468 Color_44ACI
N052.10.32.131 E020.57.43.778 N052.10.32.465 E020.57.43.208 Color_44ACI
N052.10.32.465 E020.57.43.208 N052.10.32.726 E020.57.42.441 Color_44ACI
N052.10.32.726 E020.57.42.441 N052.10.32.827 E020.57.41.828 Color_44ACI
N052.10.32.827 E020.57.41.828 N052.10.32.853 E020.57.40.556 Color_44ACI
N052.10.32.853 E020.57.40.556 N052.10.32.795 E020.57.39.526 Color_44ACI
N052.10.32.795 E020.57.39.526 N052.10.32.463 E020.57.38.222 Color_44ACI
N052.10.32.463 E020.57.38.222 N052.10.32.166 E020.57.37.619 Color_44ACI
N052.10.48.197 E020.57.41.325 N052.10.49.545 E020.57.39.547 Color_44ACI
N052.10.49.545 E020.57.39.547 N052.10.49.107 E020.57.39.100 Color_44ACI
N052.10.47.935 E020.57.39.383 N052.10.49.264 E020.57.37.602 Color_44ACI
N052.10.49.264 E020.57.37.602 N052.10.48.846 E020.57.37.135 Color_44ACI
N052.10.47.687 E020.57.37.422 N052.10.48.855 E020.57.35.849 Color_44ACI
N052.10.48.855 E020.57.35.849 N052.10.48.588 E020.57.35.243 Color_44ACI
N052.10.47.142 E020.57.34.285 N052.10.45.715 E020.57.34.795 Color_44ACI
N052.10.47.606 E020.57.37.300 N052.10.46.129 E020.57.37.793 Color_44ACI
N052.10.47.965 E020.57.39.754 N052.10.46.509 E020.57.40.269 Color_44ACI
N052.10.48.320 E020.57.42.242 N052.10.46.887 E020.57.42.707 Color_44ACI
N052.10.48.522 E020.57.44.197 N052.10.47.368 E020.57.44.628 Color_44ACI
N052.10.35.265 E020.58.08.248 N052.10.36.307 E020.58.10.990 Color_44ACI
N052.10.36.307 E020.58.10.990 N052.10.36.667 E020.58.11.411 Color_44ACI
N052.10.36.667 E020.58.11.411 N052.10.36.933 E020.58.12.107 Color_44ACI
N052.10.36.933 E020.58.12.107 N052.10.37.062 E020.58.12.813 Color_44ACI
N052.10.37.062 E020.58.12.813 N052.10.37.011 E020.58.13.169 Color_44ACI
N052.10.37.011 E020.58.13.169 N052.10.36.585 E020.58.14.030 Color_44ACI
N052.10.36.585 E020.58.14.030 N052.10.35.998 E020.58.14.577 Color_44ACI
N052.10.35.998 E020.58.14.577 N052.10.34.738 E020.58.15.720 Color_44ACI
N052.10.34.738 E020.58.15.720 N052.10.33.398 E020.58.16.949 Color_44ACI
N052.10.33.398 E020.58.16.949 N052.10.32.013 E020.58.18.180 Color_44ACI
N052.10.32.013 E020.58.18.180 N052.10.30.783 E020.58.19.304 Color_44ACI
N052.10.30.783 E020.58.19.304 N052.10.29.119 E020.58.20.769 Color_44ACI
N052.10.29.119 E020.58.20.769 N052.10.28.286 E020.58.21.521 Color_44ACI
N052.10.26.810 E020.58.18.955 N052.10.27.571 E020.58.21.158 Color_44ACI
N052.10.27.571 E020.58.21.158 N052.10.27.751 E020.58.21.380 Color_44ACI
N052.10.27.751 E020.58.21.380 N052.10.27.945 E020.58.21.514 Color_44ACI
N052.10.27.945 E020.58.21.514 N052.10.28.084 E020.58.21.556 Color_44ACI
N052.10.28.084 E020.58.21.556 N052.10.28.343 E020.58.21.532 Color_44ACI
N052.10.28.343 E020.58.21.532 N052.10.30.448 E020.58.21.335 Color_44ACI
N052.10.30.448 E020.58.21.335 N052.10.34.667 E020.58.20.131 Color_44ACI
N052.10.34.667 E020.58.20.131 N052.10.36.546 E020.58.19.649 Color_44ACI
N052.10.36.546 E020.58.19.649 N052.10.37.747 E020.58.19.341 Color_44ACI
N052.10.37.747 E020.58.19.341 N052.10.38.094 E020.58.19.109 Color_44ACI
N052.10.38.094 E020.58.19.109 N052.10.38.447 E020.58.18.658 Color_44ACI
N052.10.38.447 E020.58.18.658 N052.10.38.626 E020.58.18.243 Color_44ACI
N052.10.38.626 E020.58.18.243 N052.10.38.687 E020.58.17.848 Color_44ACI
N052.10.38.687 E020.58.17.848 N052.10.38.753 E020.58.17.286 Color_44ACI
N052.10.38.753 E020.58.17.286 N052.10.38.745 E020.58.16.765 Color_44ACI
N052.10.38.745 E020.58.16.765 N052.10.38.701 E020.58.16.348 Color_44ACI
N052.10.38.701 E020.58.16.348 N052.10.38.545 E020.58.15.917 Color_44ACI
N052.10.38.545 E020.58.15.917 N052.10.38.240 E020.58.15.308 Color_44ACI
N052.10.38.240 E020.58.15.308 N052.10.37.516 E020.58.14.297 Color_44ACI
N052.10.37.516 E020.58.14.297 N052.10.37.209 E020.58.13.749 Color_44ACI
N052.10.37.209 E020.58.13.749 N052.10.37.106 E020.58.13.288 Color_44ACI
N052.10.37.106 E020.58.13.288 N052.10.37.039 E020.58.12.768 Color_44ACI
N052.10.34.189 E020.58.11.789 N052.10.35.375 E020.58.15.156 Color_44ACI
N052.10.34.271 E020.58.16.141 N052.10.33.041 E020.58.12.748 Color_44ACI
N052.10.32.190 E020.58.13.627 N052.10.33.413 E020.58.16.951 Color_44ACI
N052.10.32.349 E020.58.17.918 N052.10.31.112 E020.58.14.493 Color_44ACI
N052.10.30.159 E020.58.15.397 N052.10.31.388 E020.58.18.780 Color_44ACI
N052.10.30.263 E020.58.19.762 N052.10.29.056 E020.58.16.427 Color_44ACI
N052.10.28.152 E020.58.17.210 N052.10.29.397 E020.58.20.536 Color_44ACI
N052.10.34.501 E020.58.15.965 N052.10.34.849 E020.58.20.065 Color_44ACI
N052.10.35.748 E020.58.19.842 N052.10.35.323 E020.58.15.255 Color_44ACI
N052.10.36.197 E020.58.14.462 N052.10.36.703 E020.58.19.624 Color_44ACI
N052.10.36.047 E020.58.10.172 N052.10.37.444 E020.58.08.587 Color_44ACI
N052.10.36.681 E020.58.11.427 N052.10.38.002 E020.58.09.890 Color_44ACI
N052.10.37.317 E020.58.06.085 N052.10.38.191 E020.58.08.318 Color_44ACI
N052.10.39.034 E020.58.07.380 N052.10.38.172 E020.58.05.168 Color_44ACI
N052.10.38.973 E020.58.04.295 N052.10.39.823 E020.58.06.460 Color_44ACI
N052.10.40.676 E020.58.05.589 N052.10.39.824 E020.58.03.362 Color_44ACI
N052.10.40.561 E020.58.02.576 N052.10.41.459 E020.58.04.742 Color_44ACI
N052.10.31.657 E020.58.18.508 N052.10.31.407 E020.58.18.463 Color_44ACI
N052.10.31.407 E020.58.18.463 N052.10.31.140 E020.58.18.410 Color_44ACI
N052.10.31.140 E020.58.18.410 N052.10.30.892 E020.58.18.423 Color_44ACI
N052.10.30.892 E020.58.18.423 N052.10.30.765 E020.58.18.517 Color_44ACI
N052.10.30.765 E020.58.18.517 N052.10.30.638 E020.58.18.655 Color_44ACI
N052.10.30.638 E020.58.18.655 N052.10.30.443 E020.58.18.953 Color_44ACI
N052.10.30.443 E020.58.18.953 N052.10.30.285 E020.58.19.361 Color_44ACI
N052.10.30.285 E020.58.19.361 N052.10.30.225 E020.58.19.754 Color_44ACI
N052.10.30.225 E020.58.19.754 N052.10.30.274 E020.58.20.079 Color_44ACI
N052.10.30.274 E020.58.20.079 N052.10.30.322 E020.58.20.550 Color_44ACI
N052.10.30.322 E020.58.20.550 N052.10.30.442 E020.58.20.876 Color_44ACI
N052.10.30.442 E020.58.20.876 N052.10.30.667 E020.58.21.170 Color_44ACI
N052.10.30.667 E020.58.21.170 N052.10.30.836 E020.58.21.227 Color_44ACI
N052.10.28.035 E020.58.04.726 N052.10.28.547 E020.58.06.328 Color_18ACI
N052.10.28.035 E020.58.04.726 N052.10.07.405 E020.58.23.313 Color_18ACI
N052.10.07.405 E020.58.23.313 N052.10.07.949 E020.58.24.948 Color_18ACI
N052.10.07.949 E020.58.24.948 N052.10.12.350 E020.58.20.909 Color_18ACI
N052.10.12.350 E020.58.20.909 N052.10.17.032 E020.58.23.086 Color_18ACI
N052.10.17.032 E020.58.23.086 N052.10.18.812 E020.58.21.512 Color_18ACI
N052.10.18.812 E020.58.21.512 N052.10.19.164 E020.58.22.558 Color_18ACI
N052.10.19.164 E020.58.22.558 N052.10.23.147 E020.58.18.961 Color_18ACI
N052.10.23.147 E020.58.18.961 N052.10.21.123 E020.58.13.036 Color_18ACI
N052.10.21.123 E020.58.13.036 N052.10.28.547 E020.58.06.328 Color_18ACI
N052.10.27.627 E020.58.24.819 N052.10.27.899 E020.58.28.431 Color_18ACI
N052.10.27.899 E020.58.28.431 N052.10.29.536 E020.58.28.088 Color_18ACI
N052.10.29.536 E020.58.28.088 N052.10.29.198 E020.58.24.455 Color_18ACI
N052.10.29.198 E020.58.24.455 N052.10.27.627 E020.58.24.814 Color_18ACI
N052.10.30.498 E020.58.27.561 N052.10.30.224 E020.58.24.699 Color_18ACI
N052.10.30.224 E020.58.24.699 N052.10.32.187 E020.58.24.301 Color_18ACI
N052.10.32.187 E020.58.24.301 N052.10.32.341 E020.58.27.174 Color_18ACI
N052.10.32.341 E020.58.27.174 N052.10.30.497 E020.58.27.571 Color_18ACI
N052.10.41.862 E020.58.17.825 N052.10.42.913 E020.58.19.129 Color_18ACI
N052.10.42.913 E020.58.19.129 N052.10.44.681 E020.58.15.445 Color_18ACI
N052.10.44.681 E020.58.15.445 N052.10.43.669 E020.58.14.142 Color_18ACI
N052.10.43.669 E020.58.14.142 N052.10.41.864 E020.58.17.826 Color_18ACI
N052.10.44.041 E020.58.11.948 N052.10.45.861 E020.58.14.306 Color_18ACI
N052.10.45.861 E020.58.14.306 N052.10.48.747 E020.58.08.231 Color_18ACI
N052.10.48.747 E020.58.08.231 N052.10.47.276 E020.58.06.497 Color_18ACI
N052.10.47.276 E020.58.06.497 N052.10.45.625 E020.58.10.058 Color_18ACI
N052.10.45.625 E020.58.10.058 N052.10.45.218 E020.58.09.509 Color_18ACI
N052.10.45.218 E020.58.09.509 N052.10.44.038 E020.58.11.958 Color_18ACI
N052.10.47.706 E020.58.04.507 N052.10.49.217 E020.58.05.022 Color_18ACI
N052.10.49.217 E020.58.05.022 N052.10.50.360 E020.57.54.946 Color_18ACI
N052.10.50.360 E020.57.54.946 N052.10.48.858 E020.57.54.475 Color_18ACI
N052.10.48.858 E020.57.54.475 N052.10.48.693 E020.57.55.166 Color_18ACI
N052.10.48.693 E020.57.55.166 N052.10.47.710 E020.58.03.978 Color_18ACI
N052.10.47.710 E020.58.03.978 N052.10.47.700 E020.58.04.507 Color_18ACI
N052.10.50.539 E020.57.43.271 N052.10.51.138 E020.57.43.048 Color_18ACI
N052.10.51.138 E020.57.43.048 N052.10.51.236 E020.57.43.684 Color_18ACI
N052.10.51.236 E020.57.43.684 N052.10.52.268 E020.57.43.264 Color_18ACI
N052.10.52.268 E020.57.43.264 N052.10.51.325 E020.57.37.358 Color_18ACI
N052.10.51.325 E020.57.37.358 N052.10.49.939 E020.57.37.882 Color_18ACI
N052.10.49.939 E020.57.37.882 N052.10.50.509 E020.57.42.144 Color_18ACI
N052.10.50.509 E020.57.42.144 N052.10.50.372 E020.57.42.220 Color_18ACI
N052.10.50.372 E020.57.42.220 N052.10.50.533 E020.57.43.256 Color_18ACI
N052.10.48.323 E020.57.34.223 N052.10.50.005 E020.57.33.497 Color_18ACI
N052.10.50.005 E020.57.33.497 N052.10.49.475 E020.57.29.962 Color_18ACI
N052.10.49.475 E020.57.29.962 N052.10.47.754 E020.57.30.626 Color_18ACI
N052.10.47.754 E020.57.30.626 N052.10.48.266 E020.57.34.246 Color_18ACI
N052.10.03.650 E020.58.27.684 N052.10.05.224 E020.58.27.972 Color_18ACI
N052.10.05.224 E020.58.27.972 N052.10.05.020 E020.58.30.741 Color_18ACI
N052.10.05.020 E020.58.30.741 N052.10.03.465 E020.58.30.503 Color_18ACI
N052.10.03.465 E020.58.30.503 N052.10.03.607 E020.58.27.714 Color_18ACI
N052.10.01.808 E020.58.31.734 N052.10.01.388 E020.58.35.823 Color_18ACI
N052.10.01.388 E020.58.35.823 N052.09.56.721 E020.58.34.742 Color_18ACI
N052.09.56.721 E020.58.34.742 N052.09.56.874 E020.58.33.228 Color_18ACI
N052.09.56.874 E020.58.33.228 N052.10.01.108 E020.58.34.169 Color_18ACI
N052.10.01.108 E020.58.34.169 N052.10.01.390 E020.58.31.605 Color_18ACI
N052.10.01.390 E020.58.31.605 N052.10.01.809 E020.58.31.658 Color_18ACI
N052.10.24.143 E020.57.08.115 N052.10.25.097 E020.57.04.935 Color_18ACI
N052.10.25.097 E020.57.04.935 N052.10.26.680 E020.57.06.154 Color_18ACI
N052.10.26.680 E020.57.06.154 N052.10.25.705 E020.57.09.360 Color_18ACI
N052.10.25.705 E020.57.09.360 N052.10.24.160 E020.57.08.171 Color_18ACI
N052.09.18.449 E020.59.01.617 N052.09.20.760 E020.58.59.530 Color_18ACI
N052.09.20.760 E020.58.59.530 N052.09.20.560 E020.58.58.855 Color_18ACI
N052.09.20.560 E020.58.58.855 N052.09.25.455 E020.58.54.397 Color_18ACI
N052.09.25.455 E020.58.54.397 N052.09.27.027 E020.58.59.067 Color_18ACI
N052.09.27.027 E020.58.59.067 N052.09.19.847 E020.59.05.638 Color_18ACI
N052.09.19.847 E020.59.05.638 N052.09.18.448 E020.59.01.617 Color_18ACI
N052.10.16.610 E020.58.06.690 N052.10.18.320 E020.58.11.687 Color_18ACI
N052.10.16.590 E020.58.13.191 N052.10.14.910 E020.58.08.173 Color_18ACI
N052.10.13.208 E020.58.09.722 N052.10.14.945 E020.58.14.741 Color_18ACI
N052.10.44.440 E020.57.20.329 N052.10.43.276 E020.57.16.945 Color_251ACI
N052.10.43.276 E020.57.16.945 N052.09.59.065 E020.57.57.189 Color_251ACI
N052.09.59.065 E020.57.57.189 N052.10.19.593 E020.56.40.814 Color_251ACI
N052.10.19.593 E020.56.40.814 N052.10.17.814 E020.56.39.527 Color_251ACI
N052.10.17.814 E020.56.39.527 N052.09.56.171 E020.57.59.882 Color_251ACI
N052.09.56.171 E020.57.59.882 N052.08.56.881 E020.58.53.803 Color_251ACI
N052.08.56.881 E020.58.53.803 N052.08.57.951 E020.58.56.985 Color_251ACI
N052.08.57.951 E020.58.56.985 N052.09.54.690 E020.58.05.542 Color_251ACI
N052.09.54.690 E020.58.05.542 N052.09.39.383 E020.59.02.970 Color_251ACI
N052.09.39.383 E020.59.02.970 N052.09.41.094 E020.59.04.134 Color_251ACI
N052.09.41.094 E020.59.04.134 N052.09.57.545 E020.58.02.818 Color_251ACI
N052.09.57.545 E020.58.02.818 N052.10.44.410 E020.57.20.294 Color_251ACI
N052.08.57.738 E020.58.52.853 N052.08.55.641 E020.58.46.585 Color_251ACI
N052.08.55.641 E020.58.46.585 N052.08.55.273 E020.58.45.225 Color_251ACI
N052.08.55.273 E020.58.45.225 N052.08.55.246 E020.58.43.847 Color_251ACI
N052.08.55.246 E020.58.43.847 N052.08.55.453 E020.58.42.655 Color_251ACI
N052.08.55.453 E020.58.42.655 N052.08.55.722 E020.58.41.817 Color_251ACI
N052.08.55.722 E020.58.41.817 N052.08.56.035 E020.58.41.216 Color_251ACI
N052.08.56.035 E020.58.41.216 N052.08.56.475 E020.58.40.594 Color_251ACI
N052.08.56.475 E020.58.40.594 N052.09.14.634 E020.58.24.233 Color_251ACI
N052.09.14.634 E020.58.24.233 N052.09.16.729 E020.58.30.077 Color_251ACI
N052.09.16.729 E020.58.30.077 N052.09.17.745 E020.58.32.929 Color_251ACI
N052.09.17.745 E020.58.32.929 N052.09.18.032 E020.58.33.379 Color_251ACI
N052.09.18.032 E020.58.33.379 N052.09.18.442 E020.58.33.623 Color_251ACI
N052.09.18.442 E020.58.33.623 N052.09.18.858 E020.58.33.653 Color_251ACI
N052.09.17.066 E020.58.35.396 N052.09.14.862 E020.58.29.183 Color_251ACI
N052.09.14.862 E020.58.29.183 N052.09.14.606 E020.58.28.662 Color_251ACI
N052.09.14.606 E020.58.28.662 N052.09.14.148 E020.58.28.107 Color_251ACI
N052.09.14.148 E020.58.28.107 N052.09.13.659 E020.58.27.966 Color_251ACI
N052.09.13.659 E020.58.27.966 N052.09.12.907 E020.58.28.222 Color_251ACI
N052.09.12.907 E020.58.28.222 N052.09.03.365 E020.58.36.744 Color_251ACI
N052.09.03.365 E020.58.36.744 N052.09.02.594 E020.58.37.888 Color_251ACI
N052.09.02.594 E020.58.37.888 N052.09.01.922 E020.58.39.379 Color_251ACI
N052.09.01.922 E020.58.39.379 N052.08.59.775 E020.58.45.406 Color_251ACI
N052.08.59.775 E020.58.45.406 N052.08.58.656 E020.58.48.758 Color_251ACI
N052.08.58.656 E020.58.48.758 N052.08.58.752 E020.58.49.495 Color_251ACI
N052.08.58.752 E020.58.49.495 N052.08.58.897 E020.58.49.984 Color_251ACI
N052.08.58.897 E020.58.49.984 N052.08.59.191 E020.58.50.582 Color_251ACI
N052.08.59.191 E020.58.50.582 N052.08.59.520 E020.58.50.831 Color_251ACI
N052.08.59.520 E020.58.50.831 N052.09.00.192 E020.58.50.729 Color_251ACI
N052.09.00.253 E020.58.39.224 N052.08.56.933 E020.58.42.640 Color_251ACI
N052.08.56.933 E020.58.42.640 N052.08.56.678 E020.58.43.201 Color_251ACI
N052.08.56.678 E020.58.43.201 N052.08.56.547 E020.58.43.751 Color_251ACI
N052.08.56.547 E020.58.43.751 N052.08.56.538 E020.58.44.427 Color_251ACI
N052.08.56.538 E020.58.44.427 N052.08.56.644 E020.58.45.101 Color_251ACI
N052.08.56.644 E020.58.45.101 N052.08.57.326 E020.58.47.151 Color_251ACI
N052.08.57.326 E020.58.47.151 N052.08.57.452 E020.58.47.284 Color_251ACI
N052.08.57.452 E020.58.47.284 N052.08.57.563 E020.58.47.314 Color_251ACI
N052.08.57.563 E020.58.47.314 N052.08.57.629 E020.58.47.239 Color_251ACI
N052.08.57.629 E020.58.47.239 N052.09.00.294 E020.58.39.899 Color_251ACI
N052.09.00.294 E020.58.39.899 N052.09.00.337 E020.58.39.431 Color_251ACI
N052.09.00.337 E020.58.39.431 N052.09.00.292 E020.58.39.215 Color_251ACI
N052.09.18.051 E020.58.38.792 N052.09.19.764 E020.58.43.355 Color_251ACI
N052.09.19.764 E020.58.43.355 N052.09.20.055 E020.58.44.419 Color_251ACI
N052.09.20.055 E020.58.44.419 N052.09.20.333 E020.58.45.817 Color_251ACI
N052.09.20.333 E020.58.45.817 N052.09.20.262 E020.58.46.607 Color_251ACI
N052.09.20.262 E020.58.46.607 N052.09.19.948 E020.58.47.405 Color_251ACI
N052.09.19.948 E020.58.47.405 N052.09.19.422 E020.58.48.193 Color_251ACI
N052.09.19.422 E020.58.48.193 N052.09.17.297 E020.58.50.237 Color_251ACI
N052.09.17.297 E020.58.50.237 N052.09.13.502 E020.58.53.702 Color_251ACI
N052.09.13.502 E020.58.53.702 N052.09.14.168 E020.58.55.826 Color_251ACI
N052.09.14.168 E020.58.55.826 N052.09.15.649 E020.58.55.147 Color_251ACI
N052.09.15.649 E020.58.55.147 N052.09.15.910 E020.58.55.380 Color_251ACI
N052.09.15.910 E020.58.55.380 N052.09.17.475 E020.59.00.106 Color_251ACI
N052.09.17.475 E020.59.00.106 N052.09.23.419 E020.58.54.847 Color_251ACI
N052.09.23.419 E020.58.54.847 N052.09.21.491 E020.58.49.098 Color_251ACI
N052.09.21.491 E020.58.49.098 N052.09.22.172 E020.58.48.351 Color_251ACI
N052.09.22.172 E020.58.48.351 N052.09.24.782 E020.58.46.016 Color_251ACI
N052.09.24.782 E020.58.46.016 N052.09.26.994 E020.58.44.063 Color_251ACI
N052.09.26.994 E020.58.44.063 N052.09.27.175 E020.58.44.111 Color_251ACI
N052.09.27.175 E020.58.44.111 N052.09.27.444 E020.58.44.341 Color_251ACI
N052.09.27.444 E020.58.44.341 N052.09.27.667 E020.58.44.623 Color_251ACI
N052.09.27.667 E020.58.44.623 N052.09.30.569 E020.58.52.784 Color_251ACI
N052.09.30.569 E020.58.52.784 N052.09.31.084 E020.58.54.120 Color_251ACI
N052.09.31.084 E020.58.54.120 N052.09.31.672 E020.58.55.231 Color_251ACI
N052.09.31.672 E020.58.55.231 N052.09.32.369 E020.58.56.373 Color_251ACI
N052.09.32.369 E020.58.56.373 N052.09.33.503 E020.58.57.654 Color_251ACI
N052.09.33.503 E020.58.57.654 N052.09.34.574 E020.58.58.548 Color_251ACI
N052.09.34.574 E020.58.58.548 N052.09.37.463 E020.59.00.618 Color_251ACI
N052.09.37.463 E020.59.00.618 N052.09.39.545 E020.59.02.057 Color_251ACI
N052.09.40.485 E020.58.58.466 N052.09.40.089 E020.58.58.965 Color_251ACI
N052.09.40.089 E020.58.58.965 N052.09.39.791 E020.58.59.098 Color_251ACI
N052.09.39.791 E020.58.59.098 N052.09.39.463 E020.58.59.154 Color_251ACI
N052.09.39.463 E020.58.59.154 N052.09.38.759 E020.58.58.809 Color_251ACI
N052.09.38.759 E020.58.58.809 N052.09.35.800 E020.58.56.693 Color_251ACI
N052.09.35.800 E020.58.56.693 N052.09.34.140 E020.58.55.295 Color_251ACI
N052.09.34.140 E020.58.55.295 N052.09.33.002 E020.58.54.062 Color_251ACI
N052.09.33.002 E020.58.54.062 N052.09.32.017 E020.58.52.409 Color_251ACI
N052.09.32.017 E020.58.52.409 N052.09.31.351 E020.58.50.697 Color_251ACI
N052.09.31.351 E020.58.50.697 N052.09.28.817 E020.58.43.126 Color_251ACI
N052.09.28.817 E020.58.43.126 N052.09.28.828 E020.58.42.736 Color_251ACI
N052.09.28.828 E020.58.42.736 N052.09.29.129 E020.58.42.214 Color_251ACI
N052.09.29.129 E020.58.42.214 N052.09.49.993 E020.58.23.091 Color_251ACI
N052.09.39.717 E020.58.19.015 N052.09.41.421 E020.58.18.483 Color_251ACI
N052.09.41.421 E020.58.18.483 N052.09.43.054 E020.58.18.190 Color_251ACI
N052.09.43.054 E020.58.18.190 N052.09.44.491 E020.58.18.075 Color_251ACI
N052.09.44.491 E020.58.18.075 N052.09.46.560 E020.58.18.478 Color_251ACI
N052.09.46.560 E020.58.18.478 N052.09.50.307 E020.58.19.463 Color_251ACI
N052.09.50.307 E020.58.19.463 N052.09.50.496 E020.58.19.693 Color_251ACI
N052.09.50.496 E020.58.19.693 N052.09.50.551 E020.58.19.946 Color_251ACI
N052.09.50.551 E020.58.19.946 N052.09.50.449 E020.58.20.356 Color_251ACI
N052.09.50.449 E020.58.20.356 N052.09.50.234 E020.58.20.611 Color_251ACI
N052.09.50.234 E020.58.20.611 N052.09.35.562 E020.58.33.811 Color_251ACI
N052.09.35.562 E020.58.33.811 N052.09.28.032 E020.58.40.554 Color_251ACI
N052.09.28.032 E020.58.40.554 N052.09.26.506 E020.58.41.223 Color_251ACI
N052.09.26.506 E020.58.41.223 N052.09.24.336 E020.58.41.189 Color_251ACI
N052.09.24.336 E020.58.41.189 N052.09.22.221 E020.58.41.032 Color_251ACI
N052.09.22.221 E020.58.41.032 N052.09.20.838 E020.58.40.913 Color_251ACI
N052.09.20.838 E020.58.40.913 N052.09.20.547 E020.58.40.674 Color_251ACI
N052.09.20.547 E020.58.40.674 N052.09.20.215 E020.58.40.141 Color_251ACI
N052.09.20.215 E020.58.40.141 N052.09.19.885 E020.58.38.832 Color_251ACI
N052.09.19.885 E020.58.38.832 N052.09.19.826 E020.58.38.342 Color_251ACI
N052.09.19.826 E020.58.38.342 N052.09.19.956 E020.58.37.649 Color_251ACI
N052.09.19.956 E020.58.37.649 N052.09.20.363 E020.58.36.658 Color_251ACI
N052.09.21.305 E020.58.43.569 N052.09.21.624 E020.58.44.519 Color_251ACI
N052.09.21.624 E020.58.44.519 N052.09.21.917 E020.58.44.926 Color_251ACI
N052.09.21.917 E020.58.44.926 N052.09.22.280 E020.58.45.191 Color_251ACI
N052.09.22.280 E020.58.45.191 N052.09.22.726 E020.58.45.207 Color_251ACI
N052.09.22.726 E020.58.45.207 N052.09.23.076 E020.58.45.207 Color_251ACI
N052.09.23.076 E020.58.45.207 N052.09.25.544 E020.58.43.325 Color_251ACI
N052.09.25.544 E020.58.43.325 N052.09.22.966 E020.58.43.406 Color_251ACI
N052.09.22.966 E020.58.43.406 N052.09.21.266 E020.58.43.547 Color_251ACI
N052.09.43.875 E020.58.15.379 N052.09.48.169 E020.58.16.801 Color_251ACI
N052.09.48.169 E020.58.16.801 N052.09.50.271 E020.58.17.478 Color_251ACI
N052.09.50.271 E020.58.17.478 N052.09.50.494 E020.58.17.455 Color_251ACI
N052.09.50.494 E020.58.17.455 N052.09.50.687 E020.58.17.218 Color_251ACI
N052.09.50.687 E020.58.17.218 N052.09.50.699 E020.58.16.993 Color_251ACI
N052.09.50.699 E020.58.16.993 N052.09.50.691 E020.58.16.736 Color_251ACI
N052.09.50.691 E020.58.16.736 N052.09.49.095 E020.58.12.267 Color_251ACI
N052.09.49.095 E020.58.12.267 N052.09.48.799 E020.58.11.839 Color_251ACI
N052.09.48.799 E020.58.11.839 N052.09.48.532 E020.58.11.718 Color_251ACI
N052.09.48.532 E020.58.11.718 N052.09.47.774 E020.58.11.709 Color_251ACI
N052.09.50.368 E020.58.09.323 N052.09.49.905 E020.58.10.150 Color_251ACI
N052.09.49.905 E020.58.10.150 N052.09.49.924 E020.58.11.739 Color_251ACI
N052.09.49.924 E020.58.11.739 N052.09.51.115 E020.58.15.676 Color_251ACI
N052.09.51.115 E020.58.15.676 N052.09.51.320 E020.58.16.242 Color_251ACI
N052.09.51.320 E020.58.16.242 N052.09.51.745 E020.58.16.509 Color_251ACI
N052.10.15.965 E020.56.46.373 N052.10.12.823 E020.56.44.054 Color_251ACI
N052.10.12.823 E020.56.44.054 N052.10.11.922 E020.56.43.735 Color_251ACI
N052.10.11.922 E020.56.43.735 N052.10.11.187 E020.56.43.858 Color_251ACI
N052.10.11.187 E020.56.43.858 N052.10.10.496 E020.56.44.231 Color_251ACI
N052.10.10.496 E020.56.44.231 N052.10.10.035 E020.56.44.718 Color_251ACI
N052.10.10.035 E020.56.44.718 N052.10.09.273 E020.56.46.050 Color_251ACI
N052.10.09.273 E020.56.46.050 N052.10.02.365 E020.57.12.656 Color_251ACI
N052.10.02.365 E020.57.12.656 N052.10.02.302 E020.57.13.607 Color_251ACI
N052.10.02.302 E020.57.13.607 N052.10.02.425 E020.57.14.697 Color_251ACI
N052.10.02.425 E020.57.14.697 N052.10.02.720 E020.57.15.878 Color_251ACI
N052.10.02.720 E020.57.15.878 N052.10.03.526 E020.57.17.105 Color_251ACI
N052.10.03.526 E020.57.17.105 N052.10.06.986 E020.57.19.832 Color_251ACI
N052.10.07.482 E020.57.17.908 N052.10.05.054 E020.57.15.906 Color_251ACI
N052.10.05.054 E020.57.15.906 N052.10.04.390 E020.57.15.112 Color_251ACI
N052.10.04.390 E020.57.15.112 N052.10.04.027 E020.57.14.550 Color_251ACI
N052.10.04.027 E020.57.14.550 N052.10.03.851 E020.57.13.378 Color_251ACI
N052.10.03.851 E020.57.13.378 N052.10.04.012 E020.57.12.634 Color_251ACI
N052.10.04.012 E020.57.12.634 N052.10.06.401 E020.57.02.847 Color_251ACI
N052.10.06.401 E020.57.02.847 N052.10.09.961 E020.56.49.442 Color_251ACI
N052.10.09.961 E020.56.49.442 N052.10.10.807 E020.56.46.952 Color_251ACI
N052.10.10.807 E020.56.46.952 N052.10.11.014 E020.56.46.522 Color_251ACI
N052.10.11.014 E020.56.46.522 N052.10.11.443 E020.56.46.322 Color_251ACI
N052.10.11.443 E020.56.46.322 N052.10.11.845 E020.56.46.296 Color_251ACI
N052.10.11.845 E020.56.46.296 N052.10.12.353 E020.56.46.552 Color_251ACI
N052.10.12.353 E020.56.46.552 N052.10.14.201 E020.56.48.017 Color_251ACI
N052.10.14.201 E020.56.48.017 N052.10.14.505 E020.56.48.775 Color_251ACI
N052.10.14.505 E020.56.48.775 N052.10.14.842 E020.56.50.419 Color_251ACI
N052.10.09.327 E020.57.19.262 N052.10.19.248 E020.57.26.856 Color_251ACI
N052.10.19.248 E020.57.26.856 N052.10.19.550 E020.57.26.808 Color_251ACI
N052.10.19.550 E020.57.26.808 N052.10.19.722 E020.57.26.642 Color_251ACI
N052.10.19.722 E020.57.26.642 N052.10.21.952 E020.57.18.789 Color_251ACI
N052.10.21.952 E020.57.18.789 N052.10.21.952 E020.57.18.501 Color_251ACI
N052.10.21.952 E020.57.18.501 N052.10.21.796 E020.57.18.092 Color_251ACI
N052.10.21.796 E020.57.18.092 N052.10.23.270 E020.57.12.877 Color_251ACI
N052.10.23.270 E020.57.12.877 N052.10.22.594 E020.57.12.216 Color_251ACI
N052.10.22.594 E020.57.12.216 N052.10.23.764 E020.57.08.096 Color_251ACI
N052.10.23.764 E020.57.08.096 N052.10.25.528 E020.57.09.418 Color_251ACI
N052.10.25.528 E020.57.09.418 N052.10.20.560 E020.57.27.434 Color_251ACI
N052.10.20.560 E020.57.27.434 N052.10.20.579 E020.57.27.666 Color_251ACI
N052.10.20.579 E020.57.27.666 N052.10.20.927 E020.57.28.036 Color_251ACI
N052.10.20.927 E020.57.28.036 N052.10.26.521 E020.57.32.310 Color_251ACI
N052.10.24.656 E020.57.33.938 N052.10.24.588 E020.57.33.030 Color_251ACI
N052.10.24.588 E020.57.33.030 N052.10.08.750 E020.57.21.177 Color_251ACI
N052.09.41.344 E020.59.03.108 N052.09.41.891 E020.59.03.363 Color_251ACI
N052.09.41.891 E020.59.03.363 N052.09.42.245 E020.59.03.419 Color_251ACI
N052.09.42.245 E020.59.03.419 N052.09.43.224 E020.59.02.941 Color_251ACI
N052.09.43.224 E020.59.02.941 N052.09.46.120 E020.58.59.569 Color_251ACI
N052.09.46.120 E020.58.59.569 N052.09.50.064 E020.58.59.477 Color_251ACI
N052.09.50.064 E020.58.59.477 N052.09.51.328 E020.59.00.320 Color_251ACI
N052.09.51.328 E020.59.00.320 N052.09.53.373 E020.58.52.926 Color_251ACI
N052.09.53.373 E020.58.52.926 N052.09.52.002 E020.58.51.909 Color_251ACI
N052.09.52.002 E020.58.51.909 N052.09.51.663 E020.58.51.471 Color_251ACI
N052.09.51.663 E020.58.51.471 N052.09.51.327 E020.58.50.608 Color_251ACI
N052.09.51.327 E020.58.50.608 N052.09.51.250 E020.58.49.951 Color_251ACI
N052.09.51.250 E020.58.49.951 N052.09.51.321 E020.58.49.225 Color_251ACI
N052.09.51.321 E020.58.49.225 N052.09.55.583 E020.58.33.562 Color_251ACI
N052.09.55.583 E020.58.33.562 N052.09.56.553 E020.58.33.979 Color_251ACI
N052.09.56.553 E020.58.33.979 N052.09.57.215 E020.58.31.583 Color_251ACI
N052.09.57.215 E020.58.31.583 N052.09.58.549 E020.58.32.166 Color_251ACI
N052.09.58.549 E020.58.32.166 N052.09.59.169 E020.58.32.305 Color_251ACI
N052.09.59.169 E020.58.32.305 N052.10.00.577 E020.58.30.867 Color_251ACI
N052.10.00.577 E020.58.30.867 N052.10.03.342 E020.58.26.272 Color_251ACI
N052.10.03.342 E020.58.26.272 N052.10.05.738 E020.58.23.625 Color_251ACI
N052.10.05.738 E020.58.23.625 N052.10.07.405 E020.58.23.313 Color_251ACI
N052.10.23.014 E020.58.18.506 N052.10.23.481 E020.58.18.487 Color_251ACI
N052.10.23.481 E020.58.18.487 N052.10.24.266 E020.58.20.582 Color_251ACI
N052.10.24.266 E020.58.20.582 N052.10.24.256 E020.58.21.246 Color_251ACI
N052.10.24.256 E020.58.21.246 N052.10.24.185 E020.58.22.198 Color_251ACI
N052.10.24.185 E020.58.22.198 N052.10.25.929 E020.58.24.121 Color_251ACI
N052.10.25.929 E020.58.24.121 N052.10.27.044 E020.58.25.236 Color_251ACI
N052.10.27.044 E020.58.25.236 N052.10.27.599 E020.58.25.070 Color_251ACI
N052.10.29.329 E020.58.25.033 N052.10.30.220 E020.58.24.822 Color_251ACI
N052.10.32.165 E020.58.24.392 N052.10.33.299 E020.58.24.082 Color_251ACI
N052.10.33.299 E020.58.24.082 N052.10.33.257 E020.58.22.276 Color_251ACI
N052.10.33.257 E020.58.22.276 N052.10.37.851 E020.58.21.099 Color_251ACI
N052.10.37.851 E020.58.21.099 N052.10.38.761 E020.58.20.651 Color_251ACI
N052.10.38.761 E020.58.20.651 N052.10.40.146 E020.58.18.599 Color_251ACI
N052.10.40.146 E020.58.18.599 N052.10.40.531 E020.58.19.620 Color_251ACI
N052.10.40.531 E020.58.19.620 N052.10.41.156 E020.58.20.036 Color_251ACI
N052.10.41.156 E020.58.20.036 N052.10.42.096 E020.58.18.120 Color_251ACI
N052.10.43.850 E020.58.14.289 N052.10.44.593 E020.58.12.668 Color_251ACI
N052.10.47.350 E020.58.06.569 N052.10.47.676 E020.58.05.876 Color_251ACI
N052.10.47.676 E020.58.05.876 N052.10.47.756 E020.58.04.512 Color_251ACI
N052.10.48.980 E020.57.54.492 N052.10.48.529 E020.57.54.204 Color_251ACI
N052.10.48.529 E020.57.54.204 N052.10.48.298 E020.57.53.717 Color_251ACI
N052.10.48.298 E020.57.53.717 N052.10.48.703 E020.57.49.910 Color_251ACI
N052.10.48.703 E020.57.49.910 N052.10.49.588 E020.57.45.412 Color_251ACI
N052.10.49.588 E020.57.45.412 N052.10.51.159 E020.57.43.305 Color_251ACI
N052.10.49.965 E020.57.37.836 N052.10.49.375 E020.57.33.796 Color_251ACI
N052.10.47.897 E020.57.30.478 N052.10.47.698 E020.57.28.361 Color_251ACI
N052.10.47.698 E020.57.28.361 N052.10.46.992 E020.57.26.370 Color_251ACI
N052.10.46.992 E020.57.26.370 N052.10.46.327 E020.57.26.548 Color_251ACI
N052.10.46.327 E020.57.26.548 N052.10.45.832 E020.57.26.983 Color_251ACI
N052.10.45.832 E020.57.26.983 N052.10.45.525 E020.57.26.897 Color_251ACI
N052.10.45.525 E020.57.26.897 N052.10.45.310 E020.57.26.304 Color_251ACI
N052.10.45.310 E020.57.26.304 N052.10.43.458 E020.57.21.203 Color_251ACI
N052.10.41.658 E020.57.22.761 N052.10.42.427 E020.57.23.072 Color_251ACI
N052.10.42.427 E020.57.23.072 N052.10.43.264 E020.57.25.555 Color_251ACI
N052.10.43.264 E020.57.25.555 N052.10.43.223 E020.57.26.600 Color_251ACI
N052.10.43.223 E020.57.26.600 N052.10.42.183 E020.57.29.653 Color_251ACI
N052.10.42.183 E020.57.29.653 N052.10.40.778 E020.57.33.370 Color_251ACI
N052.10.40.778 E020.57.33.370 N052.10.39.924 E020.57.35.157 Color_251ACI
N052.10.39.924 E020.57.35.157 N052.10.38.939 E020.57.36.332 Color_251ACI
N052.10.38.939 E020.57.36.332 N052.10.36.263 E020.57.38.827 Color_251ACI
N052.10.36.263 E020.57.38.827 N052.10.35.319 E020.57.38.949 Color_251ACI
N052.10.35.319 E020.57.38.949 N052.10.29.335 E020.57.34.243 Color_251ACI
N052.10.29.335 E020.57.34.243 N052.10.29.317 E020.57.33.882 Color_251ACI
N052.10.27.744 E020.57.35.380 N052.10.28.731 E020.57.36.189 Color_251ACI
N052.10.28.731 E020.57.36.189 N052.10.27.035 E020.57.36.055 Color_251ACI
N052.10.21.446 E020.57.41.091 N052.10.23.727 E020.57.39.667 Color_251ACI
N052.10.23.727 E020.57.39.667 N052.10.26.368 E020.57.38.606 Color_251ACI
N052.10.26.368 E020.57.38.606 N052.10.28.868 E020.57.38.347 Color_251ACI
N052.10.28.868 E020.57.38.347 N052.10.31.040 E020.57.38.465 Color_251ACI
N052.10.31.040 E020.57.38.465 N052.10.31.760 E020.57.39.059 Color_251ACI
N052.10.31.760 E020.57.39.059 N052.10.32.127 E020.57.39.822 Color_251ACI
N052.10.32.127 E020.57.39.822 N052.10.32.273 E020.57.40.623 Color_251ACI
N052.10.32.273 E020.57.40.623 N052.10.32.314 E020.57.41.067 Color_251ACI
N052.10.32.314 E020.57.41.067 N052.10.32.156 E020.57.42.017 Color_251ACI
N052.10.32.156 E020.57.42.017 N052.10.31.674 E020.57.42.993 Color_251ACI
N052.10.31.674 E020.57.42.993 N052.10.19.205 E020.57.54.277 Color_251ACI
N052.10.19.205 E020.57.54.277 N052.10.16.852 E020.57.55.779 Color_251ACI
N052.10.16.852 E020.57.55.779 N052.10.16.640 E020.57.55.745 Color_251ACI
N052.10.16.640 E020.57.55.745 N052.10.16.375 E020.57.55.500 Color_251ACI
N052.10.16.375 E020.57.55.500 N052.10.16.120 E020.57.55.194 Color_251ACI
N052.10.16.120 E020.57.55.194 N052.10.15.420 E020.57.53.680 Color_251ACI
N052.10.15.420 E020.57.53.680 N052.10.14.153 E020.57.50.018 Color_251ACI
N052.10.14.153 E020.57.50.018 N052.10.14.098 E020.57.48.660 Color_251ACI
N052.10.14.098 E020.57.48.660 N052.10.14.555 E020.57.47.372 Color_251ACI
N052.10.08.837 E020.57.52.606 N052.10.11.370 E020.57.50.389 Color_251ACI
N052.10.11.370 E020.57.50.389 N052.10.12.592 E020.57.50.387 Color_251ACI
N052.10.12.592 E020.57.50.387 N052.10.13.104 E020.57.51.124 Color_251ACI
N052.10.13.104 E020.57.51.124 N052.10.13.584 E020.57.52.860 Color_251ACI
N052.10.13.584 E020.57.52.860 N052.10.08.868 E020.57.52.609 Color_251ACI
N052.10.03.410 E020.57.57.528 N052.10.05.456 E020.57.56.259 Color_251ACI
N052.10.05.456 E020.57.56.259 N052.10.07.832 E020.57.55.276 Color_251ACI
N052.10.07.832 E020.57.55.276 N052.10.09.800 E020.57.54.857 Color_251ACI
N052.10.09.800 E020.57.54.857 N052.10.11.950 E020.57.54.981 Color_251ACI
N052.10.11.950 E020.57.54.981 N052.10.13.766 E020.57.55.273 Color_251ACI
N052.10.13.766 E020.57.55.273 N052.10.14.143 E020.57.55.381 Color_251ACI
N052.10.14.143 E020.57.55.381 N052.10.14.480 E020.57.55.892 Color_251ACI
N052.10.14.480 E020.57.55.892 N052.10.14.674 E020.57.56.471 Color_251ACI
N052.10.14.674 E020.57.56.471 N052.10.14.712 E020.57.56.941 Color_251ACI
N052.10.14.712 E020.57.56.941 N052.10.14.642 E020.57.57.594 Color_251ACI
N052.10.14.642 E020.57.57.594 N052.10.14.329 E020.57.58.521 Color_251ACI
N052.10.14.329 E020.57.58.521 N052.10.12.675 E020.58.00.193 Color_251ACI
N052.10.12.675 E020.58.00.193 N052.09.54.964 E020.58.16.387 Color_251ACI
N052.09.54.964 E020.58.16.387 N052.09.54.395 E020.58.16.533 Color_251ACI
N052.09.54.395 E020.58.16.533 N052.09.54.232 E020.58.16.389 Color_251ACI
N052.09.54.232 E020.58.16.389 N052.09.54.043 E020.58.15.788 Color_251ACI
N052.10.44.403 E020.57.27.818 N052.10.42.232 E020.57.33.391 Color_251ACI
N052.10.42.232 E020.57.33.391 N052.10.44.789 E020.57.31.061 Color_251ACI
N052.10.44.789 E020.57.31.061 N052.10.44.976 E020.57.30.723 Color_251ACI
N052.10.44.976 E020.57.30.723 N052.10.45.005 E020.57.30.217 Color_251ACI
N052.10.45.005 E020.57.30.217 N052.10.45.001 E020.57.29.723 Color_251ACI
N052.10.45.001 E020.57.29.723 N052.10.44.399 E020.57.27.827 Color_251ACI
N052.10.46.218 E020.57.43.299 N052.10.44.767 E020.57.33.792 Color_251ACI
N052.10.44.767 E020.57.33.792 N052.10.44.504 E020.57.33.649 Color_251ACI
N052.10.44.504 E020.57.33.649 N052.10.37.611 E020.57.39.888 Color_251ACI
N052.10.37.611 E020.57.39.888 N052.10.37.694 E020.57.40.390 Color_251ACI
N052.10.37.694 E020.57.40.390 N052.10.37.949 E020.57.40.781 Color_251ACI
N052.10.37.949 E020.57.40.781 N052.10.38.353 E020.57.40.880 Color_251ACI
N052.10.38.353 E020.57.40.880 N052.10.38.711 E020.57.40.744 Color_251ACI
N052.10.38.711 E020.57.40.744 N052.10.38.965 E020.57.40.569 Color_251ACI
N052.10.38.965 E020.57.40.569 N052.10.39.432 E020.57.39.286 Color_251ACI
N052.10.39.432 E020.57.39.286 N052.10.40.307 E020.57.38.803 Color_251ACI
N052.10.40.307 E020.57.38.803 N052.10.45.342 E020.57.42.450 Color_251ACI
N052.10.45.342 E020.57.42.450 N052.10.45.477 E020.57.44.260 Color_251ACI
N052.10.45.477 E020.57.44.260 N052.10.45.051 E020.57.46.173 Color_251ACI
N052.10.45.051 E020.57.46.173 N052.10.45.891 E020.57.46.779 Color_251ACI
N052.10.45.891 E020.57.46.779 N052.10.46.094 E020.57.46.650 Color_251ACI
N052.10.46.094 E020.57.46.650 N052.10.46.238 E020.57.46.522 Color_251ACI
N052.10.46.238 E020.57.46.522 N052.10.46.465 E020.57.46.132 Color_251ACI
N052.10.46.465 E020.57.46.132 N052.10.46.515 E020.57.45.472 Color_251ACI
N052.10.46.515 E020.57.45.472 N052.10.46.217 E020.57.43.343 Color_251ACI
N052.10.43.247 E020.57.50.705 N052.10.39.927 E020.57.48.391 Color_251ACI
N052.10.39.927 E020.57.48.391 N052.10.36.694 E020.57.51.191 Color_251ACI
N052.10.36.694 E020.57.51.191 N052.10.36.548 E020.57.51.587 Color_251ACI
N052.10.36.548 E020.57.51.587 N052.10.32.659 E020.57.55.121 Color_251ACI
N052.10.32.659 E020.57.55.121 N052.10.32.568 E020.57.55.402 Color_251ACI
N052.10.32.568 E020.57.55.402 N052.10.31.962 E020.57.56.053 Color_251ACI
N052.10.31.962 E020.57.56.053 N052.10.32.697 E020.57.58.103 Color_251ACI
N052.10.32.697 E020.57.58.103 N052.10.34.325 E020.57.56.690 Color_251ACI
N052.10.34.325 E020.57.56.690 N052.10.36.307 E020.57.55.878 Color_251ACI
N052.10.36.307 E020.57.55.878 N052.10.38.951 E020.57.55.518 Color_251ACI
N052.10.38.951 E020.57.55.518 N052.10.40.970 E020.58.00.375 Color_251ACI
N052.10.40.970 E020.58.00.375 N052.10.41.210 E020.58.00.438 Color_251ACI
N052.10.41.210 E020.58.00.438 N052.10.41.355 E020.58.00.365 Color_251ACI
N052.10.41.355 E020.58.00.365 N052.10.41.629 E020.57.59.490 Color_251ACI
N052.10.41.629 E020.57.59.490 N052.10.43.289 E020.57.51.403 Color_251ACI
N052.10.43.289 E020.57.51.403 N052.10.43.288 E020.57.50.682 Color_251ACI
N052.10.36.843 E020.57.42.688 N052.10.36.142 E020.57.41.903 Color_251ACI
N052.10.36.142 E020.57.41.903 N052.10.35.498 E020.57.41.986 Color_251ACI
N052.10.35.498 E020.57.41.986 N052.10.34.459 E020.57.42.781 Color_251ACI
N052.10.34.459 E020.57.42.781 N052.10.34.371 E020.57.44.169 Color_251ACI
N052.10.34.371 E020.57.44.169 N052.10.36.506 E020.57.50.436 Color_251ACI
N052.10.36.506 E020.57.50.436 N052.10.36.784 E020.57.50.637 Color_251ACI
N052.10.36.784 E020.57.50.637 N052.10.37.505 E020.57.49.867 Color_251ACI
N052.10.37.505 E020.57.49.867 N052.10.37.498 E020.57.49.528 Color_251ACI
N052.10.37.498 E020.57.49.528 N052.10.36.933 E020.57.47.566 Color_251ACI
N052.10.36.933 E020.57.47.566 N052.10.36.175 E020.57.48.277 Color_251ACI
N052.10.36.175 E020.57.48.277 N052.10.35.203 E020.57.45.332 Color_251ACI
N052.10.35.203 E020.57.45.332 N052.10.36.256 E020.57.44.348 Color_251ACI
N052.10.36.256 E020.57.44.348 N052.10.36.749 E020.57.43.636 Color_251ACI
N052.10.36.749 E020.57.43.636 N052.10.36.901 E020.57.43.216 Color_251ACI
N052.10.36.901 E020.57.43.216 N052.10.36.865 E020.57.42.750 Color_251ACI
N052.10.47.171 E020.57.50.312 N052.10.46.952 E020.57.49.982 Color_251ACI
N052.10.46.952 E020.57.49.982 N052.10.46.526 E020.57.49.846 Color_251ACI
N052.10.46.526 E020.57.49.846 N052.10.46.216 E020.57.50.138 Color_251ACI
N052.10.46.216 E020.57.50.138 N052.10.45.971 E020.57.50.742 Color_251ACI
N052.10.45.971 E020.57.50.742 N052.10.44.862 E020.57.51.270 Color_251ACI
N052.10.44.862 E020.57.51.270 N052.10.44.563 E020.57.52.420 Color_251ACI
N052.10.44.563 E020.57.52.420 N052.10.43.470 E020.57.56.949 Color_251ACI
N052.10.43.470 E020.57.56.949 N052.10.42.813 E020.58.00.564 Color_251ACI
N052.10.42.813 E020.58.00.564 N052.10.41.840 E020.58.02.515 Color_251ACI
N052.10.41.840 E020.58.02.515 N052.10.42.179 E020.58.03.710 Color_251ACI
N052.10.42.179 E020.58.03.710 N052.10.41.631 E020.58.06.725 Color_251ACI
N052.10.41.631 E020.58.06.725 N052.10.39.338 E020.58.10.821 Color_251ACI
N052.10.39.338 E020.58.10.821 N052.10.37.996 E020.58.12.884 Color_251ACI
N052.10.37.996 E020.58.12.884 N052.10.38.974 E020.58.15.361 Color_251ACI
N052.10.38.974 E020.58.15.361 N052.10.39.531 E020.58.15.934 Color_251ACI
N052.10.39.531 E020.58.15.934 N052.10.39.869 E020.58.15.917 Color_251ACI
N052.10.39.869 E020.58.15.917 N052.10.40.077 E020.58.15.580 Color_251ACI
N052.10.40.077 E020.58.15.580 N052.10.40.276 E020.58.15.072 Color_251ACI
N052.10.40.276 E020.58.15.072 N052.10.39.344 E020.58.13.602 Color_251ACI
N052.10.39.344 E020.58.13.602 N052.10.44.526 E020.58.02.507 Color_251ACI
N052.10.44.526 E020.58.02.507 N052.10.43.406 E020.58.00.020 Color_251ACI
N052.10.43.406 E020.58.00.020 N052.10.43.927 E020.57.56.002 Color_251ACI
N052.10.43.927 E020.57.56.002 N052.10.44.443 E020.57.54.960 Color_251ACI
N052.10.44.443 E020.57.54.960 N052.10.45.337 E020.57.54.910 Color_251ACI
N052.10.45.337 E020.57.54.910 N052.10.45.500 E020.57.54.385 Color_251ACI
N052.10.45.500 E020.57.54.385 N052.10.45.848 E020.57.54.262 Color_251ACI
N052.10.45.848 E020.57.54.262 N052.10.46.143 E020.57.52.206 Color_251ACI
N052.10.46.143 E020.57.52.206 N052.10.46.876 E020.57.52.055 Color_251ACI
N052.10.46.876 E020.57.52.055 N052.10.47.187 E020.57.50.307 Color_251ACI
N052.10.31.427 E020.57.53.196 N052.10.29.638 E020.57.48.051 Color_251ACI
N052.10.29.638 E020.57.48.051 N052.10.29.341 E020.57.48.080 Color_251ACI
N052.10.29.341 E020.57.48.080 N052.10.29.125 E020.57.48.356 Color_251ACI
N052.10.29.125 E020.57.48.356 N052.10.29.015 E020.57.48.928 Color_251ACI
N052.10.29.015 E020.57.48.928 N052.10.29.168 E020.57.50.076 Color_251ACI
N052.10.29.168 E020.57.50.076 N052.10.30.119 E020.57.52.934 Color_251ACI
N052.10.30.119 E020.57.52.934 N052.10.30.587 E020.57.53.547 Color_251ACI
N052.10.30.587 E020.57.53.547 N052.10.31.048 E020.57.53.613 Color_251ACI
N052.10.31.048 E020.57.53.613 N052.10.31.479 E020.57.53.276 Color_251ACI
N052.09.57.197 E020.58.18.644 N052.09.55.853 E020.58.18.492 Color_251ACI
N052.09.55.853 E020.58.18.492 N052.09.55.824 E020.58.18.046 Color_251ACI
N052.09.55.824 E020.58.18.046 N052.09.57.448 E020.58.16.589 Color_251ACI
N052.09.57.448 E020.58.16.589 N052.09.57.438 E020.58.18.223 Color_251ACI
N052.09.57.438 E020.58.18.223 N052.09.57.201 E020.58.18.634 Color_251ACI
N052.09.52.777 E020.58.20.550 N052.09.53.425 E020.58.20.198 Color_251ACI
N052.09.53.425 E020.58.20.198 N052.09.55.514 E020.58.20.552 Color_251ACI
N052.09.55.514 E020.58.20.552 N052.09.56.182 E020.58.20.844 Color_251ACI
N052.09.56.182 E020.58.20.844 N052.09.57.130 E020.58.21.767 Color_251ACI
N052.09.57.130 E020.58.21.767 N052.09.56.993 E020.58.23.189 Color_251ACI
N052.09.56.993 E020.58.23.189 N052.09.49.086 E020.58.52.126 Color_251ACI
N052.09.49.086 E020.58.52.126 N052.09.48.467 E020.58.53.482 Color_251ACI
N052.09.48.467 E020.58.53.482 N052.09.47.632 E020.58.54.976 Color_251ACI
N052.09.47.632 E020.58.54.976 N052.09.46.813 E020.58.55.755 Color_251ACI
N052.09.46.813 E020.58.55.755 N052.09.46.463 E020.58.55.890 Color_251ACI
N052.09.46.463 E020.58.55.890 N052.09.46.208 E020.58.55.560 Color_251ACI
N052.09.46.208 E020.58.55.560 N052.09.46.078 E020.58.55.351 Color_251ACI
N052.09.46.078 E020.58.55.351 N052.09.45.940 E020.58.54.824 Color_251ACI
N052.09.45.940 E020.58.54.824 N052.09.45.871 E020.58.53.589 Color_251ACI
N052.09.45.871 E020.58.53.589 N052.09.45.785 E020.58.51.004 Color_251ACI
N052.09.45.785 E020.58.51.004 N052.09.46.194 E020.58.46.670 Color_251ACI
N052.09.46.194 E020.58.46.670 N052.09.46.528 E020.58.44.016 Color_251ACI
N052.09.44.325 E020.58.52.039 N052.09.44.956 E020.58.56.645 Color_251ACI
N052.09.44.956 E020.58.56.645 N052.09.45.134 E020.58.57.286 Color_251ACI
N052.09.45.134 E020.58.57.286 N052.09.45.469 E020.58.57.669 Color_251ACI
N052.09.45.469 E020.58.57.669 N052.09.42.960 E020.59.00.602 Color_251ACI
N052.09.42.960 E020.59.00.602 N052.09.42.414 E020.59.00.889 Color_251ACI
N052.09.42.414 E020.59.00.889 N052.09.41.966 E020.59.00.831 Color_251ACI
N052.10.26.613 E020.57.48.788 N052.10.28.739 E020.57.55.068 blu
N052.10.28.739 E020.57.55.068 N052.10.30.122 E020.57.57.070 blu
N052.10.30.122 E020.57.57.070 N052.10.33.011 E020.58.04.750 blu
N052.10.33.011 E020.58.04.750 N052.10.33.696 E020.58.06.359 blu
N052.10.33.696 E020.58.06.359 N052.10.34.352 E020.58.07.861 blu
N052.10.34.352 E020.58.07.861 N052.10.34.686 E020.58.08.830 blu
N052.10.27.834 E020.57.47.782 N052.10.29.850 E020.57.53.586 oranz
N052.10.29.850 E020.57.53.586 N052.10.31.155 E020.57.55.438 oranz
N052.10.31.155 E020.57.55.438 N052.10.32.622 E020.57.59.321 oranz
N052.10.32.622 E020.57.59.321 N052.10.33.607 E020.58.01.770 oranz
N052.10.33.607 E020.58.01.770 N052.10.34.711 E020.58.04.675 oranz
N052.10.34.711 E020.58.04.675 N052.10.35.365 E020.58.06.248 oranz
N052.10.35.365 E020.58.06.248 N052.10.35.912 E020.58.07.642 oranz
N052.10.04.513 E020.58.18.615 N052.10.05.751 E020.58.22.191 sch
N052.10.06.881 E020.58.21.127 N052.10.05.645 E020.58.17.573 sch
N052.10.06.798 E020.58.16.537 N052.10.08.017 E020.58.20.029 sch
N052.10.07.953 E020.58.15.493 N052.10.09.160 E020.58.19.032 sch
N052.10.18.920 E020.58.04.627 N052.10.20.627 E020.58.09.591 sch
N052.10.18.327 E020.58.05.157 N052.10.20.041 E020.58.10.158 sch
N052.10.17.755 E020.58.05.674 N052.10.19.467 E020.58.10.667 sch
N052.10.13.208 E020.58.16.192 N052.10.11.550 E020.58.11.250 sch
N052.10.09.831 E020.58.12.810 N052.10.11.549 E020.58.17.836 sch
N052.10.28.174 E020.58.14.742 N052.10.26.488 E020.58.09.834 nonsch
N052.10.25.321 E020.58.10.877 N052.10.26.991 E020.58.15.913 nonsch
N052.10.21.210 E020.58.02.525 N052.10.22.947 E020.58.07.520 nonsch
N052.10.22.321 E020.58.08.065 N052.10.20.568 E020.58.03.070 nonsch
N052.10.20.030 E020.58.03.589 N052.10.21.795 E020.58.08.551 nonsch
N052.10.22.239 E020.58.01.549 N052.10.23.986 E020.58.06.549 nonsch
N052.10.22.751 E020.58.01.055 N052.10.24.524 E020.58.06.100 nonsch
N052.10.23.379 E020.58.00.513 N052.10.25.115 E020.58.05.507 nonsch
N052.10.24.464 E020.57.59.509 N052.10.26.260 E020.58.04.533 nonsch
N052.10.26.978 E020.57.57.178 N052.10.26.726 E020.58.03.070 nonsch
N052.10.29.537 E020.57.56.230 N052.10.28.260 E020.58.02.556 nonsch
N052.10.31.349 E020.57.58.133 N052.10.28.552 E020.58.02.663 nonsch
N052.10.31.037 E020.57.59.489 N052.10.29.311 E020.58.02.983 nonsch
N052.10.33.548 E020.58.03.853 N052.10.29.594 E020.58.04.742 nonsch
N052.10.29.508 E020.58.13.580 N052.10.27.706 E020.58.08.711 nonsch




;EPKT
LOTNISKA_EPKT N050.28.34.492 E019.06.17.397 N050.28.34.691 E019.03.34.622 teal
N050.28.34.691 E019.03.34.622 N050.28.32.781 E019.03.34.616 teal
N050.28.32.781 E019.03.34.616 N050.28.32.582 E019.06.17.392 teal
N050.28.32.582 E019.06.17.392 N050.28.34.492 E019.06.17.397 teal
N050.28.22.157 E019.03.59.431 N050.28.25.403 E019.03.59.445 Color_251ACI
N050.28.22.089 E019.03.58.346 N050.28.21.313 E019.03.58.590 Color_251ACI
N050.28.26.392 E019.04.27.968 N050.28.20.855 E019.04.27.956 Color_251ACI
N050.28.26.294 E019.05.39.195 N050.28.28.250 E019.05.39.213 Color_251ACI
N050.28.25.403 E019.03.59.445 N050.28.26.225 E019.03.59.832 Color_251ACI
N050.28.25.959 E019.03.58.362 N050.28.22.089 E019.03.58.346 Color_251ACI
N050.28.30.459 E019.05.39.219 N050.28.31.712 E019.05.39.224 Color_251ACI
N050.28.30.461 E019.05.38.134 N050.28.28.252 E019.05.38.127 Color_251ACI
N050.28.26.436 E019.04.23.544 N050.28.24.902 E019.04.21.052 Color_251ACI
N050.28.23.882 E019.04.22.613 N050.28.26.434 E019.04.26.812 Color_251ACI
N050.28.24.902 E019.04.21.052 N050.28.22.429 E019.04.17.091 Color_251ACI
N050.28.21.409 E019.04.18.653 N050.28.23.882 E019.04.22.613 Color_251ACI
N050.28.22.429 E019.04.17.091 N050.28.20.880 E019.04.14.574 Color_251ACI
N050.28.24.962 E019.05.39.097 N050.28.25.471 E019.05.39.133 Color_251ACI
N050.28.24.934 E019.05.10.210 N050.28.26.036 E019.05.10.210 Color_251ACI
N050.28.24.935 E019.05.09.040 N050.28.21.666 E019.05.09.026 Color_251ACI
N050.28.21.664 E019.05.10.196 N050.28.24.934 E019.05.10.210 Color_251ACI
N050.28.21.666 E019.05.09.026 N050.28.21.265 E019.05.08.813 Color_251ACI
N050.28.26.036 E019.05.10.210 N050.28.26.367 E019.05.10.405 Color_251ACI
N050.28.26.037 E019.05.09.040 N050.28.24.935 E019.05.09.040 Color_251ACI
N050.28.26.369 E019.05.08.847 N050.28.26.037 E019.05.09.040 Color_251ACI
N050.28.20.009 E019.05.41.683 N050.28.19.999 E019.05.46.517 Color_251ACI
N050.28.21.265 E019.05.08.813 N050.28.20.993 E019.05.08.427 Color_251ACI
N050.28.21.265 E019.05.10.403 N050.28.21.664 E019.05.10.196 Color_251ACI
N050.28.20.990 E019.05.10.794 N050.28.21.265 E019.05.10.403 Color_251ACI
N050.28.20.993 E019.05.08.427 N050.28.20.915 E019.05.08.128 Color_251ACI
N050.28.20.854 E019.04.28.872 N050.28.26.391 E019.04.28.884 Color_251ACI
N050.28.20.855 E019.04.27.956 N050.28.20.855 E019.04.27.205 Color_251ACI
N050.28.20.768 E019.05.33.539 N050.28.20.792 E019.05.13.496 Color_251ACI
N050.28.20.915 E019.05.08.128 N050.28.20.920 E019.05.05.565 Color_251ACI
N050.28.20.920 E019.05.05.565 N050.28.20.928 E019.05.05.560 Color_251ACI
N050.28.20.798 E019.05.11.539 N050.28.20.990 E019.05.10.794 Color_251ACI
N050.28.20.139 E019.04.07.378 N050.28.20.144 E019.04.01.181 Color_251ACI
N050.28.20.889 E019.04.01.402 N050.28.21.184 E019.04.00.212 Color_251ACI
N050.28.20.566 E019.03.59.480 N050.28.20.144 E019.04.01.181 Color_251ACI
N050.28.21.184 E019.04.00.212 N050.28.21.724 E019.03.59.567 Color_251ACI
N050.28.21.313 E019.03.58.590 N050.28.20.566 E019.03.59.480 Color_251ACI
N050.28.21.724 E019.03.59.567 N050.28.22.157 E019.03.59.431 Color_251ACI
N050.28.20.865 E019.04.17.768 N050.28.21.409 E019.04.18.653 Color_251ACI
N050.28.20.045 E019.05.15.974 N050.28.20.023 E019.05.33.538 Color_251ACI
N050.28.20.792 E019.05.13.496 N050.28.20.798 E019.05.11.539 Color_251ACI
N050.28.20.833 E019.04.43.935 N050.28.20.841 E019.04.39.843 Color_251ACI
N050.28.20.841 E019.04.39.843 N050.28.20.844 E019.04.37.546 Color_251ACI
N050.28.20.844 E019.04.37.546 N050.28.20.849 E019.04.34.222 Color_251ACI
N050.28.20.849 E019.04.34.222 N050.28.20.848 E019.04.32.099 Color_251ACI
N050.28.20.848 E019.04.32.099 N050.28.20.853 E019.04.29.656 Color_251ACI
N050.28.20.859 E019.04.24.873 N050.28.20.867 E019.04.22.537 Color_251ACI
N050.28.20.853 E019.04.29.656 N050.28.20.854 E019.04.28.872 Color_251ACI
N050.28.20.867 E019.04.22.537 N050.28.20.864 E019.04.20.113 Color_251ACI
N050.28.20.864 E019.04.20.113 N050.28.20.865 E019.04.17.768 Color_251ACI
N050.28.20.880 E019.04.14.574 N050.28.20.883 E019.04.13.094 Color_251ACI
N050.28.20.883 E019.04.13.094 N050.28.20.885 E019.04.10.677 Color_251ACI
N050.28.20.885 E019.04.10.677 N050.28.20.883 E019.04.08.430 Color_251ACI
N050.28.28.250 E019.05.39.213 N050.28.30.459 E019.05.39.219 Color_251ACI
N050.28.28.252 E019.05.38.127 N050.28.26.951 E019.05.38.115 Color_251ACI
N050.28.31.712 E019.05.39.224 N050.28.32.621 E019.05.39.820 Color_251ACI
N050.28.31.714 E019.05.38.138 N050.28.30.461 E019.05.38.134 Color_251ACI
N050.28.32.687 E019.05.38.687 N050.28.32.687 E019.05.38.687 Color_251ACI
N050.28.32.687 E019.05.38.687 N050.28.32.687 E019.05.38.687 Color_251ACI
N050.28.32.642 E019.05.37.542 N050.28.31.714 E019.05.38.138 Color_251ACI
N050.28.19.990 E019.06.00.137 N050.28.20.435 E019.06.02.099 Color_251ACI
N050.28.20.734 E019.05.59.934 N050.28.20.733 E019.05.50.344 Color_251ACI
N050.28.20.435 E019.06.02.099 N050.28.27.490 E019.06.16.179 Color_251ACI
N050.28.21.096 E019.06.01.525 N050.28.20.734 E019.05.59.934 Color_251ACI
N050.28.27.490 E019.06.16.179 N050.28.28.031 E019.06.16.884 Color_251ACI
N050.28.28.027 E019.06.15.358 N050.28.21.096 E019.06.01.525 Color_251ACI
N050.28.28.031 E019.06.16.884 N050.28.28.940 E019.06.17.396 Color_251ACI
N050.28.28.406 E019.06.15.852 N050.28.28.027 E019.06.15.358 Color_251ACI
N050.28.28.940 E019.06.17.396 N050.28.30.480 E019.06.17.404 Color_251ACI
N050.28.29.071 E019.06.16.226 N050.28.28.406 E019.06.15.852 Color_251ACI
N050.28.30.480 E019.06.17.404 N050.28.31.747 E019.06.17.404 Color_251ACI
N050.28.30.481 E019.06.16.234 N050.28.29.071 E019.06.16.226 Color_251ACI
N050.28.31.683 E019.06.16.234 N050.28.30.481 E019.06.16.234 Color_251ACI
N050.28.31.747 E019.06.17.404 N050.28.32.245 E019.06.17.270 Color_251ACI
N050.28.32.008 E019.06.16.146 N050.28.31.683 E019.06.16.234 Color_251ACI
N050.28.32.245 E019.06.17.270 N050.28.32.582 E019.06.17.001 Color_251ACI
N050.28.32.592 E019.06.15.681 N050.28.32.008 E019.06.16.146 Color_251ACI
N050.28.30.593 E019.03.36.212 N050.28.31.863 E019.03.36.228 Color_251ACI
N050.28.30.597 E019.03.34.991 N050.28.28.828 E019.03.34.985 Color_251ACI
N050.28.31.863 E019.03.36.228 N050.28.32.249 E019.03.36.375 Color_251ACI
N050.28.31.959 E019.03.35.008 N050.28.30.597 E019.03.34.991 Color_251ACI
N050.28.32.249 E019.03.36.375 N050.28.32.778 E019.03.36.864 Color_251ACI
N050.28.32.780 E019.03.35.323 N050.28.31.959 E019.03.35.008 Color_251ACI
N050.28.28.900 E019.03.36.206 N050.28.30.593 E019.03.36.212 Color_251ACI
N050.28.28.828 E019.03.34.985 N050.28.28.057 E019.03.35.215 Color_251ACI
N050.28.28.057 E019.03.35.215 N050.28.27.125 E019.03.36.194 Color_251ACI
N050.28.28.358 E019.03.36.368 N050.28.28.900 E019.03.36.206 Color_251ACI
N050.28.26.535 E019.03.38.522 N050.28.26.505 E019.03.56.675 Color_251ACI
N050.28.27.312 E019.03.38.758 N050.28.27.757 E019.03.36.998 Color_251ACI
N050.28.27.125 E019.03.36.194 N050.28.26.535 E019.03.38.522 Color_251ACI
N050.28.27.757 E019.03.36.998 N050.28.28.358 E019.03.36.368 Color_251ACI
N050.28.26.505 E019.03.56.675 N050.28.25.959 E019.03.58.362 Color_251ACI
N050.28.27.282 E019.03.56.818 N050.28.27.312 E019.03.38.758 Color_251ACI
N050.28.20.928 E019.05.05.560 N050.28.20.924 E019.05.03.300 Color_251ACI
N050.28.20.924 E019.05.03.300 N050.28.20.932 E019.05.01.027 Color_251ACI
N050.28.20.932 E019.05.01.027 N050.28.20.933 E019.04.57.449 Color_251ACI
N050.28.20.933 E019.04.57.449 N050.28.20.938 E019.04.55.195 Color_251ACI
N050.28.20.938 E019.04.55.195 N050.28.20.945 E019.04.50.789 Color_251ACI
N050.28.20.945 E019.04.50.789 N050.28.20.945 E019.04.47.370 Color_251ACI
N050.28.20.945 E019.04.47.370 N050.28.20.955 E019.04.43.937 Color_251ACI
N050.28.20.955 E019.04.43.937 N050.28.20.833 E019.04.43.935 Color_251ACI
N050.28.30.229 E019.04.10.054 N050.28.31.260 E019.04.12.871 Color_251ACI
N050.28.30.901 E019.04.09.443 N050.28.27.310 E019.03.59.711 Color_251ACI
N050.28.31.260 E019.04.12.871 N050.28.31.797 E019.04.14.620 Color_251ACI
N050.28.31.948 E019.04.12.300 N050.28.30.901 E019.04.09.443 Color_251ACI
N050.28.31.797 E019.04.14.620 N050.28.32.347 E019.04.16.810 Color_251ACI
N050.28.32.509 E019.04.14.130 N050.28.31.948 E019.04.12.300 Color_251ACI
N050.28.32.347 E019.04.16.810 N050.28.32.727 E019.04.18.859 Color_251ACI
N050.28.32.732 E019.04.15.017 N050.28.32.509 E019.04.14.130 Color_251ACI
N050.28.26.628 E019.04.00.297 N050.28.30.229 E019.04.10.054 Color_251ACI
N050.28.27.310 E019.03.59.711 N050.28.27.282 E019.03.56.818 Color_251ACI
N050.28.26.225 E019.03.59.832 N050.28.26.628 E019.04.00.297 Color_251ACI
N050.28.30.134 E019.05.27.432 N050.28.26.670 E019.05.36.779 Color_251ACI
N050.28.30.807 E019.05.28.043 N050.28.31.873 E019.05.25.123 Color_251ACI
N050.28.31.185 E019.05.24.555 N050.28.30.134 E019.05.27.432 Color_251ACI
N050.28.31.873 E019.05.25.123 N050.28.32.522 E019.05.22.995 Color_251ACI
N050.28.31.809 E019.05.22.509 N050.28.31.185 E019.05.24.555 Color_251ACI
N050.28.32.522 E019.05.22.995 N050.28.32.649 E019.05.22.481 Color_251ACI
N050.28.32.281 E019.05.20.601 N050.28.31.809 E019.05.22.509 Color_251ACI
N050.28.32.654 E019.05.18.558 N050.28.32.281 E019.05.20.601 Color_251ACI
N050.28.26.670 E019.05.36.779 N050.28.26.293 E019.05.37.441 Color_251ACI
N050.28.27.302 E019.05.37.500 N050.28.30.807 E019.05.28.043 Color_251ACI
N050.28.26.951 E019.05.38.115 N050.28.27.302 E019.05.37.500 Color_251ACI
N050.28.25.471 E019.05.39.133 N050.28.26.294 E019.05.39.195 Color_251ACI
N050.28.19.989 E019.05.51.524 N050.28.19.990 E019.06.00.137 Color_251ACI
N050.28.20.733 E019.05.50.344 N050.28.20.742 E019.05.47.718 Color_251ACI
N050.28.20.742 E019.05.47.718 N050.28.20.754 E019.05.41.686 Color_251ACI
N050.28.20.855 E019.04.27.205 N050.28.20.859 E019.04.24.873 Color_251ACI
N050.28.20.883 E019.04.08.430 N050.28.20.889 E019.04.01.402 Color_251ACI
N050.28.20.511 E019.04.08.430 N050.28.20.513 E019.04.10.677 olive
N050.28.20.517 E019.04.01.291 N050.28.20.511 E019.04.08.430 olive
N050.28.20.511 E019.04.08.430 N050.28.17.392 E019.04.08.459 olive
N050.28.20.483 E019.04.27.205 N050.28.20.483 E019.04.28.413 olive
N050.28.20.486 E019.04.24.871 N050.28.20.483 E019.04.27.205 olive
N050.28.20.483 E019.04.27.205 N050.28.18.401 E019.04.27.251 olive
N050.28.20.369 E019.05.47.716 N050.28.20.384 E019.05.40.315 olive
N050.28.20.361 E019.05.50.342 N050.28.20.369 E019.05.47.716 olive
N050.28.20.362 E019.06.00.035 N050.28.20.361 E019.05.50.342 olive
N050.28.20.369 E019.05.47.716 N050.28.17.032 E019.05.47.700 olive
N050.28.20.361 E019.05.50.342 N050.28.17.027 E019.05.50.334 olive
N050.28.25.605 E019.03.58.903 N050.28.22.123 E019.03.58.889 olive
N050.28.24.392 E019.04.21.833 N050.28.26.434 E019.04.25.150 olive
N050.28.21.919 E019.04.17.872 N050.28.24.392 E019.04.21.833 olive
N050.28.24.934 E019.05.09.625 N050.28.21.604 E019.05.09.610 olive
N050.28.24.934 E019.05.09.625 N050.28.26.104 E019.05.09.625 olive
N050.28.26.104 E019.05.09.625 N050.28.26.367 E019.05.09.471 olive
N050.28.26.104 E019.05.09.625 N050.28.26.368 E019.05.09.778 olive
N050.28.20.394 E019.05.36.435 N050.28.20.595 E019.05.37.548 olive
N050.28.21.604 E019.05.09.610 N050.28.21.073 E019.05.09.329 olive
N050.28.21.604 E019.05.09.610 N050.28.21.073 E019.05.09.887 olive
N050.28.21.073 E019.05.09.887 N050.28.20.677 E019.05.10.450 olive
N050.28.21.073 E019.05.09.329 N050.28.20.681 E019.05.08.772 olive
N050.28.20.681 E019.05.08.772 N050.28.20.430 E019.05.07.814 olive
N050.28.20.677 E019.05.10.450 N050.28.20.426 E019.05.11.424 olive
N050.28.20.595 E019.05.37.548 N050.28.21.042 E019.05.38.208 olive
N050.28.21.042 E019.05.38.208 N050.28.21.592 E019.05.38.496 olive
N050.28.21.592 E019.05.38.496 N050.28.24.337 E019.05.38.509 olive
N050.28.20.517 E019.04.01.291 N050.28.20.875 E019.03.59.846 olive
N050.28.20.875 E019.03.59.846 N050.28.21.518 E019.03.59.078 olive
N050.28.22.123 E019.03.58.889 N050.28.21.518 E019.03.59.078 olive
N050.28.21.919 E019.04.17.872 N050.28.20.502 E019.04.15.569 olive
N050.28.26.391 E019.04.28.426 N050.28.20.483 E019.04.28.413 olive
N050.28.20.420 E019.05.13.494 N050.28.20.426 E019.05.11.424 olive
N050.28.20.420 E019.05.13.494 N050.28.20.391 E019.05.36.686 olive
N050.28.20.461 E019.04.43.934 N050.28.17.305 E019.04.43.911 olive
N050.28.20.468 E019.04.39.841 N050.28.20.461 E019.04.43.934 olive
N050.28.20.468 E019.04.39.841 N050.28.17.266 E019.04.39.836 olive
N050.28.20.472 E019.04.37.545 N050.28.20.468 E019.04.39.841 olive
N050.28.20.472 E019.04.37.545 N050.28.17.271 E019.04.37.530 olive
N050.28.20.477 E019.04.34.221 N050.28.20.472 E019.04.37.545 olive
N050.28.20.477 E019.04.34.221 N050.28.18.448 E019.04.34.218 olive
N050.28.20.476 E019.04.32.099 N050.28.20.477 E019.04.34.221 olive
N050.28.20.476 E019.04.32.099 N050.28.18.445 E019.04.32.107 olive
N050.28.20.480 E019.04.29.654 N050.28.20.476 E019.04.32.099 olive
N050.28.20.480 E019.04.29.654 N050.28.20.483 E019.04.28.413 olive
N050.28.20.480 E019.04.29.654 N050.28.18.447 E019.04.29.660 olive
N050.28.20.486 E019.04.24.871 N050.28.18.474 E019.04.24.866 olive
N050.28.20.495 E019.04.22.536 N050.28.20.486 E019.04.24.871 olive
N050.28.20.495 E019.04.22.536 N050.28.18.111 E019.04.22.525 olive
N050.28.20.491 E019.04.20.114 N050.28.20.495 E019.04.22.536 olive
N050.28.20.491 E019.04.20.114 N050.28.20.493 E019.04.17.690 olive
N050.28.20.491 E019.04.20.114 N050.28.18.111 E019.04.20.107 olive
N050.28.20.495 E019.04.17.082 N050.28.20.493 E019.04.17.690 olive
N050.28.20.495 E019.04.17.082 N050.28.20.502 E019.04.15.569 olive
N050.28.20.507 E019.04.15.299 N050.28.20.502 E019.04.15.569 olive
N050.28.20.511 E019.04.13.092 N050.28.20.507 E019.04.15.299 olive
N050.28.20.513 E019.04.10.677 N050.28.20.511 E019.04.13.092 olive
N050.28.20.513 E019.04.10.677 N050.28.17.378 E019.04.10.751 olive
N050.28.26.303 E019.05.38.652 N050.28.28.251 E019.05.38.670 olive
N050.28.28.251 E019.05.38.670 N050.28.30.460 E019.05.38.676 olive
N050.28.30.460 E019.05.38.676 N050.28.31.782 E019.05.38.681 olive
N050.28.31.782 E019.05.38.681 N050.28.32.629 E019.05.39.236 olive
N050.28.31.782 E019.05.38.681 N050.28.32.630 E019.05.38.137 olive
N050.28.20.391 E019.05.36.686 N050.28.20.384 E019.05.40.315 olive
N050.28.20.362 E019.06.00.035 N050.28.20.765 E019.06.01.812 olive
N050.28.20.765 E019.06.01.812 N050.28.27.759 E019.06.15.768 olive
N050.28.27.759 E019.06.15.768 N050.28.28.218 E019.06.16.368 olive
N050.28.28.218 E019.06.16.368 N050.28.29.005 E019.06.16.811 olive
N050.28.29.005 E019.06.16.811 N050.28.30.480 E019.06.16.819 olive
N050.28.30.480 E019.06.16.819 N050.28.31.715 E019.06.16.819 olive
N050.28.31.715 E019.06.16.819 N050.28.32.127 E019.06.16.708 olive
N050.28.32.127 E019.06.16.708 N050.28.32.583 E019.06.16.344 olive
N050.28.21.592 E019.05.38.496 N050.28.21.051 E019.05.38.757 olive
N050.28.21.051 E019.05.38.757 N050.28.20.596 E019.05.39.396 olive
N050.28.20.596 E019.05.39.396 N050.28.20.384 E019.05.40.315 olive
N050.28.30.595 E019.03.35.602 N050.28.31.911 E019.03.35.618 olive
N050.28.31.911 E019.03.35.618 N050.28.32.782 E019.03.36.079 olive
N050.28.30.595 E019.03.35.602 N050.28.28.864 E019.03.35.595 olive
N050.28.28.864 E019.03.35.595 N050.28.28.208 E019.03.35.791 olive
N050.28.28.208 E019.03.35.791 N050.28.27.441 E019.03.36.596 olive
N050.28.27.441 E019.03.36.596 N050.28.26.923 E019.03.38.640 olive
N050.28.26.923 E019.03.38.640 N050.28.26.893 E019.03.56.822 olive
N050.28.26.429 E019.03.58.258 N050.28.25.605 E019.03.58.903 olive
N050.28.26.893 E019.03.56.822 N050.28.26.429 E019.03.58.258 olive
N050.28.26.429 E019.03.58.258 N050.28.25.605 E019.03.58.903 olive
N050.28.20.420 E019.05.13.494 N050.28.17.223 E019.05.13.511 olive
N050.28.20.426 E019.05.11.424 N050.28.17.224 E019.05.11.239 olive
N050.28.20.426 E019.05.11.424 N050.28.20.429 E019.05.08.994 olive
N050.28.20.429 E019.05.08.994 N050.28.20.430 E019.05.07.814 olive
N050.28.20.429 E019.05.08.994 N050.28.17.228 E019.05.08.978 olive
N050.28.20.435 E019.05.05.563 N050.28.17.225 E019.05.05.560 olive
N050.28.20.430 E019.05.03.299 N050.28.17.229 E019.05.03.292 olive
N050.28.20.438 E019.05.01.025 N050.28.17.226 E019.05.01.029 olive
N050.28.20.439 E019.04.57.447 N050.28.17.241 E019.04.57.447 olive
N050.28.20.444 E019.04.55.192 N050.28.17.240 E019.04.55.179 olive
N050.28.20.493 E019.04.17.690 N050.28.18.117 E019.04.17.689 olive
N050.28.20.511 E019.04.13.092 N050.28.17.475 E019.04.13.088 olive
N050.28.20.507 E019.04.15.299 N050.28.17.471 E019.04.15.304 olive
N050.28.20.451 E019.04.50.788 N050.28.17.296 E019.04.50.768 olive
N050.28.20.451 E019.04.47.368 N050.28.17.305 E019.04.47.365 olive
N050.28.20.430 E019.05.07.814 N050.28.20.435 E019.05.05.563 olive
N050.28.20.435 E019.05.05.563 N050.28.20.430 E019.05.03.299 olive
N050.28.20.430 E019.05.03.299 N050.28.20.438 E019.05.01.025 olive
N050.28.20.438 E019.05.01.025 N050.28.20.439 E019.04.57.447 olive
N050.28.20.439 E019.04.57.447 N050.28.20.444 E019.04.55.192 olive
N050.28.20.444 E019.04.55.192 N050.28.20.451 E019.04.50.788 olive
N050.28.20.451 E019.04.50.788 N050.28.20.451 E019.04.47.368 olive
N050.28.20.451 E019.04.47.368 N050.28.20.461 E019.04.43.934 olive
N050.28.30.565 E019.04.09.748 N050.28.31.604 E019.04.12.585 olive
N050.28.31.604 E019.04.12.585 N050.28.32.153 E019.04.14.375 olive
N050.28.32.153 E019.04.14.375 N050.28.32.715 E019.04.16.612 olive
N050.28.30.565 E019.04.09.748 N050.28.26.923 E019.03.59.880 olive
N050.28.26.923 E019.03.59.880 N050.28.26.401 E019.03.59.278 olive
N050.28.26.401 E019.03.59.278 N050.28.25.605 E019.03.58.903 olive
N050.28.26.893 E019.03.56.822 N050.28.26.923 E019.03.59.880 olive
N050.28.30.471 E019.05.27.738 N050.28.31.529 E019.05.24.839 olive
N050.28.31.529 E019.05.24.839 N050.28.32.165 E019.05.22.752 olive
N050.28.32.165 E019.05.22.752 N050.28.32.649 E019.05.20.797 olive
N050.28.30.471 E019.05.27.738 N050.28.26.986 E019.05.37.139 olive
N050.28.26.986 E019.05.37.139 N050.28.26.520 E019.05.37.957 olive
N050.28.24.337 E019.05.38.509 N050.28.25.487 E019.05.38.591 olive
N050.28.25.487 E019.05.38.591 N050.28.26.303 E019.05.38.652 olive
N050.28.26.520 E019.05.37.957 N050.28.25.487 E019.05.38.591 olive

                          N050.28.26.918 E019.03.59.855 N050.28.26.825 E019.05.36.559 olive
                          N050.28.26.825 E019.05.36.559 N050.28.26.762 E019.05.37.127 olive
                          N050.28.26.762 E019.05.37.127 N050.28.26.623 E019.05.37.623 olive
                          N050.28.26.623 E019.05.37.623 N050.28.26.434 E019.05.37.921 olive
                          N050.28.26.434 E019.05.37.921 N050.28.26.209 E019.05.38.152 olive
                          N050.28.27.867 E019.04.02.420 N050.28.27.736 E019.04.02.262 olive
                          N050.28.27.736 E019.04.02.262 N050.28.27.578 E019.04.02.162 olive
                          N050.28.27.578 E019.04.02.162 N050.28.27.428 E019.04.02.145 olive
                          N050.28.27.428 E019.04.02.145 N050.28.27.261 E019.04.02.228 olive
                          N050.28.27.261 E019.04.02.228 N050.28.27.117 E019.04.02.375 olive
                          N050.28.27.117 E019.04.02.375 N050.28.27.023 E019.04.02.528 olive
                          N050.28.27.023 E019.04.02.528 N050.28.26.976 E019.04.02.748 olive
                          N050.28.26.976 E019.04.02.748 N050.28.26.926 E019.04.03.029 olive

                          N050.28.26.889 E019.04.27.662 N050.28.26.871 E019.04.27.836 olive
                          N050.28.26.871 E019.04.27.836 N050.28.26.822 E019.04.28.040 olive
                          N050.28.26.822 E019.04.28.040 N050.28.26.743 E019.04.28.190 olive
                          N050.28.26.743 E019.04.28.190 N050.28.26.652 E019.04.28.289 olive
                          N050.28.26.652 E019.04.28.289 N050.28.26.546 E019.04.28.361 olive
                          N050.28.26.546 E019.04.28.361 N050.28.26.431 E019.04.28.406 olive
                          N050.28.26.431 E019.04.28.406 N050.28.26.348 E019.04.28.422 olive
                          N050.28.26.348 E019.04.28.422 N050.28.26.481 E019.04.28.445 olive
                          N050.28.26.481 E019.04.28.445 N050.28.26.607 E019.04.28.502 olive
                          N050.28.26.607 E019.04.28.502 N050.28.26.692 E019.04.28.562 olive
                          N050.28.26.692 E019.04.28.562 N050.28.26.765 E019.04.28.646 olive
                          N050.28.26.765 E019.04.28.646 N050.28.26.817 E019.04.28.752 olive
                          N050.28.26.817 E019.04.28.752 N050.28.26.862 E019.04.28.891 olive
                          N050.28.26.862 E019.04.28.891 N050.28.26.876 E019.04.29.044 olive
                          N050.28.26.876 E019.04.29.044 N050.28.26.891 E019.04.29.188 olive

                          N050.28.26.366 E019.05.09.470 N050.28.26.440 E019.05.09.409 olive
                          N050.28.26.440 E019.05.09.409 N050.28.26.558 E019.05.09.277 olive
                          N050.28.26.558 E019.05.09.277 N050.28.26.646 E019.05.09.142 olive
                          N050.28.26.646 E019.05.09.142 N050.28.26.745 E019.05.08.966 olive
                          N050.28.26.745 E019.05.08.966 N050.28.26.803 E019.05.08.774 olive
                          N050.28.26.803 E019.05.08.774 N050.28.26.840 E019.05.08.521 olive
                          N050.28.26.840 E019.05.08.521 N050.28.26.854 E019.05.08.265 olive
                          N050.28.26.851 E019.05.10.722 N050.28.26.839 E019.05.10.463 olive
                          N050.28.26.839 E019.05.10.463 N050.28.26.792 E019.05.10.243 olive
                          N050.28.26.792 E019.05.10.243 N050.28.26.714 E019.05.10.068 olive
                          N050.28.26.714 E019.05.10.068 N050.28.26.590 E019.05.09.909 olive
                          N050.28.26.590 E019.05.09.909 N050.28.26.463 E019.05.09.808 olive
                          N050.28.26.463 E019.05.09.808 N050.28.26.363 E019.05.09.770 olive
						  N050.28.28.220 E019.03.16.763 N050.28.28.204 E019.03.35.793 olive
                          N050.28.26.822 E019.05.36.585 N050.28.26.810 E019.05.37.785 olive
                          N050.28.26.810 E019.05.37.785 N050.28.26.838 E019.05.37.971 olive
                          N050.28.26.838 E019.05.37.971 N050.28.26.907 E019.05.38.134 olive
                          N050.28.26.907 E019.05.38.134 N050.28.27.028 E019.05.38.293 olive
                          N050.28.27.028 E019.05.38.293 N050.28.27.161 E019.05.38.415 olive
                          N050.28.27.161 E019.05.38.415 N050.28.27.320 E019.05.38.525 olive
                          N050.28.27.320 E019.05.38.525 N050.28.27.521 E019.05.38.585 olive
                          N050.28.27.521 E019.05.38.585 N050.28.27.850 E019.05.38.666 olive


                          N050.28.26.401 E019.04.27.959 N050.28.26.409 E019.04.00.018 Color_251ACI
                          N050.28.26.399 E019.04.28.881 N050.28.26.357 E019.05.08.854 Color_251ACI
                          N050.28.26.365 E019.05.10.402 N050.28.26.303 E019.05.35.538 Color_251ACI
                          N050.28.27.786 E019.05.33.772 N050.28.27.697 E019.05.33.898 Color_251ACI
                          N050.28.27.697 E019.05.33.898 N050.28.27.514 E019.05.33.972 Color_251ACI
                          N050.28.27.514 E019.05.33.972 N050.28.27.337 E019.05.33.899 Color_251ACI
                          N050.28.27.337 E019.05.33.899 N050.28.27.202 E019.05.33.769 Color_251ACI
                          N050.28.27.202 E019.05.33.769 N050.28.27.147 E019.05.33.553 Color_251ACI
                          N050.28.27.147 E019.05.33.553 N050.28.27.133 E019.05.33.279 Color_251ACI
                          N050.28.27.133 E019.05.33.279 N050.28.27.304 E019.04.03.580 Color_251ACI
                          N050.28.27.304 E019.04.03.580 N050.28.27.336 E019.04.03.420 Color_251ACI
                          N050.28.27.336 E019.04.03.420 N050.28.27.413 E019.04.03.368 Color_251ACI
                          N050.28.27.413 E019.04.03.368 N050.28.27.503 E019.04.03.316 Color_251ACI
                          N050.28.27.503 E019.04.03.316 N050.28.27.640 E019.04.03.332 Color_251ACI
                          N050.28.27.640 E019.04.03.332 N050.28.27.748 E019.04.03.448 Color_251ACI
                          N050.28.27.748 E019.04.03.448 N050.28.27.855 E019.04.03.620 Color_251ACI

                          N050.28.28.410 E019.03.35.095 N050.28.28.428 E019.03.16.307 Color_251ACI
                          N050.28.28.428 E019.03.16.307 N050.28.26.536 E019.03.16.306 Color_251ACI
                          N050.28.26.536 E019.03.16.306 N050.28.26.534 E019.03.38.518 Color_251ACI


N050.28.17.697 E019.04.35.525 N050.28.15.659 E019.04.35.526 Color_251ACI
N050.28.15.659 E019.04.35.526 N050.28.15.615 E019.05.00.706 Color_251ACI
N050.28.15.662 E019.05.06.212 N050.28.15.662 E019.05.08.807 Color_251ACI
N050.28.15.541 E019.05.14.542 N050.28.15.540 E019.05.15.026 Color_251ACI
N050.28.15.540 E019.05.15.026 N050.28.19.013 E019.05.14.968 Color_251ACI
N050.28.19.013 E019.05.14.968 N050.28.19.580 E019.05.15.238 Color_251ACI
N050.28.19.580 E019.05.15.238 N050.28.20.045 E019.05.15.974 Color_251ACI
N050.28.20.194 E019.05.08.993 N050.28.20.194 E019.05.08.993 Color_251ACI
N050.28.17.697 E019.04.34.421 N050.28.17.697 E019.04.35.525 Color_251ACI
N050.28.19.943 E019.06.01.864 N050.28.20.296 E019.06.02.747 Color_251ACI
N050.28.20.296 E019.06.02.747 N050.28.20.283 E019.06.03.870 Color_251ACI
N050.28.20.283 E019.06.03.870 N050.28.20.194 E019.06.13.950 Color_251ACI
N050.28.20.194 E019.06.13.950 N050.28.21.780 E019.06.17.204 Color_251ACI
N050.28.21.780 E019.06.17.204 N050.28.22.424 E019.06.17.818 Color_251ACI
N050.28.22.424 E019.06.17.818 N050.28.31.090 E019.06.17.947 Color_251ACI
N050.28.31.090 E019.06.17.947 N050.28.31.093 E019.06.17.404 Color_251ACI
N050.28.31.100 E019.06.16.234 N050.28.31.104 E019.06.15.504 Color_251ACI
N050.28.31.104 E019.06.15.504 N050.28.29.240 E019.06.15.504 Color_251ACI
N050.28.29.240 E019.06.15.504 N050.28.28.794 E019.06.15.437 Color_251ACI
N050.28.28.794 E019.06.15.437 N050.28.28.375 E019.06.15.065 Color_251ACI
N050.28.28.375 E019.06.15.065 N050.28.28.157 E019.06.14.325 Color_251ACI
N050.28.28.157 E019.06.14.325 N050.28.28.008 E019.06.11.460 Color_251ACI
N050.28.28.008 E019.06.11.460 N050.28.26.471 E019.06.11.450 Color_251ACI
N050.28.26.471 E019.06.11.450 N050.28.22.548 E019.06.03.608 Color_251ACI
N050.28.22.548 E019.06.03.608 N050.28.21.343 E019.06.00.714 Color_251ACI
N050.28.21.343 E019.06.00.714 N050.28.20.979 E019.06.01.013 Color_251ACI
N050.28.20.313 E019.06.01.560 N050.28.19.943 E019.06.01.864 Color_251ACI
N050.28.15.847 E019.05.51.506 N050.28.19.989 E019.05.51.524 Color_251ACI
N050.28.20.372 E019.05.47.716 N050.28.20.372 E019.05.47.716 Color_251ACI
N050.28.19.999 E019.05.46.517 N050.28.15.859 E019.05.46.501 Color_251ACI
N050.28.15.859 E019.05.46.501 N050.28.15.847 E019.05.51.506 Color_251ACI
N050.28.15.604 E019.05.00.201 N050.28.12.946 E019.05.00.186 Color_251ACI
N050.28.12.946 E019.05.00.186 N050.28.12.943 E019.05.01.380 Color_251ACI
N050.28.12.943 E019.05.01.380 N050.28.08.913 E019.05.01.372 Color_251ACI
N050.28.08.913 E019.05.01.372 N050.28.08.915 E019.04.59.418 Color_251ACI
N050.28.08.915 E019.04.59.418 N050.28.15.213 E019.04.59.446 Color_251ACI
N050.28.15.213 E019.04.59.446 N050.28.15.447 E019.04.59.262 Color_251ACI
N050.28.15.447 E019.04.59.262 N050.28.15.605 E019.04.59.264 Color_251ACI
N050.28.15.605 E019.04.59.264 N050.28.15.604 E019.05.00.201 Color_251ACI
N050.28.20.139 E019.04.07.378 N050.28.16.675 E019.04.07.355 Color_251ACI
N050.28.16.675 E019.04.07.355 N050.28.16.664 E019.04.15.776 Color_251ACI
N050.28.17.650 E019.04.24.998 N050.28.17.692 E019.04.25.000 Color_251ACI
N050.28.17.692 E019.04.25.000 N050.28.17.709 E019.04.34.421 Color_251ACI
N050.28.20.157 E019.04.27.205 N050.28.20.157 E019.04.27.203 Color_251ACI
N050.28.20.153 E019.04.24.870 N050.28.20.153 E019.04.24.868 Color_251ACI
N050.28.20.142 E019.04.20.115 N050.28.20.142 E019.04.20.113 Color_251ACI
N050.28.20.136 E019.04.17.690 N050.28.20.136 E019.04.17.687 Color_251ACI
N050.28.19.703 E019.05.41.683 N050.28.20.009 E019.05.41.683 Color_251ACI
N050.28.20.753 E019.05.41.686 N050.28.23.152 E019.05.41.692 Color_251ACI
N050.28.23.152 E019.05.41.692 N050.28.24.962 E019.05.39.097 Color_251ACI
N050.28.26.304 E019.05.35.535 N050.28.26.053 E019.05.36.534 Color_251ACI
N050.28.26.053 E019.05.36.534 N050.28.25.836 E019.05.36.927 Color_251ACI
N050.28.25.836 E019.05.36.927 N050.28.25.498 E019.05.37.323 Color_251ACI
N050.28.25.498 E019.05.37.323 N050.28.25.144 E019.05.37.474 Color_251ACI
N050.28.25.144 E019.05.37.474 N050.28.21.978 E019.05.37.456 Color_251ACI
N050.28.21.978 E019.05.37.456 N050.28.21.741 E019.05.37.279 Color_251ACI
N050.28.21.741 E019.05.37.279 N050.28.21.439 E019.05.36.819 Color_251ACI
N050.28.21.439 E019.05.36.819 N050.28.21.283 E019.05.36.356 Color_251ACI
N050.28.21.283 E019.05.36.356 N050.28.21.082 E019.05.33.539 Color_251ACI
N050.28.21.082 E019.05.33.539 N050.28.20.767 E019.05.33.539 Color_251ACI
N050.28.20.023 E019.05.33.538 N050.28.19.678 E019.05.33.538 Color_251ACI
N050.28.19.678 E019.05.33.538 N050.28.19.703 E019.05.41.683 Color_251ACI
N050.28.15.882 E019.04.15.767 N050.28.17.387 E019.04.15.785 maroon
N050.28.15.859 E019.04.16.486 N050.28.15.882 E019.04.15.767 maroon
N050.28.15.403 E019.04.16.486 N050.28.15.859 E019.04.16.486 maroon
N050.28.15.403 E019.04.20.976 N050.28.15.403 E019.04.16.486 maroon
N050.28.15.847 E019.04.20.976 N050.28.15.403 E019.04.20.976 maroon
N050.28.15.859 E019.04.26.974 N050.28.15.847 E019.04.20.976 maroon
N050.28.15.300 E019.04.26.991 N050.28.15.859 E019.04.26.974 maroon
N050.28.15.300 E019.04.27.833 N050.28.15.300 E019.04.26.991 maroon
N050.28.15.996 E019.04.27.815 N050.28.15.300 E019.04.27.833 maroon
N050.28.16.007 E019.04.28.095 N050.28.15.996 E019.04.27.815 maroon
N050.28.16.988 E019.04.28.078 N050.28.16.007 E019.04.28.095 maroon
N050.28.16.988 E019.04.28.814 N050.28.16.988 E019.04.28.078 maroon
N050.28.16.692 E019.04.28.832 N050.28.16.988 E019.04.28.814 maroon
N050.28.16.680 E019.04.29.305 N050.28.16.692 E019.04.28.832 maroon
N050.28.16.840 E019.04.29.534 N050.28.16.680 E019.04.29.305 maroon
N050.28.16.851 E019.04.32.602 N050.28.16.840 E019.04.29.534 maroon
N050.28.16.646 E019.04.32.620 N050.28.16.851 E019.04.32.602 maroon
N050.28.16.646 E019.04.33.638 N050.28.16.646 E019.04.32.620 maroon
N050.28.16.851 E019.04.33.620 N050.28.16.646 E019.04.33.638 maroon
N050.28.16.851 E019.04.34.322 N050.28.16.851 E019.04.33.620 maroon
N050.28.16.429 E019.04.34.322 N050.28.16.851 E019.04.34.322 maroon
N050.28.16.429 E019.04.34.883 N050.28.16.429 E019.04.34.322 maroon
N050.28.17.250 E019.04.34.883 N050.28.16.429 E019.04.34.883 maroon
N050.28.17.262 E019.04.27.815 N050.28.17.250 E019.04.34.883 maroon
N050.28.17.661 E019.04.27.798 N050.28.17.262 E019.04.27.815 maroon
N050.28.17.649 E019.04.24.764 N050.28.17.661 E019.04.27.798 maroon
N050.28.17.455 E019.04.24.764 N050.28.17.649 E019.04.24.764 maroon
N050.28.17.467 E019.04.16.048 N050.28.17.455 E019.04.24.764 maroon
N050.28.17.376 E019.04.16.048 N050.28.17.467 E019.04.16.048 maroon
N050.28.17.387 E019.04.15.785 N050.28.17.376 E019.04.16.048 maroon
N050.28.14.245 E019.05.00.706 N050.28.16.041 E019.05.00.706 maroon
N050.28.14.245 E019.05.06.212 N050.28.14.245 E019.05.00.706 maroon
N050.28.16.030 E019.05.06.212 N050.28.14.245 E019.05.06.212 maroon
N050.28.16.041 E019.05.00.706 N050.28.16.030 E019.05.06.212 maroon
N050.28.15.808 E019.05.09.246 N050.28.16.035 E019.05.09.255 maroon
N050.28.15.802 E019.05.08.807 N050.28.15.808 E019.05.09.246 maroon
N050.28.14.034 E019.05.08.807 N050.28.15.802 E019.05.08.807 maroon
N050.28.14.028 E019.05.09.255 N050.28.14.034 E019.05.08.807 maroon
N050.28.13.629 E019.05.09.255 N050.28.14.028 E019.05.09.255 maroon
N050.28.13.629 E019.05.14.130 N050.28.13.629 E019.05.09.255 maroon
N050.28.13.994 E019.05.14.112 N050.28.13.629 E019.05.14.130 maroon
N050.28.13.988 E019.05.14.542 N050.28.13.994 E019.05.14.112 maroon
N050.28.15.768 E019.05.14.542 N050.28.13.988 E019.05.14.542 maroon
N050.28.15.768 E019.05.14.121 N050.28.15.768 E019.05.14.542 maroon
N050.28.16.047 E019.05.14.112 N050.28.15.768 E019.05.14.121 maroon
N050.28.16.035 E019.05.09.255 N050.28.16.047 E019.05.14.112 maroon
N050.28.34.512 E019.06.01.120 N050.28.32.602 E019.06.01.114 teal
N050.28.30.459 E019.05.39.219 N050.28.30.461 E019.05.38.134 hold_short
N050.28.30.480 E019.06.17.404 N050.28.30.480 E019.06.16.234 hold_short
N050.28.30.592 E019.03.36.212 N050.28.30.598 E019.03.34.991 hold_short
N050.28.30.228 E019.04.10.053 N050.28.30.902 E019.04.09.444 hold_short
N050.28.30.135 E019.05.27.431 N050.28.30.806 E019.05.28.045 hold_short


;EPWR
LOTNISKA_EPWR N051.06.26.129 E016.52.15.108 N051.06.25.222 E016.52.17.986 Color_44ACI
N051.06.25.222 E016.52.17.986 N051.06.25.180 E016.52.18.432 Color_44ACI
N051.06.25.180 E016.52.18.432 N051.06.25.238 E016.52.19.037 Color_44ACI
N051.06.25.238 E016.52.19.037 N051.06.25.436 E016.52.19.615 Color_44ACI
N051.06.25.436 E016.52.19.615 N051.06.25.683 E016.52.20.154 Color_44ACI
N051.06.25.683 E016.52.20.154 N051.06.26.236 E016.52.20.600 Color_44ACI
N051.06.26.236 E016.52.20.600 N051.06.33.507 E016.52.26.215 Color_44ACI
N051.06.33.507 E016.52.26.215 N051.06.33.896 E016.52.26.544 Color_44ACI
N051.06.33.896 E016.52.26.544 N051.06.34.160 E016.52.26.951 Color_44ACI
N051.06.34.160 E016.52.26.951 N051.06.34.300 E016.52.27.503 Color_44ACI
N051.06.34.300 E016.52.27.503 N051.06.34.300 E016.52.27.910 Color_44ACI
N051.06.34.300 E016.52.27.910 N051.06.34.127 E016.52.28.686 Color_44ACI
N051.06.34.127 E016.52.28.686 N051.06.31.049 E016.52.38.925 Color_44ACI
N051.06.31.049 E016.52.38.925 N051.06.25.939 E016.52.55.624 Color_44ACI
N051.06.25.939 E016.52.55.624 N051.06.08.438 E016.53.53.499 Color_44ACI
N051.06.08.438 E016.53.53.499 N051.06.06.932 E016.53.58.268 Color_44ACI
N051.06.06.932 E016.53.58.268 N051.06.06.683 E016.53.58.516 Color_44ACI
N051.06.06.683 E016.53.58.516 N051.06.06.309 E016.53.58.731 Color_44ACI
N051.06.06.309 E016.53.58.731 N051.06.05.873 E016.53.58.847 Color_44ACI
N051.06.05.873 E016.53.58.847 N051.06.05.562 E016.53.58.731 Color_44ACI
N051.06.05.562 E016.53.58.731 N051.06.05.115 E016.53.58.450 Color_44ACI
N051.06.05.115 E016.53.58.450 N051.05.57.866 E016.53.52.788 Color_44ACI
N051.05.57.866 E016.53.52.788 N051.05.57.524 E016.53.52.281 Color_44ACI
N051.05.57.524 E016.53.52.281 N051.05.57.328 E016.53.51.852 Color_44ACI
N051.05.57.328 E016.53.51.852 N051.05.57.175 E016.53.51.306 Color_44ACI
N051.05.57.175 E016.53.51.306 N051.05.57.124 E016.53.50.633 Color_44ACI
N051.05.57.124 E016.53.50.633 N051.05.57.197 E016.53.50.099 Color_44ACI
N051.05.57.197 E016.53.50.099 N051.05.58.100 E016.53.46.919 Color_44ACI
N051.06.05.456 E016.53.58.664 N051.06.07.222 E016.53.59.947 Color_44ACI
N051.06.07.222 E016.53.59.947 N051.06.09.141 E016.54.01.511 Color_44ACI
N051.06.09.141 E016.54.01.511 N051.06.13.153 E016.54.04.657 Color_44ACI
N051.06.13.153 E016.54.04.657 N051.06.13.981 E016.54.05.317 Color_44ACI
N051.06.13.981 E016.54.05.317 N051.06.14.339 E016.54.05.668 Color_44ACI
N051.06.14.339 E016.54.05.668 N051.06.14.559 E016.54.06.034 Color_44ACI
N051.06.14.559 E016.54.06.034 N051.06.14.669 E016.54.06.516 Color_44ACI
N051.06.14.669 E016.54.06.516 N051.06.14.715 E016.54.07.524 Color_44ACI
N051.06.14.715 E016.54.07.524 N051.06.14.614 E016.54.17.585 Color_44ACI
N051.06.14.614 E016.54.17.585 N051.06.14.614 E016.54.18.155 Color_44ACI
N051.06.14.614 E016.54.18.155 N051.06.14.917 E016.54.18.272 Color_44ACI
N051.06.14.917 E016.54.18.272 N051.06.15.201 E016.54.18.170 Color_44ACI
N051.06.15.201 E016.54.18.170 N051.06.15.339 E016.54.17.775 Color_44ACI
N051.06.15.339 E016.54.17.775 N051.06.16.421 E016.54.17.731 Color_44ACI
N051.06.16.421 E016.54.17.731 N051.06.16.605 E016.54.17.556 Color_44ACI
N051.06.16.605 E016.54.17.556 N051.06.16.577 E016.54.16.913 Color_44ACI
N051.06.16.577 E016.54.16.913 N051.06.16.330 E016.54.16.547 Color_44ACI
N051.06.16.330 E016.54.16.547 N051.06.15.963 E016.54.16.606 Color_44ACI
N051.06.06.932 E016.53.58.268 N051.06.06.893 E016.53.58.692 Color_44ACI
N051.06.06.893 E016.53.58.692 N051.06.06.910 E016.53.59.145 Color_44ACI
N051.06.06.910 E016.53.59.145 N051.06.06.984 E016.53.59.543 Color_44ACI
N051.06.06.984 E016.53.59.543 N051.06.07.157 E016.53.59.899 Color_44ACI
N051.06.36.836 E016.52.30.329 N051.06.34.213 E016.52.28.298 Color_44ACI
N051.06.36.250 E016.52.32.253 N051.06.33.658 E016.52.30.245 Color_44ACI
N051.06.35.664 E016.52.34.106 N051.06.33.090 E016.52.32.133 Color_44ACI
N051.06.35.059 E016.52.36.033 N051.06.32.520 E016.52.34.032 Color_44ACI
N051.06.34.444 E016.52.37.946 N051.06.31.932 E016.52.35.986 Color_44ACI
N051.06.33.886 E016.52.39.856 N051.06.31.349 E016.52.37.927 Color_44ACI
N051.06.33.318 E016.52.41.824 N051.06.30.758 E016.52.39.877 Color_44ACI
N051.06.32.757 E016.52.43.639 N051.06.30.199 E016.52.41.702 Color_44ACI
N051.06.32.144 E016.52.45.707 N051.06.29.593 E016.52.43.682 Color_44ACI
N051.06.31.520 E016.52.47.664 N051.06.28.961 E016.52.45.748 Color_44ACI
N051.06.30.989 E016.52.49.445 N051.06.28.447 E016.52.47.428 Color_44ACI
N051.06.30.392 E016.52.51.330 N051.06.27.857 E016.52.49.355 Color_44ACI
N051.06.29.851 E016.52.53.284 N051.06.27.264 E016.52.51.293 Color_44ACI
N051.06.29.978 E016.52.54.591 N051.06.26.990 E016.52.52.189 Color_44ACI
N051.06.29.211 E016.52.55.079 N051.06.26.681 E016.52.53.201 Color_44ACI
N051.06.28.662 E016.52.56.990 N051.06.26.116 E016.52.55.046 Color_44ACI
N051.06.28.859 E016.52.58.343 N051.06.25.795 E016.52.56.101 Color_44ACI
N051.06.28.174 E016.52.58.990 N051.06.25.501 E016.52.57.073 Color_44ACI
N051.06.12.539 E016.54.04.176 N051.06.13.064 E016.54.04.294 Color_44ACI
N051.06.13.064 E016.54.04.294 N051.06.13.555 E016.54.04.182 Color_44ACI
N051.06.13.555 E016.54.04.182 N051.06.14.197 E016.54.03.862 Color_44ACI
N051.06.14.197 E016.54.03.862 N051.06.16.583 E016.54.02.041 Color_44ACI
N051.06.13.744 E016.54.05.128 N051.06.14.467 E016.54.05.285 Color_44ACI
N051.06.14.467 E016.54.05.285 N051.06.14.989 E016.54.05.285 Color_44ACI
N051.06.14.989 E016.54.05.285 N051.06.15.520 E016.54.05.045 Color_44ACI
N051.06.15.520 E016.54.05.045 N051.06.16.623 E016.54.04.182 Color_44ACI
N051.06.14.738 E016.54.09.807 N051.06.14.949 E016.54.09.870 Color_44ACI
N051.06.14.949 E016.54.09.870 N051.06.15.230 E016.54.09.807 Color_44ACI
N051.06.15.230 E016.54.09.807 N051.06.15.420 E016.54.09.407 Color_44ACI
N051.06.15.420 E016.54.09.407 N051.06.16.523 E016.54.09.343 Color_44ACI
N051.06.16.523 E016.54.09.343 N051.06.16.654 E016.54.09.088 Color_44ACI
N051.06.16.654 E016.54.09.088 N051.06.16.654 E016.54.08.608 Color_44ACI
N051.06.16.654 E016.54.08.608 N051.06.16.413 E016.54.08.289 Color_44ACI
N051.06.16.413 E016.54.08.289 N051.06.15.972 E016.54.08.001 Color_44ACI
N051.06.14.665 E016.54.12.555 N051.06.14.799 E016.54.12.687 Color_44ACI
N051.06.14.799 E016.54.12.687 N051.06.15.070 E016.54.12.671 Color_44ACI
N051.06.15.070 E016.54.12.671 N051.06.15.381 E016.54.12.223 Color_44ACI
N051.06.15.381 E016.54.12.223 N051.06.16.544 E016.54.12.175 Color_44ACI
N051.06.16.544 E016.54.12.175 N051.06.16.584 E016.54.11.632 Color_44ACI
N051.06.16.584 E016.54.11.632 N051.06.16.423 E016.54.11.121 Color_44ACI
N051.06.16.423 E016.54.11.121 N051.06.16.133 E016.54.10.881 Color_44ACI
N051.06.16.133 E016.54.10.881 N051.06.15.932 E016.54.10.833 Color_44ACI
N051.06.14.636 E016.54.15.420 N051.06.15.060 E016.54.15.421 Color_44ACI
N051.06.15.060 E016.54.15.421 N051.06.15.360 E016.54.14.958 Color_44ACI
N051.06.15.360 E016.54.14.958 N051.06.16.544 E016.54.14.990 Color_44ACI
N051.06.16.544 E016.54.14.990 N051.06.16.574 E016.54.14.558 Color_44ACI
N051.06.16.574 E016.54.14.558 N051.06.16.454 E016.54.14.111 Color_44ACI
N051.06.16.454 E016.54.14.111 N051.06.16.163 E016.54.13.807 Color_44ACI
N051.06.16.163 E016.54.13.807 N051.06.15.822 E016.54.13.631 Color_44ACI
N051.06.25.683 E016.52.20.154 N051.06.25.239 E016.52.20.079 Color_44ACI
N051.06.25.239 E016.52.20.079 N051.06.24.821 E016.52.20.243 Color_44ACI
N051.06.24.821 E016.52.20.243 N051.06.24.396 E016.52.20.734 Color_44ACI
N051.06.24.396 E016.52.20.734 N051.06.24.033 E016.52.21.859 Color_44ACI
N051.06.24.033 E016.52.21.859 N051.06.23.409 E016.52.23.978 Color_44ACI
N051.05.57.247 E016.53.53.394 N051.06.05.129 E016.53.59.589 Color_251ACI
N051.06.05.129 E016.53.59.589 N051.06.09.765 E016.54.03.140 Color_251ACI
N051.06.09.765 E016.54.03.140 N051.06.13.079 E016.54.05.830 Color_251ACI
N051.06.13.079 E016.54.05.830 N051.06.13.791 E016.54.06.427 Color_251ACI
N051.06.13.791 E016.54.06.427 N051.06.14.040 E016.54.06.984 Color_251ACI
N051.06.14.040 E016.54.06.984 N051.06.14.229 E016.54.07.662 Color_251ACI
N051.06.14.229 E016.54.07.662 N051.06.14.254 E016.54.08.638 Color_251ACI
N051.06.14.254 E016.54.08.638 N051.06.14.154 E016.54.19.068 Color_251ACI
N051.06.14.154 E016.54.19.068 N051.06.17.193 E016.54.19.149 Color_251ACI
N051.06.17.193 E016.54.19.149 N051.06.17.280 E016.54.07.398 Color_251ACI
N051.06.17.280 E016.54.07.398 N051.06.17.168 E016.54.05.308 Color_251ACI
N051.06.17.168 E016.54.05.308 N051.06.17.155 E016.54.03.596 Color_251ACI
N051.06.17.155 E016.54.03.596 N051.06.17.143 E016.54.02.243 Color_251ACI
N051.06.17.143 E016.54.02.243 N051.06.17.280 E016.54.01.128 Color_251ACI
N051.06.17.280 E016.54.01.128 N051.06.15.979 E016.54.00.420 Color_251ACI
N051.06.15.979 E016.54.00.420 N051.06.15.357 E016.54.00.434 Color_251ACI
N051.06.15.357 E016.54.00.434 N051.06.15.409 E016.54.00.797 Color_251ACI
N051.06.15.409 E016.54.00.797 N051.06.14.603 E016.54.02.445 Color_251ACI
N051.06.14.603 E016.54.02.445 N051.06.14.586 E016.54.02.696 Color_251ACI
N051.06.14.586 E016.54.02.696 N051.06.12.110 E016.54.02.654 Color_251ACI
N051.06.12.110 E016.54.02.654 N051.06.08.119 E016.53.59.664 Color_251ACI
N051.06.08.119 E016.53.59.664 N051.06.07.901 E016.53.59.287 Color_251ACI
N051.06.07.901 E016.53.59.287 N051.06.07.715 E016.53.58.806 Color_251ACI
N051.06.07.715 E016.53.58.806 N051.06.07.672 E016.53.58.345 Color_251ACI
N051.06.07.672 E016.53.58.345 N051.06.07.784 E016.53.57.885 Color_251ACI
N051.06.07.784 E016.53.57.885 N051.06.25.691 E016.52.58.972 Color_251ACI
N051.06.25.691 E016.52.58.972 N051.06.27.908 E016.53.00.577 Color_251ACI
N051.06.27.908 E016.53.00.577 N051.06.27.594 E016.53.01.797 Color_251ACI
N051.06.27.594 E016.53.01.797 N051.06.28.380 E016.53.02.298 Color_251ACI
N051.06.28.380 E016.53.02.298 N051.06.34.043 E016.52.43.447 Color_251ACI
N051.06.34.043 E016.52.43.447 N051.06.34.043 E016.52.41.757 Color_251ACI
N051.06.34.043 E016.52.41.757 N051.06.37.893 E016.52.28.922 Color_251ACI
N051.06.37.893 E016.52.28.922 N051.06.35.338 E016.52.27.137 Color_251ACI
N051.06.35.338 E016.52.27.137 N051.06.35.476 E016.52.26.605 Color_251ACI
N051.06.35.476 E016.52.26.605 N051.06.27.501 E016.52.20.626 Color_251ACI
N051.06.27.501 E016.52.20.626 N051.06.27.075 E016.52.20.187 Color_251ACI
N051.06.27.075 E016.52.20.187 N051.06.26.785 E016.52.19.756 Color_251ACI
N051.06.26.785 E016.52.19.756 N051.06.26.515 E016.52.19.186 Color_251ACI
N051.06.26.515 E016.52.19.186 N051.06.26.379 E016.52.18.416 Color_251ACI
N051.06.26.379 E016.52.18.416 N051.06.26.314 E016.52.17.863 Color_251ACI
N051.06.24.859 E016.52.22.646 N051.06.25.323 E016.52.22.125 Color_251ACI
N051.06.25.323 E016.52.22.125 N051.06.25.768 E016.52.21.857 Color_251ACI
N051.06.25.768 E016.52.21.857 N051.06.26.243 E016.52.21.832 Color_251ACI
N051.06.26.243 E016.52.21.832 N051.06.26.810 E016.52.22.125 Color_251ACI
N051.06.26.810 E016.52.22.125 N051.06.32.387 E016.52.26.423 Color_251ACI
N051.06.32.387 E016.52.26.423 N051.06.32.760 E016.52.26.743 Color_251ACI
N051.06.32.760 E016.52.26.743 N051.06.33.067 E016.52.27.329 Color_251ACI
N051.06.33.067 E016.52.27.329 N051.06.33.281 E016.52.27.916 Color_251ACI
N051.06.33.281 E016.52.27.916 N051.06.33.327 E016.52.28.550 Color_251ACI
N051.06.33.327 E016.52.28.550 N051.06.33.266 E016.52.29.063 Color_251ACI
N051.06.33.266 E016.52.29.063 N051.06.33.143 E016.52.29.796 Color_251ACI
N051.06.33.143 E016.52.29.796 N051.06.07.237 E016.53.55.136 Color_251ACI
N051.06.07.237 E016.53.55.136 N051.06.06.968 E016.53.55.914 Color_251ACI
N051.06.06.968 E016.53.55.914 N051.06.06.673 E016.53.56.580 Color_251ACI
N051.06.06.673 E016.53.56.580 N051.06.06.369 E016.53.57.019 Color_251ACI
N051.06.06.369 E016.53.57.019 N051.06.06.018 E016.53.57.382 Color_251ACI
N051.06.06.018 E016.53.57.382 N051.06.05.486 E016.53.57.473 Color_251ACI
N051.06.05.486 E016.53.57.473 N051.06.05.115 E016.53.57.367 Color_251ACI
N051.06.05.115 E016.53.57.367 N051.05.58.866 E016.53.52.463 Color_251ACI
N051.05.58.866 E016.53.52.463 N051.05.58.486 E016.53.52.009 Color_251ACI
N051.05.58.486 E016.53.52.009 N051.05.58.324 E016.53.51.418 Color_251ACI
N051.05.58.324 E016.53.51.418 N051.05.58.210 E016.53.50.828 Color_251ACI
N051.05.58.210 E016.53.50.828 N051.05.58.196 E016.53.50.272 Color_251ACI
N051.06.15.954 E016.54.00.092 N051.06.17.978 E016.54.01.262 Color_16ACI
N051.06.17.978 E016.54.01.262 N051.06.18.656 E016.53.58.712 Color_16ACI
N051.06.18.656 E016.53.58.712 N051.06.16.509 E016.53.57.212 Color_16ACI
N051.06.16.509 E016.53.57.212 N051.06.16.283 E016.53.56.686 Color_16ACI
N051.06.16.283 E016.53.56.686 N051.06.16.283 E016.53.55.546 Color_16ACI
N051.06.16.283 E016.53.55.546 N051.06.15.304 E016.53.55.591 Color_16ACI
N051.06.15.304 E016.53.55.591 N051.06.14.607 E016.53.58.232 Color_16ACI
N051.06.14.607 E016.53.58.232 N051.06.13.007 E016.53.58.292 Color_16ACI
N051.06.13.007 E016.53.58.292 N051.06.12.997 E016.54.00.122 Color_16ACI
N051.06.12.997 E016.54.00.122 N051.06.15.125 E016.54.00.002 Color_16ACI
N051.06.15.125 E016.54.00.002 N051.06.15.078 E016.53.58.997 Color_16ACI
N051.06.15.078 E016.53.58.997 N051.06.15.822 E016.53.59.042 Color_16ACI
N051.06.15.822 E016.53.59.042 N051.06.16.001 E016.53.59.717 Color_16ACI
N051.06.16.001 E016.53.59.717 N051.06.15.954 E016.54.00.092 Color_16ACI
N051.06.13.439 E016.53.54.645 N051.06.13.439 E016.53.57.381 Color_16ACI
N051.06.13.439 E016.53.57.381 N051.06.14.117 E016.53.57.357 Color_16ACI
N051.06.14.117 E016.53.57.357 N051.06.14.117 E016.53.54.717 Color_16ACI
N051.06.14.117 E016.53.54.717 N051.06.13.439 E016.53.54.645 Color_16ACI
N051.06.23.571 E016.53.13.209 N051.06.24.140 E016.53.13.644 Color_16ACI
N051.06.24.140 E016.53.13.644 N051.06.24.839 E016.53.11.112 Color_16ACI
N051.06.24.839 E016.53.11.112 N051.06.24.282 E016.53.10.716 Color_16ACI
N051.06.24.282 E016.53.10.716 N051.06.23.571 E016.53.13.209 Color_16ACI
N051.06.24.759 E016.53.08.521 N051.06.26.656 E016.53.09.730 Color_16ACI
N051.06.26.656 E016.53.09.730 N051.06.27.853 E016.53.05.517 Color_16ACI
N051.06.27.853 E016.53.05.517 N051.06.26.016 E016.53.04.289 Color_16ACI
N051.06.26.016 E016.53.04.289 N051.06.24.759 E016.53.08.521 Color_16ACI
N051.06.28.889 E016.53.04.172 N051.06.28.486 E016.53.05.608 Color_16ACI
N051.06.28.486 E016.53.05.608 N051.06.29.707 E016.53.06.458 Color_16ACI
N051.06.29.707 E016.53.06.458 N051.06.30.098 E016.53.05.041 Color_16ACI
N051.06.30.098 E016.53.05.041 N051.06.28.889 E016.53.04.172 Color_16ACI
N051.06.31.074 E016.52.53.329 N051.06.34.276 E016.52.55.604 Color_16ACI
N051.06.34.276 E016.52.55.604 N051.06.37.123 E016.52.45.985 Color_16ACI
N051.06.37.123 E016.52.45.985 N051.06.34.043 E016.52.43.447 Color_16ACI
N051.06.34.043 E016.52.43.447 N051.06.31.074 E016.52.53.329 Color_16ACI
N051.05.55.121 E016.53.53.172 N051.06.31.330 E016.51.54.397 Color_251ACI
N051.06.31.330 E016.51.54.397 N051.06.33.045 E016.51.55.738 Color_251ACI
N051.06.33.045 E016.51.55.738 N051.05.56.892 E016.53.54.558 Color_251ACI
N051.05.56.892 E016.53.54.558 N051.05.55.121 E016.53.53.172 Color_251ACI


N051.05.55.980 E016.53.50.090 N051.05.54.990 E016.53.50.520 Color_251ACI
N051.05.54.990 E016.53.50.520 N051.05.47.810 E016.53.45.060 Color_251ACI
N051.05.47.810 E016.53.45.060 N051.05.47.670 E016.53.44.610 Color_251ACI
N051.05.47.670 E016.53.44.610 N051.05.47.680 E016.53.44.250 Color_251ACI
N051.05.47.680 E016.53.44.250 N051.05.50.740 E016.53.39.270 Color_251ACI
N051.05.50.740 E016.53.39.270 N051.05.51.080 E016.53.39.140 Color_251ACI
N051.05.51.080 E016.53.39.140 N051.05.51.530 E016.53.39.420 Color_251ACI
N051.05.51.530 E016.53.39.420 N051.05.51.940 E016.53.38.080 Color_251ACI
N051.05.51.940 E016.53.38.080 N051.05.51.080 E016.53.37.430 Color_251ACI
N051.05.51.080 E016.53.37.430 N051.05.50.670 E016.53.38.820 Color_251ACI
N051.05.50.670 E016.53.38.820 N051.05.47.640 E016.53.43.620 Color_251ACI
N051.05.47.640 E016.53.43.620 N051.05.47.500 E016.53.43.720 Color_251ACI
N051.05.47.500 E016.53.43.720 N051.05.47.410 E016.53.43.760 Color_251ACI
N051.05.47.410 E016.53.43.760 N051.05.47.290 E016.53.43.720 Color_251ACI
N051.05.47.290 E016.53.43.720 N051.05.47.260 E016.53.43.540 Color_251ACI
N051.05.47.260 E016.53.43.540 N051.05.50.120 E016.53.18.790 Color_251ACI
N051.05.50.120 E016.53.18.790 N051.05.51.350 E016.53.17.800 Color_251ACI
N051.05.51.350 E016.53.17.800 N051.05.51.330 E016.53.17.820 Color_251ACI
N051.05.51.330 E016.53.17.820 N051.06.02.350 E016.53.26.340 Color_251ACI
N051.06.02.350 E016.53.26.340 N051.06.02.800 E016.53.28.050 Color_251ACI
N051.06.03.630 E016.53.25.190 N051.06.02.550 E016.53.25.830 Color_251ACI
N051.06.02.550 E016.53.25.830 N051.05.51.520 E016.53.17.250 Color_251ACI
N051.05.51.520 E016.53.17.250 N051.05.51.210 E016.53.15.130 Color_251ACI
N051.05.51.210 E016.53.15.130 N051.06.06.920 E016.52.44.860 Color_251ACI
N051.06.06.920 E016.52.44.860 N051.06.07.880 E016.52.44.540 Color_251ACI
N051.06.07.880 E016.52.44.540 N051.06.13.760 E016.52.49.000 Color_251ACI
N051.06.13.760 E016.52.49.000 N051.06.14.150 E016.52.50.740 Color_251ACI
N051.06.15.020 E016.52.47.920 N051.06.13.960 E016.52.48.500 Color_251ACI
N051.06.13.960 E016.52.48.500 N051.06.08.270 E016.52.44.140 Color_251ACI
N051.06.08.270 E016.52.44.140 N051.06.07.900 E016.52.42.460 Color_251ACI
N051.06.07.900 E016.52.42.460 N051.06.16.050 E016.52.15.680 Color_251ACI
N051.06.16.050 E016.52.15.680 N051.06.17.140 E016.52.15.090 Color_251ACI
N051.06.17.140 E016.52.15.090 N051.06.22.480 E016.52.19.030 Color_251ACI
N051.06.22.480 E016.52.19.030 N051.06.23.230 E016.52.21.240 Color_251ACI
N051.06.24.280 E016.52.17.590 N051.06.23.520 E016.52.18.450 Color_251ACI
N051.06.23.520 E016.52.18.450 N051.06.22.610 E016.52.18.540 Color_251ACI
N051.06.22.610 E016.52.18.540 N051.06.17.840 E016.52.14.800 Color_251ACI
N051.06.17.840 E016.52.14.800 N051.06.17.440 E016.52.13.600 Color_251ACI
N051.06.17.440 E016.52.13.600 N051.06.17.530 E016.52.12.310 Color_251ACI
N051.06.17.530 E016.52.12.310 N051.06.27.370 E016.51.55.380 Color_251ACI
N051.06.27.370 E016.51.55.380 N051.06.27.540 E016.51.55.260 Color_251ACI
N051.06.27.540 E016.51.55.260 N051.06.27.750 E016.51.55.120 Color_251ACI
N051.06.27.750 E016.51.55.120 N051.06.27.930 E016.51.55.050 Color_251ACI
N051.06.27.930 E016.51.55.050 N051.06.28.220 E016.51.54.980 Color_251ACI
N051.06.28.220 E016.51.54.980 N051.06.28.430 E016.51.55.020 Color_251ACI
N051.06.28.430 E016.51.55.020 N051.06.29.550 E016.51.55.890 Color_251ACI
N051.06.29.550 E016.51.55.890 N051.06.29.960 E016.51.56.810 Color_251ACI
N051.06.29.960 E016.51.56.810 N051.06.29.210 E016.51.59.440 Color_251ACI
N051.06.29.210 E016.51.59.440 N051.06.29.090 E016.52.01.740 Color_251ACI

N051.06.30.785 E016.51.56.270 N051.06.28.030 E016.51.54.270 Color_251ACI
N051.06.28.030 E016.51.54.270 N051.06.28.000 E016.51.54.250 Color_251ACI
N051.06.28.000 E016.51.54.250 N051.06.27.690 E016.51.54.290 Color_251ACI
N051.06.27.690 E016.51.54.290 N051.06.27.490 E016.51.54.480 Color_251ACI
N051.06.27.490 E016.51.54.480 N051.06.27.340 E016.51.54.720 Color_251ACI
N051.06.27.340 E016.51.54.720 N051.06.27.030 E016.51.55.170 Color_251ACI
N051.06.27.030 E016.51.55.170 N051.06.17.530 E016.52.11.530 Color_251ACI
N051.06.17.530 E016.52.11.530 N051.06.16.300 E016.52.13.340 Color_251ACI
N051.06.16.300 E016.52.13.340 N051.06.16.180 E016.52.13.550 Color_251ACI
N051.06.16.180 E016.52.13.550 N051.06.16.060 E016.52.13.920 Color_251ACI
N051.06.16.060 E016.52.13.920 N051.06.07.580 E016.52.41.790 Color_251ACI

N051.06.07.580 E016.52.41.790 N051.06.06.410 E016.52.44.640 Color_251ACI
N051.06.06.410 E016.52.44.640 N051.06.03.590 E016.52.50.090 Color_251ACI
N051.06.03.590 E016.52.50.090 N051.06.03.390 E016.52.50.280 Color_251ACI
N051.06.03.390 E016.52.50.280 N051.06.03.200 E016.52.50.400 Color_251ACI
N051.06.03.200 E016.52.50.400 N051.06.03.020 E016.52.50.470 Color_251ACI
N051.06.03.020 E016.52.50.470 N051.06.02.850 E016.52.50.500 Color_251ACI
N051.06.02.850 E016.52.50.500 N051.06.02.690 E016.52.50.430 Color_251ACI
N051.06.02.690 E016.52.50.430 N051.06.02.460 E016.52.50.260 Color_251ACI
N051.06.02.460 E016.52.50.260 N051.06.02.160 E016.52.50.020 Color_251ACI
N051.06.02.160 E016.52.50.020 N051.06.01.890 E016.52.49.880 Color_251ACI
N051.06.01.890 E016.52.49.880 N051.06.01.600 E016.52.49.820 Color_251ACI
N051.06.01.600 E016.52.49.820 N051.06.01.320 E016.52.49.910 Color_251ACI
N051.06.01.320 E016.52.49.910 N051.06.01.110 E016.52.50.060 Color_251ACI
N051.06.01.110 E016.52.50.060 N051.06.00.930 E016.52.50.250 Color_251ACI
N051.06.00.930 E016.52.50.250 N051.06.00.560 E016.52.51.060 Color_251ACI
N051.06.00.820 E016.52.51.390 N051.06.01.630 E016.52.52.500 Color_251ACI
N051.06.01.630 E016.52.52.500 N051.06.01.760 E016.52.52.590 Color_251ACI
N051.06.01.760 E016.52.52.590 N051.06.02.340 E016.52.52.430 Color_251ACI
N051.06.02.340 E016.52.52.430 N051.06.02.510 E016.52.51.770 Color_251ACI
N051.06.02.510 E016.52.51.770 N051.06.02.440 E016.52.51.010 Color_251ACI
N051.06.02.440 E016.52.51.010 N051.06.02.360 E016.52.50.780 Color_251ACI
N051.06.02.360 E016.52.50.780 N051.06.02.240 E016.52.50.620 Color_251ACI
N051.06.02.240 E016.52.50.620 N051.06.02.040 E016.52.50.400 Color_251ACI
N051.06.02.040 E016.52.50.400 N051.06.01.860 E016.52.50.330 Color_251ACI
N051.06.01.860 E016.52.50.330 N051.06.01.580 E016.52.50.380 Color_251ACI
N051.06.01.580 E016.52.50.380 N051.06.01.330 E016.52.50.500 Color_251ACI
N051.06.01.330 E016.52.50.500 N051.06.00.820 E016.52.51.390 Color_251ACI


N051.06.00.560 E016.52.51.060 N051.05.52.520 E016.53.06.560 Color_251ACI
N051.05.52.520 E016.53.06.560 N051.05.53.660 E016.53.08.070 Color_251ACI
N051.05.53.660 E016.53.08.070 N051.05.53.740 E016.53.08.920 Color_251ACI
N051.05.53.740 E016.53.08.920 N051.05.49.910 E016.53.16.470 Color_251ACI
N051.05.49.910 E016.53.16.470 N051.05.46.660 E016.53.44.560 Color_251ACI
N051.05.46.660 E016.53.44.560 N051.05.45.780 E016.53.46.990 Color_251ACI
N051.05.45.780 E016.53.46.990 N051.05.51.910 E016.53.51.740 Color_251ACI
N051.05.51.910 E016.53.51.740 N051.05.55.390 E016.53.51.940 Color_251ACI


N051.05.57.335 E016.53.49.600 N051.05.57.200 E016.53.50.020 Color_44ACI
N051.05.57.200 E016.53.50.020 N051.05.56.920 E016.53.50.540 Color_44ACI
N051.05.56.920 E016.53.50.540 N051.05.56.650 E016.53.50.840 Color_44ACI
N051.05.56.650 E016.53.50.840 N051.05.56.400 E016.53.51.000 Color_44ACI
N051.05.56.400 E016.53.51.000 N051.05.56.000 E016.53.51.200 Color_44ACI
N051.05.56.000 E016.53.51.200 N051.05.55.800 E016.53.51.250 Color_44ACI
N051.05.55.800 E016.53.51.250 N051.05.54.730 E016.53.51.100 Color_44ACI
N051.05.54.730 E016.53.51.100 N051.05.47.230 E016.53.45.260 Color_44ACI
N051.05.47.230 E016.53.45.260 N051.05.47.000 E016.53.44.910 Color_44ACI
N051.05.47.000 E016.53.44.910 N051.05.46.950 E016.53.44.700 Color_44ACI
N051.05.46.950 E016.53.44.700 N051.05.46.990 E016.53.44.120 Color_44ACI
N051.05.46.990 E016.53.44.120 N051.05.50.030 E016.53.17.320 Color_44ACI
N051.05.50.030 E016.53.17.320 N051.05.50.150 E016.53.16.900 Color_44ACI
N051.05.50.150 E016.53.16.900 N051.05.50.250 E016.53.16.600 Color_44ACI
N051.05.50.250 E016.53.16.600 N051.06.06.650 E016.52.44.710 Color_44ACI
N051.06.06.650 E016.52.44.710 N051.06.07.200 E016.52.43.400 Color_44ACI
N051.06.07.200 E016.52.43.400 N051.06.07.620 E016.52.42.400 Color_44ACI
N051.06.07.620 E016.52.42.400 N051.06.15.820 E016.52.15.500 Color_44ACI
N051.06.15.820 E016.52.15.500 N051.06.16.250 E016.52.14.600 Color_44ACI
N051.06.16.250 E016.52.14.600 N051.06.16.500 E016.52.14.400 Color_44ACI
N051.06.16.500 E016.52.14.400 N051.06.16.950 E016.52.14.450 Color_44ACI
N051.06.16.950 E016.52.14.450 N051.06.17.230 E016.52.14.640 Color_44ACI
N051.06.17.230 E016.52.14.640 N051.06.23.340 E016.52.19.400 Color_44ACI
N051.06.23.340 E016.52.19.400 N051.06.23.620 E016.52.19.600 Color_44ACI

N051.06.23.620 E016.52.19.600 N051.06.23.800 E016.52.20.100 Color_44ACI
N051.06.23.800 E016.52.20.100 N051.06.23.900 E016.52.20.800 Color_44ACI
N051.06.23.900 E016.52.20.800 N051.06.23.700 E016.52.22.000 Color_44ACI
N051.06.23.700 E016.52.22.000 N051.06.23.120 E016.52.24.200 Color_44ACI

N051.06.23.620 E016.52.19.600 N051.06.24.300 E016.52.19.300 Color_44ACI
N051.06.24.300 E016.52.19.300 N051.06.24.600 E016.52.18.820 Color_44ACI
N051.06.24.600 E016.52.18.820 N051.06.25.250 E016.52.16.500 Color_44ACI

;stand EPWR
N051.05.53.580 E016.53.06.220 N051.05.54.770 E016.53.07.810 Color_44ACI
N051.05.54.750 E016.53.04.030 N051.05.55.900 E016.53.05.630 Color_44ACI
N051.05.55.890 E016.53.01.790 N051.05.57.060 E016.53.03.400 Color_44ACI
N051.05.57.040 E016.52.59.540 N051.05.58.210 E016.53.01.150 Color_44ACI
N051.05.58.170 E016.52.57.320 N051.05.59.340 E016.52.58.930 Color_44ACI
N051.05.59.310 E016.52.55.100 N051.06.00.480 E016.52.56.710 Color_44ACI
N051.06.00.460 E016.52.52.890 N051.06.01.620 E016.52.54.500 Color_44ACI







LOTNISKA_EPRZ N050.06.35.360 E022.02.45.157 N050.06.35.611 E022.02.45.429 Color_251ACI
N050.06.37.506 E022.00.05.574 N050.06.35.360 E022.02.45.157 Color_251ACI
N050.06.33.910 E022.02.44.952 N050.06.33.659 E022.02.45.355 Color_251ACI
N050.06.36.060 E022.00.05.565 N050.06.33.910 E022.02.44.952 Color_251ACI
N050.06.36.037 E022.02.11.444 N050.06.35.580 E022.02.46.607 Color_251ACI
N050.06.36.348 E022.02.11.446 N050.06.36.037 E022.02.11.444 Color_251ACI
N050.06.38.060 E022.00.05.572 N050.06.36.348 E022.02.11.446 Color_251ACI
N050.06.35.515 E022.00.05.576 N050.06.38.060 E022.00.05.572 Color_251ACI
N050.06.33.800 E022.02.11.360 N050.06.35.515 E022.00.05.576 Color_251ACI
N050.06.34.098 E022.02.11.370 N050.06.33.800 E022.02.11.360 Color_251ACI
N050.06.33.653 E022.02.46.554 N050.06.34.098 E022.02.11.370 Color_251ACI
N050.06.35.580 E022.02.46.607 N050.06.33.653 E022.02.46.554 Color_251ACI
N050.06.17.648 E022.03.11.784 N050.06.20.853 E022.03.11.763 lime
N050.06.17.452 E022.02.36.661 N050.06.17.648 E022.03.11.784 lime
N050.06.20.667 E022.02.36.624 N050.06.17.452 E022.02.36.661 lime
N050.06.20.853 E022.03.11.763 N050.06.20.667 E022.02.36.624 lime
N050.06.15.472 E022.02.26.566 N050.06.15.745 E022.03.11.820 olive
N050.06.14.449 E022.02.26.572 N050.06.15.472 E022.02.26.566 olive
N050.06.14.724 E022.03.11.834 N050.06.14.449 E022.02.26.572 olive
N050.06.15.745 E022.03.11.820 N050.06.14.724 E022.03.11.834 olive
N050.06.52.155 E022.01.34.256 N050.06.52.224 E022.01.30.373 Color_251ACI
N050.06.52.291 E022.01.34.357 N050.06.52.155 E022.01.34.256 Color_251ACI
N050.06.52.198 E022.01.42.517 N050.06.52.291 E022.01.34.357 Color_251ACI
N050.06.49.459 E022.01.42.430 N050.06.52.198 E022.01.42.517 Color_251ACI
N050.06.49.297 E022.01.42.451 N050.06.49.459 E022.01.42.430 Color_251ACI
N050.06.49.167 E022.01.42.491 N050.06.49.297 E022.01.42.451 Color_251ACI
N050.06.49.076 E022.01.42.572 N050.06.49.167 E022.01.42.491 Color_251ACI
N050.06.49.017 E022.01.42.684 N050.06.49.076 E022.01.42.572 Color_251ACI
N050.06.48.985 E022.01.42.846 N050.06.49.017 E022.01.42.684 Color_251ACI
N050.06.48.954 E022.01.45.958 N050.06.48.985 E022.01.42.846 Color_251ACI
N050.06.40.932 E022.01.45.685 N050.06.48.954 E022.01.45.958 Color_251ACI
N050.06.40.695 E022.01.40.911 N050.06.40.932 E022.01.45.685 Color_251ACI
N050.06.40.656 E022.01.40.444 N050.06.40.695 E022.01.40.911 Color_251ACI
N050.06.40.617 E022.01.40.162 N050.06.40.656 E022.01.40.444 Color_251ACI
N050.06.40.539 E022.01.39.928 N050.06.40.617 E022.01.40.162 Color_251ACI
N050.06.40.402 E022.01.39.736 N050.06.40.539 E022.01.39.928 Color_251ACI
N050.06.40.200 E022.01.39.574 N050.06.40.402 E022.01.39.736 Color_251ACI
N050.06.39.907 E022.01.39.453 N050.06.40.200 E022.01.39.574 Color_251ACI
N050.06.39.588 E022.01.39.331 N050.06.39.907 E022.01.39.453 Color_251ACI
N050.06.38.346 E022.01.39.160 N050.06.39.588 E022.01.39.331 Color_251ACI
N050.06.36.785 E022.01.39.396 N050.06.38.346 E022.01.39.160 Color_251ACI
N050.06.36.816 E022.01.37.308 N050.06.38.378 E022.01.37.630 Color_251ACI
N050.06.38.378 E022.01.37.630 N050.06.39.964 E022.01.37.384 Color_251ACI
N050.06.39.964 E022.01.37.384 N050.06.40.244 E022.01.37.313 Color_251ACI
N050.06.40.244 E022.01.37.313 N050.06.40.472 E022.01.37.181 Color_251ACI
N050.06.40.472 E022.01.37.181 N050.06.40.609 E022.01.37.029 Color_251ACI
N050.06.40.609 E022.01.37.029 N050.06.40.687 E022.01.36.867 Color_251ACI
N050.06.40.687 E022.01.36.867 N050.06.40.784 E022.01.36.633 Color_251ACI
N050.06.40.784 E022.01.36.633 N050.06.40.836 E022.01.36.279 Color_251ACI
N050.06.40.836 E022.01.36.279 N050.06.40.849 E022.01.36.015 Color_251ACI
N050.06.40.849 E022.01.36.015 N050.06.41.080 E022.01.29.891 Color_251ACI
N050.06.41.080 E022.01.29.891 N050.06.41.129 E022.01.25.199 Color_251ACI
N050.06.41.129 E022.01.25.199 N050.06.41.135 E022.01.24.672 Color_251ACI
N050.06.41.135 E022.01.24.672 N050.06.41.128 E022.01.24.225 Color_251ACI
N050.06.41.128 E022.01.24.225 N050.06.41.076 E022.01.23.870 Color_251ACI
N050.06.41.076 E022.01.23.870 N050.06.40.952 E022.01.23.587 Color_251ACI
N050.06.40.952 E022.01.23.587 N050.06.40.816 E022.01.23.425 Color_251ACI
N050.06.40.816 E022.01.23.425 N050.06.40.634 E022.01.23.334 Color_251ACI
N050.06.40.634 E022.01.23.334 N050.06.40.484 E022.01.23.304 Color_251ACI
N050.06.40.484 E022.01.23.304 N050.06.37.966 E022.01.23.195 Color_251ACI
N050.06.37.966 E022.01.23.195 N050.06.37.777 E022.01.23.186 Color_251ACI
N050.06.37.777 E022.01.23.186 N050.06.37.576 E022.01.23.206 Color_251ACI
N050.06.37.576 E022.01.23.206 N050.06.37.413 E022.01.23.248 Color_251ACI
N050.06.37.413 E022.01.23.248 N050.06.37.244 E022.01.23.329 Color_251ACI
N050.06.37.244 E022.01.23.329 N050.06.37.088 E022.01.23.419 Color_251ACI
N050.06.37.088 E022.01.23.419 N050.06.36.990 E022.01.23.603 Color_251ACI
N050.06.46.884 E022.01.24.672 N050.06.47.275 E022.01.28.768 Color_251ACI
N050.06.46.839 E022.01.24.420 N050.06.46.884 E022.01.24.672 Color_251ACI
N050.06.46.787 E022.01.24.197 N050.06.46.839 E022.01.24.420 Color_251ACI
N050.06.46.689 E022.01.24.024 N050.06.46.787 E022.01.24.197 Color_251ACI
N050.06.46.572 E022.01.23.882 N050.06.46.689 E022.01.24.024 Color_251ACI
N050.06.46.448 E022.01.23.771 N050.06.46.572 E022.01.23.882 Color_251ACI
N050.06.46.312 E022.01.23.679 N050.06.46.448 E022.01.23.771 Color_251ACI
N050.06.46.143 E022.01.23.629 N050.06.46.312 E022.01.23.679 Color_251ACI
N050.06.45.947 E022.01.23.609 N050.06.46.143 E022.01.23.629 Color_251ACI
N050.06.44.523 E022.01.23.476 N050.06.45.947 E022.01.23.609 Color_251ACI
N050.06.42.779 E022.01.23.699 N050.06.44.523 E022.01.23.476 Color_251ACI
N050.06.42.623 E022.01.23.720 N050.06.42.779 E022.01.23.699 Color_251ACI
N050.06.42.434 E022.01.23.801 N050.06.42.623 E022.01.23.720 Color_251ACI
N050.06.42.291 E022.01.23.912 N050.06.42.434 E022.01.23.801 Color_251ACI
N050.06.42.187 E022.01.24.085 N050.06.42.291 E022.01.23.912 Color_251ACI
N050.06.42.096 E022.01.24.278 N050.06.42.187 E022.01.24.085 Color_251ACI
N050.06.42.031 E022.01.24.551 N050.06.42.096 E022.01.24.278 Color_251ACI
N050.06.41.979 E022.01.24.905 N050.06.42.031 E022.01.24.551 Color_251ACI
N050.06.41.966 E022.01.25.879 N050.06.41.979 E022.01.24.905 Color_251ACI
N050.06.41.829 E022.01.33.309 N050.06.41.966 E022.01.25.879 Color_251ACI
N050.06.41.933 E022.01.36.046 N050.06.41.829 E022.01.33.309 Color_251ACI
N050.06.41.973 E022.01.36.451 N050.06.41.933 E022.01.36.046 Color_251ACI
N050.06.42.044 E022.01.36.735 N050.06.41.973 E022.01.36.451 Color_251ACI
N050.06.42.148 E022.01.36.949 N050.06.42.044 E022.01.36.735 Color_251ACI
N050.06.42.298 E022.01.37.161 N050.06.42.148 E022.01.36.949 Color_251ACI
N050.06.42.506 E022.01.37.334 N050.06.42.298 E022.01.37.161 Color_251ACI
N050.06.42.695 E022.01.37.425 N050.06.42.506 E022.01.37.334 Color_251ACI
N050.06.44.412 E022.01.37.771 N050.06.42.695 E022.01.37.425 Color_251ACI
N050.06.46.065 E022.01.37.698 N050.06.44.409 E022.01.37.770 Color_251ACI
N050.06.46.240 E022.01.37.657 N050.06.46.065 E022.01.37.698 Color_251ACI
N050.06.46.435 E022.01.37.536 N050.06.46.240 E022.01.37.657 Color_251ACI
N050.06.46.592 E022.01.37.344 N050.06.46.435 E022.01.37.536 Color_251ACI
N050.06.46.702 E022.01.37.120 N050.06.46.592 E022.01.37.344 Color_251ACI
N050.06.46.806 E022.01.36.806 N050.06.46.702 E022.01.37.120 Color_251ACI
N050.06.46.878 E022.01.36.472 N050.06.46.806 E022.01.36.806 Color_251ACI
N050.06.46.930 E022.01.36.016 N050.06.46.878 E022.01.36.472 Color_251ACI
N050.06.47.236 E022.01.32.231 N050.06.46.930 E022.01.36.016 Color_251ACI
N050.06.47.275 E022.01.28.768 N050.06.47.236 E022.01.32.231 Color_251ACI
N050.06.52.278 E022.01.26.933 N050.06.52.232 E022.01.29.914 Color_251ACI
N050.06.46.683 E022.00.05.930 N050.06.38.069 E022.00.05.565 Color_251ACI
N050.06.46.624 E022.00.11.028 N050.06.46.683 E022.00.05.930 Color_251ACI
N050.06.43.176 E022.00.10.927 N050.06.46.624 E022.00.11.028 Color_251ACI
N050.06.43.020 E022.00.10.927 N050.06.43.176 E022.00.10.927 Color_251ACI
N050.06.42.909 E022.00.10.998 N050.06.43.020 E022.00.10.927 Color_251ACI
N050.06.42.864 E022.00.11.170 N050.06.42.909 E022.00.10.998 Color_251ACI
N050.06.42.864 E022.00.11.454 N050.06.42.864 E022.00.11.170 Color_251ACI
N050.06.42.643 E022.00.28.099 N050.06.42.864 E022.00.11.454 Color_251ACI
N050.06.42.656 E022.00.28.433 N050.06.42.643 E022.00.28.099 Color_251ACI
N050.06.42.753 E022.00.28.616 N050.06.42.656 E022.00.28.433 Color_251ACI
N050.06.42.877 E022.00.28.717 N050.06.42.753 E022.00.28.616 Color_251ACI
N050.06.42.981 E022.00.28.717 N050.06.42.877 E022.00.28.717 Color_251ACI
N050.06.42.792 E022.00.44.591 N050.06.42.981 E022.00.28.717 Color_251ACI
N050.06.42.675 E022.00.44.571 N050.06.42.792 E022.00.44.591 Color_251ACI
N050.06.42.519 E022.00.44.632 N050.06.42.675 E022.00.44.571 Color_251ACI
N050.06.42.434 E022.00.44.844 N050.06.42.519 E022.00.44.632 Color_251ACI
N050.06.42.415 E022.00.45.271 N050.06.42.434 E022.00.44.844 Color_251ACI
N050.06.42.018 E022.01.16.290 N050.06.42.415 E022.00.45.271 Color_251ACI
N050.06.42.034 E022.01.20.294 N050.06.42.018 E022.01.16.290 Color_251ACI
N050.06.42.047 E022.01.20.641 N050.06.42.034 E022.01.20.294 Color_251ACI
N050.06.42.089 E022.01.20.902 N050.06.42.047 E022.01.20.641 Color_251ACI
N050.06.42.185 E022.01.21.218 N050.06.42.089 E022.01.20.902 Color_251ACI
N050.06.42.292 E022.01.21.434 N050.06.42.185 E022.01.21.218 Color_251ACI
N050.06.42.446 E022.01.21.614 N050.06.42.292 E022.01.21.434 Color_251ACI
N050.06.42.630 E022.01.21.750 N050.06.42.446 E022.01.21.614 Color_251ACI
N050.06.42.836 E022.01.21.821 N050.06.42.630 E022.01.21.750 Color_251ACI
N050.06.43.085 E022.01.21.865 N050.06.42.836 E022.01.21.821 Color_251ACI
N050.06.44.718 E022.01.22.210 N050.06.43.085 E022.01.21.865 Color_251ACI
N050.06.52.356 E022.01.22.473 N050.06.44.718 E022.01.22.210 Color_251ACI
N050.06.52.291 E022.01.26.528 N050.06.52.356 E022.01.22.473 Color_251ACI
N050.06.37.152 E022.01.21.773 N050.06.37.028 E022.01.21.560 Color_251ACI
N050.06.37.282 E022.01.21.875 N050.06.37.152 E022.01.21.773 Color_251ACI
N050.06.37.490 E022.01.21.966 N050.06.37.282 E022.01.21.875 Color_251ACI
N050.06.37.685 E022.01.22.007 N050.06.37.490 E022.01.21.966 Color_251ACI
N050.06.37.874 E022.01.22.007 N050.06.37.685 E022.01.22.007 Color_251ACI
N050.06.40.242 E022.01.22.067 N050.06.37.874 E022.01.22.007 Color_251ACI
N050.06.40.391 E022.01.22.067 N050.06.40.242 E022.01.22.067 Color_251ACI
N050.06.40.580 E022.01.22.037 N050.06.40.391 E022.01.22.067 Color_251ACI
N050.06.40.730 E022.01.21.945 N050.06.40.580 E022.01.22.037 Color_251ACI
N050.06.40.899 E022.01.21.814 N050.06.40.730 E022.01.21.945 Color_251ACI
N050.06.41.029 E022.01.21.622 N050.06.40.899 E022.01.21.814 Color_251ACI
N050.06.41.127 E022.01.21.378 N050.06.41.029 E022.01.21.622 Color_251ACI
N050.06.41.185 E022.01.21.115 N050.06.41.127 E022.01.21.378 Color_251ACI
N050.06.41.224 E022.01.20.791 N050.06.41.185 E022.01.21.115 Color_251ACI
N050.06.41.224 E022.01.20.446 N050.06.41.224 E022.01.20.791 Color_251ACI
N050.06.41.699 E022.00.44.420 N050.06.41.224 E022.01.20.446 Color_251ACI
N050.06.41.478 E022.00.38.621 N050.06.41.699 E022.00.44.420 Color_251ACI
N050.06.41.459 E022.00.38.277 N050.06.41.478 E022.00.38.621 Color_251ACI
N050.06.41.381 E022.00.37.962 N050.06.41.459 E022.00.38.277 Color_251ACI
N050.06.41.289 E022.00.37.759 N050.06.41.381 E022.00.37.962 Color_251ACI
N050.06.41.159 E022.00.37.566 N050.06.41.289 E022.00.37.759 Color_251ACI
N050.06.41.010 E022.00.37.405 N050.06.41.159 E022.00.37.566 Color_251ACI
N050.06.40.834 E022.00.37.283 N050.06.41.010 E022.00.37.405 Color_251ACI
N050.06.40.587 E022.00.37.242 N050.06.40.834 E022.00.37.283 Color_251ACI
N050.06.40.372 E022.00.37.333 N050.06.40.587 E022.00.37.242 Color_251ACI
N050.06.40.138 E022.00.37.547 N050.06.40.372 E022.00.37.333 Color_251ACI
N050.06.39.975 E022.00.37.840 N050.06.40.138 E022.00.37.547 Color_251ACI
N050.06.38.941 E022.00.40.304 N050.06.39.975 E022.00.37.840 Color_251ACI
N050.06.38.700 E022.00.40.942 N050.06.38.941 E022.00.40.304 Color_251ACI
N050.06.38.485 E022.00.41.591 N050.06.38.700 E022.00.40.942 Color_251ACI
N050.06.38.258 E022.00.42.361 N050.06.38.485 E022.00.41.591 Color_251ACI
N050.06.38.062 E022.00.43.152 N050.06.38.258 E022.00.42.361 Color_251ACI
N050.06.37.913 E022.00.43.821 N050.06.38.062 E022.00.43.152 Color_251ACI
N050.06.37.757 E022.00.44.662 N050.06.37.913 E022.00.43.821 Color_251ACI
N050.06.37.601 E022.00.45.565 N050.06.37.757 E022.00.44.662 Color_251ACI
N050.06.37.510 E022.00.46.274 N050.06.37.601 E022.00.45.565 Color_251ACI
N050.06.38.173 E022.00.07.288 N050.06.38.024 E022.00.07.551 Color_251ACI
N050.06.38.316 E022.00.07.126 N050.06.38.173 E022.00.07.288 Color_251ACI
N050.06.38.492 E022.00.06.984 N050.06.38.316 E022.00.07.126 Color_251ACI
N050.06.38.694 E022.00.06.872 N050.06.38.492 E022.00.06.984 Color_251ACI
N050.06.38.902 E022.00.06.832 N050.06.38.694 E022.00.06.872 Color_251ACI
N050.06.39.455 E022.00.06.842 N050.06.38.902 E022.00.06.832 Color_251ACI
N050.06.39.813 E022.00.06.872 N050.06.39.455 E022.00.06.842 Color_251ACI
N050.06.40.132 E022.00.06.903 N050.06.39.813 E022.00.06.872 Color_251ACI
N050.06.40.482 E022.00.06.964 N050.06.40.132 E022.00.06.903 Color_251ACI
N050.06.40.808 E022.00.07.055 N050.06.40.482 E022.00.06.964 Color_251ACI
N050.06.41.120 E022.00.07.197 N050.06.40.808 E022.00.07.055 Color_251ACI
N050.06.41.309 E022.00.07.308 N050.06.41.120 E022.00.07.197 Color_251ACI
N050.06.41.537 E022.00.07.501 N050.06.41.309 E022.00.07.308 Color_251ACI
N050.06.41.693 E022.00.07.724 N050.06.41.537 E022.00.07.501 Color_251ACI
N050.06.41.803 E022.00.07.947 N050.06.41.693 E022.00.07.724 Color_251ACI
N050.06.41.888 E022.00.08.210 N050.06.41.803 E022.00.07.947 Color_251ACI
N050.06.41.920 E022.00.08.504 N050.06.41.888 E022.00.08.210 Color_251ACI
N050.06.42.051 E022.00.14.891 N050.06.41.920 E022.00.08.504 Color_251ACI
N050.06.42.064 E022.00.16.229 N050.06.42.051 E022.00.14.891 Color_251ACI
N050.06.42.025 E022.00.21.885 N050.06.42.064 E022.00.16.229 Color_251ACI
N050.06.41.894 E022.00.27.795 N050.06.42.025 E022.00.21.885 Color_251ACI
N050.06.41.881 E022.00.28.281 N050.06.41.894 E022.00.27.795 Color_251ACI
N050.06.41.823 E022.00.28.869 N050.06.41.881 E022.00.28.281 Color_251ACI
N050.06.41.699 E022.00.29.700 N050.06.41.823 E022.00.28.869 Color_251ACI
N050.06.41.550 E022.00.30.440 N050.06.41.699 E022.00.29.700 Color_251ACI
N050.06.41.381 E022.00.31.079 N050.06.41.550 E022.00.30.440 Color_251ACI
N050.06.41.185 E022.00.31.728 N050.06.41.381 E022.00.31.079 Color_251ACI
N050.06.40.841 E022.00.32.650 N050.06.41.185 E022.00.31.728 Color_251ACI
N050.06.37.848 E022.00.40.628 N050.06.40.841 E022.00.32.650 Color_251ACI
N050.06.37.744 E022.00.40.821 N050.06.37.848 E022.00.40.628 Color_251ACI
N050.06.37.653 E022.00.40.811 N050.06.37.744 E022.00.40.821 Color_251ACI
N050.06.37.568 E022.00.40.628 N050.06.37.653 E022.00.40.811 Color_251ACI
N050.06.51.041 E022.01.42.544 N050.06.50.866 E022.01.42.463 Color_251ACI
N050.06.51.146 E022.01.42.706 N050.06.51.041 E022.01.42.544 Color_251ACI
N050.06.51.185 E022.01.42.939 N050.06.51.146 E022.01.42.706 Color_251ACI
N050.06.51.087 E022.01.47.561 N050.06.51.185 E022.01.42.939 Color_251ACI
N050.06.51.035 E022.01.47.856 N050.06.51.087 E022.01.47.561 Color_251ACI
N050.06.50.892 E022.01.48.119 N050.06.51.035 E022.01.47.856 Color_251ACI
N050.06.50.697 E022.01.48.221 N050.06.50.892 E022.01.48.119 Color_251ACI
N050.06.49.330 E022.01.48.190 N050.06.50.697 E022.01.48.221 Color_251ACI
N050.06.49.109 E022.01.48.119 N050.06.49.330 E022.01.48.190 Color_251ACI
N050.06.48.973 E022.01.47.926 N050.06.49.109 E022.01.48.119 Color_251ACI
N050.06.48.940 E022.01.47.713 N050.06.48.973 E022.01.47.926 Color_251ACI
N050.06.48.953 E022.01.45.960 N050.06.48.940 E022.01.47.713 Color_251ACI
N050.06.53.364 E022.01.23.871 N050.06.52.980 E022.01.23.882 Color_251ACI
N050.06.53.403 E022.01.22.493 N050.06.53.364 E022.01.23.871 Color_251ACI
N050.06.52.362 E022.01.22.473 N050.06.53.403 E022.01.22.493 Color_251ACI
N050.06.53.056 E022.01.34.385 N050.06.52.315 E022.01.34.371 Color_251ACI
N050.06.53.111 E022.01.33.066 N050.06.53.056 E022.01.34.385 Color_251ACI
N050.06.52.866 E022.01.33.041 N050.06.53.111 E022.01.33.066 Color_251ACI
N050.06.53.423 E022.01.31.318 N050.06.53.362 E022.01.35.284 Color_251ACI
N050.06.52.975 E022.01.38.678 N050.06.54.918 E022.01.38.833 Color_251ACI
N050.06.53.027 E022.01.35.284 N050.06.52.975 E022.01.38.678 Color_251ACI
N050.06.54.966 E022.01.35.309 N050.06.53.027 E022.01.35.284 Color_251ACI
N050.06.54.908 E022.01.39.210 N050.06.54.966 E022.01.35.309 Color_251ACI
N050.06.59.477 E022.01.46.941 N050.06.59.535 E022.01.46.776 Color_251ACI
N050.06.59.400 E022.01.47.082 N050.06.59.477 E022.01.46.941 Color_251ACI
N050.06.59.326 E022.01.47.187 N050.06.59.400 E022.01.47.082 Color_251ACI
N050.06.59.203 E022.01.47.242 N050.06.59.326 E022.01.47.187 Color_251ACI
N050.06.59.052 E022.01.47.192 N050.06.59.203 E022.01.47.242 Color_251ACI
N050.06.58.076 E022.01.46.439 N050.06.59.052 E022.01.47.192 Color_251ACI
N050.06.57.976 E022.01.46.313 N050.06.58.076 E022.01.46.439 Color_251ACI
N050.06.57.927 E022.01.46.168 N050.06.57.976 E022.01.46.313 Color_251ACI
N050.06.57.908 E022.01.45.987 N050.06.57.927 E022.01.46.168 Color_251ACI
N050.06.57.924 E022.01.45.817 N050.06.57.908 E022.01.45.987 Color_251ACI
N050.06.58.047 E022.01.44.682 N050.06.57.924 E022.01.45.817 Color_251ACI
N050.06.58.050 E022.01.44.546 N050.06.58.047 E022.01.44.682 Color_251ACI
N050.06.58.349 E022.01.24.114 N050.06.58.050 E022.01.44.546 Color_251ACI
N050.06.55.553 E022.01.23.984 N050.06.58.349 E022.01.24.114 Color_251ACI
N050.06.55.550 E022.01.22.207 N050.06.55.553 E022.01.23.984 Color_251ACI
N050.06.55.398 E022.01.22.191 N050.06.55.550 E022.01.22.207 Color_251ACI
N050.06.55.379 E022.01.25.465 N050.06.55.398 E022.01.22.191 Color_251ACI
N050.06.53.687 E022.01.25.360 N050.06.55.379 E022.01.25.465 Color_251ACI
N050.06.53.681 E022.01.26.785 N050.06.53.687 E022.01.25.360 Color_251ACI
N050.06.54.551 E022.01.26.910 N050.06.53.681 E022.01.26.785 Color_251ACI
N050.06.54.493 E022.01.30.239 N050.06.54.551 E022.01.26.910 Color_251ACI
N050.06.53.571 E022.01.30.209 N050.06.54.493 E022.01.30.239 Color_251ACI
N050.06.53.581 E022.01.31.650 N050.06.53.571 E022.01.30.209 Color_251ACI
N050.06.55.253 E022.01.31.675 N050.06.53.581 E022.01.31.650 Color_251ACI
N050.06.55.256 E022.01.35.038 N050.06.55.253 E022.01.31.675 Color_251ACI
N050.06.55.250 E022.01.35.174 N050.06.55.256 E022.01.35.038 Color_251ACI
N050.06.55.214 E022.01.35.319 N050.06.55.250 E022.01.35.174 Color_251ACI
N050.06.55.176 E022.01.35.460 N050.06.55.214 E022.01.35.319 Color_251ACI
N050.06.55.108 E022.01.35.565 N050.06.55.176 E022.01.35.460 Color_251ACI
N050.06.55.024 E022.01.35.601 N050.06.55.108 E022.01.35.565 Color_251ACI
N050.06.54.042 E022.01.35.601 N050.06.55.024 E022.01.35.601 Color_251ACI
N050.06.53.955 E022.01.38.563 N050.06.54.042 E022.01.35.601 Color_251ACI
N050.06.54.322 E022.01.38.572 N050.06.53.955 E022.01.38.563 Color_251ACI
N050.06.54.370 E022.01.37.845 N050.06.54.322 E022.01.38.572 Color_251ACI
N050.06.54.473 E022.01.37.835 N050.06.54.370 E022.01.37.845 Color_251ACI
N050.06.54.477 E022.01.38.125 N050.06.54.473 E022.01.37.835 Color_251ACI
N050.06.54.792 E022.01.38.130 N050.06.54.477 E022.01.38.125 Color_251ACI
N050.06.54.812 E022.01.37.754 N050.06.54.792 E022.01.38.130 Color_251ACI
N050.06.55.034 E022.01.37.729 N050.06.54.812 E022.01.37.754 Color_251ACI
N050.06.55.079 E022.01.37.735 N050.06.55.034 E022.01.37.729 Color_251ACI
N050.06.55.147 E022.01.37.790 N050.06.55.079 E022.01.37.735 Color_251ACI
N050.06.55.205 E022.01.37.890 N050.06.55.147 E022.01.37.790 Color_251ACI
N050.06.55.214 E022.01.38.036 N050.06.55.205 E022.01.37.890 Color_251ACI
N050.06.55.250 E022.01.40.320 N050.06.55.214 E022.01.38.036 Color_251ACI
N050.06.55.179 E022.01.40.320 N050.06.55.250 E022.01.40.320 Color_251ACI
N050.06.54.428 E022.01.36.178 N050.06.54.783 E022.01.36.198 Color_251ACI
N050.06.54.406 E022.01.37.453 N050.06.54.428 E022.01.36.178 Color_251ACI
N050.06.54.531 E022.01.37.463 N050.06.54.406 E022.01.37.453 Color_251ACI
N050.06.54.541 E022.01.37.207 N050.06.54.531 E022.01.37.463 Color_251ACI
N050.06.54.815 E022.01.37.217 N050.06.54.541 E022.01.37.207 Color_251ACI
N050.06.54.812 E022.01.37.438 N050.06.54.815 E022.01.37.217 Color_251ACI
N050.06.55.037 E022.01.37.458 N050.06.54.812 E022.01.37.438 Color_251ACI
N050.06.55.108 E022.01.37.427 N050.06.55.037 E022.01.37.458 Color_251ACI
N050.06.55.153 E022.01.37.377 N050.06.55.108 E022.01.37.427 Color_251ACI
N050.06.55.198 E022.01.37.308 N050.06.55.153 E022.01.37.377 Color_251ACI
N050.06.55.221 E022.01.37.167 N050.06.55.198 E022.01.37.308 Color_251ACI
N050.06.55.247 E022.01.36.183 N050.06.55.221 E022.01.37.167 Color_251ACI
N050.06.55.234 E022.01.36.078 N050.06.55.247 E022.01.36.183 Color_251ACI
N050.06.55.202 E022.01.35.992 N050.06.55.234 E022.01.36.078 Color_251ACI
N050.06.55.147 E022.01.35.942 N050.06.55.202 E022.01.35.992 Color_251ACI
N050.06.55.060 E022.01.35.921 N050.06.55.147 E022.01.35.942 Color_251ACI
N050.06.54.789 E022.01.35.912 N050.06.55.060 E022.01.35.921 Color_251ACI
N050.06.54.783 E022.01.36.198 N050.06.54.789 E022.01.35.912 Color_251ACI
N050.06.58.723 E022.01.52.905 N050.06.58.862 E022.01.53.005 Color_251ACI
N050.06.58.581 E022.01.52.775 N050.06.58.723 E022.01.52.905 Color_251ACI
N050.06.58.452 E022.01.52.664 N050.06.58.581 E022.01.52.775 Color_251ACI
N050.06.58.349 E022.01.52.538 N050.06.58.452 E022.01.52.664 Color_251ACI
N050.06.58.291 E022.01.52.448 N050.06.58.349 E022.01.52.538 Color_251ACI
N050.06.58.259 E022.01.52.318 N050.06.58.291 E022.01.52.448 Color_251ACI
N050.06.58.298 E022.01.52.122 N050.06.58.259 E022.01.52.318 Color_251ACI
N050.06.59.764 E022.01.46.976 N050.06.58.298 E022.01.52.122 Color_251ACI
N050.06.54.809 E022.02.05.882 N050.06.55.121 E022.02.06.224 Color_251ACI
N050.06.54.712 E022.02.05.772 N050.06.54.809 E022.02.05.882 Color_251ACI
N050.06.54.635 E022.02.05.636 N050.06.54.712 E022.02.05.772 Color_251ACI
N050.06.54.586 E022.02.05.465 N050.06.54.635 E022.02.05.636 Color_251ACI
N050.06.54.567 E022.02.05.314 N050.06.54.586 E022.02.05.465 Color_251ACI
N050.06.54.570 E022.02.05.139 N050.06.54.567 E022.02.05.314 Color_251ACI
N050.06.54.599 E022.02.04.944 N050.06.54.570 E022.02.05.139 Color_251ACI
N050.06.54.652 E022.02.04.703 N050.06.54.599 E022.02.04.944 Color_251ACI
N050.06.57.892 E022.01.53.528 N050.06.54.652 E022.02.04.703 Color_251ACI
N050.06.57.953 E022.01.53.347 N050.06.57.892 E022.01.53.528 Color_251ACI
N050.06.58.018 E022.01.53.206 N050.06.57.953 E022.01.53.347 Color_251ACI
N050.06.58.095 E022.01.53.101 N050.06.58.018 E022.01.53.206 Color_251ACI
N050.06.58.185 E022.01.53.051 N050.06.58.095 E022.01.53.101 Color_251ACI
N050.06.58.278 E022.01.53.056 N050.06.58.185 E022.01.53.051 Color_251ACI
N050.06.58.365 E022.01.53.101 N050.06.58.278 E022.01.53.056 Color_251ACI
N050.06.58.768 E022.01.53.382 N050.06.58.365 E022.01.53.101 Color_251ACI
N050.06.47.889 E022.03.16.388 N050.06.48.425 E022.03.16.735 Color_251ACI
N050.06.47.589 E022.03.16.124 N050.06.47.889 E022.03.16.388 Color_251ACI
N050.06.47.432 E022.03.15.757 N050.06.47.589 E022.03.16.124 Color_251ACI
N050.06.47.327 E022.03.15.267 N050.06.47.432 E022.03.15.757 Color_251ACI
N050.06.46.216 E022.03.09.157 N050.06.47.327 E022.03.15.267 Color_251ACI
N050.06.45.955 E022.03.07.588 N050.06.46.216 E022.03.09.157 Color_251ACI
N050.06.45.732 E022.03.05.979 N050.06.45.955 E022.03.07.588 Color_251ACI
N050.06.44.347 E022.02.51.170 N050.06.45.732 E022.03.05.979 Color_251ACI
N050.06.44.229 E022.02.49.255 N050.06.44.347 E022.02.51.170 Color_251ACI
N050.06.44.164 E022.02.47.707 N050.06.44.229 E022.02.49.255 Color_251ACI
N050.06.44.124 E022.02.46.566 N050.06.44.164 E022.02.47.707 Color_251ACI
N050.06.44.164 E022.02.45.119 N050.06.44.124 E022.02.46.566 Color_251ACI
N050.06.44.203 E022.02.43.898 N050.06.44.164 E022.02.45.119 Color_251ACI
N050.06.44.307 E022.02.42.716 N050.06.44.203 E022.02.43.898 Color_251ACI
N050.06.44.530 E022.02.41.291 N050.06.44.307 E022.02.42.716 Color_251ACI
N050.06.44.700 E022.02.40.068 N050.06.44.530 E022.02.41.291 Color_251ACI
N050.06.44.935 E022.02.38.887 N050.06.44.700 E022.02.40.068 Color_251ACI
N050.06.45.196 E022.02.37.685 N050.06.44.935 E022.02.38.887 Color_251ACI
N050.06.45.549 E022.02.36.361 N050.06.45.196 E022.02.37.685 Color_251ACI
N050.06.54.109 E022.02.06.695 N050.06.45.549 E022.02.36.361 Color_251ACI
N050.06.54.193 E022.02.06.464 N050.06.54.109 E022.02.06.695 Color_251ACI
N050.06.54.290 E022.02.06.339 N050.06.54.193 E022.02.06.464 Color_251ACI
N050.06.54.399 E022.02.06.279 N050.06.54.290 E022.02.06.339 Color_251ACI
N050.06.54.525 E022.02.06.268 N050.06.54.399 E022.02.06.279 Color_251ACI
N050.06.54.615 E022.02.06.309 N050.06.54.525 E022.02.06.268 Color_251ACI
N050.06.54.947 E022.02.06.544 N050.06.54.615 E022.02.06.309 Color_251ACI
N050.06.44.412 E022.03.16.766 N050.06.33.085 E022.03.17.745 Color_251ACI
N050.06.46.595 E022.03.16.795 N050.06.44.412 E022.03.16.766 Color_251ACI
N050.06.47.437 E022.03.16.826 N050.06.46.595 E022.03.16.795 Color_251ACI
N050.06.47.691 E022.03.16.857 N050.06.47.437 E022.03.16.826 Color_251ACI
N050.06.47.906 E022.03.16.948 N050.06.47.691 E022.03.16.857 Color_251ACI
N050.06.48.334 E022.03.17.183 N050.06.47.906 E022.03.16.948 Color_251ACI
N050.06.44.473 E022.03.09.835 N050.06.44.501 E022.03.11.316 Color_251ACI
N050.06.43.397 E022.03.09.861 N050.06.44.473 E022.03.09.835 Color_251ACI
N050.06.43.191 E022.03.09.930 N050.06.43.397 E022.03.09.861 Color_251ACI
N050.06.43.046 E022.03.10.107 N050.06.43.191 E022.03.09.930 Color_251ACI
N050.06.43.008 E022.03.10.478 N050.06.43.046 E022.03.10.107 Color_251ACI
N050.06.42.987 E022.03.11.006 N050.06.43.008 E022.03.10.478 Color_251ACI
N050.06.43.035 E022.03.12.622 N050.06.42.987 E022.03.11.006 Color_251ACI
N050.06.43.154 E022.03.13.107 N050.06.43.035 E022.03.12.622 Color_251ACI
N050.06.43.324 E022.03.13.339 N050.06.43.154 E022.03.13.107 Color_251ACI
N050.06.43.567 E022.03.13.594 N050.06.43.324 E022.03.13.339 Color_251ACI
N050.06.43.807 E022.03.13.664 N050.06.43.567 E022.03.13.594 Color_251ACI
N050.06.44.364 E022.03.13.633 N050.06.43.807 E022.03.13.664 Color_251ACI
N050.06.44.365 E022.03.12.956 N050.06.44.364 E022.03.13.633 Color_251ACI
N050.06.45.163 E022.03.12.952 N050.06.44.365 E022.03.12.956 Color_251ACI
N050.06.45.179 E022.03.14.697 N050.06.45.163 E022.03.12.952 Color_251ACI
N050.06.44.394 E022.03.14.725 N050.06.45.179 E022.03.14.697 Color_251ACI
N050.06.44.372 E022.03.14.037 N050.06.44.394 E022.03.14.725 Color_251ACI
N050.06.43.448 E022.03.14.037 N050.06.44.372 E022.03.14.037 Color_251ACI
N050.06.43.295 E022.03.14.122 N050.06.43.448 E022.03.14.037 Color_251ACI
N050.06.43.203 E022.03.14.313 N050.06.43.295 E022.03.14.122 Color_251ACI
N050.06.43.183 E022.03.14.535 N050.06.43.203 E022.03.14.313 Color_251ACI
N050.06.43.208 E022.03.15.782 N050.06.43.183 E022.03.14.535 Color_251ACI
N050.06.43.262 E022.03.16.035 N050.06.43.208 E022.03.15.782 Color_251ACI
N050.06.43.355 E022.03.16.115 N050.06.43.262 E022.03.16.035 Color_251ACI
N050.06.43.513 E022.03.16.123 N050.06.43.355 E022.03.16.115 Color_251ACI
N050.06.44.232 E022.03.16.023 N050.06.43.513 E022.03.16.123 Color_251ACI
N050.06.46.250 E022.03.16.031 N050.06.44.232 E022.03.16.023 Color_251ACI
N050.06.46.553 E022.03.15.963 N050.06.46.250 E022.03.16.031 Color_251ACI
N050.06.46.723 E022.03.15.780 N050.06.46.553 E022.03.15.963 Color_251ACI
N050.06.46.778 E022.03.15.460 N050.06.46.723 E022.03.15.780 Color_251ACI
N050.06.46.785 E022.03.15.079 N050.06.46.778 E022.03.15.460 Color_251ACI
N050.06.46.725 E022.03.14.327 N050.06.46.785 E022.03.15.079 Color_251ACI
N050.06.46.601 E022.03.13.302 N050.06.46.725 E022.03.14.327 Color_251ACI
N050.06.46.456 E022.03.12.180 N050.06.46.601 E022.03.13.302 Color_251ACI
N050.06.45.906 E022.03.09.157 N050.06.46.456 E022.03.12.180 Color_251ACI
N050.06.45.645 E022.03.07.588 N050.06.45.906 E022.03.09.157 Color_251ACI
N050.06.45.423 E022.03.05.979 N050.06.45.645 E022.03.07.588 Color_251ACI
N050.06.44.037 E022.02.51.170 N050.06.45.423 E022.03.05.979 Color_251ACI
N050.06.43.919 E022.02.49.255 N050.06.44.037 E022.02.51.170 Color_251ACI
N050.06.43.854 E022.02.47.707 N050.06.43.919 E022.02.49.255 Color_251ACI
N050.06.43.815 E022.02.46.566 N050.06.43.854 E022.02.47.707 Color_251ACI
N050.06.43.854 E022.02.45.119 N050.06.43.815 E022.02.46.566 Color_251ACI
N050.06.43.893 E022.02.43.898 N050.06.43.854 E022.02.45.119 Color_251ACI
N050.06.43.998 E022.02.42.716 N050.06.43.893 E022.02.43.898 Color_251ACI
N050.06.44.220 E022.02.41.291 N050.06.43.998 E022.02.42.716 Color_251ACI
N050.06.44.390 E022.02.40.068 N050.06.44.220 E022.02.41.291 Color_251ACI
N050.06.44.625 E022.02.38.887 N050.06.44.390 E022.02.40.068 Color_251ACI
N050.06.44.887 E022.02.37.685 N050.06.44.625 E022.02.38.887 Color_251ACI
N050.06.45.240 E022.02.36.361 N050.06.44.887 E022.02.37.685 Color_251ACI
N050.06.51.967 E022.02.13.046 N050.06.45.240 E022.02.36.361 Color_251ACI
N050.06.05.924 E022.03.13.745 N050.06.05.807 E022.03.13.776 Color_251ACI
N050.06.06.022 E022.03.14.556 N050.06.05.924 E022.03.13.745 Color_251ACI
N050.06.05.794 E022.03.14.657 N050.06.06.022 E022.03.14.556 Color_251ACI
N050.06.05.820 E022.03.14.810 N050.06.05.794 E022.03.14.657 Color_251ACI
N050.06.06.816 E022.03.14.556 N050.06.05.820 E022.03.14.810 Color_251ACI
N050.06.06.939 E022.03.15.539 N050.06.06.816 E022.03.14.556 Color_251ACI
N050.06.07.238 E022.03.15.468 N050.06.06.939 E022.03.15.539 Color_251ACI
N050.06.07.440 E022.03.16.898 N050.06.07.238 E022.03.15.468 Color_251ACI
N050.06.07.694 E022.03.17.191 N050.06.07.440 E022.03.16.898 Color_251ACI
N050.06.09.703 E022.03.16.714 N050.06.07.694 E022.03.17.191 Color_251ACI
N050.06.14.932 E022.03.15.023 N050.06.09.703 E022.03.16.714 Color_251ACI
N050.06.14.892 E022.03.14.698 N050.06.14.932 E022.03.15.023 Color_251ACI
N050.06.09.663 E022.03.16.429 N050.06.14.892 E022.03.14.698 Color_251ACI
N050.06.07.772 E022.03.16.867 N050.06.09.663 E022.03.16.429 Color_251ACI
N050.06.07.603 E022.03.16.674 N050.06.07.772 E022.03.16.867 Color_251ACI
N050.06.07.329 E022.03.14.495 N050.06.07.603 E022.03.16.674 Color_251ACI
N050.06.07.961 E022.03.14.312 N050.06.07.329 E022.03.14.495 Color_251ACI
N050.06.08.657 E022.03.14.880 N050.06.07.961 E022.03.14.312 Color_251ACI
N050.06.09.334 E022.03.14.698 N050.06.08.657 E022.03.14.880 Color_251ACI
N050.06.10.082 E022.03.13.501 N050.06.09.334 E022.03.14.698 Color_251ACI
N050.06.09.874 E022.03.13.177 N050.06.10.082 E022.03.13.501 Color_251ACI
N050.06.09.795 E022.03.12.751 N050.06.09.874 E022.03.13.177 Color_251ACI
N050.06.09.861 E022.03.12.569 N050.06.09.795 E022.03.12.751 Color_251ACI
N050.06.09.978 E022.03.12.447 N050.06.09.861 E022.03.12.569 Color_251ACI
N050.06.11.422 E022.03.12.072 N050.06.09.978 E022.03.12.447 Color_251ACI
N050.06.11.981 E022.03.11.940 N050.06.11.422 E022.03.12.072 Color_251ACI
N050.06.12.352 E022.03.11.890 N050.06.11.981 E022.03.11.940 Color_251ACI
N050.06.12.931 E022.03.11.839 N050.06.12.352 E022.03.11.890 Color_251ACI
N050.06.14.714 E022.03.11.768 N050.06.12.931 E022.03.11.839 Color_251ACI
N050.06.07.636 E022.03.12.326 N050.06.07.245 E022.03.08.859 Color_251ACI
N050.06.07.694 E022.03.12.569 N050.06.07.636 E022.03.12.326 Color_251ACI
N050.06.07.805 E022.03.12.661 N050.06.07.694 E022.03.12.569 Color_251ACI
N050.06.07.935 E022.03.12.630 N050.06.07.805 E022.03.12.661 Color_251ACI
N050.06.11.760 E022.03.11.605 N050.06.07.935 E022.03.12.630 Color_251ACI
N050.06.12.287 E022.03.11.515 N050.06.11.760 E022.03.11.605 Color_251ACI
N050.06.12.684 E022.03.11.464 N050.06.12.287 E022.03.11.515 Color_251ACI
N050.06.13.035 E022.03.11.454 N050.06.12.684 E022.03.11.464 Color_251ACI
N050.06.14.146 E022.03.11.425 N050.06.13.035 E022.03.11.454 Color_251ACI
N050.06.14.268 E022.03.11.380 N050.06.14.146 E022.03.11.425 Color_251ACI
N050.06.14.390 E022.03.11.260 N050.06.14.268 E022.03.11.380 Color_251ACI
N050.06.14.493 E022.03.11.119 N050.06.14.390 E022.03.11.260 Color_251ACI
N050.06.14.584 E022.03.10.933 N050.06.14.493 E022.03.11.119 Color_251ACI
N050.06.14.716 E022.03.10.582 N050.06.14.584 E022.03.10.933 Color_251ACI
N050.06.07.851 E022.03.13.026 N050.06.09.021 E022.03.12.741 Color_251ACI
N050.06.07.733 E022.03.13.238 N050.06.07.851 E022.03.13.026 Color_251ACI
N050.06.07.753 E022.03.13.450 N050.06.07.733 E022.03.13.238 Color_251ACI
N050.06.07.876 E022.03.13.501 N050.06.07.753 E022.03.13.450 Color_251ACI
N050.06.09.307 E022.03.13.157 N050.06.07.876 E022.03.13.501 Color_251ACI
N050.06.09.340 E022.03.12.914 N050.06.09.307 E022.03.13.157 Color_251ACI
N050.06.09.021 E022.03.12.741 N050.06.09.340 E022.03.12.914 Color_251ACI
N050.06.05.666 E022.03.10.781 N050.06.05.495 E022.03.10.837 Color_251ACI
N050.06.05.577 E022.03.09.992 N050.06.05.666 E022.03.10.781 Color_251ACI
N050.06.05.391 E022.03.10.039 N050.06.05.577 E022.03.09.992 Color_251ACI
N050.06.05.325 E022.03.09.388 N050.06.05.391 E022.03.10.039 Color_251ACI
N050.06.42.434 E022.03.11.078 N050.06.42.421 E022.03.10.075 Color_251ACI
N050.06.41.413 E022.03.11.109 N050.06.42.434 E022.03.11.078 Color_251ACI
N050.06.41.381 E022.03.10.106 N050.06.41.413 E022.03.11.109 Color_251ACI
N050.06.40.411 E022.03.10.136 N050.06.41.381 E022.03.10.106 Color_251ACI
N050.06.40.391 E022.03.11.758 N050.06.40.411 E022.03.10.136 Color_251ACI
N050.06.39.481 E022.03.11.768 N050.06.40.391 E022.03.11.758 Color_251ACI
N050.06.39.416 E022.03.10.187 N050.06.39.481 E022.03.11.768 Color_251ACI
N050.06.33.638 E022.03.10.379 N050.06.39.416 E022.03.10.187 Color_251ACI
N050.06.33.411 E022.03.10.420 N050.06.33.638 E022.03.10.379 Color_251ACI
N050.06.33.255 E022.03.10.521 N050.06.33.411 E022.03.10.420 Color_251ACI
N050.06.33.190 E022.03.10.744 N050.06.33.255 E022.03.10.521 Color_251ACI
N050.06.33.131 E022.03.16.461 N050.06.33.190 E022.03.10.744 Color_251ACI
N050.06.33.131 E022.03.16.624 N050.06.33.131 E022.03.16.461 Color_251ACI
N050.06.33.183 E022.03.16.806 N050.06.33.131 E022.03.16.624 Color_251ACI
N050.06.33.281 E022.03.16.938 N050.06.33.183 E022.03.16.806 Color_251ACI
N050.06.33.443 E022.03.16.989 N050.06.33.281 E022.03.16.938 Color_251ACI
N050.06.33.704 E022.03.16.989 N050.06.33.443 E022.03.16.989 Color_251ACI
N050.06.42.675 E022.03.16.259 N050.06.33.704 E022.03.16.989 Color_251ACI
N050.06.42.805 E022.03.16.208 N050.06.42.675 E022.03.16.259 Color_251ACI
N050.06.42.916 E022.03.15.985 N050.06.42.805 E022.03.16.208 Color_251ACI
N050.06.42.948 E022.03.15.762 N050.06.42.916 E022.03.15.985 Color_251ACI
N050.06.42.948 E022.03.14.637 N050.06.42.948 E022.03.15.762 Color_251ACI
N050.06.42.799 E022.03.13.137 N050.06.42.948 E022.03.14.637 Color_251ACI
N050.06.42.740 E022.03.10.481 N050.06.42.799 E022.03.13.137 Color_251ACI
N050.06.42.721 E022.03.10.248 N050.06.42.740 E022.03.10.481 Color_251ACI
N050.06.42.643 E022.03.10.075 N050.06.42.721 E022.03.10.248 Color_251ACI
N050.06.42.526 E022.03.10.025 N050.06.42.643 E022.03.10.075 Color_251ACI
N050.06.42.421 E022.03.10.075 N050.06.42.526 E022.03.10.025 Color_251ACI
N050.06.55.752 E022.01.57.749 N050.06.55.517 E022.01.57.728 Color_251ACI
N050.06.55.914 E022.01.57.779 N050.06.55.752 E022.01.57.749 Color_251ACI
N050.06.56.077 E022.01.57.942 N050.06.55.914 E022.01.57.779 Color_251ACI
N050.06.56.148 E022.01.58.185 N050.06.56.077 E022.01.57.942 Color_251ACI
N050.06.56.129 E022.01.58.509 N050.06.56.148 E022.01.58.185 Color_251ACI
N050.06.56.047 E022.01.58.838 N050.06.56.129 E022.01.58.509 Color_251ACI
N050.06.51.964 E022.02.13.051 N050.06.56.047 E022.01.58.838 Color_251ACI
N050.06.57.183 E022.01.53.391 N050.06.55.420 E022.01.53.360 Color_251ACI
N050.06.57.339 E022.01.53.421 N050.06.57.183 E022.01.53.391 Color_251ACI
N050.06.57.450 E022.01.53.492 N050.06.57.339 E022.01.53.421 Color_251ACI
N050.06.57.515 E022.01.53.633 N050.06.57.450 E022.01.53.492 Color_251ACI
N050.06.57.489 E022.01.53.846 N050.06.57.515 E022.01.53.633 Color_251ACI
N050.06.56.701 E022.01.56.614 N050.06.57.489 E022.01.53.846 Color_251ACI
N050.06.56.597 E022.01.56.897 N050.06.56.701 E022.01.56.614 Color_251ACI
N050.06.56.467 E022.01.57.161 N050.06.56.597 E022.01.56.897 Color_251ACI
N050.06.56.344 E022.01.57.303 N050.06.56.467 E022.01.57.161 Color_251ACI
N050.06.56.148 E022.01.57.354 N050.06.56.344 E022.01.57.303 Color_251ACI
N050.06.55.517 E022.01.57.354 N050.06.56.148 E022.01.57.354 Color_251ACI
N050.06.57.619 E022.01.52.437 N050.06.57.872 E022.01.47.480 Color_251ACI
N050.06.57.632 E022.01.52.630 N050.06.57.619 E022.01.52.437 Color_251ACI
N050.06.57.664 E022.01.52.731 N050.06.57.632 E022.01.52.630 Color_251ACI
N050.06.57.729 E022.01.52.751 N050.06.57.664 E022.01.52.731 Color_251ACI
N050.06.57.788 E022.01.52.711 N050.06.57.729 E022.01.52.751 Color_251ACI
N050.06.57.872 E022.01.52.559 N050.06.57.788 E022.01.52.711 Color_251ACI
N050.06.59.089 E022.01.48.230 N050.06.57.872 E022.01.52.559 Color_251ACI
N050.06.59.115 E022.01.48.119 N050.06.59.089 E022.01.48.230 Color_251ACI
N050.06.59.115 E022.01.47.987 N050.06.59.115 E022.01.48.119 Color_251ACI
N050.06.59.089 E022.01.47.835 N050.06.59.115 E022.01.47.987 Color_251ACI
N050.06.59.024 E022.01.47.694 N050.06.59.089 E022.01.47.835 Color_251ACI
N050.06.58.933 E022.01.47.561 N050.06.59.024 E022.01.47.694 Color_251ACI
N050.06.58.321 E022.01.47.095 N050.06.58.933 E022.01.47.561 Color_251ACI
N050.06.58.172 E022.01.47.064 N050.06.58.321 E022.01.47.095 Color_251ACI
N050.06.58.055 E022.01.47.085 N050.06.58.172 E022.01.47.064 Color_251ACI
N050.06.57.957 E022.01.47.156 N050.06.58.055 E022.01.47.085 Color_251ACI
N050.06.57.905 E022.01.47.278 N050.06.57.957 E022.01.47.156 Color_251ACI
N050.06.57.872 E022.01.47.480 N050.06.57.905 E022.01.47.278 Color_251ACI
N050.06.50.949 E022.02.13.121 N050.06.50.946 E022.02.13.302 Color_251ACI
N050.06.50.920 E022.02.12.960 N050.06.50.949 E022.02.13.121 Color_251ACI
N050.06.50.871 E022.02.12.840 N050.06.50.920 E022.02.12.960 Color_251ACI
N050.06.50.804 E022.02.12.735 N050.06.50.871 E022.02.12.840 Color_251ACI
N050.06.50.714 E022.02.12.650 N050.06.50.804 E022.02.12.735 Color_251ACI
N050.06.50.604 E022.02.12.619 N050.06.50.714 E022.02.12.650 Color_251ACI
N050.06.50.507 E022.02.12.634 N050.06.50.604 E022.02.12.619 Color_251ACI
N050.06.50.424 E022.02.12.675 N050.06.50.507 E022.02.12.634 Color_251ACI
N050.06.50.343 E022.02.12.764 N050.06.50.424 E022.02.12.675 Color_251ACI
N050.06.50.282 E022.02.12.855 N050.06.50.343 E022.02.12.764 Color_251ACI
N050.06.50.240 E022.02.12.995 N050.06.50.282 E022.02.12.855 Color_251ACI
N050.06.50.214 E022.02.13.141 N050.06.50.240 E022.02.12.995 Color_251ACI
N050.06.50.224 E022.02.13.307 N050.06.50.214 E022.02.13.141 Color_251ACI
N050.06.50.256 E022.02.13.453 N050.06.50.224 E022.02.13.307 Color_251ACI
N050.06.50.327 E022.02.13.598 N050.06.50.256 E022.02.13.453 Color_251ACI
N050.06.50.414 E022.02.13.698 N050.06.50.327 E022.02.13.598 Color_251ACI
N050.06.50.530 E022.02.13.754 N050.06.50.414 E022.02.13.698 Color_251ACI
N050.06.50.652 E022.02.13.759 N050.06.50.530 E022.02.13.754 Color_251ACI
N050.06.50.768 E022.02.13.679 N050.06.50.652 E022.02.13.759 Color_251ACI
N050.06.50.849 E022.02.13.573 N050.06.50.768 E022.02.13.679 Color_251ACI
N050.06.50.913 E022.02.13.433 N050.06.50.849 E022.02.13.573 Color_251ACI
N050.06.50.946 E022.02.13.302 N050.06.50.913 E022.02.13.433 Color_251ACI
N050.06.50.559 E022.02.12.990 N050.06.50.714 E022.02.13.177 Color_251ACI
N050.06.50.436 E022.02.13.241 N050.06.50.559 E022.02.12.990 Color_251ACI
N050.06.50.591 E022.02.13.422 N050.06.50.436 E022.02.13.241 Color_251ACI
N050.06.50.714 E022.02.13.177 N050.06.50.591 E022.02.13.422 Color_251ACI
N050.06.57.469 E022.01.49.579 N050.06.57.339 E022.01.52.366 Color_251ACI
N050.06.57.430 E022.01.49.386 N050.06.57.469 E022.01.49.579 Color_251ACI
N050.06.57.365 E022.01.49.264 N050.06.57.430 E022.01.49.386 Color_251ACI
N050.06.57.254 E022.01.49.204 N050.06.57.365 E022.01.49.264 Color_251ACI
N050.06.57.111 E022.01.49.224 N050.06.57.254 E022.01.49.204 Color_251ACI
N050.06.57.027 E022.01.49.305 N050.06.57.111 E022.01.49.224 Color_251ACI
N050.06.57.001 E022.01.49.487 N050.06.57.027 E022.01.49.305 Color_251ACI
N050.06.56.962 E022.01.52.336 N050.06.57.001 E022.01.49.487 Color_251ACI
N050.06.56.975 E022.01.52.437 N050.06.56.962 E022.01.52.336 Color_251ACI
N050.06.57.033 E022.01.52.600 N050.06.56.975 E022.01.52.437 Color_251ACI
N050.06.57.170 E022.01.52.691 N050.06.57.033 E022.01.52.600 Color_251ACI
N050.06.57.293 E022.01.52.600 N050.06.57.170 E022.01.52.691 Color_251ACI
N050.06.57.339 E022.01.52.366 N050.06.57.293 E022.01.52.600 Color_251ACI
N050.06.57.415 E022.01.36.569 N050.06.57.473 E022.01.36.680 Color_251ACI
N050.06.57.305 E022.01.36.499 N050.06.57.415 E022.01.36.569 Color_251ACI
N050.06.56.194 E022.01.36.509 N050.06.57.305 E022.01.36.499 Color_251ACI
N050.06.56.204 E022.01.37.744 N050.06.56.194 E022.01.36.509 Color_251ACI
N050.06.57.260 E022.01.37.754 N050.06.56.204 E022.01.37.744 Color_251ACI
N050.06.57.270 E022.01.36.845 N050.06.57.260 E022.01.37.754 Color_251ACI
N050.06.57.357 E022.01.36.800 N050.06.57.270 E022.01.36.845 Color_251ACI
N050.06.57.447 E022.01.36.781 N050.06.57.357 E022.01.36.800 Color_251ACI
N050.06.57.473 E022.01.36.680 N050.06.57.447 E022.01.36.781 Color_251ACI
N050.06.56.191 E022.01.39.335 N050.06.56.181 E022.01.39.632 Color_251ACI
N050.06.56.690 E022.01.39.346 N050.06.56.191 E022.01.39.335 Color_251ACI
N050.06.56.793 E022.01.39.385 N050.06.56.690 E022.01.39.346 Color_251ACI
N050.06.56.880 E022.01.39.501 N050.06.56.793 E022.01.39.385 Color_251ACI
N050.06.56.909 E022.01.39.687 N050.06.56.880 E022.01.39.501 Color_251ACI
N050.06.56.880 E022.01.41.414 N050.06.56.909 E022.01.39.687 Color_251ACI
N050.06.56.851 E022.01.41.555 N050.06.56.880 E022.01.41.414 Color_251ACI
N050.06.56.764 E022.01.41.680 N050.06.56.851 E022.01.41.555 Color_251ACI
N050.06.56.642 E022.01.41.760 N050.06.56.764 E022.01.41.680 Color_251ACI
N050.06.56.171 E022.01.41.740 N050.06.56.642 E022.01.41.760 Color_251ACI
N050.06.56.175 E022.01.41.389 N050.06.56.171 E022.01.41.740 Color_251ACI
N050.06.56.281 E022.01.41.368 N050.06.56.175 E022.01.41.389 Color_251ACI
N050.06.56.300 E022.01.39.647 N050.06.56.281 E022.01.41.368 Color_251ACI
N050.06.56.181 E022.01.39.632 N050.06.56.300 E022.01.39.647 Color_251ACI
N050.06.55.212 E022.01.42.139 N050.06.54.880 E022.01.42.098 Color_251ACI
N050.06.55.329 E022.01.42.179 N050.06.55.212 E022.01.42.139 Color_251ACI
N050.06.55.413 E022.01.42.290 N050.06.55.329 E022.01.42.179 Color_251ACI
N050.06.55.472 E022.01.42.473 N050.06.55.413 E022.01.42.290 Color_251ACI
N050.06.55.485 E022.01.42.878 N050.06.55.472 E022.01.42.473 Color_251ACI
N050.06.55.147 E022.01.42.878 N050.06.55.485 E022.01.42.878 Color_251ACI
N050.06.55.127 E022.01.43.405 N050.06.55.147 E022.01.42.878 Color_251ACI
N050.06.55.342 E022.01.43.426 N050.06.55.127 E022.01.43.405 Color_251ACI
N050.06.55.322 E022.01.44.592 N050.06.55.342 E022.01.43.426 Color_251ACI
N050.06.55.472 E022.01.44.693 N050.06.55.322 E022.01.44.592 Color_251ACI
N050.06.55.478 E022.01.46.264 N050.06.55.472 E022.01.44.693 Color_251ACI
N050.06.56.916 E022.01.46.345 N050.06.55.478 E022.01.46.264 Color_251ACI
N050.06.57.098 E022.01.46.386 N050.06.56.916 E022.01.46.345 Color_251ACI
N050.06.57.293 E022.01.46.477 N050.06.57.098 E022.01.46.386 Color_251ACI
N050.06.57.430 E022.01.46.598 N050.06.57.293 E022.01.46.477 Color_251ACI
N050.06.57.560 E022.01.46.832 N050.06.57.430 E022.01.46.598 Color_251ACI
N050.06.57.593 E022.01.47.055 N050.06.57.560 E022.01.46.832 Color_251ACI
N050.06.57.606 E022.01.48.109 N050.06.57.593 E022.01.47.055 Color_251ACI
N050.06.57.586 E022.01.48.424 N050.06.57.606 E022.01.48.109 Color_251ACI
N050.06.57.521 E022.01.48.647 N050.06.57.586 E022.01.48.424 Color_251ACI
N050.06.57.371 E022.01.48.809 N050.06.57.521 E022.01.48.647 Color_251ACI
N050.06.57.196 E022.01.48.839 N050.06.57.371 E022.01.48.809 Color_251ACI
N050.06.55.316 E022.01.48.697 N050.06.57.196 E022.01.48.839 Color_251ACI
N050.06.56.223 E022.01.42.237 N050.06.57.566 E022.01.42.267 Color_251ACI
N050.06.56.110 E022.01.42.257 N050.06.56.223 E022.01.42.237 Color_251ACI
N050.06.55.978 E022.01.42.322 N050.06.56.110 E022.01.42.257 Color_251ACI
N050.06.55.891 E022.01.42.438 N050.06.55.978 E022.01.42.322 Color_251ACI
N050.06.55.852 E022.01.42.573 N050.06.55.891 E022.01.42.438 Color_251ACI
N050.06.55.843 E022.01.43.226 N050.06.55.852 E022.01.42.573 Color_251ACI
N050.06.55.933 E022.01.43.321 N050.06.55.843 E022.01.43.226 Color_251ACI
N050.06.55.927 E022.01.45.119 N050.06.55.933 E022.01.43.321 Color_251ACI
N050.06.55.707 E022.01.44.918 N050.06.55.927 E022.01.45.119 Color_251ACI
N050.06.55.746 E022.01.45.485 N050.06.55.707 E022.01.44.918 Color_251ACI
N050.06.55.772 E022.01.45.656 N050.06.55.746 E022.01.45.485 Color_251ACI
N050.06.55.823 E022.01.45.776 N050.06.55.772 E022.01.45.656 Color_251ACI
N050.06.55.907 E022.01.45.842 N050.06.55.823 E022.01.45.776 Color_251ACI
N050.06.56.129 E022.01.45.877 N050.06.55.907 E022.01.45.842 Color_251ACI
N050.06.56.223 E022.01.45.801 N050.06.56.129 E022.01.45.877 Color_251ACI
N050.06.56.294 E022.01.45.676 N050.06.56.223 E022.01.45.801 Color_251ACI
N050.06.57.032 E022.01.45.711 N050.06.56.294 E022.01.45.676 Color_251ACI
N050.06.57.325 E022.01.45.957 N050.06.57.032 E022.01.45.711 Color_251ACI
N050.06.57.447 E022.01.45.957 N050.06.57.325 E022.01.45.957 Color_251ACI
N050.06.57.534 E022.01.45.892 N050.06.57.447 E022.01.45.957 Color_251ACI
N050.06.57.647 E022.01.45.621 N050.06.57.534 E022.01.45.892 Color_251ACI
N050.06.57.760 E022.01.44.627 N050.06.57.647 E022.01.45.621 Color_251ACI
N050.06.57.798 E022.01.42.619 N050.06.57.760 E022.01.44.627 Color_251ACI
N050.06.57.786 E022.01.42.518 N050.06.57.798 E022.01.42.619 Color_251ACI
N050.06.57.740 E022.01.42.397 N050.06.57.786 E022.01.42.518 Color_251ACI
N050.06.57.663 E022.01.42.317 N050.06.57.740 E022.01.42.397 Color_251ACI
N050.06.57.566 E022.01.42.267 N050.06.57.663 E022.01.42.317 Color_251ACI
N050.06.05.095 E022.03.07.675 N050.06.07.090 E022.03.07.128 maroon
N050.06.05.292 E022.03.09.402 N050.06.05.095 E022.03.07.675 maroon
N050.06.07.286 E022.03.08.850 N050.06.05.292 E022.03.09.402 maroon
N050.06.07.090 E022.03.07.128 N050.06.07.286 E022.03.08.850 maroon
N050.06.05.865 E022.03.14.297 N050.06.05.450 E022.03.10.421 maroon
N050.06.05.582 E022.03.14.407 N050.06.05.865 E022.03.14.297 maroon
N050.06.05.517 E022.03.14.065 N050.06.05.582 E022.03.14.407 maroon
N050.06.04.999 E022.03.14.211 N050.06.05.517 E022.03.14.065 maroon
N050.06.05.031 E022.03.14.618 N050.06.04.999 E022.03.14.211 maroon
N050.06.04.612 E022.03.14.743 N050.06.05.031 E022.03.14.618 maroon
N050.06.04.183 E022.03.10.532 N050.06.04.612 E022.03.14.743 maroon
N050.06.04.602 E022.03.10.457 N050.06.04.183 E022.03.10.532 maroon
N050.06.04.650 E022.03.10.993 N050.06.04.602 E022.03.10.457 maroon
N050.06.05.189 E022.03.10.858 N050.06.04.650 E022.03.10.993 maroon
N050.06.05.157 E022.03.10.521 N050.06.05.189 E022.03.10.858 maroon
N050.06.05.450 E022.03.10.421 N050.06.05.157 E022.03.10.521 maroon
N050.06.04.032 E022.03.14.387 N050.06.03.752 E022.03.12.048 maroon
N050.06.03.649 E022.03.14.432 N050.06.04.032 E022.03.14.387 maroon
N050.06.03.372 E022.03.12.198 N050.06.03.649 E022.03.14.432 maroon
N050.06.03.752 E022.03.12.048 N050.06.03.372 E022.03.12.198 maroon
N050.06.13.137 E022.03.21.420 N050.06.14.194 E022.03.21.239 maroon
N050.06.13.176 E022.03.21.958 N050.06.13.137 E022.03.21.420 maroon
N050.06.13.575 E022.03.21.897 N050.06.13.176 E022.03.21.958 maroon
N050.06.13.588 E022.03.22.123 N050.06.13.575 E022.03.21.897 maroon
N050.06.13.066 E022.03.22.198 N050.06.13.588 E022.03.22.123 maroon
N050.06.13.124 E022.03.23.172 N050.06.13.066 E022.03.22.198 maroon
N050.06.14.481 E022.03.22.957 N050.06.13.124 E022.03.23.172 maroon
N050.06.14.410 E022.03.21.992 N050.06.14.481 E022.03.22.957 maroon
N050.06.13.862 E022.03.22.078 N050.06.14.410 E022.03.21.992 maroon
N050.06.13.846 E022.03.21.852 N050.06.13.862 E022.03.22.078 maroon
N050.06.14.232 E022.03.21.787 N050.06.13.846 E022.03.21.852 maroon
N050.06.14.194 E022.03.21.239 N050.06.14.232 E022.03.21.787 maroon
N050.06.09.403 E022.03.15.130 N050.06.09.358 E022.03.14.743 maroon
N050.06.08.714 E022.03.15.316 N050.06.09.403 E022.03.15.130 maroon
N050.06.08.665 E022.03.14.919 N050.06.08.714 E022.03.15.316 maroon
N050.06.09.358 E022.03.14.743 N050.06.08.665 E022.03.14.919 maroon
N050.06.44.471 E022.03.11.323 N050.06.45.850 E022.03.11.231 maroon
N050.06.44.529 E022.03.12.893 N050.06.44.471 E022.03.11.323 maroon
N050.06.45.908 E022.03.12.792 N050.06.44.529 E022.03.12.893 maroon
N050.06.45.850 E022.03.11.231 N050.06.45.908 E022.03.12.792 maroon
N050.06.43.046 E022.03.11.385 N050.06.44.244 E022.03.11.335 maroon
N050.06.43.058 E022.03.12.107 N050.06.43.046 E022.03.11.385 maroon
N050.06.44.260 E022.03.12.052 N050.06.43.058 E022.03.12.107 maroon
N050.06.44.244 E022.03.11.335 N050.06.44.260 E022.03.12.052 maroon
N050.06.42.269 E022.03.11.455 N050.06.42.672 E022.03.11.455 maroon
N050.06.42.272 E022.03.12.896 N050.06.42.269 E022.03.11.455 maroon
N050.06.42.678 E022.03.12.891 N050.06.42.272 E022.03.12.896 maroon
N050.06.42.672 E022.03.11.455 N050.06.42.678 E022.03.12.891 maroon
N050.06.52.666 E022.01.23.859 N050.06.52.979 E022.01.23.843 maroon
N050.06.52.666 E022.01.25.616 N050.06.52.666 E022.01.23.859 maroon
N050.06.52.434 E022.01.25.625 N050.06.52.666 E022.01.25.616 maroon
N050.06.52.399 E022.01.26.524 N050.06.52.434 E022.01.25.625 maroon
N050.06.51.593 E022.01.26.489 N050.06.52.399 E022.01.26.524 maroon
N050.06.51.590 E022.01.26.885 N050.06.51.593 E022.01.26.489 maroon
N050.06.52.357 E022.01.26.935 N050.06.51.590 E022.01.26.885 maroon
N050.06.52.318 E022.01.29.913 N050.06.52.357 E022.01.26.935 maroon
N050.06.51.490 E022.01.29.943 N050.06.52.318 E022.01.29.913 maroon
N050.06.51.500 E022.01.30.355 N050.06.51.490 E022.01.29.943 maroon
N050.06.51.235 E022.01.30.661 N050.06.51.500 E022.01.30.355 maroon
N050.06.51.358 E022.01.30.901 N050.06.51.235 E022.01.30.661 maroon
N050.06.51.786 E022.01.30.394 N050.06.51.358 E022.01.30.901 maroon
N050.06.52.305 E022.01.30.365 N050.06.51.786 E022.01.30.394 maroon
N050.06.52.341 E022.01.31.314 N050.06.52.305 E022.01.30.365 maroon
N050.06.52.505 E022.01.31.303 N050.06.52.341 E022.01.31.314 maroon
N050.06.52.521 E022.01.33.091 N050.06.52.505 E022.01.31.303 maroon
N050.06.52.866 E022.01.33.075 N050.06.52.521 E022.01.33.091 maroon
N050.06.52.869 E022.01.31.328 N050.06.52.866 E022.01.33.075 maroon
N050.06.53.446 E022.01.31.318 N050.06.52.869 E022.01.31.328 maroon
N050.06.53.478 E022.01.30.093 N050.06.53.446 E022.01.31.318 maroon
N050.06.54.448 E022.01.30.079 N050.06.53.478 E022.01.30.093 maroon
N050.06.54.499 E022.01.27.006 N050.06.54.448 E022.01.30.079 maroon
N050.06.53.520 E022.01.26.910 N050.06.54.499 E022.01.27.006 maroon
N050.06.53.536 E022.01.25.686 N050.06.53.520 E022.01.26.910 maroon
N050.06.52.995 E022.01.25.661 N050.06.53.536 E022.01.25.686 maroon
N050.06.52.979 E022.01.23.843 N050.06.52.995 E022.01.25.661 maroon
N050.06.53.285 E022.01.37.986 N050.06.53.268 E022.01.38.100 maroon
N050.06.53.304 E022.01.37.879 N050.06.53.285 E022.01.37.986 maroon
N050.06.53.352 E022.01.37.769 N050.06.53.304 E022.01.37.879 maroon
N050.06.53.407 E022.01.37.684 N050.06.53.352 E022.01.37.769 maroon
N050.06.53.471 E022.01.37.619 N050.06.53.407 E022.01.37.684 maroon
N050.06.53.562 E022.01.37.584 N050.06.53.471 E022.01.37.619 maroon
N050.06.53.655 E022.01.37.573 N050.06.53.562 E022.01.37.584 maroon
N050.06.53.758 E022.01.37.614 N050.06.53.655 E022.01.37.573 maroon
N050.06.53.836 E022.01.37.669 N050.06.53.758 E022.01.37.614 maroon
N050.06.53.897 E022.01.37.779 N050.06.53.836 E022.01.37.669 maroon
N050.06.53.958 E022.01.37.920 N050.06.53.897 E022.01.37.779 maroon
N050.06.53.974 E022.01.38.080 N050.06.53.958 E022.01.37.920 maroon
N050.06.53.961 E022.01.38.262 N050.06.53.974 E022.01.38.080 maroon
N050.06.53.942 E022.01.38.412 N050.06.53.961 E022.01.38.262 maroon
N050.06.53.890 E022.01.38.507 N050.06.53.942 E022.01.38.412 maroon
N050.06.53.826 E022.01.38.593 N050.06.53.890 E022.01.38.507 maroon
N050.06.53.749 E022.01.38.648 N050.06.53.826 E022.01.38.593 maroon
N050.06.53.658 E022.01.38.673 N050.06.53.749 E022.01.38.648 maroon
N050.06.53.571 E022.01.38.663 N050.06.53.658 E022.01.38.673 maroon
N050.06.53.497 E022.01.38.638 N050.06.53.571 E022.01.38.663 maroon
N050.06.53.430 E022.01.38.572 N050.06.53.497 E022.01.38.638 maroon
N050.06.53.355 E022.01.38.488 N050.06.53.430 E022.01.38.572 maroon
N050.06.53.310 E022.01.38.381 N050.06.53.355 E022.01.38.488 maroon
N050.06.53.278 E022.01.38.271 N050.06.53.310 E022.01.38.381 maroon
N050.06.53.268 E022.01.38.100 N050.06.53.278 E022.01.38.271 maroon
N050.06.53.997 E022.01.36.133 N050.06.53.964 E022.01.38.086 maroon
N050.06.53.310 E022.01.36.097 N050.06.53.997 E022.01.36.133 maroon
N050.06.53.268 E022.01.38.055 N050.06.53.310 E022.01.36.097 maroon
N050.06.53.917 E022.01.39.188 N050.06.55.153 E022.01.39.219 maroon
N050.06.53.891 E022.01.41.682 N050.06.53.917 E022.01.39.188 maroon
N050.06.54.489 E022.01.41.713 N050.06.53.891 E022.01.41.682 maroon
N050.06.54.457 E022.01.44.358 N050.06.54.489 E022.01.41.713 maroon
N050.06.54.359 E022.01.44.378 N050.06.54.457 E022.01.44.358 maroon
N050.06.54.314 E022.01.46.781 N050.06.54.359 E022.01.44.378 maroon
N050.06.54.379 E022.01.46.781 N050.06.54.314 E022.01.46.781 maroon
N050.06.54.424 E022.01.46.983 N050.06.54.379 E022.01.46.781 maroon
N050.06.55.199 E022.01.47.004 N050.06.54.424 E022.01.46.983 maroon
N050.06.55.212 E022.01.46.284 N050.06.55.199 E022.01.47.004 maroon
N050.06.54.893 E022.01.46.234 N050.06.55.212 E022.01.46.284 maroon
N050.06.54.912 E022.01.44.389 N050.06.54.893 E022.01.46.234 maroon
N050.06.54.854 E022.01.44.389 N050.06.54.912 E022.01.44.389 maroon
N050.06.54.886 E022.01.41.754 N050.06.54.854 E022.01.44.389 maroon
N050.06.55.029 E022.01.41.733 N050.06.54.886 E022.01.41.754 maroon
N050.06.55.016 E022.01.40.364 N050.06.55.029 E022.01.41.733 maroon
N050.06.55.173 E022.01.40.364 N050.06.55.016 E022.01.40.364 maroon
N050.06.55.153 E022.01.39.219 N050.06.55.173 E022.01.40.364 maroon
N050.06.54.665 E022.01.47.957 N050.06.55.322 E022.01.47.957 maroon
N050.06.54.646 E022.01.48.261 N050.06.54.665 E022.01.47.957 maroon
N050.06.54.288 E022.01.48.271 N050.06.54.646 E022.01.48.261 maroon
N050.06.54.275 E022.01.48.697 N050.06.54.288 E022.01.48.271 maroon
N050.06.55.303 E022.01.48.728 N050.06.54.275 E022.01.48.697 maroon
N050.06.55.322 E022.01.47.957 N050.06.55.303 E022.01.48.728 maroon
N050.06.49.155 E022.01.53.126 N050.06.49.109 E022.01.52.173 maroon
N050.06.55.420 E022.01.53.400 N050.06.49.155 E022.01.53.126 maroon
N050.06.55.485 E022.01.49.436 N050.06.55.420 E022.01.53.400 maroon
N050.06.55.023 E022.01.49.447 N050.06.55.485 E022.01.49.436 maroon
N050.06.55.010 E022.01.49.629 N050.06.55.023 E022.01.49.447 maroon
N050.06.54.138 E022.01.49.620 N050.06.55.010 E022.01.49.629 maroon
N050.06.54.132 E022.01.49.316 N050.06.54.138 E022.01.49.620 maroon
N050.06.52.421 E022.01.49.275 N050.06.54.132 E022.01.49.316 maroon
N050.06.52.434 E022.01.50.045 N050.06.52.421 E022.01.49.275 maroon
N050.06.53.520 E022.01.50.086 N050.06.52.434 E022.01.50.045 maroon
N050.06.53.520 E022.01.50.350 N050.06.53.520 E022.01.50.086 maroon
N050.06.54.971 E022.01.50.400 N050.06.53.520 E022.01.50.350 maroon
N050.06.54.964 E022.01.52.528 N050.06.54.971 E022.01.50.400 maroon
N050.06.52.687 E022.01.52.499 N050.06.54.964 E022.01.52.528 maroon
N050.06.52.687 E022.01.52.661 N050.06.52.687 E022.01.52.499 maroon
N050.06.49.558 E022.01.52.559 N050.06.52.687 E022.01.52.661 maroon
N050.06.49.532 E022.01.52.143 N050.06.49.558 E022.01.52.559 maroon
N050.06.49.109 E022.01.52.173 N050.06.49.532 E022.01.52.143 maroon
N050.06.41.010 E022.00.06.365 N050.06.41.902 E022.00.06.599 olive
N050.06.40.060 E022.00.06.294 N050.06.41.010 E022.00.06.365 olive
N050.06.39.051 E022.00.06.234 N050.06.40.060 E022.00.06.294 olive
N050.06.38.753 E022.00.06.274 N050.06.39.051 E022.00.06.234 olive
N050.06.38.492 E022.00.06.294 N050.06.38.753 E022.00.06.274 olive
N050.06.38.205 E022.00.06.365 N050.06.38.492 E022.00.06.294 olive
N050.06.37.874 E022.00.06.497 N050.06.38.205 E022.00.06.365 olive
N050.06.37.594 E022.00.06.690 N050.06.37.874 E022.00.06.497 olive
N050.06.37.288 E022.00.06.953 N050.06.37.594 E022.00.06.690 olive
N050.06.37.080 E022.00.07.318 N050.06.37.288 E022.00.06.953 olive
N050.06.36.911 E022.00.07.744 N050.06.37.080 E022.00.07.318 olive
N050.06.36.820 E022.00.08.373 N050.06.36.911 E022.00.07.744 olive
N050.06.36.768 E022.00.11.180 N050.06.36.820 E022.00.08.373 olive
N050.06.42.526 E022.00.08.413 N050.06.41.254 E022.01.45.380 olive
N050.06.42.506 E022.00.07.704 N050.06.42.526 E022.00.08.413 olive
N050.06.42.363 E022.00.07.207 N050.06.42.506 E022.00.07.704 olive
N050.06.42.077 E022.00.06.832 N050.06.42.363 E022.00.07.207 olive
N050.06.41.712 E022.00.06.548 N050.06.42.077 E022.00.06.832 olive
N050.06.36.169 E022.00.51.140 N050.06.36.156 E022.00.51.748 olive
N050.06.36.241 E022.00.50.015 N050.06.36.169 E022.00.51.140 olive
N050.06.36.313 E022.00.49.153 N050.06.36.241 E022.00.50.015 olive
N050.06.36.443 E022.00.48.007 N050.06.36.313 E022.00.49.153 olive
N050.06.36.645 E022.00.46.670 N050.06.36.443 E022.00.48.007 olive
N050.06.36.930 E022.00.45.179 N050.06.36.645 E022.00.46.670 olive
N050.06.37.262 E022.00.43.801 N050.06.36.930 E022.00.45.179 olive
N050.06.37.750 E022.00.42.179 N050.06.37.262 E022.00.43.801 olive
N050.06.38.303 E022.00.40.709 N050.06.37.750 E022.00.42.179 olive
N050.06.40.912 E022.00.33.775 N050.06.38.303 E022.00.40.709 olive
N050.06.41.289 E022.00.32.671 N050.06.40.912 E022.00.33.775 olive
N050.06.41.602 E022.00.31.566 N050.06.41.289 E022.00.32.671 olive
N050.06.41.849 E022.00.30.562 N050.06.41.602 E022.00.31.566 olive
N050.06.41.992 E022.00.29.883 N050.06.41.849 E022.00.30.562 olive
N050.06.42.116 E022.00.29.112 N050.06.41.992 E022.00.29.883 olive
N050.06.42.207 E022.00.28.271 N050.06.42.116 E022.00.29.112 olive
N050.06.42.291 E022.00.27.004 N050.06.42.207 E022.00.28.271 olive
N050.06.40.162 E022.00.36.026 N050.06.39.830 E022.00.36.634 olive
N050.06.40.355 E022.00.35.801 N050.06.40.162 E022.00.36.026 olive
N050.06.40.555 E022.00.35.665 N050.06.40.355 E022.00.35.801 olive
N050.06.40.790 E022.00.35.595 N050.06.40.555 E022.00.35.665 olive
N050.06.41.006 E022.00.35.600 N050.06.40.790 E022.00.35.595 olive
N050.06.41.248 E022.00.35.695 N050.06.41.006 E022.00.35.600 olive
N050.06.41.480 E022.00.35.861 N050.06.41.248 E022.00.35.695 olive
N050.06.41.686 E022.00.36.072 N050.06.41.480 E022.00.35.861 olive
N050.06.41.870 E022.00.36.373 N050.06.41.686 E022.00.36.072 olive
N050.06.42.011 E022.00.36.745 N050.06.41.870 E022.00.36.373 olive
N050.06.42.108 E022.00.37.247 N050.06.42.011 E022.00.36.745 olive
N050.06.42.137 E022.00.37.919 N050.06.42.108 E022.00.37.247 olive
N050.06.35.854 E022.01.21.258 N050.06.35.861 E022.01.19.571 olive
N050.06.35.886 E022.01.21.645 N050.06.35.854 E022.01.21.258 olive
N050.06.36.028 E022.01.22.036 N050.06.35.886 E022.01.21.645 olive
N050.06.36.238 E022.01.22.282 N050.06.36.028 E022.01.22.036 olive
N050.06.36.554 E022.01.22.463 N050.06.36.238 E022.01.22.282 olive
N050.06.36.808 E022.01.22.533 N050.06.36.554 E022.01.22.463 olive
N050.06.37.066 E022.01.22.578 N050.06.36.808 E022.01.22.533 olive
N050.06.45.410 E022.01.22.935 N050.06.37.066 E022.01.22.578 olive
N050.06.45.765 E022.01.22.944 N050.06.45.410 E022.01.22.935 olive
N050.06.46.035 E022.01.22.960 N050.06.45.765 E022.01.22.944 olive
N050.06.46.300 E022.01.22.995 N050.06.46.035 E022.01.22.960 olive
N050.06.46.570 E022.01.23.060 N050.06.46.300 E022.01.22.995 olive
N050.06.46.815 E022.01.23.161 N050.06.46.570 E022.01.23.060 olive
N050.06.47.018 E022.01.23.291 N050.06.46.815 E022.01.23.161 olive
N050.06.47.208 E022.01.23.477 N050.06.47.018 E022.01.23.291 olive
N050.06.47.350 E022.01.23.688 N050.06.47.208 E022.01.23.477 olive
N050.06.47.459 E022.01.23.929 N050.06.47.350 E022.01.23.688 olive
N050.06.47.537 E022.01.24.195 N050.06.47.459 E022.01.23.929 olive
N050.06.47.595 E022.01.24.566 N050.06.47.537 E022.01.24.195 olive
N050.06.47.608 E022.01.24.943 N050.06.47.595 E022.01.24.566 olive
N050.06.47.511 E022.01.36.273 N050.06.47.608 E022.01.24.943 olive
N050.06.47.476 E022.01.36.765 N050.06.47.511 E022.01.36.273 olive
N050.06.47.414 E022.01.37.147 N050.06.47.476 E022.01.36.765 olive
N050.06.47.324 E022.01.37.493 N050.06.47.414 E022.01.37.147 olive
N050.06.47.205 E022.01.37.785 N050.06.47.324 E022.01.37.493 olive
N050.06.47.057 E022.01.38.020 N050.06.47.205 E022.01.37.785 olive
N050.06.46.883 E022.01.38.246 N050.06.47.057 E022.01.38.020 olive
N050.06.46.602 E022.01.38.482 N050.06.46.883 E022.01.38.246 olive
N050.06.46.264 E022.01.38.628 N050.06.46.602 E022.01.38.482 olive
N050.06.37.948 E022.01.38.412 N050.06.46.264 E022.01.38.628 olive
N050.06.37.279 E022.01.38.387 N050.06.37.948 E022.01.38.412 olive
N050.06.36.853 E022.01.38.392 N050.06.37.279 E022.01.38.387 olive
N050.06.36.547 E022.01.38.417 N050.06.36.853 E022.01.38.392 olive
N050.06.36.257 E022.01.38.543 N050.06.36.547 E022.01.38.417 olive
N050.06.36.044 E022.01.38.728 N050.06.36.257 E022.01.38.543 olive
N050.06.35.835 E022.01.39.024 N050.06.36.044 E022.01.38.728 olive
N050.06.35.700 E022.01.39.341 N050.06.35.835 E022.01.39.024 olive
N050.06.35.587 E022.01.39.862 N050.06.35.700 E022.01.39.341 olive
N050.06.35.539 E022.01.43.427 N050.06.35.587 E022.01.39.862 olive
N050.06.35.136 E022.02.06.820 N050.06.35.136 E022.02.06.519 olive
N050.06.35.197 E022.02.07.122 N050.06.35.136 E022.02.06.820 olive
N050.06.35.316 E022.02.07.253 N050.06.35.197 E022.02.07.122 olive
N050.06.35.439 E022.02.07.373 N050.06.35.316 E022.02.07.253 olive
N050.06.35.561 E022.02.07.484 N050.06.35.439 E022.02.07.373 olive
N050.06.35.671 E022.02.07.655 N050.06.35.561 E022.02.07.484 olive
N050.06.35.754 E022.02.07.845 N050.06.35.671 E022.02.07.655 olive
N050.06.35.777 E022.02.08.075 N050.06.35.754 E022.02.07.845 olive
N050.06.35.787 E022.02.08.322 N050.06.35.777 E022.02.08.075 olive
N050.06.35.761 E022.02.08.573 N050.06.35.787 E022.02.08.322 olive
N050.06.35.684 E022.02.08.809 N050.06.35.761 E022.02.08.573 olive
N050.06.35.603 E022.02.09.020 N050.06.35.684 E022.02.08.809 olive
N050.06.35.490 E022.02.09.216 N050.06.35.603 E022.02.09.020 olive
N050.06.35.342 E022.02.09.280 N050.06.35.490 E022.02.09.216 olive
N050.06.35.191 E022.02.09.336 N050.06.35.342 E022.02.09.280 olive
N050.06.35.020 E022.02.09.336 N050.06.35.191 E022.02.09.336 olive
N050.06.34.791 E022.02.09.296 N050.06.35.020 E022.02.09.336 olive
N050.06.34.646 E022.02.09.155 N050.06.34.791 E022.02.09.296 olive
N050.06.34.575 E022.02.08.829 N050.06.34.646 E022.02.09.155 olive
N050.06.34.578 E022.02.07.112 N050.06.34.575 E022.02.08.829 olive
N050.06.34.634 E022.02.06.595 N050.06.34.578 E022.02.07.112 olive
N050.06.34.714 E022.02.06.128 N050.06.34.634 E022.02.06.595 olive
N050.06.34.823 E022.02.05.786 N050.06.34.714 E022.02.06.128 olive
N050.06.34.988 E022.02.05.435 N050.06.34.823 E022.02.05.786 olive
N050.06.35.149 E022.02.05.004 N050.06.34.988 E022.02.05.435 olive
N050.06.35.152 E022.02.03.568 N050.06.35.149 E022.02.05.004 olive
N050.06.35.042 E022.02.12.661 N050.06.35.251 E022.02.13.188 olive
N050.06.34.852 E022.02.13.248 N050.06.35.042 E022.02.12.661 olive
N050.06.35.040 E022.02.13.957 N050.06.35.042 E022.02.12.661 olive
N050.06.35.016 E022.02.15.676 N050.06.35.225 E022.02.16.203 olive
N050.06.34.826 E022.02.16.263 N050.06.35.016 E022.02.15.676 olive
N050.06.35.014 E022.02.16.972 N050.06.35.016 E022.02.15.675 olive
N050.06.34.951 E022.02.18.772 N050.06.35.159 E022.02.19.299 olive
N050.06.34.761 E022.02.19.359 N050.06.34.951 E022.02.18.772 olive
N050.06.34.949 E022.02.20.068 N050.06.34.951 E022.02.18.772 olive
N050.06.34.912 E022.02.21.787 N050.06.35.120 E022.02.22.313 olive
N050.06.34.721 E022.02.22.374 N050.06.34.912 E022.02.21.787 olive
N050.06.34.909 E022.02.23.083 N050.06.34.912 E022.02.21.786 olive
N050.06.34.873 E022.02.24.761 N050.06.35.081 E022.02.25.288 olive
N050.06.34.682 E022.02.25.349 N050.06.34.873 E022.02.24.761 olive
N050.06.34.870 E022.02.26.056 N050.06.34.873 E022.02.24.761 olive
N050.06.34.833 E022.02.27.755 N050.06.35.041 E022.02.28.283 olive
N050.06.34.643 E022.02.28.342 N050.06.34.833 E022.02.27.755 olive
N050.06.34.831 E022.02.29.051 N050.06.34.833 E022.02.27.755 olive
N050.06.34.794 E022.02.30.831 N050.06.35.002 E022.02.31.358 olive
N050.06.34.604 E022.02.31.418 N050.06.34.794 E022.02.30.831 olive
N050.06.34.792 E022.02.32.127 N050.06.34.794 E022.02.30.831 olive
N050.06.34.755 E022.02.33.826 N050.06.34.963 E022.02.34.353 olive
N050.06.34.565 E022.02.34.413 N050.06.34.755 E022.02.33.826 olive
N050.06.34.752 E022.02.35.122 N050.06.34.755 E022.02.33.825 olive
N050.06.34.729 E022.02.36.840 N050.06.34.937 E022.02.37.367 olive
N050.06.34.539 E022.02.37.428 N050.06.34.729 E022.02.36.840 olive
N050.06.34.726 E022.02.38.137 N050.06.34.729 E022.02.36.840 olive
N050.06.34.689 E022.02.39.814 N050.06.34.897 E022.02.40.342 olive
N050.06.34.500 E022.02.40.401 N050.06.34.689 E022.02.39.814 olive
N050.06.34.687 E022.02.41.110 N050.06.34.689 E022.02.39.814 olive
N050.06.34.663 E022.02.42.890 N050.06.34.871 E022.02.43.417 olive
N050.06.34.473 E022.02.43.478 N050.06.34.663 E022.02.42.890 olive
N050.06.34.661 E022.02.44.186 N050.06.34.663 E022.02.42.890 olive
N050.06.35.818 E022.02.11.434 N050.06.34.358 E022.02.11.398 olive
N050.06.35.850 E022.01.23.922 N050.06.35.792 E022.01.26.011 olive
N050.06.35.909 E022.01.23.527 N050.06.35.850 E022.01.23.922 olive
N050.06.36.033 E022.01.23.192 N050.06.35.909 E022.01.23.527 olive
N050.06.36.228 E022.01.22.929 N050.06.36.033 E022.01.23.192 olive
N050.06.36.436 E022.01.22.756 N050.06.36.228 E022.01.22.929 olive
N050.06.36.722 E022.01.22.645 N050.06.36.436 E022.01.22.756 olive
N050.06.37.015 E022.01.22.584 N050.06.36.722 E022.01.22.645 olive
N050.06.37.236 E022.01.22.584 N050.06.37.015 E022.01.22.584 olive
N050.06.35.623 E022.01.37.293 N050.06.35.662 E022.01.34.363 olive
N050.06.35.642 E022.01.37.627 N050.06.35.623 E022.01.37.293 olive
N050.06.35.746 E022.01.37.952 N050.06.35.642 E022.01.37.627 olive
N050.06.35.935 E022.01.38.165 N050.06.35.746 E022.01.37.952 olive
N050.06.36.182 E022.01.38.327 N050.06.35.935 E022.01.38.165 olive
N050.06.36.462 E022.01.38.408 N050.06.36.182 E022.01.38.327 olive
N050.06.36.781 E022.01.38.398 N050.06.36.462 E022.01.38.408 olive
N050.06.44.809 E022.00.08.352 N050.06.44.503 E022.00.08.322 olive
N050.06.44.842 E022.00.08.484 N050.06.44.809 E022.00.08.352 olive
N050.06.45.024 E022.00.08.717 N050.06.44.842 E022.00.08.484 olive
N050.06.45.245 E022.00.08.819 N050.06.45.024 E022.00.08.717 olive
N050.06.45.505 E022.00.08.819 N050.06.45.245 E022.00.08.819 olive
N050.06.45.726 E022.00.08.748 N050.06.45.505 E022.00.08.819 olive
N050.06.45.928 E022.00.08.565 N050.06.45.726 E022.00.08.748 olive
N050.06.46.091 E022.00.08.251 N050.06.45.928 E022.00.08.565 olive
N050.06.46.143 E022.00.07.916 N050.06.46.091 E022.00.08.251 olive
N050.06.46.162 E022.00.06.923 N050.06.46.143 E022.00.07.916 olive
N050.06.42.643 E022.00.06.741 N050.06.46.162 E022.00.06.923 olive
N050.06.41.902 E022.00.06.599 N050.06.42.643 E022.00.06.741 olive
N050.06.42.229 E022.01.38.510 N050.06.42.163 E022.01.44.010 olive
N050.06.43.562 E022.01.38.550 N050.06.43.497 E022.01.44.050 olive
N050.06.44.856 E022.01.38.611 N050.06.44.791 E022.01.44.111 olive
N050.06.46.164 E022.01.38.611 N050.06.46.098 E022.01.44.111 olive
N050.06.47.510 E022.01.36.310 N050.06.47.445 E022.01.44.152 olive
N050.06.45.811 E022.01.43.496 N050.06.43.391 E022.01.43.456 olive
N050.06.46.195 E022.01.43.496 N050.06.45.811 E022.01.43.496 olive
N050.06.46.533 E022.01.43.396 N050.06.46.195 E022.01.43.496 olive
N050.06.46.858 E022.01.43.132 N050.06.46.533 E022.01.43.396 olive
N050.06.47.106 E022.01.42.736 N050.06.46.858 E022.01.43.132 olive
N050.06.47.346 E022.01.42.128 N050.06.47.106 E022.01.42.736 olive
N050.06.47.470 E022.01.41.429 N050.06.47.346 E022.01.42.128 olive
N050.06.47.457 E022.01.40.740 N050.06.47.470 E022.01.41.429 olive
N050.06.47.340 E022.01.40.132 N050.06.47.457 E022.01.40.740 olive
N050.06.47.145 E022.01.39.574 N050.06.47.340 E022.01.40.132 olive
N050.06.46.884 E022.01.39.179 N050.06.47.145 E022.01.39.574 olive
N050.06.46.592 E022.01.38.864 N050.06.46.884 E022.01.39.179 olive
N050.06.46.195 E022.01.38.610 N050.06.46.592 E022.01.38.864 olive
N050.06.48.648 E022.01.40.404 N050.06.47.497 E022.01.39.549 olive
N050.06.51.537 E022.01.40.485 N050.06.48.648 E022.01.40.404 olive
N050.06.48.648 E022.01.37.429 N050.06.47.497 E022.01.38.041 olive
N050.06.51.576 E022.01.37.490 N050.06.48.648 E022.01.37.429 olive
N050.06.51.607 E022.01.34.516 N050.06.47.535 E022.01.34.404 olive
N050.06.51.399 E022.01.31.201 N050.06.47.554 E022.01.31.119 olive
N050.06.51.152 E022.01.27.632 N050.06.47.580 E022.01.27.561 olive
N050.06.50.885 E022.01.28.272 N050.06.47.587 E022.01.28.220 olive
N050.06.51.373 E022.01.24.418 N050.06.47.566 E022.01.24.337 olive
N050.06.43.170 E022.00.07.210 N050.06.41.667 E022.00.06.538 olive
N050.06.45.942 E022.00.07.251 N050.06.43.170 E022.00.07.210 olive
N050.06.42.539 E022.00.08.099 N050.06.42.493 E022.00.07.673 olive
N050.06.42.608 E022.00.08.575 N050.06.42.539 E022.00.08.099 olive
N050.06.42.765 E022.00.08.982 N050.06.42.608 E022.00.08.575 olive
N050.06.42.987 E022.00.09.349 N050.06.42.765 E022.00.08.982 olive
N050.06.43.190 E022.00.09.492 N050.06.42.987 E022.00.09.349 olive
N050.06.43.418 E022.00.09.512 N050.06.43.190 E022.00.09.492 olive
N050.06.45.981 E022.00.09.593 N050.06.43.418 E022.00.09.512 olive
N050.06.51.276 E022.01.34.363 N050.06.51.425 E022.01.34.525 maroon
N050.06.50.638 E022.01.34.333 N050.06.51.276 E022.01.34.363 maroon
N050.06.50.098 E022.01.32.874 N050.06.50.638 E022.01.34.333 maroon
N050.06.49.864 E022.01.32.843 N050.06.50.098 E022.01.32.874 maroon
N050.06.50.137 E022.01.34.272 N050.06.49.864 E022.01.32.843 maroon
N050.06.49.675 E022.01.34.272 N050.06.50.137 E022.01.34.272 maroon
N050.06.49.467 E022.01.33.938 N050.06.49.675 E022.01.34.272 maroon
N050.06.49.285 E022.01.33.927 N050.06.49.467 E022.01.33.938 maroon
N050.06.49.382 E022.01.34.444 N050.06.49.285 E022.01.33.927 maroon
N050.06.49.265 E022.01.34.890 N050.06.49.382 E022.01.34.444 maroon
N050.06.49.435 E022.01.34.901 N050.06.49.265 E022.01.34.890 maroon
N050.06.49.675 E022.01.34.607 N050.06.49.435 E022.01.34.901 maroon
N050.06.50.124 E022.01.34.627 N050.06.49.675 E022.01.34.607 maroon
N050.06.49.779 E022.01.36.046 N050.06.50.124 E022.01.34.627 maroon
N050.06.50.014 E022.01.36.046 N050.06.49.779 E022.01.36.046 maroon
N050.06.50.619 E022.01.34.647 N050.06.50.014 E022.01.36.046 maroon
N050.06.51.263 E022.01.34.688 N050.06.50.619 E022.01.34.647 maroon
N050.06.51.425 E022.01.34.525 N050.06.51.263 E022.01.34.688 maroon


;EPRZ

;EPBY
;- PAS
LOTNISKA_EPBY N053.05.43.827 E017.57.32.843 N053.05.55.031 E017.59.45.885 white
N053.05.55.031 E017.59.45.885 N053.05.53.103 E017.59.46.333 white
N053.05.53.103 E017.59.46.333 N053.05.41.897 E017.57.33.283 white
N053.05.41.897 E017.57.33.283 N053.05.43.822 E017.57.32.843 white
;- TAXIWAYS
N053.05.43.827 E017.57.32.841 N053.05.44.435 E017.57.32.685 blue
N053.05.44.435 E017.57.32.685 N053.05.45.885 E017.57.31.486 blue
N053.05.45.885 E017.57.31.486 N053.05.51.863 E017.57.30.135 blue
N053.05.51.863 E017.57.30.135 N053.05.51.919 E017.57.30.838 blue
N053.05.51.919 E017.57.30.838 N053.05.52.480 E017.57.30.719 blue
N053.05.52.480 E017.57.30.719 N053.06.02.677 E017.57.45.518 blue
N053.06.06.215 E017.57.45.106 N053.06.07.079 E017.57.46.286 blue
N053.06.07.079 E017.57.46.286 N053.06.06.738 E017.57.46.971 blue
N053.06.06.738 E017.57.46.971 N053.06.05.836 E017.57.45.813 blue
N053.06.05.836 E017.57.45.813 N053.06.06.208 E017.57.45.114 blue
N053.06.05.333 E017.57.46.970 N053.06.06.133 E017.57.48.075 blue
N053.06.06.133 E017.57.48.075 N053.06.05.684 E017.57.49.011 blue
N053.06.05.684 E017.57.49.011 N053.06.04.914 E017.57.47.846 blue
N053.06.04.914 E017.57.47.846 N053.06.05.336 E017.57.46.977 blue
N053.06.04.367 E017.57.48.994 N053.06.05.149 E017.57.50.118 blue
N053.06.05.149 E017.57.50.118 N053.06.04.879 E017.57.50.685 blue
N053.06.04.879 E017.57.50.685 N053.06.04.060 E017.57.49.572 blue
N053.06.04.060 E017.57.49.572 N053.06.04.343 E017.57.49.012 blue
N053.06.06.714 E017.57.43.968 N053.06.08.276 E017.57.46.045 blue
N053.06.08.276 E017.57.46.045 N053.06.04.961 E017.57.52.727 blue
N053.06.04.961 E017.57.52.727 N053.06.03.562 E017.57.50.755 blue
N053.06.03.562 E017.57.50.755 N053.06.03.342 E017.57.51.135 blue
N053.06.03.342 E017.57.51.135 N053.06.03.088 E017.57.50.114 blue
N053.06.03.088 E017.57.50.114 N053.06.02.785 E017.57.49.652 blue
N053.06.02.785 E017.57.49.652 N053.06.02.892 E017.57.49.345 blue
N053.06.02.892 E017.57.49.345 N053.06.02.598 E017.57.48.246 blue
N053.06.02.598 E017.57.48.246 N053.05.52.040 E017.57.32.912 blue
N053.05.52.040 E017.57.32.912 N053.05.52.178 E017.57.34.281 blue
N053.05.52.178 E017.57.34.281 N053.05.44.074 E017.57.36.027 blue
;- TAXI2
N053.05.41.895 E017.57.33.243 N053.05.39.029 E017.57.33.918 blue
N053.05.39.029 E017.57.33.918 N053.05.33.386 E017.57.34.959 blue
N053.05.33.386 E017.57.34.959 N053.05.36.089 E017.58.05.449 blue
N053.05.36.089 E017.58.05.449 N053.05.35.906 E017.58.06.004 blue
N053.05.35.906 E017.58.06.004 N053.05.33.038 E017.58.08.469 blue
N053.05.33.146 E017.58.11.514 N053.05.33.181 E017.58.10.703 blue
N053.05.33.181 E017.58.10.703 N053.05.36.316 E017.58.08.062 blue
N053.05.36.316 E017.58.08.062 N053.05.36.588 E017.58.11.583 blue
N053.05.36.588 E017.58.11.583 N053.05.36.388 E017.58.12.007 blue
N053.05.36.388 E017.58.12.007 N053.05.33.177 E017.58.11.514 blue
N053.05.33.177 E017.58.11.514 N053.05.33.177 E017.58.11.514 blue
N053.05.32.120 E017.58.13.000 N053.05.32.129 E017.58.13.463 blue
N053.05.32.129 E017.58.13.463 N053.05.36.062 E017.58.14.059 blue
N053.05.36.062 E017.58.14.059 N053.05.36.937 E017.58.15.399 blue
N053.05.36.937 E017.58.15.399 N053.05.43.858 E017.59.36.740 blue
N053.05.43.858 E017.59.36.740 N053.05.43.477 E017.59.37.333 blue
N053.05.43.777 E017.59.41.787 N053.05.44.330 E017.59.42.643 blue
N053.05.44.330 E017.59.42.643 N053.05.44.486 E017.59.44.526 blue
N053.05.44.486 E017.59.44.526 N053.05.43.888 E017.59.46.191 blue
N053.05.43.888 E017.59.46.191 N053.05.42.694 E017.59.46.541 blue
N053.05.42.694 E017.59.46.541 N053.05.41.888 E017.59.46.160 blue
N053.05.41.582 E017.59.52.144 N053.05.41.741 E017.59.54.089 blue
N053.05.41.741 E017.59.54.089 N053.05.41.404 E017.59.55.472 blue
N053.05.41.404 E017.59.55.472 N053.05.39.405 E017.59.56.520 blue
N053.05.39.405 E017.59.56.520 N053.05.39.668 E017.59.55.006 blue
N053.05.39.201 E017.59.54.804 N053.05.38.872 E017.59.56.785 blue
N053.05.38.872 E017.59.56.785 N053.05.36.839 E017.59.57.186 blue
N053.05.36.839 E017.59.57.186 N053.05.36.905 E017.59.57.991 blue
N053.05.36.905 E017.59.57.991 N053.05.37.601 E017.59.57.858 blue
N053.05.38.526 E017.59.57.683 N053.05.38.933 E017.59.57.620 blue
N053.05.38.933 E017.59.57.620 N053.05.39.778 E017.59.59.993 blue
N053.05.39.778 E017.59.59.993 N053.05.42.296 E017.59.59.690 blue
N053.05.42.296 E017.59.59.690 N053.05.42.390 E018.00.00.593 blue
N053.05.42.564 E018.00.02.098 N053.05.42.652 E018.00.03.224 blue
N053.05.42.652 E018.00.03.224 N053.05.43.123 E018.00.03.146 blue
N053.05.43.123 E018.00.03.146 N053.05.42.873 E018.00.00.305 blue
N053.05.42.873 E018.00.00.305 N053.05.43.120 E017.59.58.450 blue
N053.05.43.120 E017.59.58.450 N053.05.43.184 E017.59.58.253 blue
N053.05.43.184 E017.59.58.253 N053.05.42.852 E017.59.54.518 blue
N053.05.42.852 E017.59.54.518 N053.05.42.273 E017.59.53.926 blue
N053.05.42.273 E017.59.53.926 N053.05.42.077 E017.59.51.797 blue
N053.05.41.698 E017.59.56.170 N053.05.39.403 E017.59.57.388 blue
N053.05.39.403 E017.59.57.388 N053.05.40.037 E017.59.59.159 blue
N053.05.40.037 E017.59.59.159 N053.05.42.380 E017.59.58.820 blue
N053.05.42.380 E017.59.58.820 N053.05.42.620 E017.59.58.153 blue
N053.05.42.620 E017.59.58.153 N053.05.41.701 E017.59.56.197 blue
N053.05.42.193 E017.59.49.025 N053.05.42.747 E017.59.47.963 blue
N053.05.42.747 E017.59.47.963 N053.05.44.014 E017.59.47.675 blue
N053.05.44.014 E017.59.47.675 N053.05.44.910 E017.59.48.675 blue
N053.05.44.910 E017.59.48.675 N053.05.45.128 E017.59.50.626 blue
N053.05.45.128 E017.59.50.626 N053.05.50.117 E017.59.49.368 blue
N053.05.50.117 E017.59.49.368 N053.05.52.114 E017.59.46.627 blue
N053.05.52.114 E017.59.46.627 N053.05.53.101 E017.59.46.395 blue
N053.05.52.726 E017.59.41.918 N053.05.51.576 E017.59.44.630 blue
N053.05.51.576 E017.59.44.630 N053.05.45.892 E017.59.45.924 blue
N053.05.45.892 E017.59.45.924 N053.05.42.681 E017.59.08.498 blue
N053.05.42.681 E017.59.08.498 N053.05.43.021 E017.59.07.614 blue
N053.05.43.021 E017.59.07.614 N053.05.48.637 E017.59.06.295 blue
N053.05.48.637 E017.59.06.295 N053.05.49.844 E017.59.07.712 blue
N053.05.49.462 E017.59.02.739 N053.05.48.706 E017.59.04.182 blue
N053.05.48.706 E017.59.04.182 N053.05.42.642 E017.59.05.561 blue
N053.05.42.642 E017.59.05.561 N053.05.42.464 E017.59.05.245 blue
N053.05.42.464 E017.59.05.245 N053.05.38.185 E017.58.14.798 blue
N053.05.38.185 E017.58.14.798 N053.05.38.333 E017.58.14.106 blue
N053.05.38.333 E017.58.14.106 N053.05.44.335 E017.58.12.815 blue
N053.05.44.335 E017.58.12.815 N053.05.45.350 E017.58.13.982 blue
N053.05.44.849 E017.58.08.380 N053.05.43.827 E017.58.10.781 blue
N053.05.43.827 E017.58.10.781 N053.05.38.189 E017.58.12.009 blue
N053.05.38.189 E017.58.12.009 N053.05.37.886 E017.58.11.717 blue
N053.05.37.886 E017.58.11.717 N053.05.37.513 E017.58.07.015 blue
N053.05.37.513 E017.58.07.015 N053.05.37.629 E017.58.06.875 blue
N053.05.37.629 E017.58.06.875 N053.05.37.442 E017.58.06.134 blue
N053.05.37.442 E017.58.06.134 N053.05.34.916 E017.57.37.618 blue
N053.05.34.916 E017.57.37.618 N053.05.35.472 E017.57.36.665 blue
N053.05.35.472 E017.57.36.665 N053.05.42.058 E017.57.35.342 blue
;- APRONY
N053.06.02.682 E017.57.45.527 N053.06.13.680 E017.57.21.501 white
N053.06.13.680 E017.57.21.501 N053.06.15.902 E017.57.24.481 white
N053.06.15.902 E017.57.24.481 N053.06.06.711 E017.57.43.953 white
N053.05.33.071 E017.58.08.469 N053.05.22.619 E017.58.05.567 white
N053.05.22.619 E017.58.05.567 N053.05.22.303 E017.58.10.593 white
N053.05.22.303 E017.58.10.593 N053.05.32.118 E017.58.13.001 white
N053.05.43.470 E017.59.37.335 N053.05.42.040 E017.59.37.705 white
N053.05.42.040 E017.59.37.705 N053.05.42.274 E017.59.39.556 white
N053.05.42.274 E017.59.39.556 N053.05.42.123 E017.59.41.273 white
N053.05.42.123 E017.59.41.273 N053.05.42.956 E017.59.42.489 white
N053.05.42.956 E017.59.42.489 N053.05.43.800 E017.59.41.811 white
N053.05.41.889 E017.59.46.158 N053.05.41.640 E017.59.44.264 white
N053.05.41.640 E017.59.44.264 N053.05.40.970 E017.59.43.848 white
N053.05.40.970 E017.59.43.848 N053.05.39.725 E017.59.44.185 white
N053.05.39.725 E017.59.44.185 N053.05.40.555 E017.59.52.404 white
N053.05.40.555 E017.59.52.404 N053.05.41.568 E017.59.52.159 white
N053.05.42.073 E017.59.51.772 N053.05.42.411 E017.59.51.225 white
N053.05.42.411 E017.59.51.225 N053.05.42.197 E017.59.49.045 white
N053.05.39.667 E017.59.54.976 N053.05.41.268 E017.59.54.652 white
N053.05.41.268 E017.59.54.652 N053.05.41.132 E017.59.53.306 white
N053.05.41.132 E017.59.53.306 N053.05.39.133 E017.59.53.747 white
N053.05.39.133 E017.59.53.747 N053.05.39.226 E017.59.54.764 white
N053.05.37.604 E017.59.57.861 N053.05.37.654 E017.59.59.256 white
N053.05.37.654 E017.59.59.256 N053.05.38.644 E017.59.59.124 white
N053.05.38.644 E017.59.59.124 N053.05.38.550 E017.59.57.699 white
N053.05.42.388 E018.00.00.579 N053.05.41.878 E018.00.00.715 white
N053.05.41.878 E018.00.00.715 N053.05.42.016 E018.00.02.177 white
N053.05.42.016 E018.00.02.177 N053.05.42.564 E018.00.02.107 white
;- PALIWO
N053.05.46.149 E017.59.48.559 N053.05.47.150 E017.59.48.341 yellow
N053.05.47.150 E017.59.48.341 N053.05.47.300 E017.59.50.031 yellow
N053.05.47.300 E017.59.50.031 N053.05.46.276 E017.59.50.213 yellow
N053.05.46.269 E017.59.50.211 N053.05.46.144 E017.59.48.544 yellow
;- BUILD
N053.05.39.385 E017.59.53.113 N053.05.40.631 E017.59.52.868 build
N053.05.40.631 E017.59.52.868 N053.05.40.709 E017.59.53.935 build
N053.05.40.709 E017.59.53.935 N053.05.40.267 E017.59.54.015 build
N053.05.40.267 E017.59.54.015 N053.05.40.303 E017.59.54.534 build
N053.05.40.303 E017.59.54.534 N053.05.39.956 E017.59.54.576 build
N053.05.39.956 E017.59.54.576 N053.05.39.920 E017.59.54.080 build
N053.05.39.920 E017.59.54.080 N053.05.39.431 E017.59.54.187 build
N053.05.39.431 E017.59.54.187 N053.05.39.385 E017.59.53.119 build
N053.05.41.689 E018.00.01.307 N053.05.41.958 E018.00.01.241 build
N053.05.41.958 E018.00.01.241 N053.05.42.031 E018.00.02.280 build
N053.05.42.031 E018.00.02.280 N053.05.41.732 E018.00.02.358 build
N053.05.41.732 E018.00.02.358 N053.05.41.688 E018.00.01.306 build
N053.05.43.122 E017.59.56.637 N053.05.43.390 E017.59.56.606 build
N053.05.43.390 E017.59.56.606 N053.05.43.451 E017.59.57.424 build
N053.05.43.451 E017.59.57.424 N053.05.43.182 E017.59.57.482 build
N053.05.43.182 E017.59.57.482 N053.05.43.121 E017.59.56.636 build
N053.05.42.938 E017.59.54.789 N053.05.43.271 E017.59.54.730 build
N053.05.43.271 E017.59.54.730 N053.05.43.309 E017.59.55.234 build
N053.05.43.309 E017.59.55.234 N053.05.42.976 E017.59.55.277 build
N053.05.42.976 E017.59.55.277 N053.05.42.939 E017.59.54.785 build
N053.06.14.165 E017.58.44.606 N053.06.14.536 E017.58.44.502 build
N053.06.14.536 E017.58.44.502 N053.06.14.470 E017.58.43.923 build
N053.06.14.470 E017.58.43.923 N053.06.14.099 E017.58.44.043 build
N053.06.14.099 E017.58.44.043 N053.06.14.166 E017.58.44.619 build


;EPGD

LOTNISKA_EPGD N054.22.53.384 E018.27.07.256 N054.22.16.891 E018.29.32.324 Color_251ACI
N054.22.51.432 E018.27.06.018 N054.22.53.384 E018.27.07.256 Color_251ACI
N054.22.14.939 E018.29.31.078 N054.22.51.432 E018.27.06.018 Color_251ACI
N054.22.16.891 E018.29.32.324 N054.22.14.939 E018.29.31.078 Color_251ACI
N054.22.53.154 E018.27.07.123 N054.22.16.661 E018.29.32.191 Color_251ACI
N054.22.51.671 E018.27.06.186 N054.22.15.177 E018.29.31.255 Color_251ACI
N054.22.52.808 E018.27.10.924 N054.22.52.345 E018.27.11.380 Color_251ACI
N054.22.53.105 E018.27.10.683 N054.22.52.808 E018.27.10.924 Color_251ACI
N054.22.53.334 E018.27.10.542 N054.22.53.105 E018.27.10.683 Color_251ACI
N054.22.53.634 E018.27.10.397 N054.22.53.334 E018.27.10.542 Color_251ACI
N054.22.53.833 E018.27.10.341 N054.22.53.634 E018.27.10.397 Color_251ACI
N054.22.54.665 E018.27.10.206 N054.22.53.833 E018.27.10.341 Color_251ACI
N054.22.54.632 E018.27.08.359 N054.22.54.665 E018.27.10.206 Color_251ACI
N054.22.53.511 E018.27.08.448 N054.22.54.632 E018.27.08.359 Color_251ACI
N054.22.53.126 E018.27.08.292 N054.22.53.511 E018.27.08.448 Color_251ACI
N054.22.47.878 E018.27.29.924 N054.22.47.705 E018.27.29.800 Color_251ACI
N054.22.51.616 E018.27.25.375 N054.22.47.878 E018.27.29.924 Color_251ACI
N054.22.51.753 E018.27.25.176 N054.22.51.616 E018.27.25.375 Color_251ACI
N054.22.51.857 E018.27.24.983 N054.22.51.753 E018.27.25.176 Color_251ACI
N054.22.51.912 E018.27.24.760 N054.22.51.857 E018.27.24.983 Color_251ACI
N054.22.51.931 E018.27.24.474 N054.22.51.912 E018.27.24.760 Color_251ACI
N054.22.51.905 E018.27.24.238 N054.22.51.931 E018.27.24.474 Color_251ACI
N054.22.51.823 E018.27.23.988 N054.22.51.905 E018.27.24.238 Color_251ACI
N054.22.51.605 E018.27.23.747 N054.22.51.823 E018.27.23.988 Color_251ACI
N054.22.50.478 E018.27.23.009 N054.22.51.605 E018.27.23.747 Color_251ACI
N054.22.50.213 E018.27.22.878 N054.22.50.478 E018.27.23.009 Color_251ACI
N054.22.49.967 E018.27.22.844 N054.22.50.213 E018.27.22.878 Color_251ACI
N054.22.49.713 E018.27.22.896 N054.22.49.967 E018.27.22.844 Color_251ACI
N054.22.49.468 E018.27.23.028 N054.22.49.713 E018.27.22.896 Color_251ACI
N054.22.49.215 E018.27.23.280 N054.22.49.468 E018.27.23.028 Color_251ACI
N054.22.48.998 E018.27.23.587 N054.22.49.215 E018.27.23.280 Color_251ACI
N054.22.41.573 E018.27.54.505 N054.22.41.644 E018.27.53.918 Color_251ACI
N054.22.41.444 E018.27.57.255 N054.22.41.573 E018.27.54.505 Color_251ACI
N054.22.41.435 E018.27.58.194 N054.22.41.444 E018.27.57.255 Color_251ACI
N054.22.41.422 E018.27.59.072 N054.22.41.435 E018.27.58.194 Color_251ACI
N054.22.41.446 E018.27.59.605 N054.22.41.422 E018.27.59.072 Color_251ACI
N054.22.41.624 E018.28.02.175 N054.22.41.446 E018.27.59.605 Color_251ACI
N054.22.42.580 E018.28.01.117 N054.22.41.624 E018.28.02.175 Color_251ACI
N054.22.43.142 E018.28.00.381 N054.22.42.580 E018.28.01.117 Color_251ACI
N054.22.43.968 E018.27.59.271 N054.22.43.142 E018.28.00.381 Color_251ACI
N054.22.45.369 E018.27.57.148 N054.22.43.968 E018.27.59.271 Color_251ACI
N054.22.45.639 E018.27.56.713 N054.22.45.369 E018.27.57.148 Color_251ACI
N054.22.45.847 E018.27.56.328 N054.22.45.639 E018.27.56.713 Color_251ACI
N054.22.46.029 E018.27.55.870 N054.22.45.847 E018.27.56.328 Color_251ACI
N054.22.47.433 E018.27.51.423 N054.22.46.029 E018.27.55.870 Color_251ACI
N054.22.52.042 E018.27.33.140 N054.22.47.433 E018.27.51.423 Color_251ACI
N054.22.52.795 E018.27.29.441 N054.22.52.042 E018.27.33.140 Color_251ACI
N054.22.52.871 E018.27.28.880 N054.22.52.795 E018.27.29.441 Color_251ACI
N054.22.52.908 E018.27.28.518 N054.22.52.871 E018.27.28.880 Color_251ACI
N054.22.52.906 E018.27.28.187 N054.22.52.908 E018.27.28.518 Color_251ACI
N054.22.52.843 E018.27.27.887 N054.22.52.906 E018.27.28.187 Color_251ACI
N054.22.52.724 E018.27.27.591 N054.22.52.843 E018.27.27.887 Color_251ACI
N054.22.52.577 E018.27.27.381 N054.22.52.724 E018.27.27.591 Color_251ACI
N054.22.52.395 E018.27.27.195 N054.22.52.577 E018.27.27.381 Color_251ACI
N054.22.52.189 E018.27.27.094 N054.22.52.395 E018.27.27.195 Color_251ACI
N054.22.51.953 E018.27.27.112 N054.22.52.189 E018.27.27.094 Color_251ACI
N054.22.51.674 E018.27.27.268 N054.22.51.953 E018.27.27.112 Color_251ACI
N054.22.51.422 E018.27.27.468 N054.22.51.674 E018.27.27.268 Color_251ACI
N054.22.49.541 E018.27.29.481 N054.22.51.422 E018.27.27.468 Color_251ACI
N054.22.48.478 E018.27.30.853 N054.22.49.541 E018.27.29.481 Color_251ACI
N054.22.48.261 E018.27.31.160 N054.22.48.478 E018.27.30.853 Color_251ACI
N054.22.48.084 E018.27.31.435 N054.22.48.261 E018.27.31.160 Color_251ACI
N054.22.47.886 E018.27.31.831 N054.22.48.084 E018.27.31.435 Color_251ACI
N054.22.46.956 E018.27.33.778 N054.22.47.886 E018.27.31.831 Color_251ACI
N054.22.46.554 E018.27.34.638 N054.22.46.956 E018.27.33.778 Color_251ACI
N054.22.46.353 E018.27.35.164 N054.22.46.554 E018.27.34.638 Color_251ACI
N054.22.40.867 E018.28.02.967 N054.22.38.681 E018.28.05.700 Color_251ACI
N054.22.40.470 E018.27.58.590 N054.22.40.867 E018.28.02.967 Color_251ACI
N054.22.41.855 E018.28.03.748 N054.22.42.613 E018.28.02.938 Color_251ACI
N054.22.42.035 E018.28.05.031 N054.22.41.855 E018.28.03.748 Color_251ACI
N054.22.42.129 E018.28.05.394 N054.22.42.035 E018.28.05.031 Color_251ACI
N054.22.42.258 E018.28.05.699 N054.22.42.129 E018.28.05.394 Color_251ACI
N054.22.42.368 E018.28.05.889 N054.22.42.258 E018.28.05.699 Color_251ACI
N054.22.42.501 E018.28.06.055 N054.22.42.368 E018.28.05.889 Color_251ACI
N054.22.42.689 E018.28.06.181 N054.22.42.501 E018.28.06.055 Color_251ACI
N054.22.42.881 E018.28.06.211 N054.22.42.689 E018.28.06.181 Color_251ACI
N054.22.43.102 E018.28.06.148 N054.22.42.881 E018.28.06.211 Color_251ACI
N054.22.43.281 E018.28.06.021 N054.22.43.102 E018.28.06.148 Color_251ACI
N054.22.43.433 E018.28.05.874 N054.22.43.281 E018.28.06.021 Color_251ACI
N054.22.43.552 E018.28.05.717 N054.22.43.433 E018.28.05.874 Color_251ACI
N054.22.43.679 E018.28.05.483 N054.22.43.552 E018.28.05.717 Color_251ACI
N054.22.43.773 E018.28.05.253 N054.22.43.679 E018.28.05.483 Color_251ACI
N054.22.43.880 E018.28.04.948 N054.22.43.773 E018.28.05.253 Color_251ACI
N054.22.43.948 E018.28.04.674 N054.22.43.880 E018.28.04.948 Color_251ACI
N054.22.43.978 E018.28.04.380 N054.22.43.948 E018.28.04.674 Color_251ACI
N054.22.43.968 E018.28.03.953 N054.22.43.978 E018.28.04.380 Color_251ACI
N054.22.43.926 E018.28.03.663 N054.22.43.968 E018.28.03.953 Color_251ACI
N054.22.43.851 E018.28.03.397 N054.22.43.926 E018.28.03.663 Color_251ACI
N054.22.43.726 E018.28.03.136 N054.22.43.851 E018.28.03.397 Color_251ACI
N054.22.43.562 E018.28.02.933 N054.22.43.726 E018.28.03.136 Color_251ACI
N054.22.43.357 E018.28.02.815 N054.22.43.562 E018.28.02.933 Color_251ACI
N054.22.43.122 E018.28.02.764 N054.22.43.357 E018.28.02.815 Color_251ACI
N054.22.42.908 E018.28.02.776 N054.22.43.122 E018.28.02.764 Color_251ACI
N054.22.42.613 E018.28.02.938 N054.22.42.908 E018.28.02.776 Color_251ACI
N054.22.33.621 E018.28.26.257 N054.22.33.610 E018.28.25.847 Color_251ACI
N054.22.33.692 E018.28.27.480 N054.22.33.621 E018.28.26.257 Color_251ACI
N054.22.33.744 E018.28.28.398 N054.22.33.692 E018.28.27.480 Color_251ACI
N054.22.34.230 E018.28.33.774 N054.22.33.744 E018.28.28.398 Color_251ACI
N054.22.34.429 E018.28.34.918 N054.22.34.230 E018.28.33.774 Color_251ACI
N054.22.34.580 E018.28.35.433 N054.22.34.429 E018.28.34.918 Color_251ACI
N054.22.34.681 E018.28.35.736 N054.22.34.580 E018.28.35.433 Color_251ACI
N054.22.34.893 E018.28.36.029 N054.22.34.681 E018.28.35.736 Color_251ACI
N054.22.35.132 E018.28.36.132 N054.22.34.893 E018.28.36.029 Color_251ACI
N054.22.35.372 E018.28.36.183 N054.22.35.132 E018.28.36.132 Color_251ACI
N054.22.35.653 E018.28.36.124 N054.22.35.372 E018.28.36.183 Color_251ACI
N054.22.35.872 E018.28.35.930 N054.22.35.653 E018.28.36.124 Color_251ACI
N054.22.36.107 E018.28.35.563 N054.22.35.872 E018.28.35.930 Color_251ACI
N054.22.36.273 E018.28.35.122 N054.22.36.107 E018.28.35.563 Color_251ACI
N054.22.36.944 E018.28.32.818 N054.22.36.273 E018.28.35.122 Color_251ACI
N054.22.40.780 E018.28.17.546 N054.22.36.944 E018.28.32.818 Color_251ACI
N054.22.41.205 E018.28.15.417 N054.22.40.780 E018.28.17.546 Color_251ACI
N054.22.41.349 E018.28.14.557 N054.22.41.205 E018.28.15.417 Color_251ACI
N054.22.41.424 E018.28.13.831 N054.22.41.349 E018.28.14.557 Color_251ACI
N054.22.41.500 E018.28.13.244 N054.22.41.424 E018.28.13.831 Color_251ACI
N054.22.41.538 E018.28.12.446 N054.22.41.500 E018.28.13.244 Color_251ACI
N054.22.41.537 E018.28.11.071 N054.22.41.538 E018.28.12.446 Color_251ACI
N054.22.41.455 E018.28.09.630 N054.22.41.537 E018.28.11.071 Color_251ACI
N054.22.41.342 E018.28.08.117 N054.22.41.455 E018.28.09.630 Color_251ACI
N054.22.41.259 E018.28.07.154 N054.22.41.342 E018.28.08.117 Color_251ACI
N054.22.41.172 E018.28.06.321 N054.22.41.259 E018.28.07.154 Color_251ACI
N054.22.41.078 E018.28.05.505 N054.22.41.172 E018.28.06.321 Color_251ACI
N054.22.40.972 E018.28.04.759 N054.22.41.078 E018.28.05.505 Color_251ACI
N054.22.39.984 E018.28.05.814 N054.22.40.972 E018.28.04.759 Color_251ACI
N054.22.39.569 E018.28.06.360 N054.22.39.984 E018.28.05.814 Color_251ACI
N054.22.39.174 E018.28.06.968 N054.22.39.569 E018.28.06.360 Color_251ACI
N054.22.38.720 E018.28.07.721 N054.22.39.174 E018.28.06.968 Color_251ACI
N054.22.38.136 E018.28.08.821 N054.22.38.720 E018.28.07.721 Color_251ACI
N054.22.37.655 E018.28.09.754 N054.22.38.136 E018.28.08.821 Color_251ACI
N054.22.23.167 E018.29.07.977 N054.22.23.080 E018.29.07.718 Color_251ACI
N054.22.23.318 E018.29.08.248 N054.22.23.167 E018.29.07.977 Color_251ACI
N054.22.23.488 E018.29.08.494 N054.22.23.318 E018.29.08.248 Color_251ACI
N054.22.23.760 E018.29.08.774 N054.22.23.488 E018.29.08.494 Color_251ACI
N054.22.24.067 E018.29.09.004 N054.22.23.760 E018.29.08.774 Color_251ACI
N054.22.25.955 E018.29.10.159 N054.22.24.067 E018.29.09.004 Color_251ACI
N054.22.26.242 E018.29.10.292 N054.22.25.955 E018.29.10.159 Color_251ACI
N054.22.26.482 E018.29.10.369 N054.22.26.242 E018.29.10.292 Color_251ACI
N054.22.26.773 E018.29.10.363 N054.22.26.482 E018.29.10.369 Color_251ACI
N054.22.27.011 E018.29.10.266 N054.22.26.773 E018.29.10.363 Color_251ACI
N054.22.27.226 E018.29.10.046 N054.22.27.011 E018.29.10.266 Color_251ACI
N054.22.27.431 E018.29.09.755 N054.22.27.226 E018.29.10.046 Color_251ACI
N054.22.27.628 E018.29.09.350 N054.22.27.431 E018.29.09.755 Color_251ACI
N054.22.27.796 E018.29.08.840 N054.22.27.628 E018.29.09.350 Color_251ACI
N054.22.28.991 E018.29.04.605 N054.22.27.796 E018.29.08.840 Color_251ACI
N054.22.33.089 E018.28.48.376 N054.22.28.991 E018.29.04.605 Color_251ACI
N054.22.33.909 E018.28.44.229 N054.22.33.089 E018.28.48.376 Color_251ACI
N054.22.33.979 E018.28.43.677 N054.22.33.909 E018.28.44.229 Color_251ACI
N054.22.34.009 E018.28.43.183 N054.22.33.979 E018.28.43.677 Color_251ACI
N054.22.34.007 E018.28.42.634 N054.22.34.009 E018.28.43.183 Color_251ACI
N054.22.33.983 E018.28.41.702 N054.22.34.007 E018.28.42.634 Color_251ACI
N054.22.33.955 E018.28.40.908 N054.22.33.983 E018.28.41.702 Color_251ACI
N054.22.33.910 E018.28.40.122 N054.22.33.955 E018.28.40.908 Color_251ACI
N054.22.33.196 E018.28.30.640 N054.22.33.910 E018.28.40.122 Color_251ACI
N054.22.33.140 E018.28.30.044 N054.22.33.196 E018.28.30.640 Color_251ACI
N054.22.33.080 E018.28.29.631 N054.22.33.140 E018.28.30.044 Color_251ACI
N054.22.33.016 E018.28.29.357 N054.22.33.080 E018.28.29.631 Color_251ACI
N054.22.32.951 E018.28.29.118 N054.22.33.016 E018.28.29.357 Color_251ACI
N054.22.32.830 E018.28.28.944 N054.22.32.951 E018.28.29.118 Color_251ACI
N054.22.18.570 E018.29.26.034 N054.22.18.515 E018.29.25.830 Color_251ACI
N054.22.18.674 E018.29.26.241 N054.22.18.570 E018.29.26.034 Color_251ACI
N054.22.18.875 E018.29.26.516 N054.22.18.674 E018.29.26.241 Color_251ACI
N054.22.19.137 E018.29.26.751 N054.22.18.875 E018.29.26.516 Color_251ACI
N054.22.20.144 E018.29.27.481 N054.22.19.137 E018.29.26.751 Color_251ACI
N054.22.21.196 E018.29.28.118 N054.22.20.144 E018.29.27.481 Color_251ACI
N054.22.21.489 E018.29.28.234 N054.22.21.196 E018.29.28.118 Color_251ACI
N054.22.21.664 E018.29.28.272 N054.22.21.489 E018.29.28.234 Color_251ACI
N054.22.21.850 E018.29.28.293 N054.22.21.664 E018.29.28.272 Color_251ACI
N054.22.22.032 E018.29.28.245 N054.22.21.850 E018.29.28.293 Color_251ACI
N054.22.22.287 E018.29.28.140 N054.22.22.032 E018.29.28.245 Color_251ACI
N054.22.22.539 E018.29.27.966 N054.22.22.287 E018.29.28.140 Color_251ACI
N054.22.22.742 E018.29.27.754 N054.22.22.539 E018.29.27.966 Color_251ACI
N054.22.22.902 E018.29.27.512 N054.22.22.742 E018.29.27.754 Color_251ACI
N054.22.23.042 E018.29.27.209 N054.22.22.902 E018.29.27.512 Color_251ACI
N054.22.24.278 E018.29.23.281 N054.22.23.042 E018.29.27.209 Color_251ACI
N054.22.25.729 E018.29.17.515 N054.22.24.278 E018.29.23.281 Color_251ACI
N054.22.26.291 E018.29.14.776 N054.22.25.729 E018.29.17.515 Color_251ACI
N054.22.26.407 E018.29.14.167 N054.22.26.291 E018.29.14.776 Color_251ACI
N054.22.26.451 E018.29.13.735 N054.22.26.407 E018.29.14.167 Color_251ACI
N054.22.26.459 E018.29.13.439 N054.22.26.451 E018.29.13.735 Color_251ACI
N054.22.26.419 E018.29.13.089 N054.22.26.459 E018.29.13.439 Color_251ACI
N054.22.26.335 E018.29.12.761 N054.22.26.419 E018.29.13.089 Color_251ACI
N054.22.26.221 E018.29.12.492 N054.22.26.335 E018.29.12.761 Color_251ACI
N054.22.26.069 E018.29.12.221 N054.22.26.221 E018.29.12.492 Color_251ACI
N054.22.25.895 E018.29.12.000 N054.22.26.069 E018.29.12.221 Color_251ACI
N054.22.25.659 E018.29.11.792 N054.22.25.895 E018.29.12.000 Color_251ACI
N054.22.23.524 E018.29.10.403 N054.22.25.659 E018.29.11.792 Color_251ACI
N054.22.23.319 E018.29.10.267 N054.22.23.524 E018.29.10.403 Color_251ACI
N054.22.23.090 E018.29.10.191 N054.22.23.319 E018.29.10.267 Color_251ACI
N054.22.22.800 E018.29.10.188 N054.22.23.090 E018.29.10.191 Color_251ACI
N054.22.22.589 E018.29.10.261 N054.22.22.800 E018.29.10.188 Color_251ACI
N054.22.22.399 E018.29.10.396 N054.22.22.589 E018.29.10.261 Color_251ACI
N054.22.22.078 E018.29.30.615 N054.22.22.124 E018.29.30.922 Color_251ACI
N054.22.21.996 E018.29.30.383 N054.22.22.078 E018.29.30.615 Color_251ACI
N054.22.21.832 E018.29.30.137 N054.22.21.996 E018.29.30.383 Color_251ACI
N054.22.21.613 E018.29.29.948 N054.22.21.832 E018.29.30.137 Color_251ACI
N054.22.19.246 E018.29.28.421 N054.22.21.613 E018.29.29.948 Color_251ACI
N054.22.18.922 E018.29.28.234 N054.22.19.246 E018.29.28.421 Color_251ACI
N054.22.18.731 E018.29.28.177 N054.22.18.922 E018.29.28.234 Color_251ACI
N054.22.18.544 E018.29.28.182 N054.22.18.731 E018.29.28.177 Color_251ACI
N054.22.18.395 E018.29.28.232 N054.22.18.544 E018.29.28.182 Color_251ACI
N054.22.18.294 E018.29.28.322 N054.22.18.395 E018.29.28.232 Color_251ACI
N054.22.18.196 E018.29.28.506 N054.22.18.294 E018.29.28.322 Color_251ACI
N054.22.18.133 E018.29.28.771 N054.22.18.196 E018.29.28.506 Color_251ACI
N054.22.18.102 E018.29.29.352 N054.22.18.133 E018.29.28.771 Color_251ACI
N054.22.18.175 E018.29.29.880 N054.22.18.102 E018.29.29.352 Color_251ACI
N054.22.18.367 E018.29.30.493 N054.22.18.175 E018.29.29.880 Color_251ACI
N054.22.18.680 E018.29.31.080 N054.22.18.367 E018.29.30.493 Color_251ACI
N054.22.19.014 E018.29.31.529 N054.22.18.680 E018.29.31.080 Color_251ACI
N054.22.19.420 E018.29.31.905 N054.22.19.014 E018.29.31.529 Color_251ACI
N054.22.19.792 E018.29.32.165 N054.22.19.420 E018.29.31.905 Color_251ACI
N054.22.20.180 E018.29.32.400 N054.22.19.792 E018.29.32.165 Color_251ACI
N054.22.20.474 E018.29.32.499 N054.22.20.180 E018.29.32.400 Color_251ACI
N054.22.20.742 E018.29.32.534 N054.22.20.474 E018.29.32.499 Color_251ACI
N054.22.20.984 E018.29.32.507 N054.22.20.742 E018.29.32.534 Color_251ACI
N054.22.21.251 E018.29.32.386 N054.22.20.984 E018.29.32.507 Color_251ACI
N054.22.21.498 E018.29.32.177 N054.22.21.251 E018.29.32.386 Color_251ACI
N054.22.21.667 E018.29.31.988 N054.22.21.498 E018.29.32.177 Color_251ACI
N054.22.21.838 E018.29.31.756 N054.22.21.667 E018.29.31.988 Color_251ACI
N054.22.21.987 E018.29.31.505 N054.22.21.838 E018.29.31.756 Color_251ACI
N054.22.22.105 E018.29.31.209 N054.22.21.987 E018.29.31.505 Color_251ACI
N054.22.22.124 E018.29.30.922 N054.22.22.105 E018.29.31.209 Color_251ACI
N054.22.51.827 E018.28.02.399 N054.22.51.946 E018.28.02.460 Color_251ACI
N054.22.51.735 E018.28.02.358 N054.22.51.827 E018.28.02.399 Color_251ACI
N054.22.51.619 E018.28.02.403 N054.22.51.735 E018.28.02.358 Color_251ACI
N054.22.51.532 E018.28.02.571 N054.22.51.619 E018.28.02.403 Color_251ACI
N054.22.50.128 E018.28.08.018 N054.22.51.532 E018.28.02.571 Color_251ACI
N054.22.50.017 E018.28.08.464 N054.22.50.128 E018.28.08.018 Color_251ACI
N054.22.49.984 E018.28.08.905 N054.22.50.017 E018.28.08.464 Color_251ACI
N054.22.49.979 E018.28.09.278 N054.22.49.984 E018.28.08.905 Color_251ACI
N054.22.50.048 E018.28.09.571 N054.22.49.979 E018.28.09.278 Color_251ACI
N054.22.50.129 E018.28.09.802 N054.22.50.048 E018.28.09.571 Color_251ACI
N054.22.50.381 E018.28.18.164 N054.22.50.129 E018.28.09.802 Color_251ACI
N054.22.49.992 E018.28.18.529 N054.22.50.381 E018.28.18.164 Color_251ACI
N054.22.49.857 E018.28.18.659 N054.22.49.992 E018.28.18.529 Color_251ACI
N054.22.49.747 E018.28.18.870 N054.22.49.857 E018.28.18.659 Color_251ACI
N054.22.49.658 E018.28.19.116 N054.22.49.747 E018.28.18.870 Color_251ACI
N054.22.47.090 E018.28.29.088 N054.22.49.658 E018.28.19.116 Color_251ACI
N054.22.40.466 E018.28.24.922 N054.22.47.090 E018.28.29.088 Color_251ACI
N054.22.40.287 E018.28.24.822 N054.22.40.466 E018.28.24.922 Color_251ACI
N054.22.40.129 E018.28.24.785 N054.22.40.287 E018.28.24.822 Color_251ACI
N054.22.39.980 E018.28.24.819 N054.22.40.129 E018.28.24.785 Color_251ACI
N054.22.39.828 E018.28.24.947 N054.22.39.980 E018.28.24.819 Color_251ACI
N054.22.39.711 E018.28.25.227 N054.22.39.828 E018.28.24.947 Color_251ACI
N054.22.37.830 E018.28.32.722 N054.22.39.711 E018.28.25.227 Color_251ACI
N054.22.37.375 E018.28.35.153 N054.22.37.830 E018.28.32.722 Color_251ACI
N054.22.37.306 E018.28.35.454 N054.22.37.375 E018.28.35.153 Color_251ACI
N054.22.37.273 E018.28.35.878 N054.22.37.306 E018.28.35.454 Color_251ACI
N054.22.37.308 E018.28.36.211 N054.22.37.273 E018.28.35.878 Color_251ACI
N054.22.37.375 E018.28.36.546 N054.22.37.308 E018.28.36.211 Color_251ACI
N054.22.37.486 E018.28.36.928 N054.22.37.375 E018.28.36.546 Color_251ACI
N054.22.37.581 E018.28.37.265 N054.22.37.486 E018.28.36.928 Color_251ACI
N054.22.37.745 E018.28.37.694 N054.22.37.581 E018.28.37.265 Color_251ACI
N054.22.39.698 E018.28.41.960 N054.22.37.745 E018.28.37.694 Color_251ACI
N054.22.37.273 E018.28.51.506 N054.22.39.698 E018.28.41.960 Color_251ACI
N054.22.34.656 E018.28.49.884 N054.22.37.273 E018.28.51.506 Color_251ACI
N054.22.34.472 E018.28.49.784 N054.22.34.656 E018.28.49.884 Color_251ACI
N054.22.34.287 E018.28.49.711 N054.22.34.472 E018.28.49.784 Color_251ACI
N054.22.34.096 E018.28.49.689 N054.22.34.287 E018.28.49.711 Color_251ACI
N054.22.33.942 E018.28.49.705 N054.22.34.096 E018.28.49.689 Color_251ACI
N054.22.33.787 E018.28.49.764 N054.22.33.942 E018.28.49.705 Color_251ACI
N054.22.33.658 E018.28.49.868 N054.22.33.787 E018.28.49.764 Color_251ACI
N054.22.33.522 E018.28.50.042 N054.22.33.658 E018.28.49.868 Color_251ACI
N054.22.33.423 E018.28.50.226 N054.22.33.522 E018.28.50.042 Color_251ACI
N054.22.33.345 E018.28.50.482 N054.22.33.423 E018.28.50.226 Color_251ACI
N054.22.22.762 E018.29.32.698 N054.22.33.345 E018.28.50.482 Color_251ACI
N054.22.22.688 E018.29.32.980 N054.22.22.762 E018.29.32.698 Color_251ACI
N054.22.22.648 E018.29.33.247 N054.22.22.688 E018.29.32.980 Color_251ACI
N054.22.22.647 E018.29.33.482 N054.22.22.648 E018.29.33.247 Color_251ACI
N054.22.22.675 E018.29.33.684 N054.22.22.647 E018.29.33.482 Color_251ACI
N054.22.22.745 E018.29.33.941 N054.22.22.675 E018.29.33.684 Color_251ACI
N054.22.22.832 E018.29.34.165 N054.22.22.745 E018.29.33.941 Color_251ACI
N054.22.22.921 E018.29.34.327 N054.22.22.832 E018.29.34.165 Color_251ACI
N054.22.23.043 E018.29.34.466 N054.22.22.921 E018.29.34.327 Color_251ACI
N054.22.25.131 E018.29.35.957 N054.22.23.043 E018.29.34.466 Color_251ACI
N054.22.26.562 E018.29.36.803 N054.22.25.131 E018.29.35.957 Color_251ACI
N054.22.26.073 E018.29.39.275 N054.22.26.562 E018.29.36.803 Color_251ACI
N054.22.25.518 E018.29.38.889 N054.22.26.073 E018.29.39.275 Color_251ACI
N054.22.25.367 E018.29.38.810 N054.22.25.518 E018.29.38.889 Color_251ACI
N054.22.25.240 E018.29.38.818 N054.22.25.367 E018.29.38.810 Color_251ACI
N054.22.25.135 E018.29.38.881 N054.22.25.240 E018.29.38.818 Color_251ACI
N054.22.25.032 E018.29.39.022 N054.22.25.135 E018.29.38.881 Color_251ACI
N054.22.24.951 E018.29.39.191 N054.22.25.032 E018.29.39.022 Color_251ACI
N054.22.24.589 E018.29.40.810 N054.22.24.951 E018.29.39.191 Color_251ACI
N054.22.24.417 E018.29.43.122 N054.22.24.589 E018.29.40.810 Color_251ACI
N054.22.25.002 E018.29.43.571 N054.22.24.417 E018.29.43.122 Color_251ACI
N054.22.22.464 E018.29.53.458 N054.22.25.002 E018.29.43.571 Color_251ACI
N054.22.21.295 E018.29.52.848 N054.22.22.464 E018.29.53.458 Color_251ACI
N054.22.21.422 E018.29.52.030 N054.22.21.295 E018.29.52.848 Color_251ACI
N054.22.21.178 E018.29.51.917 N054.22.21.422 E018.29.52.030 Color_251ACI
N054.22.23.318 E018.29.43.569 N054.22.21.178 E018.29.51.917 Color_251ACI
N054.22.23.815 E018.29.43.838 N054.22.23.318 E018.29.43.569 Color_251ACI
N054.22.24.096 E018.29.42.196 N054.22.23.815 E018.29.43.838 Color_251ACI
N054.22.24.158 E018.29.40.694 N054.22.24.096 E018.29.42.196 Color_251ACI
N054.22.24.571 E018.29.38.634 N054.22.24.158 E018.29.40.694 Color_251ACI
N054.22.24.805 E018.29.36.866 N054.22.24.571 E018.29.38.634 Color_251ACI
N054.22.24.242 E018.29.36.392 N054.22.24.805 E018.29.36.866 Color_251ACI
N054.22.24.090 E018.29.36.321 N054.22.24.242 E018.29.36.392 Color_251ACI
N054.22.23.894 E018.29.36.290 N054.22.24.090 E018.29.36.321 Color_251ACI
N054.22.23.728 E018.29.36.314 N054.22.23.894 E018.29.36.290 Color_251ACI
N054.22.23.561 E018.29.36.407 N054.22.23.728 E018.29.36.314 Color_251ACI
N054.22.23.403 E018.29.36.570 N054.22.23.561 E018.29.36.407 Color_251ACI
N054.22.23.310 E018.29.36.764 N054.22.23.403 E018.29.36.570 Color_251ACI
N054.22.23.083 E018.29.37.671 N054.22.23.310 E018.29.36.764 Color_251ACI
N054.22.23.614 E018.29.38.099 N054.22.23.083 E018.29.37.671 Color_251ACI
N054.22.21.263 E018.29.46.937 N054.22.23.614 E018.29.38.099 Color_251ACI
N054.22.19.668 E018.29.45.888 N054.22.21.263 E018.29.46.937 Color_251ACI
N054.22.22.031 E018.29.36.781 N054.22.19.668 E018.29.45.888 Color_251ACI
N054.22.22.520 E018.29.37.189 N054.22.22.031 E018.29.36.781 Color_251ACI
N054.22.22.590 E018.29.37.011 N054.22.22.520 E018.29.37.189 Color_251ACI
N054.22.22.806 E018.29.36.121 N054.22.22.590 E018.29.37.011 Color_251ACI
N054.22.22.728 E018.29.35.585 N054.22.22.806 E018.29.36.121 Color_251ACI
N054.22.19.995 E018.29.33.789 N054.22.22.728 E018.29.35.585 Color_251ACI
N054.22.19.548 E018.29.33.463 N054.22.19.995 E018.29.33.789 Color_251ACI
N054.22.19.130 E018.29.33.103 N054.22.19.548 E018.29.33.463 Color_251ACI
N054.22.18.661 E018.29.32.602 N054.22.19.130 E018.29.33.103 Color_251ACI
N054.22.18.361 E018.29.32.120 N054.22.18.661 E018.29.32.602 Color_251ACI
N054.22.17.967 E018.29.31.458 N054.22.18.361 E018.29.32.120 Color_251ACI
N054.22.17.752 E018.29.31.121 N054.22.17.967 E018.29.31.458 Color_251ACI
N054.22.17.619 E018.29.30.965 N054.22.17.752 E018.29.31.121 Color_251ACI
N054.22.17.468 E018.29.30.859 N054.22.17.619 E018.29.30.965 Color_251ACI
N054.22.17.359 E018.29.30.842 N054.22.17.468 E018.29.30.859 Color_251ACI
N054.22.17.248 E018.29.30.887 N054.22.17.359 E018.29.30.842 Color_251ACI
N054.22.52.569 E018.28.02.754 N054.22.52.840 E018.28.02.886 Color_251ACI
N054.22.53.781 E018.28.01.775 N054.22.53.761 E018.28.01.878 Color_251ACI
N054.22.53.436 E018.28.03.161 N054.22.53.067 E018.28.02.997 Color_251ACI
N054.22.53.687 E018.28.02.186 N054.22.53.436 E018.28.03.161 Color_251ACI
N054.22.53.854 E018.28.01.493 N054.22.54.303 E018.27.59.688 Color_251ACI
N054.22.54.372 E018.27.59.379 N054.22.54.827 E018.27.57.565 Color_251ACI
N054.22.54.901 E018.27.57.266 N054.22.55.339 E018.27.55.476 Color_251ACI
N054.22.50.102 E018.27.19.894 N054.22.50.067 E018.27.19.353 Color_251ACI
N054.22.50.170 E018.27.20.221 N054.22.50.102 E018.27.19.894 Color_251ACI
N054.22.50.291 E018.27.20.612 N054.22.50.170 E018.27.20.221 Color_251ACI
N054.22.50.543 E018.27.21.021 N054.22.50.291 E018.27.20.612 Color_251ACI
N054.22.50.800 E018.27.21.265 N054.22.50.543 E018.27.21.021 Color_251ACI
N054.22.52.665 E018.27.22.488 N054.22.50.800 E018.27.21.265 Color_251ACI
N054.22.53.144 E018.27.22.816 N054.22.52.665 E018.27.22.488 Color_251ACI
N054.22.53.609 E018.27.23.292 N054.22.53.144 E018.27.22.816 Color_251ACI
N054.22.53.896 E018.27.23.833 N054.22.53.609 E018.27.23.292 Color_251ACI
N054.22.54.149 E018.27.24.416 N054.22.53.896 E018.27.23.833 Color_251ACI
N054.22.54.331 E018.27.24.977 N054.22.54.149 E018.27.24.416 Color_251ACI
N054.22.54.404 E018.27.25.548 N054.22.54.331 E018.27.24.977 Color_251ACI
N054.22.54.444 E018.27.26.090 N054.22.54.404 E018.27.25.548 Color_251ACI
N054.22.54.436 E018.27.26.568 N054.22.54.444 E018.27.26.090 Color_251ACI
N054.22.54.373 E018.27.27.103 N054.22.54.436 E018.27.26.568 Color_251ACI
N054.22.54.227 E018.27.27.815 N054.22.54.373 E018.27.27.103 Color_251ACI
N054.22.52.554 E018.27.34.306 N054.22.54.227 E018.27.27.815 Color_251ACI
N054.22.52.474 E018.27.34.640 N054.22.52.554 E018.27.34.306 Color_251ACI
N054.22.52.359 E018.27.35.416 N054.22.52.474 E018.27.34.640 Color_251ACI
N054.22.52.324 E018.27.35.909 N054.22.52.359 E018.27.35.416 Color_251ACI
N054.22.52.379 E018.27.36.296 N054.22.52.324 E018.27.35.909 Color_251ACI
N054.22.52.484 E018.27.36.686 N054.22.52.379 E018.27.36.296 Color_251ACI
N054.22.52.603 E018.27.36.964 N054.22.52.484 E018.27.36.686 Color_251ACI
N054.22.52.729 E018.27.37.164 N054.22.52.603 E018.27.36.964 Color_251ACI
N054.22.52.890 E018.27.37.279 N054.22.52.729 E018.27.37.164 Color_251ACI
N054.22.54.437 E018.27.38.324 N054.22.52.890 E018.27.37.279 Color_251ACI
N054.22.54.539 E018.27.38.383 N054.22.54.437 E018.27.38.324 Color_251ACI
N054.22.54.627 E018.27.38.372 N054.22.54.539 E018.27.38.383 Color_251ACI
N054.22.54.723 E018.27.38.274 N054.22.54.627 E018.27.38.372 Color_251ACI
N054.22.54.811 E018.27.38.071 N054.22.54.723 E018.27.38.274 Color_251ACI
N054.22.55.015 E018.27.37.232 N054.22.54.811 E018.27.38.071 Color_251ACI
N054.22.56.423 E018.27.38.103 N054.22.55.015 E018.27.37.232 Color_251ACI
N054.22.56.627 E018.27.38.264 N054.22.56.423 E018.27.38.103 Color_251ACI
N054.22.56.802 E018.27.38.511 N054.22.56.627 E018.27.38.264 Color_251ACI
N054.22.56.910 E018.27.38.762 N054.22.56.802 E018.27.38.511 Color_251ACI
N054.22.57.026 E018.27.39.144 N054.22.56.910 E018.27.38.762 Color_251ACI
N054.22.57.111 E018.27.39.446 N054.22.57.026 E018.27.39.144 Color_251ACI
N054.22.57.276 E018.27.39.631 N054.22.57.111 E018.27.39.446 Color_251ACI
N054.22.57.486 E018.27.39.767 N054.22.57.276 E018.27.39.631 Color_251ACI
N054.22.58.991 E018.27.40.740 N054.22.57.486 E018.27.39.767 Color_251ACI
N054.22.55.419 E018.27.55.151 N054.22.58.991 E018.27.40.740 Color_251ACI
N054.22.43.825 E018.28.28.273 N054.22.39.632 E018.28.25.575 Color_251ACI
N054.22.44.048 E018.28.28.167 N054.22.43.825 E018.28.28.273 Color_251ACI
N054.22.44.221 E018.28.27.898 N054.22.44.048 E018.28.28.167 Color_251ACI
N054.22.44.378 E018.28.27.385 N054.22.44.221 E018.28.27.898 Color_251ACI
N054.22.43.517 E018.28.28.655 N054.22.43.208 E018.28.29.893 Color_251ACI
N054.22.39.497 E018.28.26.073 N054.22.43.517 E018.28.28.655 Color_251ACI
N054.22.46.789 E018.28.29.542 N054.22.46.871 E018.28.28.953 Color_251ACI
N054.22.46.704 E018.28.29.851 N054.22.46.789 E018.28.29.542 Color_251ACI
N054.22.46.535 E018.28.29.979 N054.22.46.704 E018.28.29.851 Color_251ACI
N054.22.46.326 E018.28.29.965 N054.22.46.535 E018.28.29.979 Color_251ACI
N054.22.44.884 E018.28.29.062 N054.22.46.326 E018.28.29.965 Color_251ACI
N054.22.45.097 E018.28.28.133 N054.22.44.884 E018.28.29.062 Color_251ACI
N054.22.45.289 E018.28.27.954 N054.22.45.097 E018.28.28.133 Color_251ACI
N054.22.45.157 E018.28.29.973 N054.22.45.255 E018.28.29.630 Color_251ACI
N054.22.46.080 E018.28.31.715 N054.22.45.157 E018.28.29.973 Color_251ACI
N054.22.46.301 E018.28.31.292 N054.22.46.080 E018.28.31.715 Color_251ACI
N054.22.46.410 E018.28.30.916 N054.22.46.301 E018.28.31.292 Color_251ACI
N054.22.46.451 E018.28.30.656 N054.22.46.410 E018.28.30.916 Color_251ACI
N054.22.46.413 E018.28.30.426 N054.22.46.451 E018.28.30.656 Color_251ACI
N054.22.46.286 E018.28.30.225 N054.22.46.413 E018.28.30.426 Color_251ACI
N054.22.45.255 E018.28.29.630 N054.22.46.286 E018.28.30.225 Color_251ACI
N054.22.24.760 E018.29.34.879 N054.22.24.295 E018.29.35.371 Color_251ACI
N054.22.24.000 E018.29.34.562 N054.22.24.760 E018.29.34.879 Color_251ACI
N054.22.25.121 E018.29.34.168 N054.22.24.000 E018.29.34.562 Color_251ACI
N054.22.31.298 E018.29.09.985 N054.22.25.121 E018.29.34.168 Color_251ACI
N054.22.31.469 E018.29.09.366 N054.22.31.298 E018.29.09.985 Color_251ACI
N054.22.31.727 E018.29.08.772 N054.22.31.469 E018.29.09.366 Color_251ACI
N054.22.32.884 E018.29.06.385 N054.22.31.727 E018.29.08.772 Color_251ACI
N054.22.33.305 E018.29.05.487 N054.22.32.884 E018.29.06.385 Color_251ACI
N054.22.33.579 E018.29.04.719 N054.22.33.305 E018.29.05.487 Color_251ACI
N054.22.34.740 E018.29.00.513 N054.22.33.579 E018.29.04.719 Color_251ACI
N054.22.34.926 E018.28.59.756 N054.22.34.740 E018.29.00.513 Color_251ACI
N054.22.35.204 E018.28.58.849 N054.22.34.926 E018.28.59.756 Color_251ACI
N054.22.35.558 E018.28.57.999 N054.22.35.204 E018.28.58.849 Color_251ACI
N054.22.37.863 E018.28.53.469 N054.22.35.558 E018.28.57.999 Color_251ACI
N054.22.38.239 E018.28.52.620 N054.22.37.863 E018.28.53.469 Color_251ACI
N054.22.38.479 E018.28.51.885 N054.22.38.239 E018.28.52.620 Color_251ACI
N054.22.42.039 E018.28.38.452 N054.22.38.479 E018.28.51.885 Color_251ACI
N054.22.42.314 E018.28.37.666 N054.22.42.039 E018.28.38.452 Color_251ACI
N054.22.42.666 E018.28.36.885 N054.22.42.314 E018.28.37.666 Color_251ACI
N054.22.43.001 E018.28.36.314 N054.22.42.666 E018.28.36.885 Color_251ACI
N054.22.45.964 E018.28.31.917 N054.22.43.001 E018.28.36.314 Color_251ACI
N054.22.45.070 E018.28.30.334 N054.22.45.964 E018.28.31.917 Color_251ACI
N054.22.44.919 E018.28.31.024 N054.22.45.070 E018.28.30.334 Color_251ACI
N054.22.26.636 E018.29.36.824 N054.22.26.571 E018.29.36.820 Color_251ACI
N054.22.26.792 E018.29.36.782 N054.22.26.636 E018.29.36.824 Color_251ACI
N054.22.27.017 E018.29.36.606 N054.22.26.792 E018.29.36.782 Color_251ACI
N054.22.27.423 E018.29.35.059 N054.22.27.017 E018.29.36.606 Color_251ACI
N054.22.29.542 E018.29.26.390 N054.22.27.423 E018.29.35.059 Color_251ACI
N054.22.29.653 E018.29.25.960 N054.22.29.542 E018.29.26.390 Color_251ACI
N054.22.29.663 E018.29.25.612 N054.22.29.653 E018.29.25.960 Color_251ACI
N054.22.29.594 E018.29.25.309 N054.22.29.663 E018.29.25.612 Color_251ACI
N054.22.29.494 E018.29.24.918 N054.22.29.594 E018.29.25.309 Color_251ACI
N054.22.29.470 E018.29.24.567 N054.22.29.494 E018.29.24.918 Color_251ACI
N054.22.29.517 E018.29.24.080 N054.22.29.470 E018.29.24.567 Color_251ACI
N054.22.29.650 E018.29.23.617 N054.22.29.517 E018.29.24.080 Color_251ACI
N054.22.29.935 E018.29.23.269 N054.22.29.650 E018.29.23.617 Color_251ACI
N054.22.30.514 E018.29.22.679 N054.22.29.935 E018.29.23.269 Color_251ACI
N054.22.33.805 E018.29.09.403 N054.22.30.514 E018.29.22.679 Color_251ACI
N054.22.32.037 E018.29.09.947 N054.22.33.805 E018.29.09.403 Color_251ACI
N054.22.31.997 E018.29.09.420 N054.22.32.037 E018.29.09.947 Color_251ACI
N054.22.39.703 E018.29.07.357 N054.22.31.997 E018.29.09.420 Color_251ACI
N054.22.40.309 E018.28.58.409 N054.22.39.703 E018.29.07.357 Color_251ACI
N054.22.40.373 E018.28.57.662 N054.22.40.309 E018.28.58.409 Color_251ACI
N054.22.40.475 E018.28.56.759 N054.22.40.373 E018.28.57.662 Color_251ACI
N054.22.40.583 E018.28.56.032 N054.22.40.475 E018.28.56.759 Color_251ACI
N054.22.40.698 E018.28.55.463 N054.22.40.583 E018.28.56.032 Color_251ACI
N054.22.42.627 E018.28.48.530 N054.22.40.698 E018.28.55.463 Color_251ACI
N054.22.42.687 E018.28.48.341 N054.22.42.627 E018.28.48.530 Color_251ACI
N054.22.42.730 E018.28.47.976 N054.22.42.687 E018.28.48.341 Color_251ACI
N054.22.42.704 E018.28.47.731 N054.22.42.730 E018.28.47.976 Color_251ACI
N054.22.42.632 E018.28.47.533 N054.22.42.704 E018.28.47.731 Color_251ACI
N054.22.42.471 E018.28.47.347 N054.22.42.632 E018.28.47.533 Color_251ACI
N054.22.41.366 E018.28.46.625 N054.22.42.471 E018.28.47.347 Color_251ACI
N054.22.43.089 E018.28.40.009 N054.22.41.366 E018.28.46.625 Color_251ACI
N054.22.43.166 E018.28.39.595 N054.22.43.089 E018.28.40.009 Color_251ACI
N054.22.43.098 E018.28.39.241 N054.22.43.166 E018.28.39.595 Color_251ACI
N054.22.42.941 E018.28.38.950 N054.22.43.098 E018.28.39.241 Color_251ACI
N054.22.42.725 E018.28.38.796 N054.22.42.941 E018.28.38.950 Color_251ACI
N054.22.42.483 E018.28.38.779 N054.22.42.725 E018.28.38.796 Color_251ACI
N054.22.42.293 E018.28.38.871 N054.22.42.483 E018.28.38.779 Color_251ACI
N054.22.42.094 E018.28.39.278 N054.22.42.293 E018.28.38.871 Color_251ACI
N054.22.38.669 E018.28.52.213 N054.22.42.094 E018.28.39.278 Color_251ACI
N054.22.38.392 E018.28.53.068 N054.22.38.669 E018.28.52.213 Color_251ACI
N054.22.38.064 E018.28.53.797 N054.22.38.392 E018.28.53.068 Color_251ACI
N054.22.36.121 E018.28.57.565 N054.22.38.064 E018.28.53.797 Color_251ACI
N054.22.35.606 E018.28.58.666 N054.22.36.121 E018.28.57.565 Color_251ACI
N054.22.35.272 E018.28.59.588 N054.22.35.606 E018.28.58.666 Color_251ACI
N054.22.34.056 E018.29.04.227 N054.22.35.272 E018.28.59.588 Color_251ACI
N054.22.33.861 E018.29.04.878 N054.22.34.056 E018.29.04.227 Color_251ACI
N054.22.33.610 E018.29.05.613 N054.22.33.861 E018.29.04.878 Color_251ACI
N054.22.33.317 E018.29.06.240 N054.22.33.610 E018.29.05.613 Color_251ACI
N054.22.32.396 E018.29.08.101 N054.22.33.317 E018.29.06.240 Color_251ACI
N054.22.31.998 E018.29.08.983 N054.22.32.396 E018.29.08.101 Color_251ACI
N054.22.31.676 E018.29.09.853 N054.22.31.998 E018.29.08.983 Color_251ACI
N054.22.31.421 E018.29.10.727 N054.22.31.676 E018.29.09.853 Color_251ACI
N054.22.25.062 E018.29.35.930 N054.22.31.421 E018.29.10.727 Color_251ACI
N054.22.21.558 E018.29.54.275 N054.22.21.860 E018.29.53.153 Color_251ACI
N054.22.21.256 E018.29.54.115 N054.22.21.558 E018.29.54.275 Color_251ACI
N054.22.21.099 E018.29.54.009 N054.22.21.256 E018.29.54.115 Color_251ACI
N054.22.20.981 E018.29.53.905 N054.22.21.099 E018.29.54.009 Color_251ACI
N054.22.20.894 E018.29.53.699 N054.22.20.981 E018.29.53.905 Color_251ACI
N054.22.20.866 E018.29.53.514 N054.22.20.894 E018.29.53.699 Color_251ACI
N054.22.20.899 E018.29.53.308 N054.22.20.866 E018.29.53.514 Color_251ACI
N054.22.21.154 E018.29.53.003 N054.22.20.899 E018.29.53.308 Color_251ACI
N054.22.21.337 E018.29.52.119 N054.22.21.154 E018.29.53.003 Color_251ACI
N054.22.21.163 E018.29.52.046 N054.22.21.337 E018.29.52.119 Color_251ACI
N054.22.21.178 E018.29.51.925 N054.22.21.163 E018.29.52.046 Color_251ACI
N054.22.21.879 E018.29.59.863 N054.22.22.979 E018.30.04.467 Color_251ACI
N054.22.21.801 E018.29.59.106 N054.22.21.879 E018.29.59.863 Color_251ACI
N054.22.21.787 E018.29.58.388 N054.22.21.801 E018.29.59.106 Color_251ACI
N054.22.21.854 E018.29.57.536 N054.22.21.787 E018.29.58.388 Color_251ACI
N054.22.21.971 E018.29.56.879 N054.22.21.854 E018.29.57.536 Color_251ACI
N054.22.25.031 E018.29.44.427 N054.22.21.971 E018.29.56.879 Color_251ACI
N054.22.25.109 E018.29.43.977 N054.22.25.031 E018.29.44.427 Color_251ACI
N054.22.25.115 E018.29.43.768 N054.22.25.109 E018.29.43.977 Color_251ACI
N054.22.25.021 E018.29.43.587 N054.22.25.115 E018.29.43.768 Color_251ACI
N054.22.41.370 E018.29.07.697 N054.22.42.137 E018.29.07.854 Color_251ACI
N054.22.40.819 E018.29.07.694 N054.22.41.370 E018.29.07.697 Color_251ACI
N054.22.40.223 E018.29.07.723 N054.22.40.819 E018.29.07.694 Color_251ACI
N054.22.39.702 E018.29.07.829 N054.22.40.223 E018.29.07.723 Color_251ACI
N054.22.34.083 E018.29.09.317 N054.22.39.702 E018.29.07.829 Color_251ACI
N054.22.30.827 E018.29.22.508 N054.22.34.083 E018.29.09.317 Color_251ACI
N054.22.30.729 E018.29.22.886 N054.22.30.827 E018.29.22.508 Color_251ACI
N054.22.30.580 E018.29.23.104 N054.22.30.729 E018.29.22.886 Color_251ACI
N054.22.30.387 E018.29.23.300 N054.22.30.580 E018.29.23.104 Color_251ACI
N054.22.30.194 E018.29.23.497 N054.22.30.387 E018.29.23.300 Color_251ACI
N054.22.30.021 E018.29.23.765 N054.22.30.194 E018.29.23.497 Color_251ACI
N054.22.29.882 E018.29.24.052 N054.22.30.021 E018.29.23.765 Color_251ACI
N054.22.29.819 E018.29.24.328 N054.22.29.882 E018.29.24.052 Color_251ACI
N054.22.29.789 E018.29.24.623 N054.22.29.819 E018.29.24.328 Color_251ACI
N054.22.29.813 E018.29.24.939 N054.22.29.789 E018.29.24.623 Color_251ACI
N054.22.29.892 E018.29.25.294 N054.22.29.813 E018.29.24.939 Color_251ACI
N054.22.29.937 E018.29.25.648 N054.22.29.892 E018.29.25.294 Color_251ACI
N054.22.29.918 E018.29.25.978 N054.22.29.937 E018.29.25.648 Color_251ACI
N054.22.29.851 E018.29.26.394 N054.22.29.918 E018.29.25.978 Color_251ACI
N054.22.24.188 E018.29.48.689 N054.22.29.851 E018.29.26.394 Color_251ACI
N054.22.22.444 E018.29.56.107 N054.22.24.188 E018.29.48.689 Color_251ACI
N054.22.22.159 E018.29.57.259 N054.22.22.444 E018.29.56.107 Color_251ACI
N054.22.22.082 E018.29.58.076 N054.22.22.159 E018.29.57.259 Color_251ACI
N054.22.22.100 E018.29.59.039 N054.22.22.082 E018.29.58.076 Color_251ACI
N054.22.22.241 E018.29.59.958 N054.22.22.100 E018.29.59.039 Color_251ACI
N054.22.23.291 E018.30.04.349 N054.22.22.241 E018.29.59.958 Color_251ACI
N054.22.44.661 E018.28.41.376 N054.22.42.213 E018.28.44.252 Color_251ACI
N054.22.44.346 E018.28.40.813 N054.22.44.661 E018.28.41.376 Color_251ACI
N054.22.44.113 E018.28.40.447 N054.22.44.346 E018.28.40.813 Color_251ACI
N054.22.43.970 E018.28.40.017 N054.22.44.113 E018.28.40.447 Color_251ACI
N054.22.43.964 E018.28.39.457 N054.22.43.970 E018.28.40.017 Color_251ACI
N054.22.44.557 E018.28.37.084 N054.22.43.964 E018.28.39.457 Color_251ACI
N054.22.44.776 E018.28.36.732 N054.22.44.557 E018.28.37.084 Color_251ACI
N054.22.45.093 E018.28.36.404 N054.22.44.776 E018.28.36.732 Color_251ACI
N054.22.45.430 E018.28.36.182 N054.22.45.093 E018.28.36.404 Color_251ACI
N054.22.45.763 E018.28.36.100 N054.22.45.430 E018.28.36.182 Color_251ACI
N054.22.46.010 E018.28.35.924 N054.22.45.763 E018.28.36.100 Color_251ACI
N054.22.46.162 E018.28.35.619 N054.22.46.010 E018.28.35.924 Color_251ACI
N054.22.46.336 E018.28.34.897 N054.22.46.162 E018.28.35.619 Color_251ACI
N054.22.45.641 E018.28.34.483 N054.22.46.336 E018.28.34.897 Color_251ACI
N054.22.45.705 E018.28.34.172 N054.22.45.641 E018.28.34.483 Color_251ACI
N054.22.46.086 E018.28.34.356 N054.22.45.705 E018.28.34.172 Color_251ACI
N054.22.46.239 E018.28.34.401 N054.22.46.086 E018.28.34.356 Color_251ACI
N054.22.46.363 E018.28.34.287 N054.22.46.239 E018.28.34.401 Color_251ACI
N054.22.46.472 E018.28.33.927 N054.22.46.363 E018.28.34.287 Color_251ACI
N054.22.46.541 E018.28.33.443 N054.22.46.472 E018.28.33.927 Color_251ACI
N054.22.46.475 E018.28.33.000 N054.22.46.541 E018.28.33.443 Color_251ACI
N054.22.46.298 E018.28.32.639 N054.22.46.475 E018.28.33.000 Color_251ACI
N054.22.46.110 E018.28.32.241 N054.22.46.298 E018.28.32.639 Color_251ACI
N054.22.46.005 E018.28.32.444 N054.22.46.110 E018.28.32.241 Color_251ACI
N054.22.43.135 E018.28.36.673 N054.22.46.005 E018.28.32.444 Color_251ACI
N054.22.42.950 E018.28.36.992 N054.22.43.135 E018.28.36.673 Color_251ACI
N054.22.42.788 E018.28.37.261 N054.22.42.950 E018.28.36.992 Color_251ACI
N054.22.42.728 E018.28.37.467 N054.22.42.788 E018.28.37.261 Color_251ACI
N054.22.42.690 E018.28.37.640 N054.22.42.728 E018.28.37.467 Color_251ACI
N054.22.42.681 E018.28.37.954 N054.22.42.690 E018.28.37.640 Color_251ACI
N054.22.42.751 E018.28.38.220 N054.22.42.681 E018.28.37.954 Color_251ACI
N054.22.42.888 E018.28.38.474 N054.22.42.751 E018.28.38.220 Color_251ACI
N054.22.43.179 E018.28.38.722 N054.22.42.888 E018.28.38.474 Color_251ACI
N054.22.43.340 E018.28.38.855 N054.22.43.179 E018.28.38.722 Color_251ACI
N054.22.43.477 E018.28.39.092 N054.22.43.340 E018.28.38.855 Color_251ACI
N054.22.43.471 E018.28.39.336 N054.22.43.477 E018.28.39.092 Color_251ACI
N054.22.43.441 E018.28.39.614 N054.22.43.471 E018.28.39.336 Color_251ACI
N054.22.41.834 E018.28.45.642 N054.22.43.441 E018.28.39.614 Color_251ACI
N054.22.41.773 E018.28.45.849 N054.22.41.834 E018.28.45.642 Color_251ACI
N054.22.41.766 E018.28.46.128 N054.22.41.773 E018.28.45.849 Color_251ACI
N054.22.41.814 E018.28.46.393 N054.22.41.766 E018.28.46.128 Color_251ACI
N054.22.41.930 E018.28.46.594 N054.22.41.814 E018.28.46.393 Color_251ACI
N054.22.42.709 E018.28.47.136 N054.22.41.930 E018.28.46.594 Color_251ACI
N054.22.42.891 E018.28.47.323 N054.22.42.709 E018.28.47.136 Color_251ACI
N054.22.42.995 E018.28.47.558 N054.22.42.891 E018.28.47.323 Color_251ACI
N054.22.43.032 E018.28.47.805 N054.22.42.995 E018.28.47.558 Color_251ACI
N054.22.42.968 E018.28.48.150 N054.22.43.032 E018.28.47.805 Color_251ACI
N054.22.40.989 E018.28.55.273 N054.22.42.968 E018.28.48.150 Color_251ACI
N054.22.40.766 E018.28.56.184 N054.22.40.989 E018.28.55.273 Color_251ACI
N054.22.40.618 E018.28.57.171 N054.22.40.766 E018.28.56.184 Color_251ACI
N054.22.40.545 E018.28.58.250 N054.22.40.618 E018.28.57.171 Color_251ACI
N054.22.39.926 E018.29.07.284 N054.22.40.545 E018.28.58.250 Color_251ACI
N054.22.40.734 E018.29.07.164 N054.22.39.926 E018.29.07.284 Color_251ACI
N054.22.41.396 E018.29.07.156 N054.22.40.734 E018.29.07.164 Color_251ACI
N054.22.42.163 E018.29.07.314 N054.22.41.396 E018.29.07.156 Color_251ACI
N054.22.52.714 E018.28.42.413 N054.22.52.610 E018.28.44.225 Color_251ACI
N054.22.52.009 E018.28.42.400 N054.22.52.714 E018.28.42.413 Color_251ACI
N054.22.51.580 E018.28.44.417 N054.22.52.009 E018.28.42.400 Color_251ACI
N054.22.51.166 E018.28.44.231 N054.22.51.580 E018.28.44.417 Color_251ACI
N054.22.51.630 E018.28.42.147 N054.22.51.166 E018.28.44.231 Color_251ACI
N054.22.51.325 E018.28.42.022 N054.22.51.630 E018.28.42.147 Color_251ACI
N054.22.51.144 E018.28.42.184 N054.22.51.325 E018.28.42.022 Color_251ACI
N054.22.50.986 E018.28.42.313 N054.22.51.144 E018.28.42.184 Color_251ACI
N054.22.50.701 E018.28.42.259 N054.22.50.986 E018.28.42.313 Color_251ACI
N054.22.50.532 E018.28.41.985 N054.22.50.701 E018.28.42.259 Color_251ACI
N054.22.50.466 E018.28.41.579 N054.22.50.532 E018.28.41.985 Color_251ACI
N054.22.50.540 E018.28.41.269 N054.22.50.466 E018.28.41.579 Color_251ACI
N054.22.50.700 E018.28.41.069 N054.22.50.540 E018.28.41.269 Color_251ACI
N054.22.50.889 E018.28.40.995 N054.22.50.700 E018.28.41.069 Color_251ACI
N054.22.51.086 E018.28.41.078 N054.22.50.889 E018.28.40.995 Color_251ACI
N054.22.51.286 E018.28.41.407 N054.22.51.086 E018.28.41.078 Color_251ACI
N054.22.51.378 E018.28.41.693 N054.22.51.286 E018.28.41.407 Color_251ACI
N054.22.51.704 E018.28.41.838 N054.22.51.378 E018.28.41.693 Color_251ACI
N054.22.51.957 E018.28.40.665 N054.22.51.704 E018.28.41.838 Color_251ACI
N054.22.52.337 E018.28.40.884 N054.22.51.957 E018.28.40.665 Color_251ACI
N054.22.52.074 E018.28.42.020 N054.22.52.337 E018.28.40.884 Color_251ACI
N054.22.52.725 E018.28.41.994 N054.22.52.074 E018.28.42.020 Color_251ACI
N054.22.53.125 E018.28.35.359 N054.22.52.725 E018.28.41.994 Color_251ACI
N054.22.52.558 E018.28.35.146 N054.22.53.125 E018.28.35.359 Color_251ACI
N054.22.52.115 E018.28.35.605 N054.22.52.558 E018.28.35.146 Color_251ACI
N054.22.51.634 E018.28.35.468 N054.22.52.115 E018.28.35.605 Color_251ACI
N054.22.51.491 E018.28.34.251 N054.22.51.634 E018.28.35.468 Color_251ACI
N054.22.51.094 E018.28.34.242 N054.22.51.491 E018.28.34.251 Color_251ACI
N054.22.51.301 E018.28.34.728 N054.22.51.094 E018.28.34.242 Color_251ACI
N054.22.51.488 E018.28.35.178 N054.22.51.301 E018.28.34.728 Color_251ACI
N054.22.51.693 E018.28.35.751 N054.22.51.488 E018.28.35.178 Color_251ACI
N054.22.51.880 E018.28.36.551 N054.22.51.693 E018.28.35.751 Color_251ACI
N054.22.51.960 E018.28.37.273 N054.22.51.880 E018.28.36.551 Color_251ACI
N054.22.51.873 E018.28.38.474 N054.22.51.960 E018.28.37.273 Color_251ACI
N054.22.51.620 E018.28.38.422 N054.22.51.873 E018.28.38.474 Color_251ACI
N054.22.51.610 E018.28.38.788 N054.22.51.620 E018.28.38.422 Color_251ACI
N054.22.50.287 E018.28.38.401 N054.22.51.610 E018.28.38.788 Color_251ACI
N054.22.49.730 E018.28.38.223 N054.22.50.287 E018.28.38.401 Color_251ACI
N054.22.49.296 E018.28.37.931 N054.22.49.730 E018.28.38.223 Color_251ACI
N054.22.48.879 E018.28.37.466 N054.22.49.296 E018.28.37.931 Color_251ACI
N054.22.48.617 E018.28.36.958 N054.22.48.879 E018.28.37.466 Color_251ACI
N054.22.48.354 E018.28.36.486 N054.22.48.617 E018.28.36.958 Color_251ACI
N054.22.48.043 E018.28.36.168 N054.22.48.354 E018.28.36.486 Color_251ACI
N054.22.46.911 E018.28.35.251 N054.22.48.043 E018.28.36.168 Color_251ACI
N054.22.46.781 E018.28.35.138 N054.22.46.911 E018.28.35.251 Color_251ACI
N054.22.46.683 E018.28.35.114 N054.22.46.781 E018.28.35.138 Color_251ACI
N054.22.46.570 E018.28.35.193 N054.22.46.683 E018.28.35.114 Color_251ACI
N054.22.46.477 E018.28.35.397 N054.22.46.570 E018.28.35.193 Color_251ACI
N054.22.46.261 E018.28.36.448 N054.22.46.477 E018.28.35.397 Color_251ACI
N054.22.46.152 E018.28.38.032 N054.22.46.261 E018.28.36.448 Color_251ACI
N054.22.46.049 E018.28.39.407 N054.22.46.152 E018.28.38.032 Color_251ACI
N054.22.45.964 E018.28.40.503 N054.22.46.049 E018.28.39.407 Color_251ACI
N054.22.45.865 E018.28.41.318 N054.22.45.964 E018.28.40.503 Color_251ACI
N054.22.45.737 E018.28.41.956 N054.22.45.865 E018.28.41.318 Color_251ACI
N054.22.45.519 E018.28.41.853 N054.22.45.737 E018.28.41.956 Color_251ACI
N054.22.45.642 E018.28.40.988 N054.22.45.519 E018.28.41.853 Color_251ACI
N054.22.45.495 E018.28.41.118 N054.22.45.642 E018.28.40.988 Color_251ACI
N054.22.45.271 E018.28.41.242 N054.22.45.495 E018.28.41.118 Color_251ACI
N054.22.44.959 E018.28.41.361 N054.22.45.271 E018.28.41.242 Color_251ACI
N054.22.42.765 E018.28.43.962 N054.22.44.959 E018.28.41.361 Color_251ACI
N054.22.42.488 E018.28.44.255 N054.22.42.765 E018.28.43.962 Color_251ACI
N054.22.42.386 E018.28.44.405 N054.22.42.488 E018.28.44.255 Color_251ACI
N054.22.42.355 E018.28.44.508 N054.22.42.386 E018.28.44.405 Color_251ACI
N054.22.42.364 E018.28.44.604 N054.22.42.355 E018.28.44.508 Color_251ACI
N054.22.42.425 E018.28.44.765 N054.22.42.364 E018.28.44.604 Color_251ACI
N054.22.42.458 E018.28.44.958 N054.22.42.425 E018.28.44.765 Color_251ACI
N054.22.42.429 E018.28.45.218 N054.22.42.458 E018.28.44.958 Color_251ACI
N054.22.42.280 E018.28.45.486 N054.22.42.429 E018.28.45.218 Color_251ACI
N054.22.41.913 E018.28.45.835 N054.22.42.280 E018.28.45.486 Color_251ACI
N054.22.41.836 E018.28.45.647 N054.22.41.913 E018.28.45.835 Color_251ACI
N054.22.50.925 E018.28.41.532 N054.22.50.967 E018.28.41.664 Color_251ACI
N054.22.50.838 E018.28.41.543 N054.22.50.925 E018.28.41.532 Color_251ACI
N054.22.50.800 E018.28.41.640 N054.22.50.838 E018.28.41.543 Color_251ACI
N054.22.50.839 E018.28.41.776 N054.22.50.800 E018.28.41.640 Color_251ACI
N054.22.50.927 E018.28.41.765 N054.22.50.839 E018.28.41.776 Color_251ACI
N054.22.50.967 E018.28.41.664 N054.22.50.927 E018.28.41.765 Color_251ACI
N054.22.58.504 E018.27.51.361 N054.22.57.689 E018.27.54.593 Color_251ACI
N054.22.58.387 E018.27.51.213 N054.22.58.504 E018.27.51.361 Color_251ACI
N054.22.58.261 E018.27.50.995 N054.22.58.387 E018.27.51.213 Color_251ACI
N054.22.58.271 E018.27.50.628 N054.22.58.261 E018.27.50.995 Color_251ACI
N054.22.59.274 E018.27.46.534 N054.22.58.271 E018.27.50.628 Color_251ACI
N054.22.59.462 E018.27.46.127 N054.22.59.274 E018.27.46.534 Color_251ACI
N054.22.59.785 E018.27.45.992 N054.22.59.462 E018.27.46.127 Color_251ACI
N054.23.00.135 E018.27.46.103 N054.22.59.785 E018.27.45.992 Color_251ACI
N054.23.01.576 E018.27.47.023 N054.23.00.135 E018.27.46.103 Color_251ACI
N054.22.54.656 E018.28.14.636 N054.23.01.576 E018.27.47.023 Color_251ACI
N054.22.54.397 E018.28.16.857 N054.22.54.656 E018.28.14.636 Color_251ACI
N054.22.54.417 E018.28.22.664 N054.22.54.397 E018.28.16.857 Color_251ACI
N054.22.52.930 E018.28.44.212 N054.22.54.417 E018.28.22.664 Color_251ACI
N054.22.51.468 E018.28.34.267 N054.22.51.652 E018.28.34.402 Color_251ACI
N054.22.51.430 E018.28.32.831 N054.22.51.468 E018.28.34.267 Color_251ACI
N054.22.50.530 E018.28.32.262 N054.22.51.430 E018.28.32.831 Color_251ACI
N054.22.50.607 E018.28.31.865 N054.22.50.530 E018.28.32.262 Color_251ACI
N054.22.50.282 E018.28.31.668 N054.22.50.607 E018.28.31.865 Color_251ACI
N054.22.50.420 E018.28.31.048 N054.22.50.282 E018.28.31.668 Color_251ACI
N054.22.50.515 E018.28.30.792 N054.22.50.420 E018.28.31.048 Color_251ACI
N054.22.50.634 E018.28.30.870 N054.22.50.515 E018.28.30.792 Color_251ACI
N054.22.50.794 E018.28.30.671 N054.22.50.634 E018.28.30.870 Color_251ACI
N054.22.52.581 E018.28.31.825 N054.22.50.794 E018.28.30.671 Color_251ACI
N054.22.52.884 E018.28.32.055 N054.22.52.581 E018.28.31.825 Color_251ACI
N054.22.53.160 E018.28.32.459 N054.22.52.884 E018.28.32.055 Color_251ACI
N054.22.53.291 E018.28.32.904 N054.22.53.160 E018.28.32.459 Color_251ACI
N054.22.53.150 E018.28.34.854 N054.22.53.291 E018.28.32.904 Color_251ACI
N054.22.52.330 E018.28.34.605 N054.22.53.150 E018.28.34.854 Color_251ACI
N054.22.50.298 E018.28.37.000 N054.22.49.871 E018.28.37.883 Color_251ACI
N054.22.50.616 E018.28.38.039 N054.22.50.298 E018.28.37.000 Color_251ACI
N054.22.50.906 E018.28.37.936 N054.22.50.616 E018.28.38.039 Color_251ACI
N054.22.51.156 E018.28.37.655 N054.22.50.906 E018.28.37.936 Color_251ACI
N054.22.51.319 E018.28.37.335 N054.22.51.156 E018.28.37.655 Color_251ACI
N054.22.51.440 E018.28.36.941 N054.22.51.319 E018.28.37.335 Color_251ACI
N054.22.51.460 E018.28.36.592 N054.22.51.440 E018.28.36.941 Color_251ACI
N054.22.51.404 E018.28.36.221 N054.22.51.460 E018.28.36.592 Color_251ACI
N054.22.51.281 E018.28.35.898 N054.22.51.404 E018.28.36.221 Color_251ACI
N054.22.46.574 E018.28.31.381 N054.22.46.329 E018.28.31.872 Color_251ACI
N054.22.46.627 E018.28.31.070 N054.22.46.574 E018.28.31.381 Color_251ACI
N054.22.46.741 E018.28.30.938 N054.22.46.627 E018.28.31.070 Color_251ACI
N054.22.46.941 E018.28.30.882 N054.22.46.741 E018.28.30.938 Color_251ACI
N054.22.47.137 E018.28.30.964 N054.22.46.941 E018.28.30.882 Color_251ACI
N054.22.47.197 E018.28.31.179 N054.22.47.137 E018.28.30.964 Color_251ACI
N054.22.47.240 E018.28.31.636 N054.22.47.197 E018.28.31.179 Color_251ACI
N054.22.46.983 E018.28.32.581 N054.22.47.240 E018.28.31.636 Color_251ACI
N054.22.46.901 E018.28.32.732 N054.22.46.983 E018.28.32.581 Color_251ACI
N054.22.46.804 E018.28.32.656 N054.22.46.901 E018.28.32.732 Color_251ACI
N054.22.46.329 E018.28.31.872 N054.22.46.804 E018.28.32.656 Color_251ACI
N054.22.49.176 E018.28.30.981 N054.22.49.238 E018.28.31.125 Color_251ACI
N054.22.48.254 E018.28.30.411 N054.22.49.176 E018.28.30.981 Color_251ACI
N054.22.48.023 E018.28.30.378 N054.22.48.254 E018.28.30.411 Color_251ACI
N054.22.47.879 E018.28.30.403 N054.22.48.023 E018.28.30.378 Color_251ACI
N054.22.47.743 E018.28.30.551 N054.22.47.879 E018.28.30.403 Color_251ACI
N054.22.47.195 E018.28.32.875 N054.22.47.743 E018.28.30.551 Color_251ACI
N054.22.47.197 E018.28.33.207 N054.22.47.195 E018.28.32.875 Color_251ACI
N054.22.47.255 E018.28.33.508 N054.22.47.197 E018.28.33.207 Color_251ACI
N054.22.47.426 E018.28.33.730 N054.22.47.255 E018.28.33.508 Color_251ACI
N054.22.47.925 E018.28.34.026 N054.22.47.426 E018.28.33.730 Color_251ACI
N054.22.47.789 E018.28.26.829 N054.22.47.617 E018.28.27.063 Color_251ACI
N054.22.47.954 E018.28.26.824 N054.22.47.789 E018.28.26.829 Color_251ACI
N054.22.48.106 E018.28.26.921 N054.22.47.954 E018.28.26.824 Color_251ACI
N054.22.48.219 E018.28.27.209 N054.22.48.106 E018.28.26.921 Color_251ACI
N054.22.48.243 E018.28.27.578 N054.22.48.219 E018.28.27.209 Color_251ACI
N054.22.47.625 E018.28.30.019 N054.22.48.243 E018.28.27.578 Color_251ACI
N054.22.47.508 E018.28.30.290 N054.22.47.625 E018.28.30.019 Color_251ACI
N054.22.47.371 E018.28.30.456 N054.22.47.508 E018.28.30.290 Color_251ACI
N054.22.47.194 E018.28.30.479 N054.22.47.371 E018.28.30.456 Color_251ACI
N054.22.47.053 E018.28.30.400 N054.22.47.194 E018.28.30.479 Color_251ACI
N054.22.46.959 E018.28.30.183 N054.22.47.053 E018.28.30.400 Color_251ACI
N054.22.46.957 E018.28.29.851 N054.22.46.959 E018.28.30.183 Color_251ACI
N054.22.47.094 E018.28.29.300 N054.22.46.957 E018.28.29.851 Color_251ACI
N054.22.47.100 E018.28.29.073 N054.22.47.094 E018.28.29.300 Color_251ACI
N054.22.48.790 E018.28.22.841 N054.22.48.641 E018.28.23.040 Color_251ACI
N054.22.48.902 E018.28.22.761 N054.22.48.790 E018.28.22.841 Color_251ACI
N054.22.49.044 E018.28.22.805 N054.22.48.902 E018.28.22.761 Color_251ACI
N054.22.49.183 E018.28.22.955 N054.22.49.044 E018.28.22.805 Color_251ACI
N054.22.49.287 E018.28.23.189 N054.22.49.183 E018.28.22.955 Color_251ACI
N054.22.49.289 E018.28.23.522 N054.22.49.287 E018.28.23.189 Color_251ACI
N054.22.48.625 E018.28.26.064 N054.22.49.289 E018.28.23.522 Color_251ACI
N054.22.48.542 E018.28.26.286 N054.22.48.625 E018.28.26.064 Color_251ACI
N054.22.48.372 E018.28.26.468 N054.22.48.542 E018.28.26.286 Color_251ACI
N054.22.48.162 E018.28.26.488 N054.22.48.372 E018.28.26.468 Color_251ACI
N054.22.48.022 E018.28.26.373 N054.22.48.162 E018.28.26.488 Color_251ACI
N054.22.47.960 E018.28.26.194 N054.22.48.022 E018.28.26.373 Color_251ACI
N054.22.47.980 E018.28.25.881 N054.22.47.960 E018.28.26.194 Color_251ACI
N054.22.47.997 E018.28.25.637 N054.22.47.980 E018.28.25.881 Color_251ACI
N054.22.49.994 E018.28.19.087 N054.22.49.874 E018.28.18.644 Color_251ACI
N054.22.50.051 E018.28.19.595 N054.22.49.994 E018.28.19.087 Color_251ACI
N054.22.50.054 E018.28.20.092 N054.22.50.051 E018.28.19.595 Color_251ACI
N054.22.49.990 E018.28.20.644 N054.22.50.054 E018.28.20.092 Color_251ACI
N054.22.49.667 E018.28.22.015 N054.22.49.990 E018.28.20.644 Color_251ACI
N054.22.49.511 E018.28.22.334 N054.22.49.667 E018.28.22.015 Color_251ACI
N054.22.49.354 E018.28.22.437 N054.22.49.511 E018.28.22.334 Color_251ACI
N054.22.49.185 E018.28.22.425 N054.22.49.354 E018.28.22.437 Color_251ACI
N054.22.49.009 E018.28.22.231 N054.22.49.185 E018.28.22.425 Color_251ACI
N054.22.48.967 E018.28.21.967 N054.22.49.009 E018.28.22.231 Color_251ACI
N054.22.49.026 E018.28.21.588 N054.22.48.967 E018.28.21.967 Color_251ACI
N054.22.53.899 E018.28.22.664 N054.22.53.916 E018.28.22.823 Color_251ACI
N054.22.53.826 E018.28.22.501 N054.22.53.899 E018.28.22.664 Color_251ACI
N054.22.53.686 E018.28.22.387 N054.22.53.826 E018.28.22.501 Color_251ACI
N054.22.53.057 E018.28.22.397 N054.22.53.686 E018.28.22.387 Color_251ACI
N054.22.52.867 E018.28.22.506 N054.22.53.057 E018.28.22.397 Color_251ACI
N054.22.52.673 E018.28.22.737 N054.22.52.867 E018.28.22.506 Color_251ACI
N054.22.52.590 E018.28.22.959 N054.22.52.673 E018.28.22.737 Color_251ACI
N054.22.52.574 E018.28.23.151 N054.22.52.590 E018.28.22.959 Color_251ACI
N054.22.52.623 E018.28.23.364 N054.22.52.574 E018.28.23.151 Color_251ACI
N054.22.52.616 E018.28.23.608 N054.22.52.623 E018.28.23.364 Color_251ACI
N054.22.52.529 E018.28.23.969 N054.22.52.616 E018.28.23.608 Color_251ACI
N054.22.51.592 E018.28.25.620 N054.22.52.529 E018.28.23.969 Color_251ACI
N054.22.50.782 E018.28.29.464 N054.22.51.592 E018.28.25.620 Color_251ACI
N054.22.50.751 E018.28.29.812 N054.22.50.782 E018.28.29.464 Color_251ACI
N054.22.50.819 E018.28.30.149 N054.22.50.751 E018.28.29.812 Color_251ACI
N054.22.51.001 E018.28.30.336 N054.22.50.819 E018.28.30.149 Color_251ACI
N054.22.52.756 E018.28.31.469 N054.22.51.001 E018.28.30.336 Color_251ACI
N054.22.52.986 E018.28.31.555 N054.22.52.756 E018.28.31.469 Color_251ACI
N054.22.53.163 E018.28.31.532 N054.22.52.986 E018.28.31.555 Color_251ACI
N054.22.53.310 E018.28.31.384 N054.22.53.163 E018.28.31.532 Color_251ACI
N054.22.53.409 E018.28.30.972 N054.22.53.310 E018.28.31.384 Color_251ACI
N054.22.53.916 E018.28.22.823 N054.22.53.409 E018.28.30.972 Color_251ACI
N054.22.49.917 E018.28.23.530 N054.22.50.121 E018.28.23.753 Color_251ACI
N054.22.49.722 E018.28.23.429 N054.22.49.917 E018.28.23.530 Color_251ACI
N054.22.49.495 E018.28.23.641 N054.22.49.722 E018.28.23.429 Color_251ACI
N054.22.48.144 E018.28.29.179 N054.22.49.495 E018.28.23.641 Color_251ACI
N054.22.48.101 E018.28.29.544 N054.22.48.144 E018.28.29.179 Color_251ACI
N054.22.48.194 E018.28.29.795 N054.22.48.101 E018.28.29.544 Color_251ACI
N054.22.48.431 E018.28.29.968 N054.22.48.194 E018.28.29.795 Color_251ACI
N054.22.49.343 E018.28.30.521 N054.22.48.431 E018.28.29.968 Color_251ACI
N054.22.49.584 E018.28.30.571 N054.22.49.343 E018.28.30.521 Color_251ACI
N054.22.49.839 E018.28.30.502 N054.22.49.584 E018.28.30.571 Color_251ACI
N054.22.50.099 E018.28.30.275 N054.22.49.839 E018.28.30.502 Color_251ACI
N054.22.50.026 E018.28.30.112 N054.22.50.099 E018.28.30.275 Color_251ACI
N054.22.49.591 E018.28.29.890 N054.22.50.026 E018.28.30.112 Color_251ACI
N054.22.50.416 E018.28.26.309 N054.22.49.591 E018.28.29.890 Color_251ACI
N054.22.50.516 E018.28.26.246 N054.22.50.416 E018.28.26.309 Color_251ACI
N054.22.50.644 E018.28.26.010 N054.22.50.516 E018.28.26.246 Color_251ACI
N054.22.50.740 E018.28.25.719 N054.22.50.644 E018.28.26.010 Color_251ACI
N054.22.50.751 E018.28.25.335 N054.22.50.740 E018.28.25.719 Color_251ACI
N054.22.50.686 E018.28.24.859 N054.22.50.751 E018.28.25.335 Color_251ACI
N054.22.50.565 E018.28.24.448 N054.22.50.686 E018.28.24.859 Color_251ACI
N054.22.50.272 E018.28.20.599 N054.22.49.827 E018.28.22.387 Color_251ACI
N054.22.50.565 E018.28.20.373 N054.22.50.272 E018.28.20.599 Color_251ACI
N054.22.50.708 E018.28.20.383 N054.22.50.565 E018.28.20.373 Color_251ACI
N054.22.50.826 E018.28.20.496 N054.22.50.708 E018.28.20.383 Color_251ACI
N054.22.51.001 E018.28.20.980 N054.22.50.826 E018.28.20.496 Color_251ACI
N054.22.51.027 E018.28.21.210 N054.22.51.001 E018.28.20.980 Color_251ACI
N054.22.50.935 E018.28.21.378 N054.22.51.027 E018.28.21.210 Color_251ACI
N054.22.49.899 E018.28.22.584 N054.22.50.935 E018.28.21.378 Color_251ACI
N054.22.49.827 E018.28.22.387 N054.22.49.899 E018.28.22.584 Color_251ACI
N054.22.53.681 E018.28.02.591 N054.22.53.643 E018.28.02.344 Color_251ACI
N054.22.53.765 E018.28.02.737 N054.22.53.681 E018.28.02.591 Color_251ACI
N054.22.53.861 E018.28.02.849 N054.22.53.765 E018.28.02.737 Color_251ACI
N054.22.56.248 E018.28.04.287 N054.22.53.861 E018.28.02.849 Color_251ACI
N054.22.56.479 E018.28.04.303 N054.22.56.248 E018.28.04.287 Color_251ACI
N054.22.56.648 E018.28.04.157 N054.22.56.479 E018.28.04.303 Color_251ACI
N054.22.56.743 E018.28.03.901 N054.22.56.648 E018.28.04.157 Color_251ACI
N054.22.57.025 E018.28.04.060 N054.22.56.743 E018.28.03.901 Color_251ACI
N054.22.59.002 E018.27.56.186 N054.22.57.025 E018.28.04.060 Color_251ACI
N054.22.59.012 E018.27.55.820 N054.22.59.002 E018.27.56.186 Color_251ACI
N054.22.58.996 E018.27.55.591 N054.22.59.012 E018.27.55.820 Color_251ACI
N054.22.58.945 E018.27.55.448 N054.22.58.996 E018.27.55.591 Color_251ACI
N054.22.58.621 E018.27.55.198 N054.22.58.945 E018.27.55.448 Color_251ACI
N054.22.51.548 E018.28.10.910 N054.22.50.151 E018.28.09.993 Color_251ACI
N054.22.51.733 E018.28.13.458 N054.22.51.548 E018.28.10.910 Color_251ACI
N054.22.51.841 E018.28.13.956 N054.22.51.733 E018.28.13.458 Color_251ACI
N054.22.51.924 E018.28.14.135 N054.22.51.841 E018.28.13.956 Color_251ACI
N054.22.52.066 E018.28.14.180 N054.22.51.924 E018.28.14.135 Color_251ACI
N054.22.52.210 E018.28.14.155 N054.22.52.066 E018.28.14.180 Color_251ACI
N054.22.52.392 E018.28.13.975 N054.22.52.210 E018.28.14.155 Color_251ACI
N054.22.52.520 E018.28.13.721 N054.22.52.392 E018.28.13.975 Color_251ACI
N054.22.52.596 E018.28.13.342 N054.22.52.520 E018.28.13.721 Color_251ACI
N054.22.52.526 E018.28.11.466 N054.22.52.596 E018.28.13.342 Color_251ACI
N054.22.52.513 E018.28.11.116 N054.22.52.526 E018.28.11.466 Color_251ACI
N054.22.52.422 E018.28.10.813 N054.22.52.513 E018.28.11.116 Color_251ACI
N054.22.52.240 E018.28.10.625 N054.22.52.422 E018.28.10.813 Color_251ACI
N054.22.52.067 E018.28.10.490 N054.22.52.240 E018.28.10.625 Color_251ACI
N054.22.51.865 E018.28.10.215 N054.22.52.067 E018.28.10.490 Color_251ACI
N054.22.51.751 E018.28.09.962 N054.22.51.865 E018.28.10.215 Color_251ACI
N054.22.51.750 E018.28.09.560 N054.22.51.751 E018.28.09.962 Color_251ACI
N054.22.53.051 E018.28.04.262 N054.22.51.750 E018.28.09.560 Color_251ACI
N054.22.53.106 E018.28.03.847 N054.22.53.051 E018.28.04.262 Color_251ACI
N054.22.53.061 E018.28.03.476 N054.22.53.106 E018.28.03.847 Color_251ACI
N054.22.52.988 E018.28.03.332 N054.22.53.061 E018.28.03.476 Color_251ACI
N054.22.50.538 E018.28.18.115 N054.22.50.375 E018.28.17.615 Color_251ACI
N054.22.50.649 E018.28.18.088 N054.22.50.538 E018.28.18.115 Color_251ACI
N054.22.50.940 E018.28.17.933 N054.22.50.649 E018.28.18.088 Color_251ACI
N054.22.51.241 E018.28.17.779 N054.22.50.940 E018.28.17.933 Color_251ACI
N054.22.51.491 E018.28.17.533 N054.22.51.241 E018.28.17.779 Color_251ACI
N054.22.51.711 E018.28.17.147 N054.22.51.491 E018.28.17.533 Color_251ACI
N054.22.51.865 E018.28.16.737 N054.22.51.711 E018.28.17.147 Color_251ACI
N054.22.51.993 E018.28.16.081 N054.22.51.865 E018.28.16.737 Color_251ACI
N054.22.51.965 E018.28.15.468 N054.22.51.993 E018.28.16.081 Color_251ACI
N054.22.51.924 E018.28.14.975 N054.22.51.965 E018.28.15.468 Color_251ACI
N054.22.51.978 E018.28.14.611 N054.22.51.924 E018.28.14.975 Color_251ACI
N054.22.52.134 E018.28.14.552 N054.22.51.978 E018.28.14.611 Color_251ACI
N054.22.52.273 E018.28.14.684 N054.22.52.134 E018.28.14.552 Color_251ACI
N054.22.52.398 E018.28.14.955 N054.22.52.273 E018.28.14.684 Color_251ACI
N054.22.52.459 E018.28.15.554 N054.22.52.398 E018.28.14.955 Color_251ACI
N054.22.52.367 E018.28.16.124 N054.22.52.459 E018.28.15.554 Color_251ACI
N054.22.52.259 E018.28.16.851 N054.22.52.367 E018.28.16.124 Color_251ACI
N054.22.52.065 E018.28.17.485 N054.22.52.259 E018.28.16.851 Color_251ACI
N054.22.51.777 E018.28.17.956 N054.22.52.065 E018.28.17.485 Color_251ACI
N054.22.50.787 E018.28.19.095 N054.22.51.777 E018.28.17.956 Color_251ACI
N054.22.50.639 E018.28.19.277 N054.22.50.787 E018.28.19.095 Color_251ACI
N054.22.50.507 E018.28.19.268 N054.22.50.639 E018.28.19.277 Color_251ACI
N054.22.50.445 E018.28.19.088 N054.22.50.507 E018.28.19.268 Color_251ACI
N054.22.50.449 E018.28.18.547 N054.22.50.445 E018.28.19.088 Color_251ACI
N054.22.50.282 E018.28.18.623 N054.22.50.449 E018.28.18.547 Color_251ACI
N054.22.50.268 E018.28.18.308 N054.22.50.282 E018.28.18.623 Color_251ACI
N054.22.45.440 E018.28.40.802 N054.22.45.487 E018.28.40.274 Color_251ACI
N054.22.45.065 E018.28.40.881 N054.22.45.440 E018.28.40.802 Color_251ACI
N054.22.44.801 E018.28.40.880 N054.22.45.065 E018.28.40.881 Color_251ACI
N054.22.44.628 E018.28.40.808 N054.22.44.801 E018.28.40.880 Color_251ACI
N054.22.44.474 E018.28.40.631 N054.22.44.628 E018.28.40.808 Color_251ACI
N054.22.44.374 E018.28.40.468 N054.22.44.474 E018.28.40.631 Color_251ACI
N054.22.44.326 E018.28.40.212 N054.22.44.374 E018.28.40.468 Color_251ACI
N054.22.44.338 E018.28.39.970 N054.22.44.326 E018.28.40.212 Color_251ACI
N054.22.44.415 E018.28.39.766 N054.22.44.338 E018.28.39.970 Color_251ACI
N054.22.44.556 E018.28.39.610 N054.22.44.415 E018.28.39.766 Color_251ACI
N054.22.44.656 E018.28.39.556 N054.22.44.556 E018.28.39.610 Color_251ACI
N054.22.45.140 E018.28.37.501 N054.22.44.656 E018.28.39.556 Color_251ACI
N054.22.45.112 E018.28.37.116 N054.22.45.140 E018.28.37.501 Color_251ACI
N054.22.45.180 E018.28.36.825 N054.22.45.112 E018.28.37.116 Color_251ACI
N054.22.45.311 E018.28.36.651 N054.22.45.180 E018.28.36.825 Color_251ACI
N054.22.45.471 E018.28.36.601 N054.22.45.311 E018.28.36.651 Color_251ACI
N054.22.45.597 E018.28.36.627 N054.22.45.471 E018.28.36.601 Color_251ACI
N054.22.45.661 E018.28.36.701 N054.22.45.597 E018.28.36.627 Color_251ACI
N054.22.45.706 E018.28.36.843 N054.22.45.661 E018.28.36.701 Color_251ACI
N054.22.45.582 E018.28.38.801 N054.22.45.706 E018.28.36.843 Color_251ACI
N054.22.56.521 E018.28.05.198 N054.22.56.640 E018.28.05.276 Color_251ACI
N054.22.55.018 E018.28.11.426 N054.22.56.521 E018.28.05.198 Color_251ACI
N054.22.55.128 E018.28.11.434 N054.22.55.018 E018.28.11.426 Color_251ACI
N054.22.56.640 E018.28.05.276 N054.22.55.128 E018.28.11.434 Color_251ACI
N054.22.56.226 E018.28.05.090 N054.22.54.753 E018.28.11.023 Color_251ACI
N054.22.55.705 E018.28.04.776 N054.22.54.233 E018.28.10.708 Color_251ACI
N054.22.55.184 E018.28.04.478 N054.22.53.712 E018.28.10.410 Color_251ACI
N054.22.54.663 E018.28.04.162 N054.22.53.191 E018.28.10.095 Color_251ACI
N054.22.54.163 E018.28.03.919 N054.22.52.691 E018.28.09.851 Color_251ACI
N054.22.53.613 E018.28.16.087 N054.22.53.515 E018.28.16.080 Color_251ACI
N054.22.53.753 E018.28.16.192 N054.22.53.613 E018.28.16.087 Color_251ACI
N054.22.53.831 E018.28.16.363 N054.22.53.753 E018.28.16.192 Color_251ACI
N054.22.53.879 E018.28.16.610 N054.22.53.831 E018.28.16.363 Color_251ACI
N054.22.53.894 E018.28.16.854 N054.22.53.879 E018.28.16.610 Color_251ACI
N054.22.53.917 E018.28.21.094 N054.22.53.894 E018.28.16.854 Color_251ACI
N054.22.53.900 E018.28.21.302 N054.22.53.917 E018.28.21.094 Color_251ACI
N054.22.53.841 E018.28.21.454 N054.22.53.900 E018.28.21.302 Color_251ACI
N054.22.53.673 E018.28.21.591 N054.22.53.841 E018.28.21.454 Color_251ACI
N054.22.53.545 E018.28.21.634 N054.22.53.673 E018.28.21.591 Color_251ACI
N054.22.52.964 E018.28.21.630 N054.22.53.545 E018.28.21.634 Color_251ACI
N054.22.52.971 E018.28.20.951 N054.22.52.964 E018.28.21.630 Color_251ACI
N054.22.52.728 E018.28.20.421 N054.22.52.971 E018.28.20.951 Color_251ACI
N054.22.48.174 E018.29.12.367 N054.22.48.588 E018.29.12.082 teal
N054.22.48.265 E018.29.12.652 N054.22.48.174 E018.29.12.367 teal
N054.22.48.091 E018.29.12.805 N054.22.48.265 E018.29.12.652 teal
N054.22.47.957 E018.29.12.509 N054.22.48.091 E018.29.12.805 teal
N054.22.45.364 E018.29.14.247 N054.22.47.957 E018.29.12.509 teal
N054.22.45.465 E018.29.14.576 N054.22.45.364 E018.29.14.247 teal
N054.22.45.241 E018.29.14.726 N054.22.45.465 E018.29.14.576 teal
N054.22.45.140 E018.29.14.415 N054.22.45.241 E018.29.14.726 teal
N054.22.44.913 E018.29.14.486 N054.22.45.140 E018.29.14.415 teal
N054.22.44.600 E018.29.14.491 N054.22.44.913 E018.29.14.486 teal
N054.22.44.277 E018.29.14.477 N054.22.44.600 E018.29.14.491 teal
N054.22.43.928 E018.29.14.410 N054.22.44.277 E018.29.14.477 teal
N054.22.43.541 E018.29.14.306 N054.22.43.928 E018.29.14.410 teal
N054.22.43.140 E018.29.14.121 N054.22.43.541 E018.29.14.306 teal
N054.22.42.718 E018.29.13.893 N054.22.43.140 E018.29.14.121 teal
N054.22.42.362 E018.29.13.678 N054.22.42.718 E018.29.13.893 teal
N054.22.42.066 E018.29.13.475 N054.22.42.362 E018.29.13.678 teal
N054.22.41.781 E018.29.13.255 N054.22.42.066 E018.29.13.475 teal
N054.22.41.669 E018.29.13.526 N054.22.41.781 E018.29.13.255 teal
N054.22.41.492 E018.29.13.375 N054.22.41.669 E018.29.13.526 teal
N054.22.41.598 E018.29.13.112 N054.22.41.492 E018.29.13.375 teal
N054.22.41.134 E018.29.12.645 N054.22.41.598 E018.29.13.112 teal
N054.22.40.706 E018.29.12.224 N054.22.41.134 E018.29.12.645 teal
N054.22.40.296 E018.29.11.787 N054.22.40.706 E018.29.12.224 teal
N054.22.39.871 E018.29.11.245 N054.22.40.296 E018.29.11.787 teal
N054.22.39.352 E018.29.10.575 N054.22.39.871 E018.29.11.245 teal
N054.22.38.814 E018.29.09.772 N054.22.39.352 E018.29.10.575 teal
N054.22.38.628 E018.29.09.943 N054.22.38.814 E018.29.09.772 teal
N054.22.38.520 E018.29.09.683 N054.22.38.628 E018.29.09.943 teal
N054.22.38.684 E018.29.09.511 N054.22.38.520 E018.29.09.683 teal
N054.22.38.155 E018.29.08.187 N054.22.38.684 E018.29.09.511 teal
N054.22.37.959 E018.29.07.695 N054.22.38.155 E018.29.08.187 teal
N054.22.37.842 E018.29.07.374 N054.22.37.959 E018.29.07.695 teal
N054.22.37.710 E018.29.06.991 N054.22.37.842 E018.29.07.374 teal
N054.22.37.616 E018.29.06.593 N054.22.37.710 E018.29.06.991 teal
N054.22.37.511 E018.29.06.238 N054.22.37.616 E018.29.06.593 teal
N054.22.37.424 E018.29.05.805 N054.22.37.511 E018.29.06.238 teal
N054.22.37.351 E018.29.05.461 N054.22.37.424 E018.29.05.805 teal
N054.22.37.274 E018.29.05.038 N054.22.37.351 E018.29.05.461 teal
N054.22.37.220 E018.29.04.590 N054.22.37.274 E018.29.05.038 teal
N054.22.37.044 E018.29.04.631 N054.22.37.220 E018.29.04.590 teal
N054.22.37.020 E018.29.04.307 N054.22.37.044 E018.29.04.631 teal
N054.22.37.186 E018.29.04.249 N054.22.37.020 E018.29.04.307 teal
N054.22.37.159 E018.29.03.820 N054.22.37.186 E018.29.04.249 teal
N054.22.37.136 E018.29.03.245 N054.22.37.159 E018.29.03.820 teal
N054.22.37.123 E018.29.02.704 N054.22.37.136 E018.29.03.245 teal
N054.22.37.125 E018.29.02.243 N054.22.37.123 E018.29.02.704 teal
N054.22.37.130 E018.29.01.843 N054.22.37.125 E018.29.02.243 teal
N054.22.37.162 E018.29.01.471 N054.22.37.130 E018.29.01.843 teal
N054.22.37.197 E018.29.01.004 N054.22.37.162 E018.29.01.471 teal
N054.22.37.253 E018.29.00.529 N054.22.37.197 E018.29.01.004 teal
N054.22.37.310 E018.29.00.063 N054.22.37.253 E018.29.00.529 teal
N054.22.37.383 E018.28.59.589 N054.22.37.310 E018.29.00.063 teal
N054.22.37.478 E018.28.59.135 N054.22.37.383 E018.28.59.589 teal
N054.22.37.541 E018.28.58.834 N054.22.37.478 E018.28.59.135 teal
N054.22.37.384 E018.28.58.736 N054.22.37.541 E018.28.58.834 teal
N054.22.37.458 E018.28.58.437 N054.22.37.384 E018.28.58.736 teal
N054.22.37.615 E018.28.58.509 N054.22.37.458 E018.28.58.437 teal
N054.22.38.920 E018.28.53.481 N054.22.37.615 E018.28.58.509 teal
N054.22.38.709 E018.28.53.362 N054.22.38.920 E018.28.53.481 teal
N054.22.38.794 E018.28.53.072 N054.22.38.709 E018.28.53.362 teal
N054.22.38.988 E018.28.53.190 N054.22.38.794 E018.28.53.072 teal
N054.22.40.248 E018.28.48.193 N054.22.38.988 E018.28.53.190 teal
N054.22.40.065 E018.28.48.068 N054.22.40.248 E018.28.48.193 teal
N054.22.40.149 E018.28.47.778 N054.22.40.065 E018.28.48.068 teal
N054.22.40.317 E018.28.47.875 N054.22.40.149 E018.28.47.778 teal
N054.22.41.599 E018.28.42.873 N054.22.40.317 E018.28.47.875 teal
N054.22.41.405 E018.28.42.738 N054.22.41.599 E018.28.42.873 teal
N054.22.41.483 E018.28.42.464 N054.22.41.405 E018.28.42.738 teal
N054.22.41.672 E018.28.42.581 N054.22.41.483 E018.28.42.464 teal
N054.22.42.295 E018.28.40.257 N054.22.41.672 E018.28.42.581 teal
N054.22.42.112 E018.28.40.123 N054.22.42.295 E018.28.40.257 teal
N054.22.42.192 E018.28.39.788 N054.22.42.112 E018.28.40.123 teal
N054.22.42.779 E018.28.40.186 N054.22.42.192 E018.28.39.788 teal
N054.22.42.683 E018.28.40.492 N054.22.42.779 E018.28.40.186 teal
N054.22.42.478 E018.28.40.366 N054.22.42.683 E018.28.40.492 teal
N054.22.41.867 E018.28.42.673 N054.22.42.478 E018.28.40.366 teal
N054.22.42.034 E018.28.42.806 N054.22.41.867 E018.28.42.673 teal
N054.22.41.971 E018.28.43.081 N054.22.42.034 E018.28.42.806 teal
N054.22.41.782 E018.28.42.972 N054.22.41.971 E018.28.43.081 teal
N054.22.40.483 E018.28.48.001 N054.22.41.782 E018.28.42.972 teal
N054.22.40.678 E018.28.48.118 N054.22.40.483 E018.28.48.001 teal
N054.22.40.604 E018.28.48.400 N054.22.40.678 E018.28.48.118 teal
N054.22.40.431 E018.28.48.301 N054.22.40.604 E018.28.48.400 teal
N054.22.39.194 E018.28.53.281 N054.22.40.431 E018.28.48.301 teal
N054.22.39.372 E018.28.53.398 N054.22.39.194 E018.28.53.281 teal
N054.22.39.286 E018.28.53.723 N054.22.39.372 E018.28.53.398 teal
N054.22.39.114 E018.28.53.607 N054.22.39.286 E018.28.53.723 teal
N054.22.37.799 E018.28.58.608 N054.22.39.114 E018.28.53.607 teal
N054.22.38.032 E018.28.58.737 N054.22.37.799 E018.28.58.608 teal
N054.22.37.963 E018.28.59.054 N054.22.38.032 E018.28.58.737 teal
N054.22.37.741 E018.28.58.943 N054.22.37.963 E018.28.59.054 teal
N054.22.37.643 E018.28.59.328 N054.22.37.741 E018.28.58.943 teal
N054.22.37.553 E018.28.59.792 N054.22.37.643 E018.28.59.328 teal
N054.22.37.446 E018.29.00.498 N054.22.37.553 E018.28.59.792 teal
N054.22.37.387 E018.29.01.069 N054.22.37.446 E018.29.00.498 teal
N054.22.37.351 E018.29.01.606 N054.22.37.387 E018.29.01.069 teal
N054.22.37.319 E018.29.02.169 N054.22.37.351 E018.29.01.606 teal
N054.22.37.328 E018.29.02.840 N054.22.37.319 E018.29.02.169 teal
N054.22.37.349 E018.29.03.477 N054.22.37.328 E018.29.02.840 teal
N054.22.37.401 E018.29.04.203 N054.22.37.349 E018.29.03.477 teal
N054.22.37.649 E018.29.04.150 N054.22.37.401 E018.29.04.203 teal
N054.22.37.685 E018.29.04.457 N054.22.37.649 E018.29.04.150 teal
N054.22.37.436 E018.29.04.527 N054.22.37.685 E018.29.04.457 teal
N054.22.37.475 E018.29.04.930 N054.22.37.436 E018.29.04.527 teal
N054.22.37.538 E018.29.05.422 N054.22.37.475 E018.29.04.930 teal
N054.22.37.654 E018.29.06.021 N054.22.37.538 E018.29.05.422 teal
N054.22.37.848 E018.29.06.748 N054.22.37.654 E018.29.06.021 teal
N054.22.38.088 E018.29.07.417 N054.22.37.848 E018.29.06.748 teal
N054.22.38.386 E018.29.08.168 N054.22.38.088 E018.29.07.417 teal
N054.22.38.859 E018.29.09.306 N054.22.38.386 E018.29.08.168 teal
N054.22.39.074 E018.29.09.086 N054.22.38.859 E018.29.09.306 teal
N054.22.39.187 E018.29.09.354 N054.22.39.074 E018.29.09.086 teal
N054.22.38.983 E018.29.09.592 N054.22.39.187 E018.29.09.354 teal
N054.22.39.495 E018.29.10.341 N054.22.38.983 E018.29.09.592 teal
N054.22.39.988 E018.29.10.983 N054.22.39.495 E018.29.10.341 teal
N054.22.40.424 E018.29.11.518 N054.22.39.988 E018.29.10.983 teal
N054.22.40.807 E018.29.11.953 N054.22.40.424 E018.29.11.518 teal
N054.22.41.255 E018.29.12.410 N054.22.40.807 E018.29.11.953 teal
N054.22.41.711 E018.29.12.807 N054.22.41.255 E018.29.12.410 teal
N054.22.41.834 E018.29.12.501 N054.22.41.711 E018.29.12.807 teal
N054.22.41.990 E018.29.12.643 N054.22.41.834 E018.29.12.501 teal
N054.22.41.870 E018.29.12.991 N054.22.41.990 E018.29.12.643 teal
N054.22.42.155 E018.29.13.202 N054.22.41.870 E018.29.12.991 teal
N054.22.42.505 E018.29.13.452 N054.22.42.155 E018.29.13.202 teal
N054.22.42.878 E018.29.13.678 N054.22.42.505 E018.29.13.452 teal
N054.22.43.387 E018.29.13.921 N054.22.42.878 E018.29.13.678 teal
N054.22.43.772 E018.29.14.069 N054.22.43.387 E018.29.13.921 teal
N054.22.44.176 E018.29.14.166 N054.22.43.772 E018.29.14.069 teal
N054.22.44.586 E018.29.14.212 N054.22.44.176 E018.29.14.166 teal
N054.22.44.866 E018.29.14.196 N054.22.44.586 E018.29.14.212 teal
N054.22.45.061 E018.29.14.087 N054.22.44.866 E018.29.14.196 teal
N054.22.44.942 E018.29.13.818 N054.22.45.061 E018.29.14.087 teal
N054.22.45.128 E018.29.13.630 N054.22.44.942 E018.29.13.818 teal
N054.22.45.268 E018.29.13.953 N054.22.45.128 E018.29.13.630 teal
N054.22.47.855 E018.29.12.197 N054.22.45.268 E018.29.13.953 teal
N054.22.47.759 E018.29.11.904 N054.22.47.855 E018.29.12.197 teal
N054.22.47.938 E018.29.11.759 N054.22.47.759 E018.29.11.904 teal
N054.22.48.067 E018.29.12.081 N054.22.47.938 E018.29.11.759 teal
N054.22.48.513 E018.29.11.785 N054.22.48.067 E018.29.12.081 teal
N054.22.53.196 E018.28.15.902 N054.22.53.504 E018.28.16.071 maroon
N054.22.53.130 E018.28.15.880 N054.22.53.196 E018.28.15.902 maroon
N054.22.53.064 E018.28.15.919 N054.22.53.130 E018.28.15.880 maroon
N054.22.52.758 E018.28.16.247 N054.22.53.064 E018.28.15.919 maroon
N054.22.52.947 E018.28.18.009 N054.22.52.758 E018.28.16.247 maroon
N054.22.52.975 E018.28.18.184 N054.22.52.947 E018.28.18.009 maroon
N054.22.52.964 E018.28.18.401 N054.22.52.975 E018.28.18.184 maroon
N054.22.52.892 E018.28.18.597 N054.22.52.964 E018.28.18.401 maroon
N054.22.52.817 E018.28.18.748 N054.22.52.892 E018.28.18.597 maroon
N054.22.51.850 E018.28.20.005 N054.22.52.817 E018.28.18.748 maroon
N054.22.51.890 E018.28.20.556 N054.22.51.850 E018.28.20.005 maroon
N054.22.51.926 E018.28.20.672 N054.22.51.890 E018.28.20.556 maroon
N054.22.51.973 E018.28.20.735 N054.22.51.926 E018.28.20.672 maroon
N054.22.52.331 E018.28.20.882 N054.22.51.973 E018.28.20.735 maroon
N054.22.53.754 E018.28.19.177 N054.22.52.331 E018.28.20.882 maroon
N054.22.53.779 E018.28.19.083 N054.22.53.754 E018.28.19.177 maroon
N054.22.53.776 E018.28.18.978 N054.22.53.779 E018.28.19.083 maroon
N054.22.53.504 E018.28.16.071 N054.22.53.776 E018.28.18.978 maroon
N054.22.52.909 E018.28.22.026 N054.22.52.486 E018.28.21.057 maroon
N054.22.52.581 E018.28.22.404 N054.22.52.909 E018.28.22.026 maroon
N054.22.52.220 E018.28.22.154 N054.22.52.581 E018.28.22.404 maroon
N054.22.52.076 E018.28.21.804 N054.22.52.220 E018.28.22.154 maroon
N054.22.51.941 E018.28.21.734 N054.22.52.076 E018.28.21.804 maroon
N054.22.51.750 E018.28.21.904 N054.22.51.941 E018.28.21.734 maroon
N054.22.51.276 E018.28.20.949 N054.22.51.750 E018.28.21.904 maroon
N054.22.51.609 E018.28.20.606 N054.22.51.276 E018.28.20.949 maroon
N054.22.52.015 E018.28.20.826 N054.22.51.609 E018.28.20.606 maroon
N054.22.52.127 E018.28.21.146 N054.22.52.015 E018.28.20.826 maroon
N054.22.52.294 E018.28.21.236 N054.22.52.127 E018.28.21.146 maroon
N054.22.52.486 E018.28.21.057 N054.22.52.294 E018.28.21.236 maroon
N054.22.51.906 E018.28.22.193 N054.22.51.942 E018.28.22.700 maroon
N054.22.51.871 E018.28.22.086 N054.22.51.906 E018.28.22.193 maroon
N054.22.51.818 E018.28.22.030 N054.22.51.871 E018.28.22.086 maroon
N054.22.51.546 E018.28.21.916 N054.22.51.818 E018.28.22.030 maroon
N054.22.50.103 E018.28.23.767 N054.22.51.546 E018.28.21.916 maroon
N054.22.50.099 E018.28.24.306 N054.22.50.103 E018.28.23.767 maroon
N054.22.50.135 E018.28.24.387 N054.22.50.099 E018.28.24.306 maroon
N054.22.50.173 E018.28.24.433 N054.22.50.135 E018.28.24.387 maroon
N054.22.50.482 E018.28.24.550 N054.22.50.173 E018.28.24.433 maroon
N054.22.51.942 E018.28.22.700 N054.22.50.482 E018.28.24.550 maroon
N054.22.49.383 E018.28.26.642 N054.22.49.672 E018.28.25.513 maroon
N054.22.49.783 E018.28.26.887 N054.22.49.383 E018.28.26.642 maroon
N054.22.49.746 E018.28.27.015 N054.22.49.783 E018.28.26.887 maroon
N054.22.49.616 E018.28.26.945 N054.22.49.746 E018.28.27.015 maroon
N054.22.49.531 E018.28.27.270 N054.22.49.616 E018.28.26.945 maroon
N054.22.49.569 E018.28.27.290 N054.22.49.531 E018.28.27.270 maroon
N054.22.48.995 E018.28.29.626 N054.22.49.569 E018.28.27.290 maroon
N054.22.49.374 E018.28.29.818 N054.22.48.995 E018.28.29.626 maroon
N054.22.50.368 E018.28.25.943 N054.22.49.374 E018.28.29.818 maroon
N054.22.49.672 E018.28.25.513 N054.22.50.368 E018.28.25.943 maroon
N054.22.50.307 E018.28.31.648 N054.22.50.443 E018.28.31.065 maroon
N054.22.50.528 E018.28.31.793 N054.22.50.307 E018.28.31.648 maroon
N054.22.50.570 E018.28.31.648 N054.22.50.528 E018.28.31.793 maroon
N054.22.50.743 E018.28.31.747 N054.22.50.570 E018.28.31.648 maroon
N054.22.50.837 E018.28.31.310 N054.22.50.743 E018.28.31.747 maroon
N054.22.50.443 E018.28.31.065 N054.22.50.837 E018.28.31.310 maroon
N054.22.52.373 E018.28.33.985 N054.22.52.335 E018.28.34.603 maroon
N054.22.51.721 E018.28.33.790 N054.22.52.373 E018.28.33.985 maroon
N054.22.51.653 E018.28.34.406 N054.22.51.721 E018.28.33.790 maroon
N054.22.52.335 E018.28.34.603 N054.22.51.653 E018.28.34.406 maroon
N054.22.49.665 E018.28.31.456 N054.22.49.679 E018.28.31.953 maroon
N054.22.49.630 E018.28.31.323 N054.22.49.665 E018.28.31.456 maroon
N054.22.49.560 E018.28.31.258 N054.22.49.630 E018.28.31.323 maroon
N054.22.49.229 E018.28.31.131 N054.22.49.560 E018.28.31.258 maroon
N054.22.47.832 E018.28.32.898 N054.22.49.229 E018.28.31.131 maroon
N054.22.48.070 E018.28.35.638 N054.22.47.832 E018.28.32.898 maroon
N054.22.48.418 E018.28.35.966 N054.22.48.070 E018.28.35.638 maroon
N054.22.48.510 E018.28.36.015 N054.22.48.418 E018.28.35.966 maroon
N054.22.48.583 E018.28.35.951 N054.22.48.510 E018.28.36.015 maroon
N054.22.48.803 E018.28.35.522 N054.22.48.583 E018.28.35.951 maroon
N054.22.48.616 E018.28.33.317 N054.22.48.803 E018.28.35.522 maroon
N054.22.49.679 E018.28.31.953 N054.22.48.616 E018.28.33.317 maroon
N054.22.51.323 E018.28.35.850 N054.22.51.090 E018.28.35.330 maroon
N054.22.50.272 E018.28.36.988 N054.22.51.323 E018.28.35.850 maroon
N054.22.50.433 E018.28.37.313 N054.22.50.272 E018.28.36.988 maroon
N054.22.49.778 E018.28.37.999 N054.22.50.433 E018.28.37.313 maroon
N054.22.49.396 E018.28.37.137 N054.22.49.778 E018.28.37.999 maroon
N054.22.50.008 E018.28.36.404 N054.22.49.396 E018.28.37.137 maroon
N054.22.50.055 E018.28.36.504 N054.22.50.008 E018.28.36.404 maroon
N054.22.51.090 E018.28.35.330 N054.22.50.055 E018.28.36.504 maroon
N054.22.50.042 E018.28.41.837 N054.22.50.149 E018.28.41.940 maroon
N054.22.49.916 E018.28.41.829 N054.22.50.042 E018.28.41.837 maroon
N054.22.49.805 E018.28.41.891 N054.22.49.916 E018.28.41.829 maroon
N054.22.49.686 E018.28.42.022 N054.22.49.805 E018.28.41.891 maroon
N054.22.49.637 E018.28.42.219 N054.22.49.686 E018.28.42.022 maroon
N054.22.49.631 E018.28.42.427 N054.22.49.637 E018.28.42.219 maroon
N054.22.49.675 E018.28.42.621 N054.22.49.631 E018.28.42.427 maroon
N054.22.49.738 E018.28.42.748 N054.22.49.675 E018.28.42.621 maroon
N054.22.49.818 E018.28.42.831 N054.22.49.738 E018.28.42.748 maroon
N054.22.49.954 E018.28.42.858 N054.22.49.818 E018.28.42.831 maroon
N054.22.50.059 E018.28.42.839 N054.22.49.954 E018.28.42.858 maroon
N054.22.50.161 E018.28.42.715 N054.22.50.059 E018.28.42.839 maroon
N054.22.50.236 E018.28.42.572 N054.22.50.161 E018.28.42.715 maroon
N054.22.50.265 E018.28.42.314 N054.22.50.236 E018.28.42.572 maroon
N054.22.50.232 E018.28.42.111 N054.22.50.265 E018.28.42.314 maroon
N054.22.50.149 E018.28.41.940 N054.22.50.232 E018.28.42.111 maroon
N054.22.49.479 E018.28.42.373 N054.22.49.636 E018.28.42.471 maroon
N054.22.49.545 E018.28.41.777 N054.22.49.479 E018.28.42.373 maroon
N054.22.49.654 E018.28.41.576 N054.22.49.545 E018.28.41.777 maroon
N054.22.49.824 E018.28.40.587 N054.22.49.654 E018.28.41.576 maroon
N054.22.50.332 E018.28.40.847 N054.22.49.824 E018.28.40.587 maroon
N054.22.50.149 E018.28.41.931 N054.22.50.332 E018.28.40.847 maroon
N054.22.50.480 E018.28.42.502 N054.22.50.256 E018.28.42.234 maroon
N054.22.51.261 E018.28.42.825 N054.22.50.480 E018.28.42.502 maroon
N054.22.51.035 E018.28.43.671 N054.22.51.261 E018.28.42.825 maroon
N054.22.49.764 E018.28.43.010 N054.22.51.035 E018.28.43.671 maroon
N054.22.49.834 E018.28.42.850 N054.22.49.764 E018.28.43.010 maroon
N054.22.50.937 E018.28.44.790 N054.22.50.877 E018.28.43.886 maroon
N054.22.50.564 E018.28.44.843 N054.22.50.937 E018.28.44.790 maroon
N054.22.50.509 E018.28.43.938 N054.22.50.564 E018.28.44.843 maroon
N054.22.50.877 E018.28.43.886 N054.22.50.509 E018.28.43.938 maroon
N054.22.46.845 E018.28.37.921 N054.22.49.308 E018.28.38.750 maroon
N054.22.46.698 E018.28.38.894 N054.22.46.845 E018.28.37.921 maroon
N054.22.47.335 E018.28.39.095 N054.22.46.698 E018.28.38.894 maroon
N054.22.46.806 E018.28.43.436 N054.22.47.335 E018.28.39.095 maroon
N054.22.47.922 E018.28.43.773 N054.22.46.806 E018.28.43.436 maroon
N054.22.48.427 E018.28.39.473 N054.22.47.922 E018.28.43.773 maroon
N054.22.49.195 E018.28.39.700 N054.22.48.427 E018.28.39.473 maroon
N054.22.49.308 E018.28.38.750 N054.22.49.195 E018.28.39.700 maroon
N054.22.45.782 E018.28.40.328 N054.22.45.908 E018.28.38.864 maroon
N054.22.44.941 E018.28.40.185 N054.22.45.782 E018.28.40.328 maroon
N054.22.45.021 E018.28.39.229 N054.22.44.941 E018.28.40.185 maroon
N054.22.45.499 E018.28.39.331 N054.22.45.021 E018.28.39.229 maroon
N054.22.45.557 E018.28.38.787 N054.22.45.499 E018.28.39.331 maroon
N054.22.45.908 E018.28.38.864 N054.22.45.557 E018.28.38.787 maroon
N054.22.44.141 E018.28.34.065 N054.22.44.947 E018.28.31.031 maroon
N054.22.42.405 E018.28.32.920 N054.22.44.141 E018.28.34.065 maroon
N054.22.43.201 E018.28.29.885 N054.22.42.405 E018.28.32.920 maroon
N054.22.44.947 E018.28.31.031 N054.22.43.201 E018.28.29.885 maroon
N054.22.24.846 E018.29.41.020 N054.22.25.515 E018.29.41.465 maroon
N054.22.24.688 E018.29.41.618 N054.22.24.846 E018.29.41.020 maroon
N054.22.25.033 E018.29.41.833 N054.22.24.688 E018.29.41.618 maroon
N054.22.24.917 E018.29.42.278 N054.22.25.033 E018.29.41.833 maroon
N054.22.25.268 E018.29.42.475 N054.22.24.917 E018.29.42.278 maroon
N054.22.25.515 E018.29.41.465 N054.22.25.268 E018.29.42.475 maroon
N054.22.27.451 E018.29.31.755 N054.22.27.924 E018.29.32.118 maroon
N054.22.26.926 E018.29.33.512 N054.22.27.451 E018.29.31.755 maroon
N054.22.26.334 E018.29.33.098 N054.22.26.926 E018.29.33.512 maroon
N054.22.25.766 E018.29.35.200 N054.22.26.334 E018.29.33.098 maroon
N054.22.26.849 E018.29.35.934 N054.22.25.766 E018.29.35.200 maroon
N054.22.27.924 E018.29.32.118 N054.22.26.849 E018.29.35.934 maroon
N054.22.28.307 E018.29.26.855 N054.22.28.678 E018.29.27.075 maroon
N054.22.28.051 E018.29.27.971 N054.22.28.307 E018.29.26.855 maroon
N054.22.27.960 E018.29.27.913 N054.22.28.051 E018.29.27.971 maroon
N054.22.27.717 E018.29.28.871 N054.22.27.960 E018.29.27.913 maroon
N054.22.27.826 E018.29.28.930 N054.22.27.717 E018.29.28.871 maroon
N054.22.27.561 E018.29.29.925 N054.22.27.826 E018.29.28.930 maroon
N054.22.27.876 E018.29.30.127 N054.22.27.561 E018.29.29.925 maroon
N054.22.28.144 E018.29.29.137 N054.22.27.876 E018.29.30.127 maroon
N054.22.28.118 E018.29.29.109 N054.22.28.144 E018.29.29.137 maroon
N054.22.28.361 E018.29.28.148 N054.22.28.118 E018.29.29.109 maroon
N054.22.28.417 E018.29.28.182 N054.22.28.361 E018.29.28.148 maroon
N054.22.28.678 E018.29.27.075 N054.22.28.417 E018.29.28.182 maroon
N054.22.30.688 E018.29.17.571 N054.22.31.489 E018.29.18.069 maroon
N054.22.30.549 E018.29.18.087 N054.22.30.688 E018.29.17.571 maroon
N054.22.31.361 E018.29.18.590 N054.22.30.549 E018.29.18.087 maroon
N054.22.31.489 E018.29.18.069 N054.22.31.361 E018.29.18.590 maroon
N054.22.30.929 E018.29.16.570 N054.22.31.731 E018.29.17.068 maroon
N054.22.30.790 E018.29.17.086 N054.22.30.929 E018.29.16.570 maroon
N054.22.31.603 E018.29.17.590 N054.22.30.790 E018.29.17.086 maroon
N054.22.31.731 E018.29.17.068 N054.22.31.603 E018.29.17.590 maroon
N054.22.32.417 E018.29.09.907 N054.22.33.169 E018.29.10.573 maroon
N054.22.32.235 E018.29.10.388 N054.22.32.417 E018.29.09.907 maroon
N054.22.32.997 E018.29.11.062 N054.22.32.235 E018.29.10.388 maroon
N054.22.33.169 E018.29.10.573 N054.22.32.997 E018.29.11.062 maroon
N054.22.32.023 E018.29.15.618 N054.22.31.746 E018.29.16.604 maroon
N054.22.31.660 E018.29.15.370 N054.22.32.023 E018.29.15.618 maroon
N054.22.31.537 E018.29.15.775 N054.22.31.660 E018.29.15.370 maroon
N054.22.31.146 E018.29.15.498 N054.22.31.537 E018.29.15.775 maroon
N054.22.30.964 E018.29.16.090 N054.22.31.146 E018.29.15.498 maroon
N054.22.31.746 E018.29.16.604 N054.22.30.964 E018.29.16.090 maroon
N054.22.58.636 E018.27.55.190 N054.22.55.975 E018.27.53.474 maroon
N054.22.56.395 E018.28.04.111 N054.22.58.636 E018.27.55.190 maroon
N054.22.53.730 E018.28.02.433 N054.22.56.395 E018.28.04.111 maroon
N054.22.53.768 E018.28.02.235 N054.22.53.730 E018.28.02.433 maroon
N054.22.53.314 E018.28.01.979 N054.22.53.768 E018.28.02.235 maroon
N054.22.52.961 E018.28.03.477 N054.22.53.314 E018.28.01.979 maroon
N054.22.53.037 E018.28.03.509 N054.22.52.961 E018.28.03.477 maroon
N054.22.52.857 E018.28.04.689 N054.22.53.037 E018.28.03.509 maroon
N054.22.52.715 E018.28.04.679 N054.22.52.857 E018.28.04.689 maroon
N054.22.52.710 E018.28.04.853 N054.22.52.715 E018.28.04.679 maroon
N054.22.52.686 E018.28.05.112 N054.22.52.710 E018.28.04.853 maroon
N054.22.52.631 E018.28.05.534 N054.22.52.686 E018.28.05.112 maroon
N054.22.52.560 E018.28.05.922 N054.22.52.631 E018.28.05.534 maroon
N054.22.52.307 E018.28.06.966 N054.22.52.560 E018.28.05.922 maroon
N054.22.52.208 E018.28.07.394 N054.22.52.307 E018.28.06.966 maroon
N054.22.52.095 E018.28.07.726 N054.22.52.208 E018.28.07.394 maroon
N054.22.51.953 E018.28.08.090 N054.22.52.095 E018.28.07.726 maroon
N054.22.51.832 E018.28.08.317 N054.22.51.953 E018.28.08.090 maroon
N054.22.51.950 E018.28.08.412 N054.22.51.832 E018.28.08.317 maroon
N054.22.51.553 E018.28.09.499 N054.22.51.950 E018.28.08.412 maroon
N054.22.51.256 E018.28.09.330 N054.22.51.553 E018.28.09.499 maroon
N054.22.51.182 E018.28.09.613 N054.22.51.256 E018.28.09.330 maroon
N054.22.50.977 E018.28.09.512 N054.22.51.182 E018.28.09.613 maroon
N054.22.50.871 E018.28.09.965 N054.22.50.977 E018.28.09.512 maroon
N054.22.50.643 E018.28.09.872 N054.22.50.871 E018.28.09.965 maroon
N054.22.50.586 E018.28.10.147 N054.22.50.643 E018.28.09.872 maroon
N054.22.50.353 E018.28.10.052 N054.22.50.586 E018.28.10.147 maroon
N054.22.50.407 E018.28.09.691 N054.22.50.353 E018.28.10.052 maroon
N054.22.50.234 E018.28.09.583 N054.22.50.407 E018.28.09.691 maroon
N054.22.51.005 E018.28.06.825 N054.22.50.234 E018.28.09.583 maroon
N054.22.50.757 E018.28.06.678 N054.22.51.005 E018.28.06.825 maroon
N054.22.51.136 E018.28.05.241 N054.22.50.757 E018.28.06.678 maroon
N054.22.51.363 E018.28.05.378 N054.22.51.136 E018.28.05.241 maroon
N054.22.51.706 E018.28.04.053 N054.22.51.363 E018.28.05.378 maroon
N054.22.51.555 E018.28.03.938 N054.22.51.706 E018.28.04.053 maroon
N054.22.51.948 E018.28.02.408 N054.22.51.555 E018.28.03.938 maroon
N054.22.52.570 E018.28.02.737 N054.22.51.948 E018.28.02.408 maroon
N054.22.52.535 E018.28.03.022 N054.22.52.570 E018.28.02.737 maroon
N054.22.52.724 E018.28.03.130 N054.22.52.535 E018.28.03.022 maroon
N054.22.52.678 E018.28.03.380 N054.22.52.724 E018.28.03.130 maroon
N054.22.52.711 E018.28.03.399 N054.22.52.678 E018.28.03.380 maroon
N054.22.53.173 E018.28.01.525 N054.22.52.711 E018.28.03.399 maroon
N054.22.53.837 E018.28.01.926 N054.22.53.173 E018.28.01.525 maroon
N054.22.53.861 E018.28.01.833 N054.22.53.837 E018.28.01.926 maroon
N054.22.53.409 E018.28.01.532 N054.22.53.861 E018.28.01.833 maroon
N054.22.53.391 E018.28.01.575 N054.22.53.409 E018.28.01.532 maroon
N054.22.53.078 E018.28.01.379 N054.22.53.391 E018.28.01.575 maroon
N054.22.53.188 E018.28.00.978 N054.22.53.078 E018.28.01.379 maroon
N054.22.53.485 E018.28.01.163 N054.22.53.188 E018.28.00.978 maroon
N054.22.53.466 E018.28.01.232 N054.22.53.485 E018.28.01.163 maroon
N054.22.53.946 E018.28.01.542 N054.22.53.466 E018.28.01.232 maroon
N054.22.54.395 E018.27.59.755 N054.22.53.946 E018.28.01.542 maroon
N054.22.53.958 E018.27.59.464 N054.22.54.395 E018.27.59.755 maroon
N054.22.53.940 E018.27.59.524 N054.22.53.958 E018.27.59.464 maroon
N054.22.53.584 E018.27.59.307 N054.22.53.940 E018.27.59.524 maroon
N054.22.53.700 E018.27.58.872 N054.22.53.584 E018.27.59.307 maroon
N054.22.54.045 E018.27.59.096 N054.22.53.700 E018.27.58.872 maroon
N054.22.54.021 E018.27.59.163 N054.22.54.045 E018.27.59.096 maroon
N054.22.54.475 E018.27.59.447 N054.22.54.021 E018.27.59.163 maroon
N054.22.54.924 E018.27.57.623 N054.22.54.475 E018.27.59.447 maroon
N054.22.54.418 E018.27.57.293 N054.22.54.924 E018.27.57.623 maroon
N054.22.54.399 E018.27.57.371 N054.22.54.418 E018.27.57.293 maroon
N054.22.54.118 E018.27.57.194 N054.22.54.399 E018.27.57.371 maroon
N054.22.54.217 E018.27.56.792 N054.22.54.118 E018.27.57.194 maroon
N054.22.54.498 E018.27.56.959 N054.22.54.217 E018.27.56.792 maroon
N054.22.54.491 E018.27.57.011 N054.22.54.498 E018.27.56.959 maroon
N054.22.54.993 E018.27.57.324 N054.22.54.491 E018.27.57.011 maroon
N054.22.55.441 E018.27.55.553 N054.22.54.993 E018.27.57.324 maroon
N054.22.54.988 E018.27.55.253 N054.22.55.441 E018.27.55.553 maroon
N054.22.54.965 E018.27.55.321 N054.22.54.988 E018.27.55.253 maroon
N054.22.54.641 E018.27.55.115 N054.22.54.965 E018.27.55.321 maroon
N054.22.54.752 E018.27.54.662 N054.22.54.641 E018.27.55.115 maroon
N054.22.55.081 E018.27.54.867 N054.22.54.752 E018.27.54.662 maroon
N054.22.55.063 E018.27.54.936 N054.22.55.081 E018.27.54.867 maroon
N054.22.55.522 E018.27.55.211 N054.22.55.063 E018.27.54.936 maroon
N054.22.55.975 E018.27.53.474 N054.22.55.522 E018.27.55.211 maroon
N054.22.17.360 E018.29.25.981 N054.22.17.462 E018.29.25.516 olive
N054.22.17.305 E018.29.26.432 N054.22.17.360 E018.29.25.981 olive
N054.22.17.293 E018.29.27.270 N054.22.17.305 E018.29.26.432 olive
N054.22.17.382 E018.29.28.029 N054.22.17.293 E018.29.27.270 olive
N054.22.17.548 E018.29.28.827 N054.22.17.382 E018.29.28.029 olive
N054.22.17.756 E018.29.29.715 N054.22.17.548 E018.29.28.827 olive
N054.22.17.979 E018.29.30.412 N054.22.17.756 E018.29.29.715 olive
N054.22.18.355 E018.29.31.207 N054.22.17.979 E018.29.30.412 olive
N054.22.18.808 E018.29.31.972 N054.22.18.355 E018.29.31.207 olive
N054.22.19.224 E018.29.32.473 N054.22.18.808 E018.29.31.972 olive
N054.22.19.720 E018.29.32.909 N054.22.19.224 E018.29.32.473 olive
N054.22.20.033 E018.29.33.158 N054.22.19.720 E018.29.32.909 olive
N054.22.20.488 E018.29.33.396 N054.22.20.033 E018.29.33.158 olive
N054.22.20.821 E018.29.33.462 N054.22.20.488 E018.29.33.396 olive
N054.22.21.087 E018.29.33.376 N054.22.20.821 E018.29.33.462 olive
N054.22.21.403 E018.29.33.249 N054.22.21.087 E018.29.33.376 olive
N054.22.21.688 E018.29.33.034 N054.22.21.403 E018.29.33.249 olive
N054.22.21.936 E018.29.32.799 N054.22.21.688 E018.29.33.034 olive
N054.22.22.169 E018.29.32.501 N054.22.21.936 E018.29.32.799 olive
N054.22.22.389 E018.29.32.089 N054.22.22.169 E018.29.32.501 olive
N054.22.22.625 E018.29.31.453 N054.22.22.389 E018.29.32.089 olive
N054.22.53.890 E018.27.27.527 N054.22.22.625 E018.29.31.453 olive
N054.22.54.033 E018.27.26.732 N054.22.53.890 E018.27.27.527 olive
N054.22.54.070 E018.27.26.175 N054.22.54.033 E018.27.26.732 olive
N054.22.54.051 E018.27.25.667 N054.22.54.070 E018.27.26.175 olive
N054.22.53.934 E018.27.25.099 N054.22.54.051 E018.27.25.667 olive
N054.22.53.758 E018.27.24.650 N054.22.53.934 E018.27.25.099 olive
N054.22.53.548 E018.27.24.269 N054.22.53.758 E018.27.24.650 olive
N054.22.53.293 E018.27.23.919 N054.22.53.548 E018.27.24.269 olive
N054.22.52.906 E018.27.23.578 N054.22.53.293 E018.27.23.919 olive
N054.22.51.225 E018.27.22.519 N054.22.52.906 E018.27.23.578 olive
N054.22.50.415 E018.27.21.922 N054.22.51.225 E018.27.22.519 olive
N054.22.50.010 E018.27.21.388 N054.22.50.415 E018.27.21.922 olive
N054.22.49.740 E018.27.20.775 N054.22.50.010 E018.27.21.388 olive
N054.22.49.638 E018.27.20.068 N054.22.49.740 E018.27.20.775 olive
N054.22.49.571 E018.27.19.294 N054.22.49.638 E018.27.20.068 olive
N054.22.49.590 E018.27.18.579 N054.22.49.571 E018.27.19.294 olive
N054.22.49.688 E018.27.17.396 N054.22.49.590 E018.27.18.579 olive
N054.22.50.909 E018.27.22.316 N054.22.51.205 E018.27.22.510 olive
N054.22.50.632 E018.27.22.184 N054.22.50.909 E018.27.22.316 olive
N054.22.50.339 E018.27.22.069 N054.22.50.632 E018.27.22.184 olive
N054.22.50.011 E018.27.22.038 N054.22.50.339 E018.27.22.069 olive
N054.22.49.702 E018.27.22.086 N054.22.50.011 E018.27.22.038 olive
N054.22.49.353 E018.27.22.237 N054.22.49.702 E018.27.22.086 olive
N054.22.49.014 E018.27.22.596 N054.22.49.353 E018.27.22.237 olive
N054.22.48.707 E018.27.22.984 N054.22.49.014 E018.27.22.596 olive
N054.22.48.364 E018.27.23.509 N054.22.48.707 E018.27.22.984 olive
N054.22.48.016 E018.27.24.182 N054.22.48.364 E018.27.23.509 olive
N054.22.47.777 E018.27.24.923 N054.22.48.016 E018.27.24.182 olive
N054.22.46.888 E018.27.32.624 N054.22.46.388 E018.27.33.687 olive
N054.22.47.269 E018.27.31.928 N054.22.46.888 E018.27.32.624 olive
N054.22.47.661 E018.27.31.250 N054.22.47.269 E018.27.31.928 olive
N054.22.48.039 E018.27.30.666 N054.22.47.661 E018.27.31.250 olive
N054.22.48.463 E018.27.30.078 N054.22.48.039 E018.27.30.666 olive
N054.22.51.912 E018.27.25.778 N054.22.48.463 E018.27.30.078 olive
N054.22.52.121 E018.27.25.575 N054.22.51.912 E018.27.25.778 olive
N054.22.52.369 E018.27.25.522 N054.22.52.121 E018.27.25.575 olive
N054.22.52.648 E018.27.25.550 N054.22.52.369 E018.27.25.522 olive
N054.22.52.935 E018.27.25.683 N054.22.52.648 E018.27.25.550 olive
N054.22.53.166 E018.27.25.872 N054.22.52.935 E018.27.25.683 olive
N054.22.53.378 E018.27.26.148 N054.22.53.166 E018.27.25.872 olive
N054.22.53.540 E018.27.26.463 N054.22.53.378 E018.27.26.148 olive
N054.22.53.642 E018.27.26.749 N054.22.53.540 E018.27.26.463 olive
N054.22.53.745 E018.27.27.173 N054.22.53.642 E018.27.26.749 olive
N054.22.53.765 E018.27.27.671 N054.22.53.745 E018.27.27.173 olive
N054.22.53.719 E018.27.28.146 N054.22.53.765 E018.27.27.671 olive
N054.22.53.576 E018.27.28.772 N054.22.53.719 E018.27.28.146 olive
N054.22.42.026 E018.28.14.074 N054.22.41.826 E018.28.15.372 olive
N054.22.42.077 E018.28.12.993 N054.22.42.026 E018.28.14.074 olive
N054.22.42.028 E018.28.11.574 N054.22.42.077 E018.28.12.993 olive
N054.22.41.893 E018.28.10.009 N054.22.42.028 E018.28.11.574 olive
N054.22.41.637 E018.28.07.277 N054.22.41.893 E018.28.10.009 olive
N054.22.41.250 E018.28.02.445 N054.22.41.637 E018.28.07.277 olive
N054.22.41.013 E018.27.59.103 N054.22.41.250 E018.28.02.445 olive
N054.22.40.891 E018.27.56.545 N054.22.41.013 E018.27.59.103 olive
N054.22.40.864 E018.27.54.672 N054.22.40.891 E018.27.56.545 olive
N054.22.40.901 E018.27.53.714 N054.22.40.864 E018.27.54.672 olive
N054.22.41.023 E018.27.52.865 N054.22.40.901 E018.27.53.714 olive
N054.22.41.186 E018.27.52.159 N054.22.41.023 E018.27.52.865 olive
N054.22.46.435 E018.27.56.573 N054.22.46.901 E018.27.55.223 olive
N054.22.45.971 E018.27.57.415 N054.22.46.435 E018.27.56.573 olive
N054.22.45.294 E018.27.58.401 N054.22.45.971 E018.27.57.415 olive
N054.22.44.597 E018.27.59.316 N054.22.45.294 E018.27.58.401 olive
N054.22.43.194 E018.28.01.039 N054.22.44.597 E018.27.59.316 olive
N054.22.42.177 E018.28.02.369 N054.22.43.194 E018.28.01.039 olive
N054.22.40.185 E018.28.04.716 N054.22.42.177 E018.28.02.369 olive
N054.22.39.418 E018.28.05.730 N054.22.40.185 E018.28.04.716 olive
N054.22.38.916 E018.28.06.379 N054.22.39.418 E018.28.05.730 olive
N054.22.37.806 E018.28.07.859 N054.22.38.916 E018.28.06.379 olive
N054.22.37.244 E018.28.08.678 N054.22.37.806 E018.28.07.859 olive
N054.22.36.755 E018.28.09.642 N054.22.37.244 E018.28.08.678 olive
N054.22.36.432 E018.28.10.599 N054.22.36.755 E018.28.09.642 olive
N054.22.42.944 E018.28.01.438 N054.22.42.684 E018.28.01.699 olive
N054.22.43.195 E018.28.01.299 N054.22.42.944 E018.28.01.438 olive
N054.22.43.487 E018.28.01.240 N054.22.43.195 E018.28.01.299 olive
N054.22.43.782 E018.28.01.286 N054.22.43.487 E018.28.01.240 olive
N054.22.44.068 E018.28.01.445 N054.22.43.782 E018.28.01.286 olive
N054.22.44.309 E018.28.01.679 N054.22.44.068 E018.28.01.445 olive
N054.22.44.523 E018.28.02.059 N054.22.44.309 E018.28.01.679 olive
N054.22.44.677 E018.28.02.487 N054.22.44.523 E018.28.02.059 olive
N054.22.44.750 E018.28.03.014 N054.22.44.677 E018.28.02.487 olive
N054.22.44.727 E018.28.03.665 N054.22.44.750 E018.28.03.014 olive
N054.22.44.594 E018.28.04.326 N054.22.44.727 E018.28.03.665 olive
N054.22.41.596 E018.28.06.646 N054.22.41.557 E018.28.06.278 olive
N054.22.41.681 E018.28.06.947 N054.22.41.596 E018.28.06.646 olive
N054.22.41.880 E018.28.07.292 N054.22.41.681 E018.28.06.947 olive
N054.22.42.040 E018.28.07.477 N054.22.41.880 E018.28.07.292 olive
N054.22.42.211 E018.28.07.654 N054.22.42.040 E018.28.07.477 olive
N054.22.42.410 E018.28.07.789 N054.22.42.211 E018.28.07.654 olive
N054.22.42.599 E018.28.07.889 N054.22.42.410 E018.28.07.789 olive
N054.22.42.779 E018.28.07.944 N054.22.42.599 E018.28.07.889 olive
N054.22.42.960 E018.28.07.939 N054.22.42.779 E018.28.07.944 olive
N054.22.43.159 E018.28.07.892 N054.22.42.960 E018.28.07.939 olive
N054.22.43.387 E018.28.07.760 N054.22.43.159 E018.28.07.892 olive
N054.22.43.596 E018.28.07.539 N054.22.43.387 E018.28.07.760 olive
N054.22.43.728 E018.28.07.339 N054.22.43.596 E018.28.07.539 olive
N054.22.43.901 E018.28.07.020 N054.22.43.728 E018.28.07.339 olive
N054.22.44.082 E018.28.06.423 N054.22.43.901 E018.28.07.020 olive
N054.22.34.385 E018.28.44.688 N054.22.34.258 E018.28.45.340 olive
N054.22.34.472 E018.28.43.952 N054.22.34.385 E018.28.44.688 olive
N054.22.34.513 E018.28.43.239 N054.22.34.472 E018.28.43.952 olive
N054.22.34.530 E018.28.42.593 N054.22.34.513 E018.28.43.239 olive
N054.22.34.515 E018.28.41.927 N054.22.34.530 E018.28.42.593 olive
N054.22.34.488 E018.28.41.278 N054.22.34.515 E018.28.41.927 olive
N054.22.34.420 E018.28.40.539 N054.22.34.488 E018.28.41.278 olive
N054.22.34.351 E018.28.39.817 N054.22.34.420 E018.28.40.539 olive
N054.22.33.022 E018.28.26.210 N054.22.34.351 E018.28.39.817 olive
N054.22.36.368 E018.28.36.869 N054.22.36.543 E018.28.36.298 olive
N054.22.36.240 E018.28.37.156 N054.22.36.368 E018.28.36.869 olive
N054.22.36.091 E018.28.37.390 N054.22.36.240 E018.28.37.156 olive
N054.22.35.938 E018.28.37.571 N054.22.36.091 E018.28.37.390 olive
N054.22.35.764 E018.28.37.716 N054.22.35.938 E018.28.37.571 olive
N054.22.35.569 E018.28.37.815 N054.22.35.764 E018.28.37.716 olive
N054.22.35.387 E018.28.37.847 N054.22.35.569 E018.28.37.815 olive
N054.22.35.173 E018.28.37.841 N054.22.35.387 E018.28.37.847 olive
N054.22.34.982 E018.28.37.810 N054.22.35.173 E018.28.37.841 olive
N054.22.34.776 E018.28.37.718 N054.22.34.982 E018.28.37.810 olive
N054.22.34.550 E018.28.37.537 N054.22.34.776 E018.28.37.718 olive
N054.22.34.375 E018.28.37.342 N054.22.34.550 E018.28.37.537 olive
N054.22.34.223 E018.28.37.080 N054.22.34.375 E018.28.37.342 olive
N054.22.34.085 E018.28.36.697 N054.22.34.223 E018.28.37.080 olive
N054.22.33.983 E018.28.36.019 N054.22.34.085 E018.28.36.697 olive
N054.22.27.983 E018.29.10.053 N054.22.28.162 E018.29.09.500 olive
N054.22.27.859 E018.29.10.332 N054.22.27.983 E018.29.10.053 olive
N054.22.27.693 E018.29.10.600 N054.22.27.859 E018.29.10.332 olive
N054.22.27.512 E018.29.10.804 N054.22.27.693 E018.29.10.600 olive
N054.22.27.321 E018.29.10.966 N054.22.27.512 E018.29.10.804 olive
N054.22.27.104 E018.29.11.082 N054.22.27.321 E018.29.10.966 olive
N054.22.26.899 E018.29.11.155 N054.22.27.104 E018.29.11.082 olive
N054.22.26.640 E018.29.11.198 N054.22.26.899 E018.29.11.155 olive
N054.22.26.388 E018.29.11.189 N054.22.26.640 E018.29.11.198 olive
N054.22.26.078 E018.29.11.107 N054.22.26.388 E018.29.11.189 olive
N054.22.25.758 E018.29.10.973 N054.22.26.078 E018.29.11.107 olive
N054.22.24.215 E018.29.09.980 N054.22.25.758 E018.29.10.973 olive
N054.22.24.016 E018.29.09.862 N054.22.24.215 E018.29.09.980 olive
N054.22.23.559 E018.29.09.509 N054.22.24.016 E018.29.09.862 olive
N054.22.23.304 E018.29.09.213 N054.22.23.559 E018.29.09.509 olive
N054.22.23.072 E018.29.08.867 N054.22.23.304 E018.29.09.213 olive
N054.22.22.878 E018.29.08.514 N054.22.23.072 E018.29.08.867 olive
N054.22.22.728 E018.29.08.200 N054.22.22.878 E018.29.08.514 olive
N054.22.23.546 E018.29.09.586 N054.22.24.005 E018.29.09.852 olive
N054.22.23.296 E018.29.09.517 N054.22.23.546 E018.29.09.586 olive
N054.22.23.011 E018.29.09.489 N054.22.23.296 E018.29.09.517 olive
N054.22.22.724 E018.29.09.530 N054.22.23.011 E018.29.09.489 olive
N054.22.22.425 E018.29.09.641 N054.22.22.724 E018.29.09.530 olive
N054.22.26.972 E018.29.14.135 N054.22.26.889 E018.29.14.574 olive
N054.22.26.997 E018.29.13.832 N054.22.26.972 E018.29.14.135 olive
N054.22.27.006 E018.29.13.503 N054.22.26.997 E018.29.13.832 olive
N054.22.26.987 E018.29.13.206 N054.22.27.006 E018.29.13.503 olive
N054.22.26.950 E018.29.12.951 N054.22.26.987 E018.29.13.206 olive
N054.22.26.896 E018.29.12.712 N054.22.26.950 E018.29.12.951 olive
N054.22.26.820 E018.29.12.472 N054.22.26.896 E018.29.12.712 olive
N054.22.26.712 E018.29.12.195 N054.22.26.820 E018.29.12.472 olive
N054.22.26.572 E018.29.11.916 N054.22.26.712 E018.29.12.195 olive
N054.22.26.408 E018.29.11.661 N054.22.26.572 E018.29.11.916 olive
N054.22.26.201 E018.29.11.403 N054.22.26.408 E018.29.11.661 olive
N054.22.26.004 E018.29.11.189 N054.22.26.201 E018.29.11.403 olive
N054.22.25.720 E018.29.10.953 N054.22.26.004 E018.29.11.189 olive
N054.22.23.382 E018.29.28.215 N054.22.23.596 E018.29.27.638 olive
N054.22.23.216 E018.29.28.482 N054.22.23.382 E018.29.28.215 olive
N054.22.23.017 E018.29.28.755 N054.22.23.216 E018.29.28.482 olive
N054.22.22.796 E018.29.28.993 N054.22.23.017 E018.29.28.755 olive
N054.22.22.562 E018.29.29.151 N054.22.22.796 E018.29.28.993 olive
N054.22.22.301 E018.29.29.273 N054.22.22.562 E018.29.29.151 olive
N054.22.21.997 E018.29.29.330 N054.22.22.301 E018.29.29.273 olive
N054.22.21.685 E018.29.29.292 N054.22.21.997 E018.29.29.330 olive
N054.22.21.371 E018.29.29.149 N054.22.21.685 E018.29.29.292 olive
N054.22.19.220 E018.29.27.749 N054.22.21.371 E018.29.29.149 olive
N054.22.18.887 E018.29.27.483 N054.22.19.220 E018.29.27.749 olive
N054.22.18.669 E018.29.27.242 N054.22.18.887 E018.29.27.483 olive
N054.22.18.437 E018.29.26.887 N054.22.18.669 E018.29.27.242 olive
N054.22.18.255 E018.29.26.526 N054.22.18.437 E018.29.26.887 olive
N054.22.18.095 E018.29.26.123 N054.22.18.255 E018.29.26.526 olive
N054.22.17.997 E018.29.25.699 N054.22.18.095 E018.29.26.123 olive
N054.22.17.937 E018.29.25.294 N054.22.17.997 E018.29.25.699 olive
N054.22.17.927 E018.29.24.859 N054.22.17.937 E018.29.25.294 olive
N054.22.17.950 E018.29.24.399 N054.22.17.927 E018.29.24.859 olive
N054.22.17.993 E018.29.24.019 N054.22.17.950 E018.29.24.399 olive
N054.22.18.094 E018.29.23.539 N054.22.17.993 E018.29.24.019 olive
N054.22.25.095 E018.29.37.559 N054.22.24.445 E018.29.40.400 olive
N054.22.25.172 E018.29.37.162 N054.22.25.095 E018.29.37.559 olive
N054.22.25.159 E018.29.36.828 N054.22.25.172 E018.29.37.162 olive
N054.22.25.068 E018.29.36.543 N054.22.25.159 E018.29.36.828 olive
N054.22.24.788 E018.29.36.279 N054.22.25.068 E018.29.36.543 olive
N054.22.20.610 E018.29.33.425 N054.22.24.788 E018.29.36.279 olive
N054.22.21.280 E018.29.45.361 N054.22.21.184 E018.29.45.214 olive
N054.22.21.319 E018.29.45.521 N054.22.21.280 E018.29.45.361 olive
N054.22.21.246 E018.29.45.778 N054.22.21.319 E018.29.45.521 olive
N054.22.21.109 E018.29.45.944 N054.22.21.246 E018.29.45.778 olive
N054.22.20.955 E018.29.45.933 N054.22.21.109 E018.29.45.944 olive
N054.22.20.749 E018.29.45.815 N054.22.20.955 E018.29.45.933 olive
N054.22.20.565 E018.29.45.662 N054.22.20.749 E018.29.45.815 olive
N054.22.20.397 E018.29.45.388 N054.22.20.565 E018.29.45.662 olive
N054.22.20.284 E018.29.45.065 N054.22.20.397 E018.29.45.388 olive
N054.22.20.292 E018.29.44.769 N054.22.20.284 E018.29.45.065 olive
N054.22.21.834 E018.29.38.719 N054.22.20.292 E018.29.44.769 olive
N054.22.22.819 E018.29.37.754 N054.22.21.834 E018.29.38.719 olive
N054.22.23.146 E018.29.36.272 N054.22.22.819 E018.29.37.754 olive
N054.22.23.198 E018.29.35.978 N054.22.23.146 E018.29.36.272 olive
N054.22.23.205 E018.29.35.716 N054.22.23.198 E018.29.35.978 olive
N054.22.23.146 E018.29.35.451 N054.22.23.205 E018.29.35.716 olive
N054.22.23.010 E018.29.35.179 N054.22.23.146 E018.29.35.451 olive
N054.22.22.789 E018.29.34.779 N054.22.23.010 E018.29.35.179 olive
N054.22.22.635 E018.29.34.384 N054.22.22.789 E018.29.34.779 olive
N054.22.22.480 E018.29.33.971 N054.22.22.635 E018.29.34.384 olive
N054.22.22.404 E018.29.33.512 N054.22.22.480 E018.29.33.971 olive
N054.22.22.395 E018.29.33.039 N054.22.22.404 E018.29.33.512 olive
N054.22.22.422 E018.29.32.481 N054.22.22.395 E018.29.33.039 olive
N054.22.22.502 E018.29.31.944 N054.22.22.422 E018.29.32.481 olive
N054.22.22.638 E018.29.31.394 N054.22.22.502 E018.29.31.944 olive
N054.22.23.888 E018.29.35.681 N054.22.24.050 E018.29.35.779 olive
N054.22.23.737 E018.29.35.601 N054.22.23.888 E018.29.35.681 olive
N054.22.23.600 E018.29.35.574 N054.22.23.737 E018.29.35.601 olive
N054.22.23.456 E018.29.35.625 N054.22.23.600 E018.29.35.574 olive
N054.22.23.361 E018.29.35.688 N054.22.23.456 E018.29.35.625 olive
N054.22.23.287 E018.29.35.814 N054.22.23.361 E018.29.35.688 olive
N054.22.23.186 E018.29.36.059 N054.22.23.287 E018.29.35.814 olive
N054.22.45.948 E018.27.57.466 N054.22.45.720 E018.27.57.748 olive
N054.22.46.176 E018.27.57.184 N054.22.45.948 E018.27.57.466 olive
N054.22.46.336 E018.27.56.986 N054.22.46.176 E018.27.57.184 olive
N054.22.46.595 E018.27.56.759 N054.22.46.336 E018.27.56.986 olive
N054.22.46.874 E018.27.56.655 N054.22.46.595 E018.27.56.759 olive
N054.22.47.206 E018.27.56.590 N054.22.46.874 E018.27.56.655 olive
N054.22.47.548 E018.27.56.596 N054.22.47.206 E018.27.56.590 olive
N054.22.47.941 E018.27.56.745 N054.22.47.548 E018.27.56.596 olive
N054.22.48.289 E018.27.56.909 N054.22.47.941 E018.27.56.745 olive
N054.22.49.783 E018.27.57.920 N054.22.48.289 E018.27.56.909 olive
N054.22.49.978 E018.27.58.056 N054.22.49.783 E018.27.57.920 olive
N054.22.50.175 E018.27.58.104 N054.22.49.978 E018.27.58.056 olive
N054.22.50.373 E018.27.58.099 N054.22.50.175 E018.27.58.104 olive
N054.22.50.585 E018.27.58.027 N054.22.50.373 E018.27.58.099 olive
N054.22.50.787 E018.27.57.883 N054.22.50.585 E018.27.58.027 olive
N054.22.50.969 E018.27.57.685 N054.22.50.787 E018.27.57.883 olive
N054.22.51.121 E018.27.57.382 N054.22.50.969 E018.27.57.685 olive
N054.22.51.265 E018.27.56.936 N054.22.51.121 E018.27.57.382 olive
N054.22.55.102 E018.27.41.844 N054.22.51.265 E018.27.56.936 olive
N054.22.55.200 E018.27.41.448 N054.22.55.102 E018.27.41.844 olive
N054.22.55.222 E018.27.41.065 N054.22.55.200 E018.27.41.448 olive
N054.22.55.208 E018.27.40.749 N054.22.55.222 E018.27.41.065 olive
N054.22.55.153 E018.27.40.361 N054.22.55.208 E018.27.40.749 olive
N054.22.54.965 E018.27.39.946 N054.22.55.153 E018.27.40.361 olive
N054.22.54.602 E018.27.39.519 N054.22.54.965 E018.27.39.946 olive
N054.22.53.312 E018.27.38.714 N054.22.54.602 E018.27.39.519 olive
N054.22.53.009 E018.27.38.501 N054.22.53.312 E018.27.38.714 olive
N054.22.52.785 E018.27.38.241 N054.22.53.009 E018.27.38.501 olive
N054.22.52.562 E018.27.37.929 N054.22.52.785 E018.27.38.241 olive
N054.22.52.372 E018.27.37.601 N054.22.52.562 E018.27.37.929 olive
N054.22.52.215 E018.27.37.276 N054.22.52.372 E018.27.37.601 olive
N054.22.52.072 E018.27.36.864 N054.22.52.215 E018.27.37.276 olive
N054.22.51.965 E018.27.36.349 N054.22.52.072 E018.27.36.864 olive
N054.22.51.932 E018.27.35.927 N054.22.51.965 E018.27.36.349 olive
N054.22.51.921 E018.27.35.507 N054.22.51.932 E018.27.35.927 olive
N054.22.51.988 E018.27.35.074 N054.22.51.921 E018.27.35.507 olive
N054.22.50.887 E018.27.39.562 N054.22.50.786 E018.27.39.851 olive
N054.22.50.996 E018.27.39.369 N054.22.50.887 E018.27.39.562 olive
N054.22.51.150 E018.27.39.154 N054.22.50.996 E018.27.39.369 olive
N054.22.51.336 E018.27.38.957 N054.22.51.150 E018.27.39.154 olive
N054.22.51.506 E018.27.38.778 N054.22.51.336 E018.27.38.957 olive
N054.22.51.680 E018.27.38.633 N054.22.51.506 E018.27.38.778 olive
N054.22.51.859 E018.27.38.514 N054.22.51.680 E018.27.38.633 olive
N054.22.52.080 E018.27.38.425 N054.22.51.859 E018.27.38.514 olive
N054.22.52.290 E018.27.38.378 N054.22.52.080 E018.27.38.425 olive
N054.22.52.542 E018.27.38.396 N054.22.52.290 E018.27.38.378 olive
N054.22.52.793 E018.27.38.465 N054.22.52.542 E018.27.38.396 olive
N054.22.53.064 E018.27.38.562 N054.22.52.793 E018.27.38.465 olive
N054.22.53.302 E018.27.38.708 N054.22.53.064 E018.27.38.562 olive
N054.22.47.900 E018.27.56.693 N054.22.48.040 E018.27.56.790 olive
N054.22.47.756 E018.27.56.527 N054.22.47.900 E018.27.56.693 olive
N054.22.47.640 E018.27.56.354 N054.22.47.756 E018.27.56.527 olive
N054.22.47.526 E018.27.56.120 N054.22.47.640 E018.27.56.354 olive
N054.22.47.438 E018.27.55.904 N054.22.47.526 E018.27.56.120 olive
N054.22.47.362 E018.27.55.682 N054.22.47.438 E018.27.55.904 olive
N054.22.47.283 E018.27.55.381 N054.22.47.362 E018.27.55.682 olive
N054.22.47.253 E018.27.55.048 N054.22.47.283 E018.27.55.381 olive
N054.22.47.230 E018.27.54.690 N054.22.47.253 E018.27.55.048 olive
N054.22.47.223 E018.27.54.350 N054.22.47.230 E018.27.54.690 olive
N054.22.47.238 E018.27.53.977 N054.22.47.223 E018.27.54.350 olive
N054.22.47.320 E018.27.53.574 N054.22.47.238 E018.27.53.977 olive
N054.22.42.830 E018.28.11.525 N054.22.42.718 E018.28.11.822 olive
N054.22.42.967 E018.28.11.325 N054.22.42.830 E018.28.11.525 olive
N054.22.43.082 E018.28.11.150 N054.22.42.967 E018.28.11.325 olive
N054.22.43.206 E018.28.11.010 N054.22.43.082 E018.28.11.150 olive
N054.22.43.393 E018.28.10.814 N054.22.43.206 E018.28.11.010 olive
N054.22.43.656 E018.28.10.615 N054.22.43.393 E018.28.10.814 olive
N054.22.43.818 E018.28.10.487 N054.22.43.656 E018.28.10.615 olive
N054.22.43.970 E018.28.10.358 N054.22.43.818 E018.28.10.487 olive
N054.22.44.115 E018.28.10.254 N054.22.43.970 E018.28.10.358 olive
N054.22.44.288 E018.28.10.153 N054.22.44.115 E018.28.10.254 olive
N054.22.44.417 E018.28.10.067 N054.22.44.288 E018.28.10.153 olive
N054.22.44.574 E018.28.09.920 N054.22.44.417 E018.28.10.067 olive
N054.22.44.715 E018.28.09.791 N054.22.44.574 E018.28.09.920 olive
N054.22.44.819 E018.28.09.606 N054.22.44.715 E018.28.09.791 olive
N054.22.44.891 E018.28.09.385 N054.22.44.819 E018.28.09.606 olive
N054.22.47.525 E018.27.58.991 N054.22.44.891 E018.28.09.385 olive
N054.22.47.588 E018.27.58.691 N054.22.47.525 E018.27.58.991 olive
N054.22.47.652 E018.27.58.347 N054.22.47.588 E018.27.58.691 olive
N054.22.47.682 E018.27.58.070 N054.22.47.652 E018.27.58.347 olive
N054.22.47.695 E018.27.57.785 N054.22.47.682 E018.27.58.070 olive
N054.22.47.685 E018.27.57.540 N054.22.47.695 E018.27.57.785 olive
N054.22.47.653 E018.27.57.312 N054.22.47.685 E018.27.57.540 olive
N054.22.47.609 E018.27.57.108 N054.22.47.653 E018.27.57.312 olive
N054.22.47.554 E018.27.56.905 N054.22.47.609 E018.27.57.108 olive
N054.22.47.483 E018.27.56.708 N054.22.47.554 E018.27.56.905 olive
N054.22.47.384 E018.27.56.493 N054.22.47.483 E018.27.56.708 olive
N054.22.47.291 E018.27.56.278 N054.22.47.384 E018.27.56.493 olive
N054.22.47.225 E018.27.56.099 N054.22.47.291 E018.27.56.278 olive
N054.22.47.153 E018.27.55.903 N054.22.47.225 E018.27.56.099 olive
N054.22.47.111 E018.27.55.648 N054.22.47.153 E018.27.55.903 olive
N054.22.47.075 E018.27.55.358 N054.22.47.111 E018.27.55.648 olive
N054.22.47.084 E018.27.55.028 N054.22.47.075 E018.27.55.358 olive
N054.22.47.122 E018.27.54.639 N054.22.47.084 E018.27.55.028 olive
N054.22.47.152 E018.27.54.328 N054.22.47.122 E018.27.54.639 olive
N054.22.47.211 E018.27.53.983 N054.22.47.152 E018.27.54.328 olive
N054.22.48.697 E018.27.57.235 N054.22.48.963 E018.27.57.358 olive
N054.22.48.539 E018.27.57.215 N054.22.48.697 E018.27.57.235 olive
N054.22.48.384 E018.27.57.240 N054.22.48.539 E018.27.57.215 olive
N054.22.48.224 E018.27.57.299 N054.22.48.384 E018.27.57.240 olive
N054.22.48.089 E018.27.57.402 N054.22.48.224 E018.27.57.299 olive
N054.22.47.959 E018.27.57.541 N054.22.48.089 E018.27.57.402 olive
N054.22.47.838 E018.27.57.751 N054.22.47.959 E018.27.57.541 olive
N054.22.47.761 E018.27.57.963 N054.22.47.838 E018.27.57.751 olive
N054.22.47.681 E018.27.58.280 N054.22.47.761 E018.27.57.963 olive
N054.22.47.643 E018.27.58.486 N054.22.47.681 E018.27.58.280 olive
N054.22.47.575 E018.27.58.768 N054.22.47.643 E018.27.58.486 olive
N054.22.47.620 E018.27.58.519 N054.22.47.575 E018.27.58.768 olive
N054.22.47.628 E018.27.58.215 N054.22.47.620 E018.27.58.519 olive
N054.22.47.631 E018.27.57.902 N054.22.47.628 E018.27.58.215 olive
N054.22.47.591 E018.27.57.569 N054.22.47.631 E018.27.57.902 olive
N054.22.47.504 E018.27.57.319 N054.22.47.591 E018.27.57.569 olive
N054.22.47.384 E018.27.57.102 N054.22.47.504 E018.27.57.319 olive
N054.22.47.229 E018.27.56.952 N054.22.47.384 E018.27.57.102 olive
N054.22.47.041 E018.27.56.800 N054.22.47.229 E018.27.56.952 olive
N054.22.46.762 E018.27.56.772 N054.22.47.041 E018.27.56.800 olive
N054.22.46.546 E018.27.56.853 N054.22.46.762 E018.27.56.772 olive
N054.22.46.322 E018.27.57.004 N054.22.46.546 E018.27.56.853 olive
N054.22.41.617 E018.28.06.891 N054.22.41.573 E018.28.06.505 olive
N054.22.41.674 E018.28.07.226 N054.22.41.617 E018.28.06.891 olive
N054.22.41.757 E018.28.07.588 N054.22.41.674 E018.28.07.226 olive
N054.22.41.868 E018.28.07.935 N054.22.41.757 E018.28.07.588 olive
N054.22.42.006 E018.28.08.309 N054.22.41.868 E018.28.07.935 olive
N054.22.42.162 E018.28.08.642 N054.22.42.006 E018.28.08.309 olive
N054.22.42.335 E018.28.08.941 N054.22.42.162 E018.28.08.642 olive
N054.22.42.552 E018.28.09.226 N054.22.42.335 E018.28.08.941 olive
N054.22.42.783 E018.28.09.433 N054.22.42.552 E018.28.09.226 olive
N054.22.46.380 E018.28.11.732 N054.22.42.783 E018.28.09.433 olive
N054.22.46.643 E018.28.11.932 N054.22.46.380 E018.28.11.732 olive
N054.22.46.898 E018.28.12.245 N054.22.46.643 E018.28.11.932 olive
N054.22.47.087 E018.28.12.546 N054.22.46.898 E018.28.12.245 olive
N054.22.47.264 E018.28.12.897 N054.22.47.087 E018.28.12.546 olive
N054.22.47.433 E018.28.13.352 N054.22.47.264 E018.28.12.897 olive
N054.22.47.530 E018.28.13.820 N054.22.47.433 E018.28.13.352 olive
N054.22.47.583 E018.28.14.311 N054.22.47.530 E018.28.13.820 olive
N054.22.47.574 E018.28.14.841 N054.22.47.583 E018.28.14.311 olive
N054.22.47.512 E018.28.15.290 N054.22.47.574 E018.28.14.841 olive
N054.22.47.368 E018.28.15.889 N054.22.47.512 E018.28.15.290 olive
N054.22.44.877 E018.28.25.918 N054.22.47.368 E018.28.15.889 olive
N054.22.44.760 E018.28.27.607 N054.22.44.877 E018.28.25.918 olive
N054.22.44.186 E018.28.29.961 N054.22.44.760 E018.28.27.607 olive
N054.22.45.215 E018.28.10.965 N054.22.45.377 E018.28.11.089 olive
N054.22.45.115 E018.28.10.818 N054.22.45.215 E018.28.10.965 olive
N054.22.45.006 E018.28.10.602 N054.22.45.115 E018.28.10.818 olive
N054.22.44.924 E018.28.10.388 N054.22.45.006 E018.28.10.602 olive
N054.22.44.870 E018.28.10.140 N054.22.44.924 E018.28.10.388 olive
N054.22.44.851 E018.28.09.844 N054.22.44.870 E018.28.10.140 olive
N054.22.44.863 E018.28.09.575 N054.22.44.851 E018.28.09.844 olive
N054.22.44.897 E018.28.09.333 N054.22.44.863 E018.28.09.575 olive
N054.22.43.717 E018.28.10.593 N054.22.43.527 E018.28.10.719 olive
N054.22.43.861 E018.28.10.542 N054.22.43.717 E018.28.10.593 olive
N054.22.44.015 E018.28.10.509 N054.22.43.861 E018.28.10.542 olive
N054.22.44.208 E018.28.10.495 N054.22.44.015 E018.28.10.509 olive
N054.22.44.399 E018.28.10.526 N054.22.44.208 E018.28.10.495 olive
N054.22.44.556 E018.28.10.581 N054.22.44.399 E018.28.10.526 olive
N054.22.44.821 E018.28.10.729 N054.22.44.556 E018.28.10.581 olive
N054.22.44.644 E018.28.10.595 N054.22.44.821 E018.28.10.729 olive
N054.22.44.505 E018.28.10.464 N054.22.44.644 E018.28.10.595 olive
N054.22.44.366 E018.28.10.315 N054.22.44.505 E018.28.10.464 olive
N054.22.44.239 E018.28.10.141 N054.22.44.366 E018.28.10.315 olive
N054.22.44.076 E018.28.09.869 N054.22.44.239 E018.28.10.141 olive
N054.22.43.957 E018.28.09.634 N054.22.44.076 E018.28.09.869 olive
N054.22.43.850 E018.28.09.331 N054.22.43.957 E018.28.09.634 olive
N054.22.43.776 E018.28.09.004 N054.22.43.850 E018.28.09.331 olive
N054.22.43.721 E018.28.08.600 N054.22.43.776 E018.28.09.004 olive
N054.22.43.716 E018.28.08.183 N054.22.43.721 E018.28.08.600 olive
N054.22.43.742 E018.28.07.828 N054.22.43.716 E018.28.08.183 olive
N054.22.43.812 E018.28.07.476 N054.22.43.742 E018.28.07.828 olive
N054.22.57.088 E018.27.42.574 N054.22.57.209 E018.27.43.001 olive
N054.22.56.946 E018.27.42.127 N054.22.57.088 E018.27.42.574 olive
N054.22.56.773 E018.27.41.608 N054.22.56.946 E018.27.42.127 olive
N054.22.56.510 E018.27.41.118 N054.22.56.773 E018.27.41.608 olive
N054.22.56.203 E018.27.40.642 N054.22.56.510 E018.27.41.118 olive
N054.22.55.806 E018.27.40.248 N054.22.56.203 E018.27.40.642 olive
N054.22.55.286 E018.27.39.898 N054.22.55.806 E018.27.40.248 olive
N054.22.54.678 E018.27.39.577 N054.22.55.286 E018.27.39.898 olive
N054.22.57.422 E018.27.43.698 N054.22.55.014 E018.27.42.223 olive
N054.22.56.880 E018.27.45.777 N054.22.54.473 E018.27.44.302 olive
N054.22.56.361 E018.27.47.875 N054.22.53.953 E018.27.46.400 olive
N054.22.55.820 E018.27.49.937 N054.22.53.412 E018.27.48.461 olive
N054.22.55.300 E018.27.52.034 N054.22.52.893 E018.27.50.559 olive
N054.22.54.768 E018.27.54.167 N054.22.52.361 E018.27.52.692 olive
N054.22.54.227 E018.27.56.264 N054.22.51.819 E018.27.54.788 olive
N054.22.53.696 E018.27.58.344 N054.22.51.289 E018.27.56.868 olive
N054.22.51.961 E018.27.59.693 N054.22.52.921 E018.28.00.307 olive
N054.22.51.718 E018.27.59.546 N054.22.51.961 E018.27.59.693 olive
N054.22.51.447 E018.27.59.232 N054.22.51.718 E018.27.59.546 olive
N054.22.51.290 E018.27.58.925 N054.22.51.447 E018.27.59.232 olive
N054.22.51.177 E018.27.58.639 N054.22.51.290 E018.27.58.925 olive
N054.22.51.090 E018.27.58.207 N054.22.51.177 E018.27.58.639 olive
N054.22.51.093 E018.27.57.711 N054.22.51.090 E018.27.58.207 olive
N054.22.51.169 E018.27.57.307 N054.22.51.093 E018.27.57.711 olive
N054.22.51.285 E018.27.56.872 N054.22.51.169 E018.27.57.307 olive
N054.22.51.382 E018.27.59.167 N054.22.53.148 E018.28.00.227 olive
N054.22.49.965 E018.27.58.043 N054.22.51.382 E018.27.59.167 olive
N054.22.54.858 E018.27.42.826 N054.22.50.682 E018.27.40.227 olive
N054.22.54.140 E018.27.45.649 N054.22.49.964 E018.27.43.050 olive
N054.22.53.568 E018.27.47.942 N054.22.49.392 E018.27.45.343 olive
N054.22.52.879 E018.27.50.697 N054.22.48.703 E018.27.48.098 olive
N054.22.52.269 E018.27.52.983 N054.22.48.120 E018.27.50.382 olive
N054.22.51.579 E018.27.55.747 N054.22.47.425 E018.27.53.154 olive
N054.22.47.208 E018.28.00.210 N054.22.50.655 E018.28.02.350 olive
N054.22.46.650 E018.28.02.480 N054.22.50.098 E018.28.04.621 olive
N054.22.46.060 E018.28.04.748 N054.22.49.507 E018.28.06.889 olive
N054.22.45.502 E018.28.07.036 N054.22.48.950 E018.28.09.177 olive
N054.22.44.454 E018.28.05.024 N054.22.49.159 E018.28.07.945 olive
N054.22.45.601 E018.28.00.503 N054.22.50.380 E018.28.03.569 olive
N054.22.47.356 E018.28.15.923 N054.22.42.504 E018.28.12.708 olive
N054.22.46.984 E018.28.17.455 N054.22.42.098 E018.28.14.255 olive
N054.22.46.465 E018.28.19.535 N054.22.41.530 E018.28.16.506 olive
N054.22.45.909 E018.28.21.736 N054.22.40.987 E018.28.18.673 olive
N054.22.45.389 E018.28.23.834 N054.22.40.492 E018.28.20.650 olive
N054.22.44.892 E018.28.25.915 N054.22.39.962 E018.28.22.730 olive
N054.22.48.167 E018.28.12.429 N054.22.49.562 E018.28.12.227 olive
N054.22.47.856 E018.28.12.512 N054.22.48.167 E018.28.12.429 olive
N054.22.47.514 E018.28.12.524 N054.22.47.856 E018.28.12.512 olive
N054.22.47.185 E018.28.12.449 N054.22.47.514 E018.28.12.524 olive
N054.22.46.893 E018.28.12.255 N054.22.47.185 E018.28.12.449 olive
N054.22.44.463 E018.28.14.887 N054.22.42.503 E018.28.13.565 olive
N054.22.44.515 E018.28.14.996 N054.22.44.463 E018.28.14.887 olive
N054.22.44.609 E018.28.15.194 N054.22.44.515 E018.28.14.996 olive
N054.22.44.734 E018.28.15.448 N054.22.44.609 E018.28.15.194 olive
N054.22.44.860 E018.28.15.684 N054.22.44.734 E018.28.15.448 olive
N054.22.44.965 E018.28.15.883 N054.22.44.860 E018.28.15.684 olive
N054.22.45.094 E018.28.15.997 N054.22.44.965 E018.28.15.883 olive
N054.22.45.290 E018.28.16.080 N054.22.45.094 E018.28.15.997 olive
N054.22.45.454 E018.28.16.144 N054.22.45.290 E018.28.16.080 olive
N054.22.45.608 E018.28.16.137 N054.22.45.454 E018.28.16.144 olive
N054.22.45.742 E018.28.16.076 N054.22.45.608 E018.28.16.137 olive
N054.22.45.868 E018.28.15.927 N054.22.45.742 E018.28.16.076 olive
N054.22.45.976 E018.28.15.584 N054.22.45.868 E018.28.15.927 olive
N054.22.46.074 E018.28.15.224 N054.22.45.976 E018.28.15.584 olive
N054.22.46.150 E018.28.14.845 N054.22.46.074 E018.28.15.224 olive
N054.22.46.190 E018.28.14.585 N054.22.46.150 E018.28.14.845 olive
N054.22.46.341 E018.28.14.333 N054.22.46.190 E018.28.14.585 olive
N054.22.46.545 E018.28.14.120 N054.22.46.341 E018.28.14.333 olive
N054.22.46.717 E018.28.13.851 N054.22.46.545 E018.28.14.120 olive
N054.22.46.893 E018.28.13.479 N054.22.46.717 E018.28.13.851 olive
N054.22.46.973 E018.28.12.977 N054.22.46.893 E018.28.13.479 olive
N054.22.46.908 E018.28.12.518 N054.22.46.973 E018.28.12.977 olive
N054.22.46.669 E018.28.11.977 N054.22.46.908 E018.28.12.518 olive
N054.22.49.688 E018.28.14.491 N054.22.47.558 E018.28.14.976 olive
N054.22.47.686 E018.28.17.170 N054.22.47.121 E018.28.16.869 olive
N054.22.49.680 E018.28.16.798 N054.22.47.686 E018.28.17.170 olive
N054.22.47.031 E018.28.19.783 N054.22.46.466 E018.28.19.483 olive
N054.22.48.993 E018.28.19.375 N054.22.47.031 E018.28.19.783 olive
N054.22.46.364 E018.28.22.431 N054.22.45.810 E018.28.22.149 olive
N054.22.48.326 E018.28.22.058 N054.22.46.364 E018.28.22.431 olive
N054.22.45.731 E018.28.25.063 N054.22.45.166 E018.28.24.745 olive
N054.22.47.670 E018.28.24.688 N054.22.45.731 E018.28.25.063 olive
N054.22.45.031 E018.28.25.663 N054.22.45.029 E018.28.25.348 olive
N054.22.45.078 E018.28.25.981 N054.22.45.031 E018.28.25.663 olive
N054.22.45.199 E018.28.26.391 N054.22.45.078 E018.28.25.981 olive
N054.22.45.356 E018.28.26.699 N054.22.45.199 E018.28.26.391 olive
N054.22.45.548 E018.28.26.939 N054.22.45.356 E018.28.26.699 olive
N054.22.45.871 E018.28.27.206 N054.22.45.548 E018.28.26.939 olive
N054.22.46.211 E018.28.27.264 N054.22.45.871 E018.28.27.206 olive
N054.22.46.521 E018.28.27.251 N054.22.46.211 E018.28.27.264 olive
N054.22.46.809 E018.28.27.166 N054.22.46.521 E018.28.27.251 olive
N054.22.47.034 E018.28.27.023 N054.22.46.809 E018.28.27.166 olive
N054.22.36.482 E018.28.46.258 N054.22.35.997 E018.28.46.755 olive
N054.22.36.590 E018.28.46.300 N054.22.36.482 E018.28.46.258 olive
N054.22.36.743 E018.28.46.336 N054.22.36.590 E018.28.46.300 olive
N054.22.36.929 E018.28.46.340 N054.22.36.743 E018.28.46.336 olive
N054.22.37.095 E018.28.46.316 N054.22.36.929 E018.28.46.340 olive
N054.22.37.272 E018.28.46.242 N054.22.37.095 E018.28.46.316 olive
N054.22.37.395 E018.28.46.163 N054.22.37.272 E018.28.46.242 olive
N054.22.37.514 E018.28.46.041 N054.22.37.395 E018.28.46.163 olive
N054.22.38.373 E018.28.42.671 N054.22.37.514 E018.28.46.041 olive
N054.22.38.436 E018.28.42.379 N054.22.38.373 E018.28.42.671 olive
N054.22.38.477 E018.28.42.060 N054.22.38.436 E018.28.42.379 olive
N054.22.38.490 E018.28.41.782 N054.22.38.477 E018.28.42.060 olive
N054.22.38.493 E018.28.41.469 N054.22.38.490 E018.28.41.782 olive
N054.22.38.453 E018.28.41.109 N054.22.38.493 E018.28.41.469 olive
N054.22.38.392 E018.28.40.722 N054.22.38.453 E018.28.41.109 olive
N054.22.38.305 E018.28.40.308 N054.22.38.392 E018.28.40.722 olive
N054.22.38.194 E018.28.39.952 N054.22.38.305 E018.28.40.308 olive
N054.22.38.009 E018.28.39.504 N054.22.38.194 E018.28.39.952 olive
N054.22.37.733 E018.28.38.945 N054.22.38.009 E018.28.39.504 olive
N054.22.37.290 E018.28.38.063 N054.22.37.733 E018.28.38.945 olive
N054.22.37.141 E018.28.37.705 N054.22.37.290 E018.28.38.063 olive
N054.22.37.024 E018.28.37.357 N054.22.37.141 E018.28.37.705 olive
N054.22.36.899 E018.28.36.905 N054.22.37.024 E018.28.37.357 olive
N054.22.36.826 E018.28.36.561 N054.22.36.899 E018.28.36.905 olive
N054.22.36.771 E018.28.36.182 N054.22.36.826 E018.28.36.561 olive
N054.22.36.758 E018.28.35.825 N054.22.36.771 E018.28.36.182 olive
N054.22.36.763 E018.28.35.469 N054.22.36.758 E018.28.35.825 olive
N054.22.36.851 E018.28.35.031 N054.22.36.763 E018.28.35.469 olive
N054.22.37.630 E018.28.42.765 N054.22.37.061 E018.28.43.140 olive
N054.22.37.746 E018.28.42.820 N054.22.37.630 E018.28.42.765 olive
N054.22.37.861 E018.28.42.863 N054.22.37.746 E018.28.42.820 olive
N054.22.37.985 E018.28.42.893 N054.22.37.861 E018.28.42.863 olive
N054.22.38.110 E018.28.42.901 N054.22.37.985 E018.28.42.893 olive
N054.22.38.220 E018.28.42.869 N054.22.38.110 E018.28.42.901 olive
N054.22.38.325 E018.28.42.782 N054.22.38.220 E018.28.42.869 olive
N054.22.38.389 E018.28.42.631 N054.22.38.325 E018.28.42.782 olive
N054.22.36.274 E018.28.47.261 N054.22.35.983 E018.28.47.468 olive
N054.22.36.377 E018.28.47.312 N054.22.36.274 E018.28.47.261 olive
N054.22.36.480 E018.28.47.346 N054.22.36.377 E018.28.47.312 olive
N054.22.36.605 E018.28.47.380 N054.22.36.480 E018.28.47.346 olive
N054.22.36.715 E018.28.47.379 N054.22.36.605 E018.28.47.380 olive
N054.22.36.853 E018.28.47.353 N054.22.36.715 E018.28.47.379 olive
N054.22.36.970 E018.28.47.292 N054.22.36.853 E018.28.47.353 olive
N054.22.37.071 E018.28.47.194 N054.22.36.970 E018.28.47.292 olive
N054.22.37.162 E018.28.47.070 N054.22.37.071 E018.28.47.194 olive
N054.22.37.242 E018.28.46.945 N054.22.37.162 E018.28.47.070 olive
N054.22.37.307 E018.28.46.783 N054.22.37.242 E018.28.46.945 olive
N054.22.37.367 E018.28.46.587 N054.22.37.307 E018.28.46.783 olive
N054.22.35.592 E018.28.43.038 N054.22.37.367 E018.28.46.587 olive
N054.22.35.483 E018.28.42.805 N054.22.35.592 E018.28.43.038 olive
N054.22.35.413 E018.28.42.574 N054.22.35.483 E018.28.42.805 olive
N054.22.35.360 E018.28.42.309 N054.22.35.413 E018.28.42.574 olive
N054.22.35.323 E018.28.42.063 N054.22.35.360 E018.28.42.309 olive
N054.22.35.303 E018.28.41.766 N054.22.35.323 E018.28.42.063 olive
N054.22.35.311 E018.28.41.462 N054.22.35.303 E018.28.41.766 olive
N054.22.35.342 E018.28.41.133 N054.22.35.311 E018.28.41.462 olive
N054.22.35.425 E018.28.40.721 N054.22.35.342 E018.28.41.133 olive
N054.22.22.748 E018.29.39.485 N054.22.22.686 E018.29.39.367 olive
N054.22.22.789 E018.29.39.601 N054.22.22.748 E018.29.39.485 olive
N054.22.22.814 E018.29.39.715 N054.22.22.789 E018.29.39.601 olive
N054.22.22.821 E018.29.39.855 N054.22.22.814 E018.29.39.715 olive
N054.22.22.806 E018.29.39.984 N054.22.22.821 E018.29.39.855 olive
N054.22.22.738 E018.29.40.084 N054.22.22.806 E018.29.39.984 olive
N054.22.22.632 E018.29.40.129 N054.22.22.738 E018.29.40.084 olive
N054.22.22.522 E018.29.40.121 N054.22.22.632 E018.29.40.129 olive
N054.22.22.139 E018.29.39.905 N054.22.22.522 E018.29.40.121 olive
N054.22.22.000 E018.29.39.755 N054.22.22.139 E018.29.39.905 olive
N054.22.21.896 E018.29.39.574 N054.22.22.000 E018.29.39.755 olive
N054.22.21.715 E018.29.39.162 N054.22.21.896 E018.29.39.574 olive
N054.22.22.267 E018.29.41.453 N054.22.22.205 E018.29.41.336 olive
N054.22.22.308 E018.29.41.569 N054.22.22.267 E018.29.41.453 olive
N054.22.22.332 E018.29.41.684 N054.22.22.308 E018.29.41.569 olive
N054.22.22.340 E018.29.41.824 N054.22.22.332 E018.29.41.684 olive
N054.22.22.325 E018.29.41.953 N054.22.22.340 E018.29.41.824 olive
N054.22.22.257 E018.29.42.053 N054.22.22.325 E018.29.41.953 olive
N054.22.22.151 E018.29.42.098 N054.22.22.257 E018.29.42.053 olive
N054.22.22.042 E018.29.42.090 N054.22.22.151 E018.29.42.098 olive
N054.22.21.658 E018.29.41.873 N054.22.22.042 E018.29.42.090 olive
N054.22.21.519 E018.29.41.724 N054.22.21.658 E018.29.41.873 olive
N054.22.21.414 E018.29.41.543 N054.22.21.519 E018.29.41.724 olive
N054.22.21.234 E018.29.41.131 N054.22.21.414 E018.29.41.543 olive
N054.22.21.759 E018.29.43.403 N054.22.21.697 E018.29.43.285 olive
N054.22.21.800 E018.29.43.519 N054.22.21.759 E018.29.43.403 olive
N054.22.21.824 E018.29.43.633 N054.22.21.800 E018.29.43.519 olive
N054.22.21.831 E018.29.43.773 N054.22.21.824 E018.29.43.633 olive
N054.22.21.817 E018.29.43.903 N054.22.21.831 E018.29.43.773 olive
N054.22.21.748 E018.29.44.002 N054.22.21.817 E018.29.43.903 olive
N054.22.21.643 E018.29.44.047 N054.22.21.748 E018.29.44.002 olive
N054.22.21.533 E018.29.44.040 N054.22.21.643 E018.29.44.047 olive
N054.22.21.150 E018.29.43.823 N054.22.21.533 E018.29.44.040 olive
N054.22.21.011 E018.29.43.674 N054.22.21.150 E018.29.43.823 olive
N054.22.20.906 E018.29.43.492 N054.22.21.011 E018.29.43.674 olive
N054.22.20.726 E018.29.43.080 N054.22.20.906 E018.29.43.492 olive
N054.22.44.517 E018.28.18.236 N054.22.44.570 E018.28.18.401 maroon
N054.22.44.072 E018.28.17.952 N054.22.44.517 E018.28.18.236 maroon
N054.22.43.934 E018.28.16.750 N054.22.44.072 E018.28.17.952 maroon
N054.22.43.790 E018.28.16.656 N054.22.43.934 E018.28.16.750 maroon
N054.22.43.741 E018.28.17.740 N054.22.43.790 E018.28.16.656 maroon
N054.22.43.431 E018.28.17.543 N054.22.43.741 E018.28.17.740 maroon
N054.22.43.347 E018.28.17.237 N054.22.43.431 E018.28.17.543 maroon
N054.22.43.236 E018.28.17.163 N054.22.43.347 E018.28.17.237 maroon
N054.22.43.217 E018.28.17.543 N054.22.43.236 E018.28.17.163 maroon
N054.22.43.073 E018.28.17.813 N054.22.43.217 E018.28.17.543 maroon
N054.22.43.182 E018.28.17.887 N054.22.43.073 E018.28.17.813 maroon
N054.22.43.377 E018.28.17.758 N054.22.43.182 E018.28.17.887 maroon
N054.22.43.682 E018.28.17.957 N054.22.43.377 E018.28.17.758 maroon
N054.22.43.244 E018.28.18.783 N054.22.43.682 E018.28.17.957 maroon
N054.22.43.397 E018.28.18.879 N054.22.43.244 E018.28.18.783 maroon
N054.22.44.006 E018.28.18.157 N054.22.43.397 E018.28.18.879 maroon
N054.22.44.472 E018.28.18.462 N054.22.44.006 E018.28.18.157 maroon
N054.22.44.570 E018.28.18.401 N054.22.44.472 E018.28.18.462 maroon
N054.22.43.596 E018.28.22.504 N054.22.43.650 E018.28.22.669 maroon
N054.22.43.151 E018.28.22.220 N054.22.43.596 E018.28.22.504 maroon
N054.22.43.013 E018.28.21.019 N054.22.43.151 E018.28.22.220 maroon
N054.22.42.869 E018.28.20.924 N054.22.43.013 E018.28.21.019 maroon
N054.22.42.820 E018.28.22.010 N054.22.42.869 E018.28.20.924 maroon
N054.22.42.511 E018.28.21.811 N054.22.42.820 E018.28.22.010 maroon
N054.22.42.427 E018.28.21.505 N054.22.42.511 E018.28.21.811 maroon
N054.22.42.315 E018.28.21.432 N054.22.42.427 E018.28.21.505 maroon
N054.22.42.296 E018.28.21.811 N054.22.42.315 E018.28.21.432 maroon
N054.22.42.152 E018.28.22.082 N054.22.42.296 E018.28.21.811 maroon
N054.22.42.261 E018.28.22.155 N054.22.42.152 E018.28.22.082 maroon
N054.22.42.456 E018.28.22.026 N054.22.42.261 E018.28.22.155 maroon
N054.22.42.762 E018.28.22.227 N054.22.42.456 E018.28.22.026 maroon
N054.22.42.323 E018.28.23.052 N054.22.42.762 E018.28.22.227 maroon
N054.22.42.477 E018.28.23.148 N054.22.42.323 E018.28.23.052 maroon
N054.22.43.085 E018.28.22.426 N054.22.42.477 E018.28.23.148 maroon
N054.22.43.551 E018.28.22.730 N054.22.43.085 E018.28.22.426 maroon
N054.22.43.650 E018.28.22.669 N054.22.43.551 E018.28.22.730 maroon
N054.22.42.807 E018.28.24.478 N054.22.42.849 E018.28.24.609 maroon
N054.22.42.453 E018.28.24.252 N054.22.42.807 E018.28.24.478 maroon
N054.22.42.343 E018.28.23.296 N054.22.42.453 E018.28.24.252 maroon
N054.22.42.229 E018.28.23.221 N054.22.42.343 E018.28.23.296 maroon
N054.22.42.190 E018.28.24.084 N054.22.42.229 E018.28.23.221 maroon
N054.22.41.944 E018.28.23.926 N054.22.42.190 E018.28.24.084 maroon
N054.22.41.877 E018.28.23.683 N054.22.41.944 E018.28.23.926 maroon
N054.22.41.789 E018.28.23.625 N054.22.41.877 E018.28.23.683 maroon
N054.22.41.773 E018.28.23.926 N054.22.41.789 E018.28.23.625 maroon
N054.22.41.659 E018.28.24.142 N054.22.41.773 E018.28.23.926 maroon
N054.22.41.745 E018.28.24.200 N054.22.41.659 E018.28.24.142 maroon
N054.22.41.901 E018.28.24.098 N054.22.41.745 E018.28.24.200 maroon
N054.22.42.143 E018.28.24.256 N054.22.41.901 E018.28.24.098 maroon
N054.22.41.795 E018.28.24.913 N054.22.42.143 E018.28.24.256 maroon
N054.22.41.917 E018.28.24.989 N054.22.41.795 E018.28.24.913 maroon
N054.22.42.401 E018.28.24.415 N054.22.41.917 E018.28.24.989 maroon
N054.22.42.771 E018.28.24.658 N054.22.42.401 E018.28.24.415 maroon
N054.22.42.849 E018.28.24.609 N054.22.42.771 E018.28.24.658 maroon
N054.22.46.157 E018.28.24.675 N054.22.46.115 E018.28.24.546 maroon
N054.22.46.506 E018.28.24.898 N054.22.46.157 E018.28.24.675 maroon
N054.22.46.614 E018.28.25.840 N054.22.46.506 E018.28.24.898 maroon
N054.22.46.727 E018.28.25.914 N054.22.46.614 E018.28.25.840 maroon
N054.22.46.765 E018.28.25.063 N054.22.46.727 E018.28.25.914 maroon
N054.22.47.008 E018.28.25.219 N054.22.46.765 E018.28.25.063 maroon
N054.22.47.074 E018.28.25.458 N054.22.47.008 E018.28.25.219 maroon
N054.22.47.161 E018.28.25.516 N054.22.47.074 E018.28.25.458 maroon
N054.22.47.176 E018.28.25.219 N054.22.47.161 E018.28.25.516 maroon
N054.22.47.289 E018.28.25.006 N054.22.47.176 E018.28.25.219 maroon
N054.22.47.204 E018.28.24.949 N054.22.47.289 E018.28.25.006 maroon
N054.22.47.051 E018.28.25.050 N054.22.47.204 E018.28.24.949 maroon
N054.22.46.811 E018.28.24.894 N054.22.47.051 E018.28.25.050 maroon
N054.22.47.155 E018.28.24.246 N054.22.46.811 E018.28.24.894 maroon
N054.22.47.035 E018.28.24.171 N054.22.47.155 E018.28.24.246 maroon
N054.22.46.558 E018.28.24.736 N054.22.47.035 E018.28.24.171 maroon
N054.22.46.192 E018.28.24.498 N054.22.46.558 E018.28.24.736 maroon
N054.22.46.115 E018.28.24.546 N054.22.46.192 E018.28.24.498 maroon
N054.22.45.756 E018.28.26.374 N054.22.45.731 E018.28.26.298 maroon
N054.22.45.961 E018.28.26.506 N054.22.45.756 E018.28.26.374 maroon
N054.22.46.025 E018.28.27.060 N054.22.45.961 E018.28.26.506 maroon
N054.22.46.092 E018.28.27.104 N054.22.46.025 E018.28.27.060 maroon
N054.22.46.114 E018.28.26.603 N054.22.46.092 E018.28.27.104 maroon
N054.22.46.257 E018.28.26.694 N054.22.46.114 E018.28.26.603 maroon
N054.22.46.296 E018.28.26.835 N054.22.46.257 E018.28.26.694 maroon
N054.22.46.348 E018.28.26.869 N054.22.46.296 E018.28.26.835 maroon
N054.22.46.356 E018.28.26.694 N054.22.46.348 E018.28.26.869 maroon
N054.22.46.423 E018.28.26.569 N054.22.46.356 E018.28.26.694 maroon
N054.22.46.373 E018.28.26.535 N054.22.46.423 E018.28.26.569 maroon
N054.22.46.282 E018.28.26.595 N054.22.46.373 E018.28.26.535 maroon
N054.22.46.141 E018.28.26.502 N054.22.46.282 E018.28.26.595 maroon
N054.22.46.344 E018.28.26.121 N054.22.46.141 E018.28.26.502 maroon
N054.22.46.273 E018.28.26.077 N054.22.46.344 E018.28.26.121 maroon
N054.22.45.992 E018.28.26.410 N054.22.46.273 E018.28.26.077 maroon
N054.22.45.777 E018.28.26.270 N054.22.45.992 E018.28.26.410 maroon
N054.22.45.731 E018.28.26.298 N054.22.45.777 E018.28.26.270 maroon
N054.22.56.516 E018.27.45.469 N054.22.56.570 E018.27.45.638 maroon
N054.22.56.059 E018.27.45.177 N054.22.56.516 E018.27.45.469 maroon
N054.22.55.917 E018.27.43.944 N054.22.56.059 E018.27.45.177 maroon
N054.22.55.769 E018.27.43.847 N054.22.55.917 E018.27.43.944 maroon
N054.22.55.719 E018.27.44.961 N054.22.55.769 E018.27.43.847 maroon
N054.22.55.401 E018.27.44.757 N054.22.55.719 E018.27.44.961 maroon
N054.22.55.315 E018.27.44.444 N054.22.55.401 E018.27.44.757 maroon
N054.22.55.201 E018.27.44.368 N054.22.55.315 E018.27.44.444 maroon
N054.22.55.181 E018.27.44.757 N054.22.55.201 E018.27.44.368 maroon
N054.22.55.034 E018.27.45.036 N054.22.55.181 E018.27.44.757 maroon
N054.22.55.145 E018.27.45.111 N054.22.55.034 E018.27.45.036 maroon
N054.22.55.346 E018.27.44.978 N054.22.55.145 E018.27.45.111 maroon
N054.22.55.659 E018.27.45.183 N054.22.55.346 E018.27.44.978 maroon
N054.22.55.209 E018.27.46.031 N054.22.55.659 E018.27.45.183 maroon
N054.22.55.367 E018.27.46.129 N054.22.55.209 E018.27.46.031 maroon
N054.22.55.991 E018.27.45.389 N054.22.55.367 E018.27.46.129 maroon
N054.22.56.469 E018.27.45.701 N054.22.55.991 E018.27.45.389 maroon
N054.22.56.570 E018.27.45.638 N054.22.56.469 E018.27.45.701 maroon




;EPZG
;- PAS 06/24
LOTNISKA_EPZG N052.08.02.208 E015.46.54.750 N052.08.36.787 E015.48.53.524 white
N052.08.36.787 E015.48.53.524 N052.08.35.064 E015.48.54.845 white
N052.08.35.064 E015.48.54.845 N052.08.00.482 E015.46.56.064 white
N052.08.00.482 E015.46.56.064 N052.08.02.202 E015.46.54.741 white
;- TAXIWAY
N052.08.02.191 E015.46.54.743 N052.08.06.929 E015.46.51.219 blue
N052.08.06.929 E015.46.51.219 N052.08.06.634 E015.46.50.197 blue
N052.08.06.634 E015.46.50.197 N052.08.06.475 E015.46.49.242 blue
N052.08.06.475 E015.46.49.242 N052.08.06.518 E015.46.48.249 blue
N052.08.06.518 E015.46.48.249 N052.08.06.840 E015.46.47.578 blue
N052.08.06.840 E015.46.47.578 N052.08.07.545 E015.46.47.135 blue
N052.08.07.545 E015.46.47.135 N052.08.08.054 E015.46.47.414 blue
N052.08.08.054 E015.46.47.414 N052.08.08.508 E015.46.47.962 blue
N052.08.08.508 E015.46.47.962 N052.08.09.059 E015.46.49.538 blue
N052.08.09.059 E015.46.49.538 N052.08.12.606 E015.46.46.924 blue
N052.08.12.606 E015.46.46.924 N052.08.12.664 E015.46.47.124 blue
N052.08.12.664 E015.46.47.124 N052.08.14.932 E015.46.45.359 blue
N052.08.15.332 E015.46.46.820 N052.08.13.045 E015.46.48.558 blue
N052.08.13.045 E015.46.48.558 N052.08.29.529 E015.47.46.140 blue
N052.08.29.529 E015.47.46.140 N052.08.32.622 E015.47.43.922 blue
N052.08.32.622 E015.47.43.922 N052.08.40.676 E015.48.11.812 blue
N052.08.41.697 E015.48.15.225 N052.08.42.318 E015.48.17.503 blue
N052.08.42.318 E015.48.17.503 N052.08.42.135 E015.48.17.663 blue
N052.08.40.755 E015.48.16.863 N052.08.36.880 E015.48.03.544 blue
N052.08.36.880 E015.48.03.544 N052.08.36.438 E015.48.03.115 blue
N052.08.36.438 E015.48.03.115 N052.08.35.072 E015.48.04.058 blue
N052.08.35.072 E015.48.04.058 N052.08.34.925 E015.48.04.890 blue
N052.08.34.925 E015.48.04.890 N052.08.38.103 E015.48.15.991 blue
N052.08.38.103 E015.48.15.991 N052.08.40.694 E015.48.16.784 blue
N052.08.37.096 E015.48.17.268 N052.08.36.387 E015.48.16.833 blue
N052.08.36.387 E015.48.16.833 N052.08.28.385 E015.48.22.936 blue
N052.08.28.385 E015.48.22.936 N052.08.28.193 E015.48.23.988 blue
N052.08.37.085 E015.48.17.235 N052.08.45.123 E015.48.45.276 blue
N052.08.45.123 E015.48.45.276 N052.08.36.704 E015.48.51.337 blue
N052.08.36.704 E015.48.51.337 N052.08.36.113 E015.48.51.079 blue
N052.08.36.827 E015.48.53.507 N052.08.37.760 E015.48.52.823 blue
N052.08.37.760 E015.48.52.823 N052.08.39.551 E015.48.53.815 blue
N052.08.39.551 E015.48.53.815 N052.08.42.921 E015.48.51.511 blue
N052.08.42.921 E015.48.51.511 N052.08.43.298 E015.48.53.095 blue
N052.08.43.298 E015.48.53.095 N052.08.43.750 E015.48.53.756 blue
N052.08.43.750 E015.48.53.756 N052.08.44.601 E015.48.54.131 blue
N052.08.44.601 E015.48.54.131 N052.08.45.104 E015.48.53.974 blue
N052.08.45.104 E015.48.53.974 N052.08.45.474 E015.48.53.425 blue
N052.08.45.474 E015.48.53.425 N052.08.45.750 E015.48.52.234 blue
N052.08.45.750 E015.48.52.234 N052.08.45.593 E015.48.50.922 blue
N052.08.45.593 E015.48.50.922 N052.08.45.271 E015.48.49.788 blue
N052.08.45.271 E015.48.49.788 N052.08.46.529 E015.48.48.832 blue
N052.08.03.112 E015.46.57.855 N052.08.03.629 E015.46.55.982 blue
N052.08.03.629 E015.46.55.982 N052.08.11.610 E015.46.49.919 blue
N052.08.11.610 E015.46.49.919 N052.08.12.172 E015.46.50.292 blue
N052.08.12.172 E015.46.50.292 N052.08.17.533 E015.47.09.250 blue
N052.08.17.533 E015.47.09.250 N052.08.17.363 E015.47.11.204 blue
N052.08.17.363 E015.47.11.204 N052.08.15.308 E015.47.12.780 blue
N052.08.15.308 E015.47.12.780 N052.08.14.563 E015.47.10.262 blue
N052.08.14.563 E015.47.10.262 N052.08.12.630 E015.47.11.782 blue
N052.08.12.630 E015.47.11.782 N052.08.13.373 E015.47.14.351 blue
N052.08.13.373 E015.47.14.351 N052.08.09.525 E015.47.17.357 blue
N052.08.09.525 E015.47.17.357 N052.08.08.613 E015.47.16.668 blue
N052.08.09.759 E015.47.20.699 N052.08.09.957 E015.47.19.312 blue
N052.08.09.957 E015.47.19.312 N052.08.13.955 E015.47.16.201 blue
N052.08.13.955 E015.47.16.201 N052.08.14.084 E015.47.16.668 blue
N052.08.14.084 E015.47.16.668 N052.08.16.094 E015.47.15.286 blue
N052.08.16.094 E015.47.15.286 N052.08.15.893 E015.47.14.630 blue
N052.08.15.893 E015.47.14.630 N052.08.18.046 E015.47.12.974 blue
N052.08.18.046 E015.47.12.974 N052.08.18.923 E015.47.13.776 blue
N052.08.18.923 E015.47.13.776 N052.08.25.123 E015.47.35.644 blue
N052.08.25.123 E015.47.35.644 N052.08.24.916 E015.47.37.569 blue
N052.08.24.916 E015.47.37.569 N052.08.17.676 E015.47.45.384 blue
N052.08.17.676 E015.47.45.384 N052.08.16.829 E015.47.44.923 blue
N052.08.17.865 E015.47.48.521 N052.08.18.042 E015.47.47.496 blue
N052.08.18.042 E015.47.47.496 N052.08.25.516 E015.47.39.439 blue
N052.08.25.516 E015.47.39.439 N052.08.26.407 E015.47.39.948 blue
N052.08.26.407 E015.47.39.948 N052.08.35.995 E015.48.13.497 blue
N052.08.35.995 E015.48.13.497 N052.08.35.654 E015.48.15.103 blue
N052.08.35.654 E015.48.15.103 N052.08.27.879 E015.48.21.052 blue
N052.08.27.879 E015.48.21.052 N052.08.27.221 E015.48.20.595 blue
N052.08.32.012 E015.47.46.601 N052.08.34.857 E015.47.56.448 blue
N052.08.34.857 E015.47.56.448 N052.08.34.816 E015.47.57.145 blue
N052.08.34.816 E015.47.57.145 N052.08.33.286 E015.47.58.203 blue
N052.08.33.286 E015.47.58.203 N052.08.32.936 E015.47.57.888 blue
N052.08.32.936 E015.47.57.888 N052.08.30.073 E015.47.48.032 blue
N052.08.30.073 E015.47.48.032 N052.08.31.981 E015.47.46.644 blue

;- APRON
N052.08.46.529 E015.48.48.832 N052.08.48.800 E015.48.49.453 white
N052.08.48.800 E015.48.49.453 N052.08.50.735 E015.48.47.970 white
N052.08.50.735 E015.48.47.970 N052.08.42.182 E015.48.17.692 white
N052.08.41.689 E015.48.15.249 N052.08.43.347 E015.48.13.935 white
N052.08.43.347 E015.48.13.935 N052.08.42.321 E015.48.10.577 white
N052.08.42.321 E015.48.10.577 N052.08.40.717 E015.48.11.856 white
N052.08.15.332 E015.46.46.831 N052.08.15.893 E015.46.48.492 white
N052.08.15.893 E015.46.48.492 N052.08.17.061 E015.46.47.595 white
N052.08.17.061 E015.46.47.595 N052.08.15.969 E015.46.43.768 white
N052.08.15.969 E015.46.43.768 N052.08.16.967 E015.46.43.041 white
N052.08.16.967 E015.46.43.041 N052.08.16.580 E015.46.41.741 white
N052.08.16.580 E015.46.41.741 N052.08.18.524 E015.46.40.325 white
N052.08.18.524 E015.46.40.325 N052.08.18.095 E015.46.39.241 white
N052.08.18.095 E015.46.39.241 N052.08.17.762 E015.46.39.472 white
N052.08.17.762 E015.46.39.472 N052.08.17.378 E015.46.38.274 white
N052.08.17.378 E015.46.38.274 N052.08.16.099 E015.46.39.196 white
N052.08.16.099 E015.46.39.196 N052.08.15.786 E015.46.38.158 white
N052.08.15.786 E015.46.38.158 N052.08.13.985 E015.46.39.583 white
N052.08.13.985 E015.46.39.583 N052.08.15.293 E015.46.44.304 white
N052.08.15.293 E015.46.44.304 N052.08.14.743 E015.46.44.750 white
N052.08.14.743 E015.46.44.750 N052.08.14.939 E015.46.45.408 white
;- PALIWO
N052.08.41.366 E015.48.12.491 N052.08.42.273 E015.48.11.773 yellow
N052.08.42.273 E015.48.11.773 N052.08.42.673 E015.48.13.250 yellow
N052.08.42.673 E015.48.13.250 N052.08.41.793 E015.48.13.944 yellow
N052.08.41.793 E015.48.13.944 N052.08.41.366 E015.48.12.491 yellow
;- BUILD
N052.08.46.942 E015.48.00.879 N052.08.47.263 E015.48.00.645 build
N052.08.47.263 E015.48.00.645 N052.08.47.078 E015.48.00.120 build
N052.08.47.078 E015.48.00.120 N052.08.46.758 E015.48.00.382 build
N052.08.46.758 E015.48.00.382 N052.08.46.942 E015.48.00.870 build
N052.08.34.770 E015.47.52.464 N052.08.35.935 E015.47.51.569 build
N052.08.35.935 E015.47.51.569 N052.08.35.149 E015.47.48.716 build
N052.08.35.149 E015.47.48.716 N052.08.33.965 E015.47.49.609 build
N052.08.33.965 E015.47.49.609 N052.08.34.772 E015.47.52.448 build
N052.08.33.570 E015.47.48.221 N052.08.34.739 E015.47.47.336 build
N052.08.34.739 E015.47.47.336 N052.08.33.950 E015.47.44.461 build
N052.08.33.950 E015.47.44.461 N052.08.32.786 E015.47.45.368 build
N052.08.32.786 E015.47.45.368 N052.08.33.573 E015.47.48.201 build
N052.08.14.619 E015.46.41.348 N052.08.16.084 E015.46.40.241 build
N052.08.16.084 E015.46.40.241 N052.08.15.842 E015.46.39.305 build
N052.08.15.842 E015.46.39.305 N052.08.14.953 E015.46.39.936 build
N052.08.14.953 E015.46.39.936 N052.08.14.689 E015.46.39.022 build
N052.08.14.689 E015.46.39.022 N052.08.14.113 E015.46.39.483 build
N052.08.14.113 E015.46.39.483 N052.08.14.626 E015.46.41.321 build
N052.08.16.028 E015.46.38.833 N052.08.16.347 E015.46.38.563 build
N052.08.16.347 E015.46.38.563 N052.08.16.185 E015.46.37.969 build
N052.08.16.185 E015.46.37.969 N052.08.15.865 E015.46.38.249 build
N052.08.15.865 E015.46.38.249 N052.08.16.030 E015.46.38.806 build
N052.08.16.249 E015.46.39.511 N052.08.16.834 E015.46.39.052 build
N052.08.16.834 E015.46.39.052 N052.08.17.002 E015.46.39.546 build
N052.08.17.002 E015.46.39.546 N052.08.16.416 E015.46.39.977 build
N052.08.16.416 E015.46.39.977 N052.08.16.249 E015.46.39.493 build
N052.08.17.141 E015.46.38.890 N052.08.17.433 E015.46.38.668 build
N052.08.17.433 E015.46.38.668 N052.08.17.536 E015.46.39.151 build
N052.08.17.536 E015.46.39.151 N052.08.17.244 E015.46.39.364 build
N052.08.17.244 E015.46.39.364 N052.08.17.141 E015.46.38.881 build
N052.08.16.443 E015.46.41.469 N052.08.17.027 E015.46.41.032 build
N052.08.17.027 E015.46.41.032 N052.08.17.195 E015.46.41.500 build
N052.08.17.195 E015.46.41.500 N052.08.16.611 E015.46.41.974 build
N052.08.16.611 E015.46.41.974 N052.08.16.443 E015.46.41.477 build

;EPSC
;Runway 31/13
LOTNISKA_EPSC N053.34.39.203 E014.55.00.647 N053.35.32.207 E014.53.17.608 runway
N053.35.32.207 E014.53.17.608 N053.35.30.763 E014.53.15.500 runway
N053.35.30.763 E014.53.15.500 N053.34.37.760 E014.54.58.540 runway
N053.34.37.760 E014.54.58.540 N053.34.39.203 E014.55.00.647 runway
;Taxiway borders
N053.35.29.227 E014.53.32.680 N053.35.29.479 E014.53.33.491 apron
N053.35.29.755 E014.53.31.647 N053.35.28.513 E014.53.29.845 apron
N053.35.27.984 E014.53.30.877 N053.35.29.227 E014.53.32.680 apron
N053.35.28.513 E014.53.29.845 N053.35.27.027 E014.53.27.648 apron
N053.35.26.497 E014.53.28.709 N053.35.27.984 E014.53.30.877 apron
N053.34.52.043 E014.54.59.830 N053.34.51.722 E014.54.59.827 apron
N053.34.51.722 E014.54.59.827 N053.34.51.185 E014.54.59.402 apron
N053.34.51.185 E014.54.59.402 N053.34.49.153 E014.54.56.454 apron
N053.35.05.538 E014.54.34.111 N053.34.52.616 E014.54.59.271 apron
N053.35.05.783 E014.54.34.468 N053.35.14.699 E014.54.17.107 apron
N053.35.05.783 E014.54.34.468 N053.34.59.208 E014.54.47.269 apron
N053.34.53.291 E014.54.58.790 N053.34.52.755 E014.54.59.765 apron
N053.35.13.031 E014.53.54.885 N053.35.14.523 E014.53.57.060 apron
N053.35.14.523 E014.53.57.060 N053.35.16.256 E014.53.59.572 apron
N053.35.14.756 E014.53.56.606 N053.35.13.264 E014.53.54.432 apron
N053.35.20.280 E014.54.05.430 N053.35.19.940 E014.54.06.077 apron
N053.35.20.482 E014.54.04.931 N053.35.17.580 e014.54.00.703 apron
N053.35.20.674 E014.54.05.624 N053.35.21.155 E014.54.04.751 apron
N053.34.52.616 E014.54.59.271 N053.34.52.043 E014.54.59.830 apron
N053.35.14.699 E014.54.17.107 N053.35.14.778 E014.54.17.232 apron
N053.35.14.464 E014.54.16.732 N053.35.05.538 E014.54.34.111 apron
N053.35.14.612 E014.54.16.443 N053.35.14.334 E014.54.16.005 apron
N053.35.14.848 E014.54.16.818 N053.35.20.184 E014.54.06.436 apron
N053.35.16.371 E014.54.18.960 N053.35.14.928 E014.54.16.946 apron
N053.35.28.170 E014.53.50.029 N053.35.25.827 E014.53.54.595 apron
N053.35.25.827 E014.53.54.595 N053.35.24.886 E014.53.56.425 apron
N053.35.24.886 E014.53.56.425 N053.35.23.925 E014.53.58.293 apron
N053.35.23.925 E014.53.58.293 N053.35.23.226 E014.53.59.647 apron
N053.35.23.226 E014.53.59.647 N053.35.22.643 E014.54.00.785 apron
N053.35.22.643 E014.54.00.785 N053.35.22.124 E014.54.01.795 apron
N053.35.22.124 E014.54.01.795 N053.35.21.659 E014.54.02.698 apron
N053.35.21.659 E014.54.02.698 N053.35.20.842 E014.54.04.277 apron
N053.35.30.403 E014.53.45.672 N053.35.29.616 E014.53.47.196 apron
N053.35.29.616 E014.53.47.196 N053.35.28.170 E014.53.50.029 apron
N053.35.32.968 E014.53.27.925 N053.35.31.990 E014.53.29.827 apron
N053.35.33.168 E014.53.26.234 N053.35.33.157 E014.53.27.148 apron
N053.35.33.839 E014.53.25.040 N053.35.33.378 E014.53.21.552 apron
N053.35.33.157 E014.53.27.148 N053.35.32.968 E014.53.27.925 apron
N053.35.32.589 E014.53.21.854 N053.35.33.168 E014.53.26.234 apron
N053.35.33.378 E014.53.21.552 N053.35.33.149 E014.53.19.886 apron
N053.35.32.388 E014.53.20.397 N053.35.32.589 E014.53.21.854 apron
N053.35.33.149 E014.53.19.886 N053.35.32.742 E014.53.18.722 apron
N053.35.31.913 E014.53.19.323 N053.35.32.114 E014.53.19.611 apron
N053.35.32.352 E014.53.18.161 N053.35.32.044 E014.53.17.925 apron
N053.35.32.114 E014.53.19.611 N053.35.32.388 E014.53.20.397 apron
N053.35.32.742 E014.53.18.722 N053.35.32.352 E014.53.18.161 apron
N053.35.31.555 E014.53.19.048 N053.35.31.913 E014.53.19.323 apron
N053.35.31.465 E014.53.19.051 N053.35.31.555 E014.53.19.048 apron
N053.35.29.479 E014.53.33.491 N053.35.29.484 E014.53.33.704 apron
N053.35.30.275 E014.53.31.952 N053.35.29.755 E014.53.31.647 apron
N053.35.30.678 E014.53.31.888 N053.35.30.275 E014.53.31.952 apron
N053.35.31.132 E014.53.31.501 N053.35.30.678 E014.53.31.888 apron
N053.35.30.581 E014.53.45.322 N053.35.30.403 E014.53.45.672 apron
N053.35.17.347 E014.54.01.156 N053.35.20.280 E014.54.05.430 apron
N053.35.16.490 e014.53.59.119 N053.35.14.756 E014.53.56.606 apron
N053.35.19.940 E014.54.06.077 N053.35.14.612 E014.54.16.443 apron
N053.35.20.184 E014.54.06.436 N053.35.20.641 E014.54.05.563 apron
N053.35.20.641 E014.54.05.563 N053.35.20.674 E014.54.05.624 apron
N053.35.20.842 E014.54.04.277 N053.35.20.482 E014.54.04.931 apron
N053.35.21.155 E014.54.04.751 N053.35.21.336 E014.54.04.401 apron
N053.35.14.778 E014.54.17.232 N053.35.16.146 E014.54.19.142 apron
N053.35.14.928 E014.54.16.946 N053.35.14.848 E014.54.16.818 apron
N053.35.14.182 E014.54.16.287 N053.35.14.464 E014.54.16.732 apron
N053.35.14.334 E014.54.16.005 N053.35.11.794 E014.54.12.209 apron
N053.35.11.643 E014.54.12.494 N053.35.14.182 E014.54.16.287 apron
N053.35.11.794 E014.54.12.209 N053.35.11.715 E014.54.12.089 apron
N053.35.11.566 E014.54.12.377 N053.35.11.643 E014.54.12.494 apron
N053.35.31.263 E014.53.31.259 N053.35.31.132 E014.53.31.501 apron
N053.35.31.990 E014.53.29.827 N053.35.31.263 E014.53.31.259 apron
;Taxiway center lines
N053.35.29.549 E014.53.32.249 N053.35.28.248 E014.53.30.361 olive
N053.35.28.248 E014.53.30.361 N053.35.26.753 E014.53.28.181 olive
N053.34.52.087 E014.55.00.103 N053.34.51.570 E014.55.00.098 olive
N053.34.51.570 E014.55.00.098 N053.34.51.069 E014.54.59.703 olive
N053.35.13.144 E014.53.54.653 N053.35.14.639 E014.53.56.833 olive
N053.34.52.087 E014.55.00.103 N053.34.52.720 E014.54.59.484 olive
N053.34.52.720 E014.54.59.484 N053.35.05.660 E014.54.34.290 olive
N053.35.14.656 E014.54.16.774 N053.35.05.660 E014.54.34.290 olive
N053.35.16.472 E014.54.19.349 N053.35.16.660 E014.54.20.488 olive
N053.35.16.660 E014.54.20.488 N053.35.16.450 E014.54.20.908 olive
N053.35.25.986 E014.53.54.827 N053.35.28.329 E014.53.50.260 olive
N053.35.25.045 E014.53.56.657 N053.35.25.986 E014.53.54.827 olive
N053.35.25.045 E014.53.56.657 N053.35.25.850 E014.53.57.888 olive
N053.35.24.084 E014.53.58.526 N053.35.25.045 E014.53.56.657 olive
N053.35.24.084 E014.53.58.526 N053.35.24.900 E014.53.59.729 olive
N053.35.23.385 E014.53.59.879 N053.35.24.084 E014.53.58.526 olive
N053.35.23.385 E014.53.59.879 N053.35.24.230 E014.54.01.088 olive
N053.35.22.802 E014.54.01.017 N053.35.23.385 E014.53.59.879 olive
N053.35.22.802 E014.54.01.017 N053.35.23.621 E014.54.02.209 olive
N053.35.22.283 E014.54.02.028 N053.35.22.802 E014.54.01.017 olive
N053.35.22.283 E014.54.02.028 N053.35.23.100 E014.54.03.209 olive
N053.35.21.817 E014.54.02.930 N053.35.22.283 E014.54.02.028 olive
N053.35.21.817 E014.54.02.930 N053.35.22.630 E014.54.04.108 olive
N053.35.29.775 E014.53.47.428 N053.35.30.562 E014.53.45.904 olive
N053.35.29.775 E014.53.47.428 N053.35.28.329 E014.53.50.260 olive
N053.34.42.302 E014.55.03.768 N053.34.41.108 E014.55.02.041 olive
N053.34.41.108 E014.55.02.041 N053.34.39.933 E014.55.00.335 olive
N053.34.42.921 E014.55.04.259 N053.34.42.302 E014.55.03.768 olive
N053.34.44.311 E014.55.03.528 N053.34.43.705 E014.55.04.173 olive
N053.34.43.705 E014.55.04.173 N053.34.42.921 E014.55.04.259 olive
N053.34.39.933 E014.55.00.335 N053.34.39.669 E014.54.59.735 olive
N053.35.33.318 E014.53.28.286 N053.35.33.560 E014.53.27.289 olive
N053.35.33.560 E014.53.27.289 N053.35.33.573 E014.53.26.165 olive
N053.35.33.573 E014.53.26.165 N053.35.32.983 E014.53.21.703 olive
N053.35.32.983 E014.53.21.703 N053.35.32.768 E014.53.20.142 olive
N053.35.32.768 E014.53.20.142 N053.35.32.428 E014.53.19.166 olive
N053.35.32.428 E014.53.19.166 N053.35.32.132 E014.53.18.742 olive
N053.35.32.132 E014.53.18.742 N053.35.31.768 e014.53.18.462 olive
N053.35.29.549 E014.53.32.249 N053.35.29.880 E014.53.33.311 olive
N053.35.29.549 E014.53.32.249 N053.35.30.225 E014.53.32.645 olive
N053.35.30.225 E014.53.32.645 N053.35.30.793 E014.53.32.554 olive
N053.35.29.880 E014.53.33.311 N053.35.29.903 E014.53.34.278 olive
N053.35.29.903 E014.53.34.278 N053.35.29.736 E014.53.35.252 olive
N053.35.29.736 E014.53.35.252 N053.35.31.382 E014.53.32.052 olive
N053.35.30.793 E014.53.32.554 N053.35.31.382 E014.53.32.052 olive
N053.35.27.972 E014.53.40.667 N053.35.27.472 E014.53.40.413 olive
N053.35.27.972 E014.53.40.667 N053.35.27.744 E014.53.39.885 olive
N053.35.27.921 E014.53.38.779 N053.35.29.736 E014.53.35.252 olive
N053.35.27.744 E014.53.39.885 N053.35.27.921 E014.53.38.779 olive
N053.35.26.900 E014.53.40.764 N053.35.27.921 E014.53.38.779 olive
N053.35.27.472 E014.53.40.413 N053.35.26.900 E014.53.40.764 olive
N053.35.30.562 E014.53.45.904 N053.35.30.993 E014.53.45.057 olive
N053.35.30.993 E014.53.45.057 N053.35.31.668 E014.53.46.033 olive
N053.35.16.917 E014.54.00.133 N053.35.26.900 E014.53.40.764 olive
N053.35.14.639 E014.53.56.833 N053.35.16.917 E014.54.00.133 olive
N053.35.16.917 E014.54.00.133 N053.35.20.520 E014.54.05.383 olive
N053.35.14.656 E014.54.16.774 N053.35.20.062 E014.54.06.257 olive
N053.35.20.062 E014.54.06.257 N053.35.20.520 E014.54.05.383 olive
N053.35.21.817 E014.54.02.930 N053.35.20.999 E014.54.04.514 olive
N053.35.20.999 E014.54.04.514 N053.35.20.520 E014.54.05.383 olive
N053.35.14.656 E014.54.16.774 N053.35.14.853 E014.54.17.089 olive
N053.35.14.853 E014.54.17.089 N053.35.16.472 E014.54.19.349 olive
N053.35.14.656 E014.54.16.774 N053.35.14.258 E014.54.16.146 olive
N053.35.14.258 E014.54.16.146 N053.35.11.718 E014.54.12.351 olive
N053.35.11.115 E014.54.11.434 N053.35.16.917 E014.54.00.133 olive
N053.35.11.718 E014.54.12.351 N053.35.11.115 E014.54.11.434 olive
N053.34.51.069 E014.54.59.703 N053.34.48.986 E014.54.56.680 olive
N053.34.48.986 E014.54.56.680 N053.34.48.522 E014.54.56.410 olive
N053.34.48.986 E014.54.56.680 N053.34.48.755 E014.54.55.959 olive
N053.34.48.884 E014.54.54.641 N053.35.11.115 E014.54.11.434 olive
N053.34.48.755 E014.54.55.959 N053.34.48.884 E014.54.54.641 olive
N053.34.44.311 E014.55.03.528 N053.34.47.797 E014.54.56.753 olive
N053.34.47.797 E014.54.56.753 N053.34.48.884 E014.54.54.641 olive
N053.34.48.522 E014.54.56.410 N053.34.47.797 E014.54.56.753 olive
N053.35.30.912 E014.53.44.938 N053.35.30.993 E014.53.45.057 olive
N053.35.30.912 E014.53.44.938 N053.35.32.018 E014.53.42.782 olive
N053.35.32.642 E014.53.45.992 N053.35.33.328 E014.53.44.692 olive
N053.35.32.642 E014.53.45.992 N053.35.31.668 E014.53.46.033 olive
N053.35.27.972 E014.53.40.667 N053.35.29.602 E014.53.43.038 olive
N053.35.29.602 E014.53.43.038 N053.35.30.912 E014.53.44.938 olive
N053.35.29.602 E014.53.43.038 N053.35.30.714 E014.53.40.891 olive
N053.35.29.549 E014.53.32.249 N053.35.31.289 E014.53.35.131 olive
N053.35.31.382 E014.53.32.052 N053.35.31.566 E014.53.31.710 olive
N053.35.31.566 E014.53.31.710 N053.35.32.296 E014.53.30.272 olive
N053.35.32.296 E014.53.30.272 N053.35.33.318 E014.53.28.286 olive
N053.35.29.775 E014.53.47.428 N053.35.30.578 E014.53.48.463 olive
N053.35.28.329 E014.53.50.260 N053.35.29.062 E014.53.51.303 olive
N053.35.31.289 E014.53.35.131 N053.35.32.922 E014.53.38.169 olive
N053.35.33.573 E014.53.26.165 N053.35.34.360 E014.53.31.943 olive
N053.35.34.360 E014.53.31.943 N053.35.35.350 E014.53.33.386 olive
N053.35.31.566 E014.53.31.710 N053.35.34.223 E014.53.35.582 olive
N053.35.32.296 E014.53.30.272 N053.35.34.535 E014.53.33.546 olive
;Apron borders
N053.35.36.817 E014.53.35.466 N053.35.36.387 E014.53.32.556 apron
N053.35.36.387 E014.53.32.556 N053.35.34.780 E014.53.30.210 apron
N053.35.27.608 E014.53.41.219 N053.35.27.922 E014.53.41.501 apron
N053.35.27.922 E014.53.41.501 N053.35.30.576 E014.53.45.331 apron
N053.35.32.663 E014.53.48.342 N053.35.34.617 E014.53.44.574 apron
N053.35.34.617 E014.53.44.574 N053.35.35.184 E014.53.45.402 apron
N053.35.35.184 E014.53.45.402 N053.35.35.771 E014.53.44.261 apron
N053.35.35.771 E014.53.44.261 N053.35.34.854 E014.53.39.244 apron
N053.35.34.854 E014.53.39.244 N053.35.36.817 E014.53.35.466 apron
N053.35.21.336 E014.54.04.401 N053.35.22.108 E014.54.04.532 apron
N053.35.22.108 E014.54.04.532 N053.35.22.745 E014.54.05.552 apron
N053.35.22.745 E014.54.05.552 N053.35.32.038 E014.53.47.486 apron
N053.35.32.038 E014.53.47.486 N053.35.32.663 E014.53.48.342 apron
N053.35.20.982 E014.54.04.005 N053.35.20.982 E014.54.04.006 apron
N053.34.59.208 E014.54.47.269 N053.34.59.400 E014.54.50.726 apron
N053.34.59.400 E014.54.50.726 N053.34.55.656 E014.54.58.048 apron
N053.34.55.656 E014.54.58.048 N053.34.53.872 E014.54.58.227 apron
N053.34.53.872 E014.54.58.227 N053.34.53.291 E014.54.58.790 apron
N053.34.52.755 E014.54.59.765 N053.34.51.898 E014.55.01.449 apron
N053.34.51.898 E014.55.01.449 N053.34.51.530 E014.55.00.908 apron
N053.34.51.530 E014.55.00.908 N053.34.51.087 E014.55.00.939 apron
N053.34.51.087 E014.55.00.939 N053.34.50.492 E014.55.02.078 apron
N053.34.50.492 E014.55.02.078 N053.34.48.457 E014.54.59.101 apron
N053.35.16.120 E014.54.19.164 N053.35.16.119 E014.54.19.556 apron
N053.35.16.119 E014.54.19.556 N053.35.15.765 E014.54.20.219 apron
N053.35.15.765 E014.54.20.219 N053.35.16.055 E014.54.20.615 apron
N053.35.16.055 E014.54.20.615 N053.35.15.823 E014.54.21.082 apron
N053.35.15.823 E014.54.21.082 N053.35.15.840 E014.54.21.322 apron
N053.35.15.840 E014.54.21.322 N053.35.16.637 E014.54.22.466 apron
N053.35.16.637 E014.54.22.466 N053.35.18.685 E014.54.18.580 apron
N053.35.18.685 E014.54.18.580 N053.35.17.518 E014.54.16.956 apron
N053.35.17.518 E014.54.16.956 N053.35.16.521 E014.54.18.890 apron
N053.35.16.521 E014.54.18.890 N053.35.16.371 E014.54.18.960 apron
N053.35.16.146 E014.54.19.142 N053.35.16.120 E014.54.19.164 apron
N053.35.34.480 E014.53.27.992 N053.35.34.019 E014.53.24.691 apron
N053.35.34.019 E014.53.24.691 N053.35.33.839 E014.53.25.040 apron
N053.35.29.484 E014.53.33.704 N053.35.29.028 E014.53.34.534 apron
N053.35.29.028 E014.53.34.534 N053.35.27.668 E014.53.37.083 apron
N053.35.27.668 E014.53.37.083 N053.35.25.526 E014.53.41.272 apron
N053.35.25.526 E014.53.41.272 N053.35.25.484 E014.53.41.639 apron
N053.35.25.484 E014.53.41.639 N053.35.16.490 E014.53.59.119 apron
N053.35.16.256 E014.53.59.572 N053.34.47.982 E014.54.54.521 apron
N053.34.47.982 E014.54.54.521 N053.34.46.934 E014.54.52.992 apron
N053.34.46.934 E014.54.52.992 N053.34.46.664 E014.54.53.513 apron
N053.34.46.664 E014.54.53.513 N053.34.46.731 E014.54.54.496 apron
N053.34.46.731 E014.54.54.496 N053.34.46.137 E014.54.55.723 apron
N053.34.46.137 E014.54.55.723 N053.34.46.839 E014.54.56.758 apron
N053.34.46.839 E014.54.56.758 N053.34.45.306 E014.54.59.728 apron
N053.34.45.306 E014.54.59.728 N053.34.43.618 E014.55.02.709 apron
N053.34.43.618 E014.55.02.709 N053.34.43.216 E014.55.03.044 apron
N053.34.43.216 E014.55.03.044 N053.34.42.827 E014.55.02.908 apron
N053.34.42.827 E014.55.02.908 N053.34.41.460 E014.55.01.236 apron
N053.34.41.460 E014.55.01.236 N053.34.40.450 E014.54.59.579 apron
N053.34.40.450 E014.54.59.579 N053.34.40.333 E014.54.59.188 apron
N053.34.40.333 E014.54.59.188 N053.34.40.413 E014.54.58.295 apron
N053.34.39.646 E014.54.59.746 N053.34.39.620 E014.54.59.796 apron
N053.34.39.190 E014.55.00.627 N053.34.39.166 E014.55.00.673 apron
N053.34.39.166 E014.55.00.673 N053.34.43.457 E014.55.06.896 apron
N053.34.43.457 E014.55.06.896 N053.34.46.328 E014.55.01.359 apron
N053.34.46.328 E014.55.01.359 N053.34.47.945 E014.54.58.360 apron
N053.34.47.945 E014.54.58.360 N053.34.48.455 E014.54.59.112 apron
N053.34.49.125 E014.54.56.130 N053.34.50.950 E014.54.52.395 apron
N053.34.50.950 E014.54.52.395 N053.35.11.566 E014.54.12.377 apron
N053.35.11.715 E014.54.12.089 N053.35.17.347 E014.54.01.157 apron
N053.35.17.580 E014.54.00.704 N053.35.27.618 E014.53.41.221 apron
N053.35.34.480 E014.53.27.992 N053.35.34.780 E014.53.30.210 apron
N053.34.49.153 E014.54.56.454 N053.34.49.125 E014.54.56.130 apron

;EPPO
LOTNISKA_EPPO N052.25.29.069 E016.48.25.382 N052.25.29.145 E016.48.25.031 Color_44ACI
N052.25.29.145 E016.48.25.031 N052.25.29.200 E016.48.24.660 Color_44ACI
N052.25.29.200 E016.48.24.660 N052.25.29.234 E016.48.24.268 Color_44ACI
N052.25.29.234 E016.48.24.268 N052.25.29.220 E016.48.23.931 Color_44ACI
N052.25.29.220 E016.48.23.931 N052.25.29.192 E016.48.23.562 Color_44ACI
N052.25.29.192 E016.48.23.562 N052.25.29.148 E016.48.23.313 Color_44ACI
N052.25.29.148 E016.48.23.313 N052.25.29.004 E016.48.22.819 Color_44ACI
N052.25.29.004 E016.48.22.819 N052.25.28.839 E016.48.22.465 Color_44ACI
N052.25.28.839 E016.48.22.465 N052.25.28.611 E016.48.22.131 Color_44ACI
N052.25.28.611 E016.48.22.131 N052.25.28.339 E016.48.21.840 Color_44ACI
N052.25.28.339 E016.48.21.840 N052.25.28.015 E016.48.21.585 Color_44ACI
N052.25.28.015 E016.48.21.585 N052.25.26.339 E016.48.20.594 Color_44ACI
N052.25.26.339 E016.48.20.594 N052.25.25.858 E016.48.20.311 Color_44ACI
N052.25.25.858 E016.48.20.311 N052.25.25.411 E016.48.20.117 Color_44ACI
N052.25.25.411 E016.48.20.117 N052.25.25.067 E016.48.20.078 Color_44ACI
N052.25.25.067 E016.48.20.078 N052.25.24.743 E016.48.20.157 Color_44ACI
N052.25.24.743 E016.48.20.157 N052.25.24.458 E016.48.20.343 Color_44ACI
N052.25.24.458 E016.48.20.343 N052.25.24.200 E016.48.20.661 Color_44ACI
N052.25.24.200 E016.48.20.661 N052.25.24.005 E016.48.21.018 Color_44ACI
N052.25.24.005 E016.48.21.018 N052.25.23.867 E016.48.21.378 Color_44ACI
N052.25.23.867 E016.48.21.378 N052.25.23.781 E016.48.21.707 Color_44ACI
N052.25.23.781 E016.48.21.707 N052.25.20.062 E016.48.41.100 Color_44ACI
N052.25.20.062 E016.48.41.100 N052.25.19.296 E016.48.45.144 Color_44ACI
N052.25.19.296 E016.48.45.144 N052.25.14.755 E016.49.08.879 Color_44ACI
N052.25.14.755 E016.49.08.879 N052.25.08.026 E016.49.44.039 Color_44ACI
N052.25.08.026 E016.49.44.039 N052.25.07.240 E016.49.48.181 Color_44ACI
N052.25.07.240 E016.49.48.181 N052.25.02.850 E016.50.11.597 Color_44ACI
N052.25.02.850 E016.50.11.597 N052.25.02.431 E016.50.13.837 Color_44ACI
N052.25.02.431 E016.50.13.837 N052.25.00.498 E016.50.24.089 Color_44ACI
N052.25.00.498 E016.50.24.089 N052.25.00.571 E016.50.24.499 Color_44ACI
N052.25.00.571 E016.50.24.499 N052.25.00.749 E016.50.24.994 Color_44ACI
N052.25.00.749 E016.50.24.994 N052.25.00.925 E016.50.25.374 Color_44ACI
N052.25.00.925 E016.50.25.374 N052.25.01.202 E016.50.25.884 Color_44ACI
N052.25.01.202 E016.50.25.884 N052.25.01.471 E016.50.26.343 Color_44ACI
N052.25.01.471 E016.50.26.343 N052.25.01.562 E016.50.26.474 Color_44ACI
N052.25.01.562 E016.50.26.474 N052.25.03.609 E016.50.27.659 Color_44ACI
N052.25.03.609 E016.50.27.659 N052.25.03.817 E016.50.27.741 Color_44ACI
N052.25.03.817 E016.50.27.741 N052.25.04.041 E016.50.27.755 Color_44ACI
N052.25.04.041 E016.50.27.755 N052.25.04.234 E016.50.27.700 Color_44ACI
N052.25.04.234 E016.50.27.700 N052.25.04.411 E016.50.27.600 Color_44ACI
N052.25.04.411 E016.50.27.600 N052.25.04.588 E016.50.27.456 Color_44ACI
N052.25.04.588 E016.50.27.456 N052.25.04.772 E016.50.27.263 Color_44ACI
N052.25.04.772 E016.50.27.263 N052.25.04.981 E016.50.26.994 Color_44ACI
N052.25.04.981 E016.50.26.994 N052.25.05.154 E016.50.26.735 Color_44ACI
N052.25.05.154 E016.50.26.735 N052.25.05.318 E016.50.26.477 Color_44ACI
N052.25.05.318 E016.50.26.477 N052.25.05.445 E016.50.26.254 Color_44ACI
N052.25.05.445 E016.50.26.254 N052.25.05.554 E016.50.26.039 Color_44ACI
N052.25.05.554 E016.50.26.039 N052.25.05.665 E016.50.25.760 Color_44ACI
N052.25.05.665 E016.50.25.760 N052.25.05.769 E016.50.25.477 Color_44ACI
N052.25.05.769 E016.50.25.477 N052.25.05.917 E016.50.25.047 Color_44ACI
N052.25.05.917 E016.50.25.047 N052.25.05.974 E016.50.24.808 Color_44ACI
N052.25.06.134 E016.50.24.621 N052.25.05.967 E016.50.25.770 Color_44ACI
N052.25.05.967 E016.50.25.770 N052.25.05.847 E016.50.27.025 Color_44ACI
N052.25.05.847 E016.50.27.025 N052.25.05.853 E016.50.27.420 Color_44ACI
N052.25.05.853 E016.50.27.420 N052.25.05.903 E016.50.27.831 Color_44ACI
N052.25.05.903 E016.50.27.831 N052.25.06.022 E016.50.28.256 Color_44ACI
N052.25.06.022 E016.50.28.256 N052.25.06.217 E016.50.28.659 Color_44ACI
N052.25.06.217 E016.50.28.659 N052.25.06.445 E016.50.28.974 Color_44ACI
N052.25.06.445 E016.50.28.974 N052.25.06.652 E016.50.29.183 Color_44ACI
N052.25.06.652 E016.50.29.183 N052.25.06.936 E016.50.29.421 Color_44ACI
N052.25.06.936 E016.50.29.421 N052.25.07.203 E016.50.29.605 Color_44ACI
N052.25.07.203 E016.50.29.605 N052.25.09.700 E016.50.30.884 Color_44ACI
N052.25.09.700 E016.50.30.884 N052.25.16.479 E016.50.31.597 Color_44ACI
N052.25.16.479 E016.50.31.597 N052.25.19.970 E016.50.31.961 Color_44ACI
N052.25.19.970 E016.50.31.961 N052.25.21.397 E016.50.32.114 Color_44ACI
N052.25.21.397 E016.50.32.114 N052.25.28.171 E016.50.32.826 Color_44ACI
N052.25.28.171 E016.50.32.826 N052.25.28.341 E016.50.32.950 Color_44ACI
N052.25.28.341 E016.50.32.950 N052.25.28.485 E016.50.33.069 Color_44ACI
N052.25.28.485 E016.50.33.069 N052.25.28.606 E016.50.33.216 Color_44ACI
N052.25.28.606 E016.50.33.216 N052.25.28.692 E016.50.33.424 Color_44ACI
N052.25.28.692 E016.50.33.424 N052.25.28.714 E016.50.33.604 Color_44ACI
N052.25.28.714 E016.50.33.604 N052.25.28.697 E016.50.33.824 Color_44ACI
N052.25.28.697 E016.50.33.824 N052.25.28.632 E016.50.34.082 Color_44ACI
N052.25.28.632 E016.50.34.082 N052.25.27.646 E016.50.37.651 Color_44ACI
N052.25.21.397 E016.50.32.114 N052.25.21.719 E016.50.32.318 Color_44ACI
N052.25.21.719 E016.50.32.318 N052.25.21.887 E016.50.32.451 Color_44ACI
N052.25.21.887 E016.50.32.451 N052.25.22.019 E016.50.32.603 Color_44ACI
N052.25.22.019 E016.50.32.603 N052.25.22.109 E016.50.32.772 Color_44ACI
N052.25.22.109 E016.50.32.772 N052.25.22.161 E016.50.32.954 Color_44ACI
N052.25.22.161 E016.50.32.954 N052.25.22.181 E016.50.33.209 Color_44ACI
N052.25.22.181 E016.50.33.209 N052.25.22.161 E016.50.33.453 Color_44ACI
N052.25.22.161 E016.50.33.453 N052.25.22.092 E016.50.33.792 Color_44ACI
N052.25.22.092 E016.50.33.792 N052.25.20.774 E016.50.38.425 Color_44ACI
N052.25.19.970 E016.50.31.961 N052.25.19.970 E016.50.31.961 Color_44ACI
N052.25.19.970 E016.50.31.961 N052.25.20.185 E016.50.32.090 Color_44ACI
N052.25.20.185 E016.50.32.090 N052.25.20.387 E016.50.32.235 Color_44ACI
N052.25.20.387 E016.50.32.235 N052.25.20.507 E016.50.32.342 Color_44ACI
N052.25.20.507 E016.50.32.342 N052.25.20.621 E016.50.32.489 Color_44ACI
N052.25.20.621 E016.50.32.489 N052.25.20.669 E016.50.32.582 Color_44ACI
N052.25.20.669 E016.50.32.582 N052.25.20.708 E016.50.32.685 Color_44ACI
N052.25.20.708 E016.50.32.685 N052.25.20.744 E016.50.32.859 Color_44ACI
N052.25.20.744 E016.50.32.859 N052.25.20.752 E016.50.33.113 Color_44ACI
N052.25.20.752 E016.50.33.113 N052.25.20.730 E016.50.33.320 Color_44ACI
N052.25.20.730 E016.50.33.320 N052.25.20.682 E016.50.33.574 Color_44ACI
N052.25.20.682 E016.50.33.574 N052.25.19.723 E016.50.37.009 Color_44ACI
N052.25.22.608 E016.48.58.937 N052.25.22.795 E016.48.57.763 Color_44ACI
N052.25.22.795 E016.48.57.763 N052.25.22.906 E016.48.56.509 Color_44ACI
N052.25.22.906 E016.48.56.509 N052.25.22.923 E016.48.55.180 Color_44ACI
N052.25.22.923 E016.48.55.180 N052.25.22.795 E016.48.53.436 Color_44ACI
N052.25.22.795 E016.48.53.436 N052.25.22.453 E016.48.51.422 Color_44ACI
N052.25.22.453 E016.48.51.422 N052.25.22.190 E016.48.50.328 Color_44ACI
N052.25.22.190 E016.48.50.328 N052.25.21.878 E016.48.49.176 Color_44ACI
N052.25.21.878 E016.48.49.176 N052.25.21.311 E016.48.47.111 Color_44ACI
N052.25.21.311 E016.48.47.111 N052.25.20.726 E016.48.44.996 Color_44ACI
N052.25.20.726 E016.48.44.996 N052.25.20.225 E016.48.43.172 Color_44ACI
N052.25.20.225 E016.48.43.172 N052.25.20.112 E016.48.42.677 Color_44ACI
N052.25.20.112 E016.48.42.677 N052.25.20.045 E016.48.42.257 Color_44ACI
N052.25.20.045 E016.48.42.257 N052.25.20.022 E016.48.41.742 Color_44ACI
N052.25.20.022 E016.48.41.742 N052.25.20.043 E016.48.41.319 Color_44ACI
N052.25.20.043 E016.48.41.319 N052.25.20.062 E016.48.41.100 Color_44ACI
N052.25.19.296 E016.48.45.144 N052.25.19.453 E016.48.44.929 Color_44ACI
N052.25.19.453 E016.48.44.929 N052.25.19.639 E016.48.44.754 Color_44ACI
N052.25.19.639 E016.48.44.754 N052.25.19.858 E016.48.44.629 Color_44ACI
N052.25.19.858 E016.48.44.629 N052.25.20.070 E016.48.44.612 Color_44ACI
N052.25.20.070 E016.48.44.612 N052.25.20.270 E016.48.44.679 Color_44ACI
N052.25.20.270 E016.48.44.679 N052.25.20.434 E016.48.44.807 Color_44ACI
N052.25.20.434 E016.48.44.807 N052.25.20.599 E016.48.45.008 Color_44ACI
N052.25.20.599 E016.48.45.008 N052.25.20.744 E016.48.45.253 Color_44ACI
N052.25.20.744 E016.48.45.253 N052.25.20.868 E016.48.45.510 Color_44ACI
N052.25.12.163 E016.49.48.629 N052.25.08.893 E016.49.46.979 Color_44ACI
N052.25.08.893 E016.49.46.979 N052.25.06.328 E016.49.45.696 Color_44ACI
N052.25.06.328 E016.49.45.696 N052.25.03.700 E016.49.44.375 Color_44ACI
N052.25.03.700 E016.49.44.375 N052.25.02.977 E016.49.44.011 Color_44ACI
N052.25.02.977 E016.49.44.011 N052.25.01.220 E016.49.43.118 Color_44ACI
N052.25.01.220 E016.49.43.118 N052.25.00.523 E016.49.42.853 Color_44ACI
N052.25.02.431 E016.50.13.837 N052.25.02.532 E016.50.13.485 Color_44ACI
N052.25.02.532 E016.50.13.485 N052.25.02.641 E016.50.13.241 Color_44ACI
N052.25.02.641 E016.50.13.241 N052.25.02.777 E016.50.13.060 Color_44ACI
N052.25.02.777 E016.50.13.060 N052.25.02.974 E016.50.12.950 Color_44ACI
N052.25.02.974 E016.50.12.950 N052.25.03.205 E016.50.12.960 Color_44ACI
N052.25.03.205 E016.50.12.960 N052.25.03.455 E016.50.13.062 Color_44ACI
N052.25.03.455 E016.50.13.062 N052.25.03.839 E016.50.13.252 Color_44ACI
N052.25.03.839 E016.50.13.252 N052.25.04.167 E016.50.13.266 Color_44ACI
N052.25.04.167 E016.50.13.266 N052.25.04.373 E016.50.13.154 Color_44ACI
N052.25.04.373 E016.50.13.154 N052.25.04.586 E016.50.12.909 Color_44ACI
N052.25.04.586 E016.50.12.909 N052.25.04.927 E016.50.12.479 Color_44ACI
N052.25.04.927 E016.50.12.479 N052.25.05.604 E016.50.11.587 Color_44ACI
N052.25.05.604 E016.50.11.587 N052.25.06.505 E016.50.10.381 Color_44ACI
N052.25.06.505 E016.50.10.381 N052.25.07.042 E016.50.09.645 Color_44ACI
N052.25.07.042 E016.50.09.645 N052.25.08.094 E016.50.08.093 Color_44ACI
N052.25.08.094 E016.50.08.093 N052.25.08.822 E016.50.06.813 Color_44ACI
N052.25.08.822 E016.50.06.813 N052.25.09.348 E016.50.05.672 Color_44ACI
N052.25.09.348 E016.50.05.672 N052.25.09.763 E016.50.04.516 Color_44ACI
N052.25.09.763 E016.50.04.516 N052.25.10.059 E016.50.03.392 Color_44ACI
N052.25.02.850 E016.50.11.597 N052.25.02.832 E016.50.11.941 Color_44ACI
N052.25.02.832 E016.50.11.941 N052.25.02.867 E016.50.12.209 Color_44ACI
N052.25.02.867 E016.50.12.209 N052.25.02.943 E016.50.12.457 Color_44ACI
N052.25.02.943 E016.50.12.457 N052.25.03.043 E016.50.12.659 Color_44ACI
N052.25.03.043 E016.50.12.659 N052.25.03.172 E016.50.12.841 Color_44ACI
N052.25.03.172 E016.50.12.841 N052.25.03.346 E016.50.13.017 Color_44ACI
N052.24.59.173 E016.49.35.280 N052.24.59.182 E016.49.35.238 Color_44ACI
N052.24.59.182 E016.49.35.238 N052.24.59.211 E016.49.35.125 Color_44ACI
N052.24.59.211 E016.49.35.125 N052.24.59.261 E016.49.34.958 Color_44ACI
N052.24.59.261 E016.49.34.958 N052.24.59.331 E016.49.34.757 Color_44ACI
N052.24.59.331 E016.49.34.757 N052.24.59.423 E016.49.34.540 Color_44ACI
N052.24.59.423 E016.49.34.540 N052.24.59.537 E016.49.34.327 Color_44ACI
N052.24.59.537 E016.49.34.327 N052.24.59.674 E016.49.34.135 Color_44ACI
N052.24.59.674 E016.49.34.135 N052.24.59.835 E016.49.33.985 Color_44ACI
N052.24.59.835 E016.49.33.985 N052.25.00.020 E016.49.33.893 Color_44ACI
N052.25.00.020 E016.49.33.893 N052.25.00.157 E016.49.33.875 Color_44ACI
N052.25.00.157 E016.49.33.875 N052.25.00.175 E016.49.33.876 Color_44ACI
N052.25.00.175 E016.49.33.876 N052.25.00.254 E016.49.33.880 Color_44ACI
N052.25.00.254 E016.49.33.880 N052.25.00.441 E016.49.33.889 Color_44ACI
N052.25.00.441 E016.49.33.889 N052.25.01.315 E016.49.33.934 Color_44ACI
N052.25.01.315 E016.49.33.934 N052.25.03.592 E016.49.34.050 Color_44ACI
N052.25.03.592 E016.49.34.050 N052.25.03.626 E016.49.34.053 Color_44ACI
N052.25.03.626 E016.49.34.053 N052.25.03.677 E016.49.34.060 Color_44ACI
N052.25.03.677 E016.49.34.060 N052.25.03.759 E016.49.34.077 Color_44ACI
N052.25.03.759 E016.49.34.077 N052.25.03.860 E016.49.34.106 Color_44ACI
N052.25.03.860 E016.49.34.106 N052.25.03.967 E016.49.34.151 Color_44ACI
N052.25.03.967 E016.49.34.151 N052.25.04.069 E016.49.34.217 Color_44ACI
N052.25.04.069 E016.49.34.217 N052.25.04.161 E016.49.34.319 Color_44ACI
N052.25.04.161 E016.49.34.319 N052.25.04.238 E016.49.34.477 Color_44ACI
N052.25.04.238 E016.49.34.477 N052.25.04.299 E016.49.34.713 Color_44ACI
N052.25.04.299 E016.49.34.713 N052.25.04.338 E016.49.35.047 Color_44ACI
N052.24.58.599 E016.50.24.702 N052.24.58.578 E016.50.24.687 Color_44ACI
N052.24.58.578 E016.50.24.687 N052.24.58.515 E016.50.24.623 Color_44ACI
N052.24.58.515 E016.50.24.623 N052.24.58.405 E016.50.24.480 Color_44ACI
N052.24.58.405 E016.50.24.480 N052.24.58.244 E016.50.24.228 Color_44ACI
N052.24.58.244 E016.50.24.228 N052.24.58.028 E016.50.23.839 Color_44ACI
N052.24.58.028 E016.50.23.839 N052.24.57.895 E016.50.23.579 Color_44ACI
N052.24.57.895 E016.50.23.579 N052.24.57.827 E016.50.23.455 Color_44ACI
N052.24.57.827 E016.50.23.455 N052.24.57.570 E016.50.22.989 Color_44ACI
N052.24.57.570 E016.50.22.989 N052.24.57.034 E016.50.22.017 Color_44ACI
N052.24.57.034 E016.50.22.017 N052.24.56.437 E016.50.20.933 Color_44ACI
N052.24.56.437 E016.50.20.933 N052.24.56.154 E016.50.20.420 Color_44ACI
N052.24.59.080 E016.50.24.976 N052.24.59.181 E016.50.24.992 Color_44ACI
N052.24.59.181 E016.50.24.992 N052.24.59.439 E016.50.24.990 Color_44ACI
N052.24.59.439 E016.50.24.990 N052.24.59.789 E016.50.24.890 Color_44ACI
N052.24.59.789 E016.50.24.890 N052.25.00.165 E016.50.24.616 Color_44ACI
N052.25.00.165 E016.50.24.616 N052.25.00.498 E016.50.24.089 Color_44ACI
N052.24.58.599 E016.50.24.702 N052.25.01.562 E016.50.26.474 Color_44ACI
N052.24.56.829 E016.50.21.645 N052.24.56.816 E016.50.21.633 Color_44ACI
N052.24.56.816 E016.50.21.633 N052.24.56.778 E016.50.21.599 Color_44ACI
N052.24.56.778 E016.50.21.599 N052.24.56.715 E016.50.21.552 Color_44ACI
N052.24.56.715 E016.50.21.552 N052.24.56.627 E016.50.21.495 Color_44ACI
N052.24.56.627 E016.50.21.495 N052.24.56.516 E016.50.21.436 Color_44ACI
N052.24.56.516 E016.50.21.436 N052.24.56.381 E016.50.21.380 Color_44ACI
N052.24.56.381 E016.50.21.380 N052.24.56.224 E016.50.21.333 Color_44ACI
N052.24.56.224 E016.50.21.333 N052.24.56.045 E016.50.21.302 Color_44ACI
N052.24.56.045 E016.50.21.302 N052.24.55.843 E016.50.21.293 Color_44ACI
N052.24.55.843 E016.50.21.293 N052.24.55.697 E016.50.21.301 Color_44ACI
N052.24.55.697 E016.50.21.301 N052.24.55.684 E016.50.21.301 Color_44ACI
N052.24.55.684 E016.50.21.301 N052.24.55.626 E016.50.21.301 Color_44ACI
N052.24.55.626 E016.50.21.301 N052.24.55.489 E016.50.21.299 Color_44ACI
N052.24.55.489 E016.50.21.299 N052.24.55.239 E016.50.21.296 Color_44ACI
N052.24.55.239 E016.50.21.296 N052.24.54.846 E016.50.21.292 Color_44ACI
N052.24.54.846 E016.50.21.292 N052.24.54.342 E016.50.21.287 Color_44ACI
N052.24.54.342 E016.50.21.287 N052.24.53.828 E016.50.21.281 Color_44ACI
N052.24.53.828 E016.50.21.281 N052.24.53.404 E016.50.21.277 Color_44ACI
N052.24.53.404 E016.50.21.277 N052.24.53.171 E016.50.21.274 Color_44ACI
N052.24.53.171 E016.50.21.274 N052.24.53.153 E016.50.21.274 Color_44ACI
N052.24.53.153 E016.50.21.274 N052.24.53.145 E016.50.21.275 Color_44ACI
N052.24.53.145 E016.50.21.275 N052.24.53.121 E016.50.21.278 Color_44ACI
N052.24.53.121 E016.50.21.278 N052.24.53.069 E016.50.21.284 Color_44ACI
N052.24.53.069 E016.50.21.284 N052.24.52.979 E016.50.21.294 Color_44ACI
N052.24.52.979 E016.50.21.294 N052.24.52.847 E016.50.21.304 Color_44ACI
N052.24.52.847 E016.50.21.304 N052.24.52.698 E016.50.21.277 Color_44ACI
N052.24.52.698 E016.50.21.277 N052.24.52.576 E016.50.21.159 Color_44ACI
N052.24.52.576 E016.50.21.159 N052.24.52.519 E016.50.20.900 Color_44ACI
N052.24.52.519 E016.50.20.900 N052.24.52.570 E016.50.20.446 Color_44ACI
N052.24.52.570 E016.50.20.446 N052.24.52.599 E016.50.20.381 Color_44ACI
N052.24.52.599 E016.50.20.381 N052.24.52.679 E016.50.20.235 Color_44ACI
N052.24.52.679 E016.50.20.235 N052.24.52.795 E016.50.20.079 Color_44ACI
N052.24.52.795 E016.50.20.079 N052.24.52.935 E016.50.19.988 Color_44ACI
N052.24.52.935 E016.50.19.988 N052.24.53.085 E016.50.20.033 Color_44ACI
N052.24.53.085 E016.50.20.033 N052.24.53.160 E016.50.20.131 Color_44ACI
N052.24.53.160 E016.50.20.131 N052.24.53.185 E016.50.20.176 Color_44ACI
N052.24.53.185 E016.50.20.176 N052.24.53.275 E016.50.20.346 Color_44ACI
N052.24.53.275 E016.50.20.346 N052.24.53.465 E016.50.20.700 Color_44ACI
N052.24.53.465 E016.50.20.700 N052.24.53.677 E016.50.21.094 Color_44ACI
N052.24.53.677 E016.50.21.094 N052.24.53.777 E016.50.21.281 Color_44ACI
N052.25.12.163 E016.49.48.629 N052.25.12.345 E016.49.48.945 Color_44ACI
N052.25.12.345 E016.49.48.945 N052.25.12.619 E016.49.49.850 Color_44ACI
N052.25.12.619 E016.49.49.850 N052.25.12.584 E016.49.51.279 Color_44ACI
N052.25.12.163 E016.49.48.629 N052.25.12.317 E016.49.48.644 Color_44ACI
N052.25.12.317 E016.49.48.644 N052.25.12.699 E016.49.48.481 Color_44ACI
N052.25.12.699 E016.49.48.481 N052.25.13.193 E016.49.47.825 Color_44ACI
N052.25.08.026 E016.49.44.039 N052.25.07.922 E016.49.44.229 Color_44ACI
N052.25.07.922 E016.49.44.229 N052.25.07.646 E016.49.44.676 Color_44ACI
N052.25.07.646 E016.49.44.676 N052.25.07.252 E016.49.45.193 Color_44ACI
N052.25.07.252 E016.49.45.193 N052.25.06.794 E016.49.45.594 Color_44ACI
N052.25.06.794 E016.49.45.594 N052.25.06.328 E016.49.45.696 Color_44ACI
N052.25.08.033 E016.49.44.040 N052.25.08.035 E016.49.44.302 Color_44ACI
N052.25.08.035 E016.49.44.302 N052.25.08.074 E016.49.44.942 Color_44ACI
N052.25.08.074 E016.49.44.942 N052.25.08.200 E016.49.45.747 Color_44ACI
N052.25.08.200 E016.49.45.747 N052.25.08.461 E016.49.46.500 Color_44ACI
N052.25.08.461 E016.49.46.500 N052.25.08.908 E016.49.46.985 Color_44ACI
N052.25.07.259 E016.49.48.127 N052.25.07.342 E016.49.47.964 Color_44ACI
N052.25.07.342 E016.49.47.964 N052.25.07.574 E016.49.47.591 Color_44ACI
N052.25.07.574 E016.49.47.591 N052.25.07.928 E016.49.47.185 Color_44ACI
N052.25.07.928 E016.49.47.185 N052.25.08.376 E016.49.46.922 Color_44ACI
N052.25.08.376 E016.49.46.922 N052.25.08.893 E016.49.46.979 Color_44ACI
N052.25.07.240 E016.49.48.181 N052.25.07.237 E016.49.48.024 Color_44ACI
N052.25.07.237 E016.49.48.024 N052.25.07.190 E016.49.47.609 Color_44ACI
N052.25.07.190 E016.49.47.609 N052.25.07.050 E016.49.47.021 Color_44ACI
N052.25.07.050 E016.49.47.021 N052.25.06.762 E016.49.46.346 Color_44ACI
N052.25.06.762 E016.49.46.346 N052.25.06.276 E016.49.45.670 Color_44ACI
N052.25.04.402 E016.49.42.678 N052.25.04.415 E016.49.42.865 Color_44ACI
N052.25.04.415 E016.49.42.865 N052.25.04.472 E016.49.43.337 Color_44ACI
N052.25.04.472 E016.49.43.337 N052.25.04.599 E016.49.43.958 Color_44ACI
N052.25.04.599 E016.49.43.958 N052.25.04.821 E016.49.44.594 Color_44ACI
N052.25.04.821 E016.49.44.594 N052.25.05.164 E016.49.45.110 Color_44ACI
N052.25.04.366 E016.49.38.518 N052.25.04.369 E016.49.38.951 Color_44ACI
N052.25.04.369 E016.49.38.951 N052.25.04.379 E016.49.39.983 Color_44ACI
N052.25.04.379 E016.49.39.983 N052.25.04.389 E016.49.41.214 Color_44ACI
N052.25.04.389 E016.49.41.214 N052.25.04.398 E016.49.42.246 Color_44ACI
N052.25.04.398 E016.49.42.246 N052.25.04.402 E016.49.42.678 Color_44ACI
N052.25.04.335 E016.49.34.982 N052.25.04.337 E016.49.35.253 Color_44ACI
N052.25.04.337 E016.49.35.253 N052.25.04.343 E016.49.35.901 Color_44ACI
N052.25.04.343 E016.49.35.901 N052.25.04.350 E016.49.36.673 Color_44ACI
N052.25.04.350 E016.49.36.673 N052.25.04.355 E016.49.37.320 Color_44ACI
N052.25.04.355 E016.49.37.320 N052.25.04.358 E016.49.37.592 Color_44ACI
N052.24.59.202 E016.49.37.290 N052.24.59.224 E016.49.37.196 Color_44ACI
N052.24.59.224 E016.49.37.196 N052.24.59.293 E016.49.36.958 Color_44ACI
N052.24.59.293 E016.49.36.958 N052.24.59.410 E016.49.36.642 Color_44ACI
N052.24.59.410 E016.49.36.642 N052.24.59.579 E016.49.36.315 Color_44ACI
N052.24.59.579 E016.49.36.315 N052.24.59.802 E016.49.36.044 Color_44ACI
N052.24.59.802 E016.49.36.044 N052.25.00.080 E016.49.35.895 Color_44ACI
N052.25.00.080 E016.49.35.895 N052.25.00.194 E016.49.35.885 Color_44ACI
N052.25.00.194 E016.49.35.885 N052.25.00.312 E016.49.35.891 Color_44ACI
N052.25.00.312 E016.49.35.891 N052.25.00.702 E016.49.35.911 Color_44ACI
N052.25.00.702 E016.49.35.911 N052.25.01.515 E016.49.35.953 Color_44ACI
N052.25.01.515 E016.49.35.953 N052.25.02.586 E016.49.36.007 Color_44ACI
N052.25.02.586 E016.49.36.007 N052.25.03.439 E016.49.36.051 Color_44ACI
N052.25.03.439 E016.49.36.051 N052.25.03.651 E016.49.36.063 Color_44ACI
N052.25.03.651 E016.49.36.063 N052.25.03.728 E016.49.36.081 Color_44ACI
N052.25.03.728 E016.49.36.081 N052.25.03.856 E016.49.36.126 Color_44ACI
N052.25.03.856 E016.49.36.126 N052.25.03.987 E016.49.36.202 Color_44ACI
N052.25.03.987 E016.49.36.202 N052.25.04.095 E016.49.36.335 Color_44ACI
N052.25.04.095 E016.49.36.335 N052.25.04.205 E016.49.36.604 Color_44ACI
N052.25.04.205 E016.49.36.604 N052.25.04.348 E016.49.37.097 Color_44ACI
N052.24.59.237 E016.49.40.022 N052.24.59.259 E016.49.39.927 Color_44ACI
N052.24.59.259 E016.49.39.927 N052.24.59.328 E016.49.39.689 Color_44ACI
N052.24.59.328 E016.49.39.689 N052.24.59.445 E016.49.39.373 Color_44ACI
N052.24.59.445 E016.49.39.373 N052.24.59.614 E016.49.39.046 Color_44ACI
N052.24.59.614 E016.49.39.046 N052.24.59.836 E016.49.38.775 Color_44ACI
N052.24.59.836 E016.49.38.775 N052.25.00.115 E016.49.38.627 Color_44ACI
N052.25.00.115 E016.49.38.627 N052.25.00.229 E016.49.38.616 Color_44ACI
N052.25.00.229 E016.49.38.616 N052.25.00.347 E016.49.38.622 Color_44ACI
N052.25.00.347 E016.49.38.622 N052.25.00.737 E016.49.38.642 Color_44ACI
N052.25.00.737 E016.49.38.642 N052.25.01.550 E016.49.38.684 Color_44ACI
N052.25.01.550 E016.49.38.684 N052.25.02.621 E016.49.38.739 Color_44ACI
N052.25.02.621 E016.49.38.739 N052.25.03.474 E016.49.38.782 Color_44ACI
N052.25.03.474 E016.49.38.782 N052.25.03.685 E016.49.38.794 Color_44ACI
N052.25.03.685 E016.49.38.794 N052.25.03.762 E016.49.38.813 Color_44ACI
N052.25.03.762 E016.49.38.813 N052.25.03.890 E016.49.38.858 Color_44ACI
N052.25.03.890 E016.49.38.858 N052.25.04.022 E016.49.38.933 Color_44ACI
N052.25.04.022 E016.49.38.933 N052.25.04.130 E016.49.39.066 Color_44ACI
N052.25.04.130 E016.49.39.066 N052.25.04.240 E016.49.39.335 Color_44ACI
N052.25.04.240 E016.49.39.335 N052.25.04.383 E016.49.39.828 Color_44ACI
N052.25.04.358 E016.49.37.592 N052.25.04.366 E016.49.38.518 Color_44ACI
N052.24.59.252 E016.49.41.138 N052.24.59.231 E016.49.39.617 Color_44ACI
N052.24.59.231 E016.49.39.617 N052.24.59.192 E016.49.36.793 Color_44ACI
N052.24.59.192 E016.49.36.793 N052.24.59.170 E016.49.35.272 Color_44ACI
N052.24.56.175 E016.50.20.456 N052.24.56.163 E016.50.20.437 Color_44ACI
N052.24.56.163 E016.50.20.437 N052.24.56.131 E016.50.20.384 Color_44ACI
N052.24.56.131 E016.50.20.384 N052.24.56.085 E016.50.20.301 Color_44ACI
N052.24.56.085 E016.50.20.301 N052.24.56.035 E016.50.20.192 Color_44ACI
N052.24.56.035 E016.50.20.192 N052.24.55.985 E016.50.20.061 Color_44ACI
N052.24.55.985 E016.50.20.061 N052.24.55.945 E016.50.19.913 Color_44ACI
N052.24.55.945 E016.50.19.913 N052.24.55.919 E016.50.19.750 Color_44ACI
N052.24.55.919 E016.50.19.750 N052.24.55.918 E016.50.19.694 Color_44ACI
N052.24.55.918 E016.50.19.694 N052.24.55.925 E016.50.19.426 Color_44ACI
N052.24.55.925 E016.50.19.426 N052.24.55.946 E016.50.18.630 Color_44ACI
N052.24.55.946 E016.50.18.630 N052.24.55.988 E016.50.17.020 Color_44ACI
N052.24.55.988 E016.50.17.020 N052.24.56.050 E016.50.14.676 Color_44ACI
N052.24.56.050 E016.50.14.676 N052.24.56.110 E016.50.12.379 Color_44ACI
N052.24.56.110 E016.50.12.379 N052.24.56.147 E016.50.10.995 Color_44ACI
N052.24.56.147 E016.50.10.995 N052.24.56.150 E016.50.10.880 Color_44ACI
N052.24.56.150 E016.50.10.880 N052.24.56.151 E016.50.10.807 Color_44ACI
N052.24.56.151 E016.50.10.807 N052.24.56.156 E016.50.10.564 Color_44ACI
N052.24.56.156 E016.50.10.564 N052.24.56.166 E016.50.10.050 Color_44ACI
N052.24.56.166 E016.50.10.050 N052.24.56.183 E016.50.09.249 Color_44ACI
N052.24.56.183 E016.50.09.249 N052.24.56.200 E016.50.08.414 Color_44ACI
N052.24.56.200 E016.50.08.414 N052.24.56.211 E016.50.07.850 Color_44ACI
N052.24.56.211 E016.50.07.850 N052.24.56.214 E016.50.07.753 Color_44ACI
N052.24.56.214 E016.50.07.753 N052.24.56.251 E016.50.07.444 Color_44ACI
N052.24.56.251 E016.50.07.444 N052.24.56.392 E016.50.06.279 Color_44ACI
N052.24.56.392 E016.50.06.279 N052.24.56.704 E016.50.03.687 Color_44ACI
N052.24.56.704 E016.50.03.687 N052.24.57.222 E016.49.59.390 Color_44ACI
N052.24.57.222 E016.49.59.390 N052.24.57.798 E016.49.54.618 Color_44ACI
N052.24.57.798 E016.49.54.618 N052.24.58.224 E016.49.51.083 Color_44ACI
N052.24.58.224 E016.49.51.083 N052.24.58.323 E016.49.50.257 Color_44ACI
N052.24.58.323 E016.49.50.257 N052.24.58.334 E016.49.50.183 Color_44ACI
N052.24.58.334 E016.49.50.183 N052.24.58.382 E016.49.49.857 Color_44ACI
N052.24.58.382 E016.49.49.857 N052.24.58.494 E016.49.49.090 Color_44ACI
N052.24.58.494 E016.49.49.090 N052.24.58.691 E016.49.47.744 Color_44ACI
N052.24.58.691 E016.49.47.744 N052.24.58.925 E016.49.46.149 Color_44ACI
N052.24.58.925 E016.49.46.149 N052.24.59.112 E016.49.44.868 Color_44ACI
N052.24.59.112 E016.49.44.868 N052.24.59.173 E016.49.44.452 Color_44ACI
N052.24.59.173 E016.49.44.452 N052.24.59.174 E016.49.44.423 Color_44ACI
N052.24.59.174 E016.49.44.423 N052.24.59.177 E016.49.44.264 Color_44ACI
N052.24.59.177 E016.49.44.264 N052.24.59.187 E016.49.43.865 Color_44ACI
N052.24.59.187 E016.49.43.865 N052.24.59.205 E016.49.43.129 Color_44ACI
N052.24.59.205 E016.49.43.129 N052.24.59.227 E016.49.42.195 Color_44ACI
N052.24.59.227 E016.49.42.195 N052.24.59.246 E016.49.41.391 Color_44ACI
N052.24.59.246 E016.49.41.391 N052.24.59.254 E016.49.41.049 Color_44ACI
N052.25.00.523 E016.49.42.853 N052.25.00.233 E016.49.43.036 Color_44ACI
N052.25.00.233 E016.49.43.036 N052.24.59.625 E016.49.43.678 Color_44ACI
N052.24.59.625 E016.49.43.678 N052.24.59.097 E016.49.44.921 Color_44ACI
N052.24.59.251 E016.49.41.179 N052.24.59.421 E016.49.41.558 Color_44ACI
N052.24.59.421 E016.49.41.558 N052.24.59.862 E016.49.42.308 Color_44ACI
N052.24.59.862 E016.49.42.308 N052.25.00.523 E016.49.42.853 Color_44ACI
N052.24.59.200 E016.49.43.305 N052.24.59.358 E016.49.43.331 Color_44ACI
N052.24.59.358 E016.49.43.331 N052.24.59.702 E016.49.43.332 Color_44ACI
N052.24.59.702 E016.49.43.332 N052.25.00.110 E016.49.43.166 Color_44ACI
N052.24.54.238 E016.50.20.620 N052.24.54.239 E016.50.20.761 Color_44ACI
N052.24.54.239 E016.50.20.761 N052.24.54.313 E016.50.21.051 Color_44ACI
N052.24.54.313 E016.50.21.051 N052.24.54.560 E016.50.21.289 Color_44ACI
N052.24.54.565 E016.50.19.202 N052.24.54.462 E016.50.19.260 Color_44ACI
N052.24.54.462 E016.50.19.260 N052.24.54.284 E016.50.19.532 Color_44ACI
N052.24.54.284 E016.50.19.532 N052.24.54.231 E016.50.20.166 Color_44ACI
N052.24.55.537 E016.50.21.300 N052.24.55.580 E016.50.21.287 Color_44ACI
N052.24.55.580 E016.50.21.287 N052.24.55.683 E016.50.21.220 Color_44ACI
N052.24.55.683 E016.50.21.220 N052.24.55.804 E016.50.21.058 Color_44ACI
N052.24.55.804 E016.50.21.058 N052.24.55.904 E016.50.20.758 Color_44ACI
N052.24.55.904 E016.50.20.758 N052.24.55.943 E016.50.20.279 Color_44ACI
N052.24.55.944 E016.50.20.286 N052.24.55.943 E016.50.20.247 Color_44ACI
N052.24.55.943 E016.50.20.247 N052.24.55.937 E016.50.20.143 Color_44ACI
N052.24.55.937 E016.50.20.143 N052.24.55.921 E016.50.19.994 Color_44ACI
N052.24.55.921 E016.50.19.994 N052.24.55.890 E016.50.19.819 Color_44ACI
N052.24.55.890 E016.50.19.819 N052.24.55.838 E016.50.19.639 Color_44ACI
N052.24.55.838 E016.50.19.639 N052.24.55.762 E016.50.19.473 Color_44ACI
N052.24.55.762 E016.50.19.473 N052.24.55.655 E016.50.19.340 Color_44ACI
N052.24.55.655 E016.50.19.340 N052.24.55.513 E016.50.19.260 Color_44ACI
N052.24.55.513 E016.50.19.260 N052.24.55.426 E016.50.19.246 Color_44ACI
N052.24.55.426 E016.50.19.246 N052.24.55.405 E016.50.19.245 Color_44ACI
N052.24.55.405 E016.50.19.245 N052.24.55.327 E016.50.19.241 Color_44ACI
N052.24.55.327 E016.50.19.241 N052.24.55.152 E016.50.19.232 Color_44ACI
N052.24.55.152 E016.50.19.232 N052.24.54.843 E016.50.19.216 Color_44ACI
N052.24.54.843 E016.50.19.216 N052.24.54.411 E016.50.19.194 Color_44ACI
N052.24.54.411 E016.50.19.194 N052.24.53.959 E016.50.19.171 Color_44ACI
N052.24.53.959 E016.50.19.171 N052.24.53.603 E016.50.19.153 Color_44ACI
N052.24.53.603 E016.50.19.153 N052.24.53.459 E016.50.19.145 Color_44ACI
N052.24.53.384 E016.50.18.809 N052.24.53.392 E016.50.18.832 Color_44ACI
N052.24.53.392 E016.50.18.832 N052.24.53.418 E016.50.18.890 Color_44ACI
N052.24.53.418 E016.50.18.890 N052.24.53.465 E016.50.18.971 Color_44ACI
N052.24.53.465 E016.50.18.971 N052.24.53.537 E016.50.19.063 Color_44ACI
N052.24.53.537 E016.50.19.063 N052.24.53.637 E016.50.19.154 Color_44ACI
N052.24.54.272 E016.50.18.687 N052.24.54.276 E016.50.18.728 Color_44ACI
N052.24.54.276 E016.50.18.728 N052.24.54.296 E016.50.18.832 Color_44ACI
N052.24.54.296 E016.50.18.832 N052.24.54.343 E016.50.18.966 Color_44ACI
N052.24.54.343 E016.50.18.966 N052.24.54.429 E016.50.19.100 Color_44ACI
N052.24.54.429 E016.50.19.100 N052.24.54.565 E016.50.19.202 Color_44ACI
N052.24.55.500 E016.50.19.256 N052.24.55.946 E016.50.18.619 Color_44ACI
N052.24.55.556 E016.50.17.119 N052.24.53.438 E016.50.17.012 Color_44ACI
N052.24.54.575 E016.50.17.069 N052.24.54.535 E016.50.17.117 Color_44ACI
N052.24.54.535 E016.50.17.117 N052.24.54.442 E016.50.17.260 Color_44ACI
N052.24.54.442 E016.50.17.260 N052.24.54.336 E016.50.17.496 Color_44ACI
N052.24.54.336 E016.50.17.496 N052.24.54.259 E016.50.17.821 Color_44ACI
N052.24.54.259 E016.50.17.821 N052.24.54.249 E016.50.18.234 Color_44ACI
N052.24.53.741 E016.50.17.027 N052.24.53.692 E016.50.17.063 Color_44ACI
N052.24.53.692 E016.50.17.063 N052.24.53.579 E016.50.17.190 Color_44ACI
N052.24.53.579 E016.50.17.190 N052.24.53.449 E016.50.17.433 Color_44ACI
N052.24.53.449 E016.50.17.433 N052.24.53.353 E016.50.17.819 Color_44ACI
N052.24.53.353 E016.50.17.819 N052.24.53.340 E016.50.18.373 Color_44ACI
N052.24.55.965 E016.50.17.885 N052.24.55.556 E016.50.17.119 Color_44ACI
N052.24.55.556 E016.50.17.119 N052.24.55.742 E016.50.16.855 Color_44ACI
N052.24.55.742 E016.50.16.855 N052.24.55.742 E016.50.16.855 Color_44ACI
N052.24.55.742 E016.50.16.855 N052.24.55.970 E016.50.16.525 Color_44ACI
N052.24.55.970 E016.50.16.525 N052.24.56.002 E016.50.16.478 Color_44ACI
N052.24.58.450 E016.49.33.978 N052.24.56.464 E016.49.33.812 Color_44ACI
N052.24.58.974 E016.49.37.432 N052.24.58.961 E016.49.37.407 Color_44ACI
N052.24.58.961 E016.49.37.407 N052.24.58.920 E016.49.37.341 Color_44ACI
N052.24.58.920 E016.49.37.341 N052.24.58.845 E016.49.37.255 Color_44ACI
N052.24.58.845 E016.49.37.255 N052.24.58.728 E016.49.37.165 Color_44ACI
N052.24.58.728 E016.49.37.165 N052.24.58.564 E016.49.37.090 Color_44ACI
N052.24.58.564 E016.49.37.090 N052.24.58.460 E016.49.37.064 Color_44ACI
N052.24.58.460 E016.49.37.064 N052.24.58.385 E016.49.37.056 Color_44ACI
N052.24.58.385 E016.49.37.056 N052.24.58.104 E016.49.37.028 Color_44ACI
N052.24.58.104 E016.49.37.028 N052.24.57.516 E016.49.36.969 Color_44ACI
N052.24.57.516 E016.49.36.969 N052.24.56.860 E016.49.36.903 Color_44ACI
N052.24.56.860 E016.49.36.903 N052.24.56.550 E016.49.36.871 Color_44ACI
N052.24.59.210 E016.49.38.122 N052.24.59.203 E016.49.38.030 Color_44ACI
N052.24.59.203 E016.49.38.030 N052.24.59.144 E016.49.37.785 Color_44ACI
N052.24.59.144 E016.49.37.785 N052.24.58.974 E016.49.37.432 Color_44ACI
N052.24.59.173 E016.49.35.421 N052.24.59.058 E016.49.35.099 Color_44ACI
N052.24.59.058 E016.49.35.099 N052.24.58.774 E016.49.34.495 Color_44ACI
N052.24.58.774 E016.49.34.495 N052.24.58.413 E016.49.34.148 Color_44ACI
N052.24.59.170 E016.49.35.272 N052.24.59.155 E016.49.34.956 Color_44ACI
N052.24.59.155 E016.49.34.956 N052.24.58.943 E016.49.34.425 Color_44ACI
N052.24.58.943 E016.49.34.425 N052.24.58.450 E016.49.33.978 Color_44ACI
N052.24.59.249 E016.49.40.876 N052.24.59.228 E016.49.40.795 Color_44ACI
N052.24.59.228 E016.49.40.795 N052.24.59.165 E016.49.40.597 Color_44ACI
N052.24.59.165 E016.49.40.597 N052.24.59.057 E016.49.40.345 Color_44ACI
N052.24.59.057 E016.49.40.345 N052.24.58.905 E016.49.40.103 Color_44ACI
N052.24.58.905 E016.49.40.103 N052.24.58.707 E016.49.39.936 Color_44ACI
N052.24.58.707 E016.49.39.936 N052.24.58.587 E016.49.39.899 Color_44ACI
N052.24.58.587 E016.49.39.899 N052.24.58.510 E016.49.39.893 Color_44ACI
N052.24.58.510 E016.49.39.893 N052.24.58.219 E016.49.39.871 Color_44ACI
N052.24.58.219 E016.49.39.871 N052.24.57.612 E016.49.39.825 Color_44ACI
N052.24.57.612 E016.49.39.825 N052.24.56.936 E016.49.39.773 Color_44ACI
N052.24.56.936 E016.49.39.773 N052.24.56.616 E016.49.39.748 Color_44ACI
N052.24.59.232 E016.49.39.703 N052.24.59.165 E016.49.39.402 Color_44ACI
N052.24.59.165 E016.49.39.402 N052.24.58.962 E016.49.38.788 Color_44ACI
N052.24.58.962 E016.49.38.788 N052.24.58.625 E016.49.38.294 Color_44ACI
N052.24.58.625 E016.49.38.294 N052.24.58.536 E016.49.38.226 Color_44ACI
N052.24.58.536 E016.49.38.226 N052.24.58.322 E016.49.38.174 Color_44ACI
N052.24.58.322 E016.49.38.174 N052.24.58.059 E016.49.38.365 Color_44ACI
N052.24.58.059 E016.49.38.365 N052.24.58.040 E016.49.38.392 Color_44ACI
N052.24.58.040 E016.49.38.392 N052.24.57.986 E016.49.38.458 Color_44ACI
N052.24.57.986 E016.49.38.458 N052.24.57.901 E016.49.38.540 Color_44ACI
N052.24.57.901 E016.49.38.540 N052.24.57.789 E016.49.38.617 Color_44ACI
N052.24.57.789 E016.49.38.617 N052.24.57.656 E016.49.38.667 Color_44ACI
N052.24.57.656 E016.49.38.667 N052.24.57.581 E016.49.38.675 Color_44ACI
N052.24.57.581 E016.49.38.675 N052.24.57.538 E016.49.38.669 Color_44ACI
N052.24.57.538 E016.49.38.669 N052.24.57.375 E016.49.38.648 Color_44ACI
N052.24.57.375 E016.49.38.648 N052.24.57.034 E016.49.38.603 Color_44ACI
N052.24.57.034 E016.49.38.603 N052.24.56.655 E016.49.38.553 Color_44ACI
N052.24.56.655 E016.49.38.553 N052.24.56.475 E016.49.38.530 Color_44ACI
N052.24.57.965 E016.49.34.411 N052.24.57.825 E016.49.34.585 Color_44ACI
N052.24.57.825 E016.49.34.585 N052.24.57.724 E016.49.34.655 Color_44ACI
N052.24.57.724 E016.49.34.655 N052.24.57.601 E016.49.34.691 Color_44ACI
N052.24.57.601 E016.49.34.691 N052.24.57.486 E016.49.34.681 Color_44ACI
N052.24.57.486 E016.49.34.681 N052.24.57.324 E016.49.34.656 Color_44ACI
N052.24.57.324 E016.49.34.656 N052.24.56.425 E016.49.34.517 Color_44ACI
N052.24.58.413 E016.49.34.148 N052.24.58.172 E016.49.34.195 Color_44ACI
N052.24.58.172 E016.49.34.195 N052.24.57.965 E016.49.34.411 Color_44ACI
N052.24.56.431 E016.49.42.572 N052.24.56.993 E016.49.42.732 Color_44ACI
N052.24.56.993 E016.49.42.732 N052.24.58.170 E016.49.43.055 Color_44ACI
N052.24.58.170 E016.49.43.055 N052.24.59.200 E016.49.43.305 Color_44ACI
N052.24.58.524 E016.49.42.406 N052.24.58.381 E016.49.42.424 Color_44ACI
N052.24.58.381 E016.49.42.424 N052.24.58.066 E016.49.42.560 Color_44ACI
N052.24.58.066 E016.49.42.560 N052.24.57.748 E016.49.42.941 Color_44ACI
N052.24.59.207 E016.49.43.052 N052.24.59.118 E016.49.42.885 Color_44ACI
N052.24.59.118 E016.49.42.885 N052.24.58.878 E016.49.42.576 Color_44ACI
N052.24.58.878 E016.49.42.576 N052.24.58.524 E016.49.42.406 Color_44ACI
N052.24.58.896 E016.49.46.378 N052.24.58.561 E016.49.46.510 Color_44ACI
N052.24.58.561 E016.49.46.510 N052.24.58.296 E016.49.46.455 Color_44ACI
N052.24.58.296 E016.49.46.455 N052.24.58.098 E016.49.46.293 Color_44ACI
N052.24.58.098 E016.49.46.293 N052.24.57.966 E016.49.46.106 Color_44ACI
N052.24.57.966 E016.49.46.106 N052.24.57.901 E016.49.45.973 Color_44ACI
N052.24.57.901 E016.49.45.973 N052.24.57.891 E016.49.45.952 Color_44ACI
N052.24.57.891 E016.49.45.952 N052.24.57.832 E016.49.45.935 Color_44ACI
N052.24.57.832 E016.49.45.935 N052.24.57.608 E016.49.45.868 Color_44ACI
N052.24.57.608 E016.49.45.868 N052.24.57.141 E016.49.45.728 Color_44ACI
N052.24.57.141 E016.49.45.728 N052.24.56.621 E016.49.45.572 Color_44ACI
N052.24.56.621 E016.49.45.572 N052.24.56.375 E016.49.45.498 Color_44ACI
N052.24.58.889 E016.49.46.392 N052.24.58.780 E016.49.46.178 Color_44ACI
N052.24.58.780 E016.49.46.178 N052.24.58.449 E016.49.45.866 Color_44ACI
N052.24.58.449 E016.49.45.866 N052.24.57.888 E016.49.45.956 Color_44ACI
N052.24.58.855 E016.49.46.627 N052.24.56.038 E016.49.49.176 Color_44ACI
N052.24.58.505 E016.49.49.037 N052.24.58.204 E016.49.49.239 Color_44ACI
N052.24.58.204 E016.49.49.239 N052.24.57.952 E016.49.49.219 Color_44ACI
N052.24.57.952 E016.49.49.219 N052.24.57.755 E016.49.49.070 Color_44ACI
N052.24.57.755 E016.49.49.070 N052.24.57.617 E016.49.48.881 Color_44ACI
N052.24.57.617 E016.49.48.881 N052.24.57.546 E016.49.48.743 Color_44ACI
N052.24.57.546 E016.49.48.743 N052.24.57.534 E016.49.48.720 Color_44ACI
N052.24.57.534 E016.49.48.720 N052.24.57.477 E016.49.48.698 Color_44ACI
N052.24.57.477 E016.49.48.698 N052.24.57.260 E016.49.48.613 Color_44ACI
N052.24.57.260 E016.49.48.613 N052.24.56.808 E016.49.48.437 Color_44ACI
N052.24.56.808 E016.49.48.437 N052.24.56.303 E016.49.48.240 Color_44ACI
N052.24.56.303 E016.49.48.240 N052.24.56.065 E016.49.48.147 Color_44ACI
N052.24.58.502 E016.49.49.038 N052.24.58.382 E016.49.48.818 Color_44ACI
N052.24.58.382 E016.49.48.818 N052.24.58.047 E016.49.48.529 Color_44ACI
N052.24.58.047 E016.49.48.529 N052.24.57.533 E016.49.48.730 Color_44ACI
N052.24.57.199 E016.49.51.245 N052.24.55.701 E016.49.50.740 Color_44ACI
N052.24.56.899 E016.49.53.862 N052.24.55.430 E016.49.53.243 Color_44ACI
N052.24.55.156 E016.50.10.668 N052.24.53.972 E016.50.10.455 Color_44ACI
N052.24.57.565 E016.49.56.549 N052.24.57.285 E016.49.56.776 Color_44ACI
N052.24.57.285 E016.49.56.776 N052.24.57.035 E016.49.56.777 Color_44ACI
N052.24.57.035 E016.49.56.777 N052.24.56.827 E016.49.56.643 Color_44ACI
N052.24.56.827 E016.49.56.643 N052.24.56.675 E016.49.56.464 Color_44ACI
N052.24.56.675 E016.49.56.464 N052.24.56.592 E016.49.56.331 Color_44ACI
N052.24.56.592 E016.49.56.331 N052.24.56.579 E016.49.56.310 Color_44ACI
N052.24.56.579 E016.49.56.310 N052.24.56.519 E016.49.56.291 Color_44ACI
N052.24.56.519 E016.49.56.291 N052.24.56.294 E016.49.56.223 Color_44ACI
N052.24.56.294 E016.49.56.223 N052.24.55.825 E016.49.56.080 Color_44ACI
N052.24.55.825 E016.49.56.080 N052.24.55.301 E016.49.55.920 Color_44ACI
N052.24.55.301 E016.49.55.920 N052.24.55.053 E016.49.55.845 Color_44ACI
N052.24.57.256 E016.49.59.130 N052.24.56.969 E016.49.59.315 Color_44ACI
N052.24.56.969 E016.49.59.315 N052.24.56.723 E016.49.59.286 Color_44ACI
N052.24.56.723 E016.49.59.286 N052.24.56.525 E016.49.59.132 Color_44ACI
N052.24.56.525 E016.49.59.132 N052.24.56.384 E016.49.58.941 Color_44ACI
N052.24.56.384 E016.49.58.941 N052.24.56.309 E016.49.58.803 Color_44ACI
N052.24.56.309 E016.49.58.803 N052.24.56.298 E016.49.58.781 Color_44ACI
N052.24.56.298 E016.49.58.781 N052.24.56.248 E016.49.58.765 Color_44ACI
N052.24.56.248 E016.49.58.765 N052.24.56.061 E016.49.58.704 Color_44ACI
N052.24.56.061 E016.49.58.704 N052.24.55.670 E016.49.58.575 Color_44ACI
N052.24.55.670 E016.49.58.575 N052.24.55.234 E016.49.58.433 Color_44ACI
N052.24.55.234 E016.49.58.433 N052.24.55.028 E016.49.58.365 Color_44ACI
N052.24.57.002 E016.50.01.235 N052.24.56.714 E016.50.01.492 Color_44ACI
N052.24.56.714 E016.50.01.492 N052.24.56.455 E016.50.01.489 Color_44ACI
N052.24.56.455 E016.50.01.489 N052.24.56.239 E016.50.01.331 Color_44ACI
N052.24.56.239 E016.50.01.331 N052.24.56.080 E016.50.01.122 Color_44ACI
N052.24.56.080 E016.50.01.122 N052.24.55.994 E016.50.00.968 Color_44ACI
N052.24.55.994 E016.50.00.968 N052.24.55.980 E016.50.00.943 Color_44ACI
N052.24.55.980 E016.50.00.943 N052.24.55.934 E016.50.00.921 Color_44ACI
N052.24.55.934 E016.50.00.921 N052.24.55.757 E016.50.00.840 Color_44ACI
N052.24.55.757 E016.50.00.840 N052.24.55.390 E016.50.00.671 Color_44ACI
N052.24.55.390 E016.50.00.671 N052.24.54.980 E016.50.00.483 Color_44ACI
N052.24.54.980 E016.50.00.483 N052.24.54.786 E016.50.00.394 Color_44ACI
N052.24.56.697 E016.50.03.774 N052.24.56.416 E016.50.04.029 Color_44ACI
N052.24.56.416 E016.50.04.029 N052.24.56.163 E016.50.04.012 Color_44ACI
N052.24.56.163 E016.50.04.012 N052.24.55.950 E016.50.03.833 Color_44ACI
N052.24.55.950 E016.50.03.833 N052.24.55.794 E016.50.03.604 Color_44ACI
N052.24.55.794 E016.50.03.604 N052.24.55.709 E016.50.03.436 Color_44ACI
N052.24.55.709 E016.50.03.436 N052.24.55.696 E016.50.03.409 Color_44ACI
N052.24.55.696 E016.50.03.409 N052.24.55.647 E016.50.03.390 Color_44ACI
N052.24.55.647 E016.50.03.390 N052.24.55.462 E016.50.03.316 Color_44ACI
N052.24.55.462 E016.50.03.316 N052.24.55.077 E016.50.03.163 Color_44ACI
N052.24.55.077 E016.50.03.163 N052.24.54.647 E016.50.02.992 Color_44ACI
N052.24.54.647 E016.50.02.992 N052.24.54.444 E016.50.02.911 Color_44ACI
N052.24.56.414 E016.50.06.121 N052.24.56.124 E016.50.06.349 Color_44ACI
N052.24.56.124 E016.50.06.349 N052.24.55.875 E016.50.06.339 Color_44ACI
N052.24.55.875 E016.50.06.339 N052.24.55.676 E016.50.06.188 Color_44ACI
N052.24.55.676 E016.50.06.188 N052.24.55.534 E016.50.05.991 Color_44ACI
N052.24.55.534 E016.50.05.991 N052.24.55.459 E016.50.05.847 Color_44ACI
N052.24.55.459 E016.50.05.847 N052.24.55.448 E016.50.05.823 Color_44ACI
N052.24.55.448 E016.50.05.823 N052.24.55.406 E016.50.05.799 Color_44ACI
N052.24.55.406 E016.50.05.799 N052.24.55.247 E016.50.05.709 Color_44ACI
N052.24.55.247 E016.50.05.709 N052.24.54.915 E016.50.05.521 Color_44ACI
N052.24.54.915 E016.50.05.521 N052.24.54.546 E016.50.05.312 Color_44ACI
N052.24.54.546 E016.50.05.312 N052.24.54.371 E016.50.05.213 Color_44ACI
N052.24.56.194 E016.50.08.624 N052.24.56.154 E016.50.08.552 Color_44ACI
N052.24.56.154 E016.50.08.552 N052.24.56.040 E016.50.08.392 Color_44ACI
N052.24.56.040 E016.50.08.392 N052.24.55.864 E016.50.08.226 Color_44ACI
N052.24.55.864 E016.50.08.226 N052.24.55.637 E016.50.08.137 Color_44ACI
N052.24.55.637 E016.50.08.137 N052.24.55.369 E016.50.08.209 Color_44ACI
N052.24.55.369 E016.50.08.209 N052.24.55.223 E016.50.08.331 Color_44ACI
N052.24.55.223 E016.50.08.331 N052.24.55.179 E016.50.08.321 Color_44ACI
N052.24.55.179 E016.50.08.321 N052.24.55.013 E016.50.08.283 Color_44ACI
N052.24.55.013 E016.50.08.283 N052.24.54.666 E016.50.08.206 Color_44ACI
N052.24.54.666 E016.50.08.206 N052.24.54.280 E016.50.08.119 Color_44ACI
N052.24.54.280 E016.50.08.119 N052.24.54.097 E016.50.08.078 Color_44ACI
N052.24.58.172 E016.49.51.510 N052.24.58.041 E016.49.51.297 Color_44ACI
N052.24.58.041 E016.49.51.297 N052.24.57.694 E016.49.51.026 Color_44ACI
N052.24.57.694 E016.49.51.026 N052.24.57.198 E016.49.51.246 Color_44ACI
N052.24.57.199 E016.49.51.245 N052.24.57.330 E016.49.51.458 Color_44ACI
N052.24.57.330 E016.49.51.458 N052.24.57.678 E016.49.51.729 Color_44ACI
N052.24.57.678 E016.49.51.729 N052.24.58.173 E016.49.51.509 Color_44ACI
N052.24.57.849 E016.49.54.189 N052.24.57.722 E016.49.53.943 Color_44ACI
N052.24.57.722 E016.49.53.943 N052.24.57.382 E016.49.53.626 Color_44ACI
N052.24.57.382 E016.49.53.626 N052.24.56.894 E016.49.53.871 Color_44ACI
N052.24.56.899 E016.49.53.862 N052.24.57.026 E016.49.54.109 Color_44ACI
N052.24.57.026 E016.49.54.109 N052.24.57.366 E016.49.54.426 Color_44ACI
N052.24.57.366 E016.49.54.426 N052.24.57.855 E016.49.54.182 Color_44ACI
N052.24.57.565 E016.49.56.551 N052.24.57.428 E016.49.56.338 Color_44ACI
N052.24.57.428 E016.49.56.338 N052.24.57.073 E016.49.56.072 Color_44ACI
N052.24.57.073 E016.49.56.072 N052.24.56.581 E016.49.56.309 Color_44ACI
N052.24.57.253 E016.49.59.138 N052.24.57.129 E016.49.58.915 Color_44ACI
N052.24.57.129 E016.49.58.915 N052.24.56.794 E016.49.58.613 Color_44ACI
N052.24.56.794 E016.49.58.613 N052.24.56.298 E016.49.58.781 Color_44ACI
N052.24.56.999 E016.50.01.244 N052.24.56.856 E016.50.00.994 Color_44ACI
N052.24.56.856 E016.50.00.994 N052.24.56.488 E016.50.00.678 Color_44ACI
N052.24.56.488 E016.50.00.678 N052.24.55.981 E016.50.00.940 Color_44ACI
N052.24.56.694 E016.50.03.772 N052.24.56.551 E016.50.03.505 Color_44ACI
N052.24.56.551 E016.50.03.505 N052.24.56.186 E016.50.03.161 Color_44ACI
N052.24.56.186 E016.50.03.161 N052.24.55.693 E016.50.03.424 Color_44ACI
N052.24.56.410 E016.50.06.132 N052.24.56.286 E016.50.05.899 Color_44ACI
N052.24.56.286 E016.50.05.899 N052.24.55.948 E016.50.05.598 Color_44ACI
N052.24.55.948 E016.50.05.598 N052.24.55.446 E016.50.05.825 Color_44ACI
N052.24.55.224 E016.50.08.336 N052.24.55.355 E016.50.08.537 Color_44ACI
N052.24.55.355 E016.50.08.537 N052.24.55.702 E016.50.08.801 Color_44ACI
N052.24.55.702 E016.50.08.801 N052.24.56.195 E016.50.08.619 Color_44ACI
N052.24.55.151 E016.50.10.646 N052.24.55.299 E016.50.10.846 Color_44ACI
N052.24.55.299 E016.50.10.846 N052.24.55.668 E016.50.11.047 Color_44ACI
N052.24.55.668 E016.50.11.047 N052.24.56.149 E016.50.10.649 Color_44ACI
N052.24.56.154 E016.50.10.647 N052.24.56.005 E016.50.10.450 Color_44ACI
N052.24.56.005 E016.50.10.450 N052.24.55.634 E016.50.10.258 Color_44ACI
N052.24.55.634 E016.50.10.258 N052.24.55.156 E016.50.10.668 Color_44ACI
N052.24.55.659 E016.50.12.772 N052.24.53.487 E016.50.12.748 Color_44ACI
N052.24.56.079 E016.50.13.552 N052.24.55.932 E016.50.13.278 Color_44ACI
N052.24.55.932 E016.50.13.278 N052.24.55.703 E016.50.12.853 Color_44ACI
N052.24.55.703 E016.50.12.853 N052.24.55.667 E016.50.12.762 Color_44ACI
N052.24.55.667 E016.50.12.762 N052.24.55.853 E016.50.12.493 Color_44ACI
N052.24.55.853 E016.50.12.493 N052.24.56.117 E016.50.12.113 Color_44ACI
N052.24.56.019 E016.50.15.836 N052.24.55.865 E016.50.15.550 Color_44ACI
N052.24.55.865 E016.50.15.550 N052.24.55.626 E016.50.15.108 Color_44ACI
N052.24.55.626 E016.50.15.108 N052.24.55.588 E016.50.15.013 Color_44ACI
N052.24.55.588 E016.50.15.013 N052.24.55.783 E016.50.14.732 Color_44ACI
N052.24.55.783 E016.50.14.732 N052.24.56.059 E016.50.14.336 Color_44ACI
N052.24.55.580 E016.50.15.024 N052.24.53.610 E016.50.14.878 Color_44ACI
N052.24.54.319 E016.50.16.516 N052.24.54.329 E016.50.16.625 Color_44ACI
N052.24.54.329 E016.50.16.625 N052.24.54.395 E016.50.16.858 Color_44ACI
N052.24.54.395 E016.50.16.858 N052.24.54.575 E016.50.17.069 Color_44ACI
N052.24.54.320 E016.50.16.064 N052.24.54.319 E016.50.15.770 Color_44ACI
N052.24.54.319 E016.50.15.770 N052.24.54.384 E016.50.15.229 Color_44ACI
N052.24.54.384 E016.50.15.229 N052.24.54.624 E016.50.14.953 Color_44ACI
N052.24.53.416 E016.50.16.476 N052.24.53.425 E016.50.16.565 Color_44ACI
N052.24.53.425 E016.50.16.565 N052.24.53.493 E016.50.16.777 Color_44ACI
N052.24.53.493 E016.50.16.777 N052.24.53.678 E016.50.17.024 Color_44ACI
N052.24.53.745 E016.50.14.888 N052.24.53.650 E016.50.15.010 Color_44ACI
N052.24.53.650 E016.50.15.010 N052.24.53.483 E016.50.15.392 Color_44ACI
N052.24.53.483 E016.50.15.392 N052.24.53.420 E016.50.16.059 Color_44ACI
N052.24.54.336 E016.50.14.359 N052.24.54.334 E016.50.14.452 Color_44ACI
N052.24.54.334 E016.50.14.452 N052.24.54.376 E016.50.14.676 Color_44ACI
N052.24.54.376 E016.50.14.676 N052.24.54.534 E016.50.14.947 Color_44ACI
N052.24.53.497 E016.50.14.360 N052.24.53.500 E016.50.14.436 Color_44ACI
N052.24.53.500 E016.50.14.436 N052.24.53.558 E016.50.14.629 Color_44ACI
N052.24.53.558 E016.50.14.629 N052.24.53.745 E016.50.14.888 Color_44ACI
N052.24.53.871 E016.50.12.752 N052.24.53.762 E016.50.12.815 Color_44ACI
N052.24.53.762 E016.50.12.815 N052.24.53.565 E016.50.13.135 Color_44ACI
N052.24.53.565 E016.50.13.135 N052.24.53.474 E016.50.13.908 Color_44ACI
N052.24.54.695 E016.50.12.761 N052.24.54.596 E016.50.12.850 Color_44ACI
N052.24.54.596 E016.50.12.850 N052.24.54.420 E016.50.13.194 Color_44ACI
N052.24.54.420 E016.50.13.194 N052.24.54.350 E016.50.13.905 Color_44ACI
N052.24.54.350 E016.50.13.905 N052.24.54.336 E016.50.14.359 Color_44ACI
N052.24.53.474 E016.50.13.908 N052.24.53.497 E016.50.14.360 Color_44ACI
N052.24.53.420 E016.50.16.059 N052.24.53.416 E016.50.16.476 Color_44ACI
N052.24.54.320 E016.50.16.064 N052.24.54.319 E016.50.16.516 Color_44ACI
N052.24.54.249 E016.50.18.234 N052.24.54.272 E016.50.18.687 Color_44ACI
N052.24.53.340 E016.50.18.373 N052.24.53.384 E016.50.18.809 Color_44ACI
N052.24.54.231 E016.50.20.166 N052.24.54.238 E016.50.20.620 Color_44ACI
N052.25.13.193 E016.49.47.825 N052.25.13.450 E016.49.46.795 Color_44ACI
N052.25.28.268 E016.48.25.672 N052.25.28.244 E016.48.25.360 Color_251ACI
N052.25.28.244 E016.48.25.360 N052.25.28.184 E016.48.24.955 Color_251ACI
N052.25.28.184 E016.48.24.955 N052.25.28.072 E016.48.24.501 Color_251ACI
N052.25.28.072 E016.48.24.501 N052.25.27.894 E016.48.23.998 Color_251ACI
N052.25.27.894 E016.48.23.998 N052.25.27.610 E016.48.23.356 Color_251ACI
N052.25.27.610 E016.48.23.356 N052.25.27.295 E016.48.22.925 Color_251ACI
N052.25.27.295 E016.48.22.925 N052.25.27.088 E016.48.22.727 Color_251ACI
N052.25.27.088 E016.48.22.727 N052.25.26.694 E016.48.22.414 Color_251ACI
N052.25.26.694 E016.48.22.414 N052.25.26.122 E016.48.22.059 Color_251ACI
N052.25.26.122 E016.48.22.059 N052.25.25.571 E016.48.21.717 Color_251ACI
N052.25.25.571 E016.48.21.717 N052.25.25.318 E016.48.21.560 Color_251ACI
N052.25.25.318 E016.48.21.560 N052.25.25.318 E016.48.21.560 Color_251ACI
N052.25.25.318 E016.48.21.560 N052.25.25.105 E016.48.21.553 Color_251ACI
N052.25.25.105 E016.48.21.553 N052.25.24.879 E016.48.21.626 Color_251ACI
N052.25.24.879 E016.48.21.626 N052.25.24.691 E016.48.21.796 Color_251ACI
N052.25.24.691 E016.48.21.796 N052.25.24.529 E016.48.22.097 Color_251ACI
N052.25.24.529 E016.48.22.097 N052.25.24.354 E016.48.22.674 Color_251ACI
N052.25.24.354 E016.48.22.674 N052.25.24.190 E016.48.23.559 Color_251ACI
N052.25.24.190 E016.48.23.559 N052.25.21.093 E016.48.40.249 Color_251ACI
N052.25.21.093 E016.48.40.249 N052.25.20.915 E016.48.41.211 Color_251ACI
N052.25.20.915 E016.48.41.211 N052.25.20.847 E016.48.41.748 Color_251ACI
N052.25.20.847 E016.48.41.748 N052.25.20.903 E016.48.42.185 Color_251ACI
N052.25.20.903 E016.48.42.185 N052.25.21.021 E016.48.42.584 Color_251ACI
N052.25.21.021 E016.48.42.584 N052.25.23.116 E016.48.48.947 Color_251ACI
N052.25.23.116 E016.48.48.947 N052.25.23.200 E016.48.49.130 Color_251ACI
N052.25.23.200 E016.48.49.130 N052.25.23.257 E016.48.49.222 Color_251ACI
N052.25.23.257 E016.48.49.222 N052.25.23.257 E016.48.49.222 Color_251ACI
N052.25.23.257 E016.48.49.222 N052.25.23.343 E016.48.49.294 Color_251ACI
N052.25.23.343 E016.48.49.294 N052.25.23.442 E016.48.49.281 Color_251ACI
N052.25.23.442 E016.48.49.281 N052.25.23.514 E016.48.49.231 Color_251ACI
N052.25.23.514 E016.48.49.231 N052.25.23.760 E016.48.48.881 Color_251ACI
N052.25.21.790 E016.48.59.021 N052.25.21.747 E016.48.58.458 Color_251ACI
N052.25.21.747 E016.48.58.458 N052.25.20.972 E016.48.49.612 Color_251ACI
N052.25.20.972 E016.48.49.612 N052.25.20.884 E016.48.48.721 Color_251ACI
N052.25.20.884 E016.48.48.721 N052.25.20.808 E016.48.47.959 Color_251ACI
N052.25.20.808 E016.48.47.959 N052.25.20.704 E016.48.47.296 Color_251ACI
N052.25.20.704 E016.48.47.296 N052.25.20.526 E016.48.46.830 Color_251ACI
N052.25.20.526 E016.48.46.830 N052.25.20.285 E016.48.46.514 Color_251ACI
N052.25.20.285 E016.48.46.514 N052.25.19.789 E016.48.46.754 Color_251ACI
N052.25.19.789 E016.48.46.754 N052.25.08.865 E016.49.43.550 Color_251ACI
N052.25.08.865 E016.49.43.550 N052.25.09.026 E016.49.44.267 Color_251ACI
N052.25.09.026 E016.49.44.267 N052.25.09.316 E016.49.45.022 Color_251ACI
N052.25.09.316 E016.49.45.022 N052.25.09.744 E016.49.45.763 Color_251ACI
N052.25.09.744 E016.49.45.763 N052.25.10.163 E016.49.46.353 Color_251ACI
N052.25.10.163 E016.49.46.353 N052.25.10.342 E016.49.46.581 Color_251ACI
N052.25.10.342 E016.49.46.581 N052.25.11.508 E016.49.47.203 Color_251ACI
N052.25.11.508 E016.49.47.203 N052.25.11.757 E016.49.47.053 Color_251ACI
N052.25.11.757 E016.49.47.053 N052.25.12.068 E016.49.46.756 Color_251ACI
N052.25.12.068 E016.49.46.756 N052.25.12.398 E016.49.46.311 Color_251ACI
N052.25.12.398 E016.49.46.311 N052.25.12.696 E016.49.45.837 Color_251ACI
N052.25.11.689 E016.49.51.020 N052.25.11.592 E016.49.50.459 Color_251ACI
N052.25.11.592 E016.49.50.459 N052.25.11.461 E016.49.49.954 Color_251ACI
N052.25.11.461 E016.49.49.954 N052.25.11.287 E016.49.49.505 Color_251ACI
N052.25.11.287 E016.49.49.505 N052.25.11.006 E016.49.48.971 Color_251ACI
N052.25.11.006 E016.49.48.971 N052.25.10.603 E016.49.48.807 Color_251ACI
N052.25.10.603 E016.49.48.807 N052.25.10.266 E016.49.48.670 Color_251ACI
N052.25.10.266 E016.49.48.670 N052.25.08.717 E016.49.48.896 Color_251ACI
N052.25.08.717 E016.49.48.896 N052.25.08.485 E016.49.48.987 Color_251ACI
N052.25.08.485 E016.49.48.987 N052.25.08.226 E016.49.49.156 Color_251ACI
N052.25.08.226 E016.49.49.156 N052.25.08.053 E016.49.49.358 Color_251ACI
N052.25.08.053 E016.49.49.358 N052.25.07.847 E016.49.49.797 Color_251ACI
N052.25.07.847 E016.49.49.797 N052.25.07.641 E016.49.50.819 Color_251ACI
N052.25.07.641 E016.49.50.819 N052.25.03.593 E016.50.10.822 Color_251ACI
N052.25.03.593 E016.50.10.822 N052.25.03.522 E016.50.11.386 Color_251ACI
N052.25.03.522 E016.50.11.386 N052.25.03.535 E016.50.11.637 Color_251ACI
N052.25.03.535 E016.50.11.637 N052.25.03.606 E016.50.11.834 Color_251ACI
N052.25.03.606 E016.50.11.834 N052.25.03.717 E016.50.11.958 Color_251ACI
N052.25.03.717 E016.50.11.958 N052.25.03.912 E016.50.12.049 Color_251ACI
N052.25.03.912 E016.50.12.049 N052.25.04.036 E016.50.12.025 Color_251ACI
N052.25.04.036 E016.50.12.025 N052.25.04.240 E016.50.11.774 Color_251ACI
N052.25.04.240 E016.50.11.774 N052.25.09.147 E016.50.04.106 Color_251ACI
N052.25.07.777 E016.50.11.159 N052.25.06.729 E016.50.12.129 Color_251ACI
N052.25.06.729 E016.50.12.129 N052.25.04.548 E016.50.14.206 Color_251ACI
N052.25.04.548 E016.50.14.206 N052.25.04.269 E016.50.14.446 Color_251ACI
N052.25.04.269 E016.50.14.446 N052.25.03.913 E016.50.14.614 Color_251ACI
N052.25.03.913 E016.50.14.614 N052.25.03.567 E016.50.14.631 Color_251ACI
N052.25.03.567 E016.50.14.631 N052.25.03.186 E016.50.14.531 Color_251ACI
N052.25.03.186 E016.50.14.531 N052.25.03.186 E016.50.14.531 Color_251ACI
N052.25.03.186 E016.50.14.531 N052.25.03.136 E016.50.14.531 Color_251ACI
N052.25.03.136 E016.50.14.531 N052.25.03.074 E016.50.14.553 Color_251ACI
N052.25.03.074 E016.50.14.553 N052.25.03.015 E016.50.14.637 Color_251ACI
N052.25.03.015 E016.50.14.637 N052.25.02.966 E016.50.14.757 Color_251ACI
N052.25.02.966 E016.50.14.757 N052.25.02.913 E016.50.14.949 Color_251ACI
N052.25.02.913 E016.50.14.949 N052.25.01.368 E016.50.23.147 Color_251ACI
N052.25.01.368 E016.50.23.147 N052.25.01.431 E016.50.24.169 Color_251ACI
N052.25.01.431 E016.50.24.169 N052.25.02.497 E016.50.26.359 Color_251ACI
N052.25.02.497 E016.50.26.359 N052.25.02.957 E016.50.26.709 Color_251ACI
N052.25.02.957 E016.50.26.709 N052.25.03.435 E016.50.26.852 Color_251ACI
N052.25.03.435 E016.50.26.852 N052.25.03.701 E016.50.26.823 Color_251ACI
N052.25.03.701 E016.50.26.823 N052.25.04.053 E016.50.26.633 Color_251ACI
N052.25.04.053 E016.50.26.633 N052.25.04.633 E016.50.26.009 Color_251ACI
N052.25.04.633 E016.50.26.009 N052.25.05.000 E016.50.25.449 Color_251ACI
N052.25.25.789 E016.48.38.434 N052.25.25.671 E016.48.38.700 Color_251ACI
N052.25.25.671 E016.48.38.700 N052.25.25.544 E016.48.38.820 Color_251ACI
N052.25.25.544 E016.48.38.820 N052.25.25.355 E016.48.38.903 Color_251ACI
N052.25.25.355 E016.48.38.903 N052.25.25.109 E016.48.38.851 Color_251ACI
N052.25.25.109 E016.48.38.851 N052.25.24.818 E016.48.38.676 Color_251ACI
N052.25.24.818 E016.48.38.676 N052.25.24.458 E016.48.38.344 Color_251ACI
N052.25.24.458 E016.48.38.344 N052.25.24.214 E016.48.39.582 Color_251ACI
N052.25.24.214 E016.48.39.582 N052.25.24.515 E016.48.39.892 Color_251ACI
N052.25.24.515 E016.48.39.892 N052.25.24.719 E016.48.40.191 Color_251ACI
N052.25.24.719 E016.48.40.191 N052.25.24.872 E016.48.40.586 Color_251ACI
N052.25.24.872 E016.48.40.586 N052.25.24.994 E016.48.41.093 Color_251ACI
N052.25.24.994 E016.48.41.093 N052.25.25.101 E016.48.41.975 Color_251ACI
N052.25.16.911 E016.49.24.137 N052.25.16.535 E016.49.24.757 Color_251ACI
N052.25.16.535 E016.49.24.757 N052.25.16.137 E016.49.25.157 Color_251ACI
N052.25.16.137 E016.49.25.157 N052.25.15.774 E016.49.25.356 Color_251ACI
N052.25.15.774 E016.49.25.356 N052.25.15.401 E016.49.25.397 Color_251ACI
N052.25.15.401 E016.49.25.397 N052.25.15.034 E016.49.25.231 Color_251ACI
N052.25.15.034 E016.49.25.231 N052.25.14.671 E016.49.27.038 Color_251ACI
N052.25.14.671 E016.49.27.038 N052.25.14.967 E016.49.27.091 Color_251ACI
N052.25.14.967 E016.49.27.091 N052.25.15.260 E016.49.27.203 Color_251ACI
N052.25.15.260 E016.49.27.203 N052.25.15.448 E016.49.27.361 Color_251ACI
N052.25.15.448 E016.49.27.361 N052.25.15.634 E016.49.27.688 Color_251ACI
N052.25.15.634 E016.49.27.688 N052.25.15.806 E016.49.28.240 Color_251ACI
N052.25.15.806 E016.49.28.240 N052.25.15.875 E016.49.28.745 Color_251ACI
N052.25.15.875 E016.49.28.745 N052.25.15.909 E016.49.29.297 Color_251ACI
N052.25.06.423 E016.49.48.634 N052.25.06.419 E016.49.48.028 Color_251ACI
N052.25.06.419 E016.49.48.028 N052.25.06.307 E016.49.47.670 Color_251ACI
N052.25.06.307 E016.49.47.670 N052.25.05.999 E016.49.47.043 Color_251ACI
N052.25.05.999 E016.49.47.043 N052.25.05.551 E016.49.46.359 Color_251ACI
N052.25.05.551 E016.49.46.359 N052.25.00.954 E016.49.43.835 Color_251ACI
N052.25.00.954 E016.49.43.835 N052.25.00.586 E016.49.43.823 Color_251ACI
N052.25.00.586 E016.49.43.823 N052.25.00.375 E016.49.43.894 Color_251ACI
N052.25.00.375 E016.49.43.894 N052.25.00.121 E016.49.44.074 Color_251ACI
N052.25.00.121 E016.49.44.074 N052.24.59.967 E016.49.44.299 Color_251ACI
N052.24.59.967 E016.49.44.299 N052.24.59.788 E016.49.44.700 Color_251ACI
N052.24.59.788 E016.49.44.700 N052.24.59.668 E016.49.45.148 Color_251ACI
N052.24.59.668 E016.49.45.148 N052.24.59.581 E016.49.45.563 Color_251ACI
N052.24.59.581 E016.49.45.563 N052.24.56.836 E016.50.07.704 Color_251ACI
N052.24.56.836 E016.50.07.704 N052.24.56.538 E016.50.19.597 Color_251ACI
N052.24.56.538 E016.50.19.597 N052.24.58.853 E016.50.24.155 Color_251ACI
N052.24.58.853 E016.50.24.155 N052.24.59.681 E016.50.23.215 Color_251ACI
N052.24.59.681 E016.50.23.215 N052.25.00.201 E016.50.21.671 Color_251ACI
N052.25.00.201 E016.50.21.671 N052.25.06.423 E016.49.48.634 Color_251ACI
N052.25.05.941 E016.50.29.408 N052.25.09.859 E016.50.31.415 Color_251ACI
N052.25.09.859 E016.50.31.415 N052.25.17.986 E016.50.32.155 Color_251ACI
N052.25.17.986 E016.50.32.155 N052.25.19.607 E016.50.33.213 Color_251ACI
N052.25.19.607 E016.50.33.213 N052.25.18.296 E016.50.37.251 Color_251ACI
N052.25.18.296 E016.50.37.251 N052.25.19.082 E016.50.37.840 Color_251ACI
N052.25.19.082 E016.50.37.840 N052.25.18.861 E016.50.38.671 Color_251ACI
N052.25.18.861 E016.50.38.671 N052.25.20.881 E016.50.39.944 Color_251ACI
N052.25.20.881 E016.50.39.944 N052.25.21.067 E016.50.39.233 Color_251ACI
N052.25.21.067 E016.50.39.233 N052.25.21.478 E016.50.39.548 Color_251ACI
N052.25.21.478 E016.50.39.548 N052.25.21.301 E016.50.40.223 Color_251ACI
N052.25.21.301 E016.50.40.223 N052.25.23.195 E016.50.41.446 Color_251ACI
N052.25.23.195 E016.50.41.446 N052.25.23.549 E016.50.39.885 Color_251ACI
N052.25.23.549 E016.50.39.885 N052.25.22.679 E016.50.39.139 Color_251ACI
N052.25.22.679 E016.50.39.139 N052.25.23.478 E016.50.35.631 Color_251ACI
N052.25.23.478 E016.50.35.631 N052.25.22.811 E016.50.35.104 Color_251ACI
N052.25.22.811 E016.50.35.104 N052.25.23.010 E016.50.34.444 Color_251ACI
N052.25.23.010 E016.50.34.444 N052.25.23.687 E016.50.34.910 Color_251ACI
N052.25.23.687 E016.50.34.910 N052.25.23.970 E016.50.34.035 Color_251ACI
N052.25.23.970 E016.50.34.035 N052.25.24.461 E016.50.34.420 Color_251ACI
N052.25.24.461 E016.50.34.420 N052.25.24.572 E016.50.34.072 Color_251ACI
N052.25.24.572 E016.50.34.072 N052.25.23.483 E016.50.33.200 Color_251ACI
N052.25.23.483 E016.50.33.200 N052.25.23.281 E016.50.33.005 Color_251ACI
N052.25.23.281 E016.50.33.005 N052.25.23.212 E016.50.32.913 Color_251ACI
N052.25.23.212 E016.50.32.913 N052.25.23.189 E016.50.32.853 Color_251ACI
N052.25.23.189 E016.50.32.853 N052.25.23.188 E016.50.32.819 Color_251ACI
N052.25.23.188 E016.50.32.819 N052.25.23.197 E016.50.32.795 Color_251ACI
N052.25.23.197 E016.50.32.795 N052.25.23.218 E016.50.32.770 Color_251ACI
N052.25.23.218 E016.50.32.770 N052.25.23.244 E016.50.32.756 Color_251ACI
N052.25.23.244 E016.50.32.756 N052.25.23.336 E016.50.32.732 Color_251ACI
N052.25.23.336 E016.50.32.732 N052.25.23.478 E016.50.32.734 Color_251ACI
N052.25.23.478 E016.50.32.734 N052.25.23.713 E016.50.32.755 Color_251ACI
N052.25.23.713 E016.50.32.755 N052.25.27.052 E016.50.33.102 Color_251ACI
N052.25.27.052 E016.50.33.102 N052.25.27.201 E016.50.33.210 Color_251ACI
N052.25.27.201 E016.50.33.210 N052.25.27.306 E016.50.33.287 Color_251ACI
N052.25.27.306 E016.50.33.287 N052.25.27.397 E016.50.33.376 Color_251ACI
N052.25.27.397 E016.50.33.376 N052.25.27.469 E016.50.33.493 Color_251ACI
N052.25.27.469 E016.50.33.493 N052.25.27.518 E016.50.33.629 Color_251ACI
N052.25.27.518 E016.50.33.629 N052.25.27.535 E016.50.33.793 Color_251ACI
N052.25.27.535 E016.50.33.793 N052.25.27.529 E016.50.33.919 Color_251ACI
N052.25.27.529 E016.50.33.919 N052.25.27.512 E016.50.34.037 Color_251ACI
N052.25.27.512 E016.50.34.037 N052.25.26.240 E016.50.39.705 Color_251ACI
N052.25.26.240 E016.50.39.705 N052.25.30.233 E016.50.42.401 Color_251ACI
N052.25.30.233 E016.50.42.401 N052.25.33.050 E016.50.32.130 Color_251ACI
N052.25.33.050 E016.50.32.130 N052.25.33.975 E016.50.32.634 Color_251ACI
N052.25.33.975 E016.50.32.634 N052.25.34.443 E016.50.31.258 Color_251ACI
N052.25.34.443 E016.50.31.258 N052.25.30.431 E016.50.28.182 Color_251ACI
N052.25.30.431 E016.50.28.182 N052.25.29.966 E016.50.27.866 Color_251ACI
N052.25.29.966 E016.50.27.866 N052.25.29.681 E016.50.27.711 Color_251ACI
N052.25.29.681 E016.50.27.711 N052.25.29.439 E016.50.27.720 Color_251ACI
N052.25.29.439 E016.50.27.720 N052.25.29.258 E016.50.27.807 Color_251ACI
N052.25.29.258 E016.50.27.807 N052.25.29.043 E016.50.28.019 Color_251ACI
N052.25.29.043 E016.50.28.019 N052.25.28.864 E016.50.28.316 Color_251ACI
N052.25.28.864 E016.50.28.316 N052.25.28.699 E016.50.28.675 Color_251ACI
N052.25.28.699 E016.50.28.675 N052.25.28.547 E016.50.29.089 Color_251ACI
N052.25.28.547 E016.50.29.089 N052.25.28.409 E016.50.29.569 Color_251ACI
N052.25.28.409 E016.50.29.569 N052.25.28.269 E016.50.30.091 Color_251ACI
N052.25.28.269 E016.50.30.091 N052.25.28.147 E016.50.30.677 Color_251ACI
N052.25.28.147 E016.50.30.677 N052.25.28.035 E016.50.31.328 Color_251ACI
N052.25.28.035 E016.50.31.328 N052.25.27.933 E016.50.31.732 Color_251ACI
N052.25.27.933 E016.50.31.732 N052.25.27.775 E016.50.32.039 Color_251ACI
N052.25.27.775 E016.50.32.039 N052.25.27.578 E016.50.32.241 Color_251ACI
N052.25.27.578 E016.50.32.241 N052.25.27.355 E016.50.32.311 Color_251ACI
N052.25.27.355 E016.50.32.311 N052.25.27.154 E016.50.32.265 Color_251ACI
N052.25.27.154 E016.50.32.265 N052.25.26.961 E016.50.32.204 Color_251ACI
N052.25.26.961 E016.50.32.204 N052.25.09.502 E016.50.30.409 Color_251ACI
N052.25.09.502 E016.50.30.409 N052.25.07.112 E016.50.29.135 Color_251ACI
N052.25.07.112 E016.50.29.135 N052.25.06.838 E016.50.28.735 Color_251ACI
N052.25.06.838 E016.50.28.735 N052.25.06.631 E016.50.28.391 Color_251ACI
N052.25.06.631 E016.50.28.391 N052.25.06.509 E016.50.28.064 Color_251ACI
N052.25.06.509 E016.50.28.064 N052.25.06.427 E016.50.27.694 Color_251ACI
N052.25.06.427 E016.50.27.694 N052.25.06.399 E016.50.27.389 Color_251ACI
N052.25.06.399 E016.50.27.389 N052.25.06.414 E016.50.27.105 Color_251ACI
N052.25.06.414 E016.50.27.105 N052.25.06.451 E016.50.26.811 Color_251ACI
N052.25.03.303 E016.49.43.041 N052.25.00.037 E016.49.41.316 Color_251ACI
N052.25.00.037 E016.49.41.316 N052.25.00.104 E016.49.40.829 Color_251ACI
N052.25.00.104 E016.49.40.829 N052.25.00.151 E016.49.40.702 Color_251ACI
N052.25.00.151 E016.49.40.702 N052.25.00.222 E016.49.40.626 Color_251ACI
N052.25.00.222 E016.49.40.626 N052.25.00.328 E016.49.40.594 Color_251ACI
N052.25.00.328 E016.49.40.594 N052.25.00.532 E016.49.40.619 Color_251ACI
N052.25.00.532 E016.49.40.619 N052.25.03.851 E016.49.41.888 Color_251ACI
N052.25.03.851 E016.49.41.888 N052.25.03.932 E016.49.42.029 Color_251ACI
N052.25.03.932 E016.49.42.029 N052.25.03.995 E016.49.42.288 Color_251ACI
N052.25.03.995 E016.49.42.288 N052.25.03.990 E016.49.42.538 Color_251ACI
N052.25.03.990 E016.49.42.538 N052.25.03.937 E016.49.42.805 Color_251ACI
N052.25.03.937 E016.49.42.805 N052.25.03.303 E016.49.43.041 Color_251ACI
N052.25.04.389 E016.50.28.597 N052.24.54.012 E016.50.22.837 Color_251ACI
N052.24.54.012 E016.50.22.837 N052.24.51.632 E016.50.22.666 Color_251ACI
N052.24.51.632 E016.50.22.666 N052.24.51.644 E016.50.19.993 Color_251ACI
N052.24.51.644 E016.50.19.993 N052.24.51.835 E016.50.19.950 Color_251ACI
N052.24.51.835 E016.50.19.950 N052.24.51.774 E016.50.18.780 Color_251ACI
N052.24.51.774 E016.50.18.780 N052.24.52.444 E016.50.18.837 Color_251ACI
N052.24.52.444 E016.50.18.837 N052.24.52.621 E016.50.10.683 Color_251ACI
N052.24.52.621 E016.50.10.683 N052.24.53.387 E016.50.10.787 Color_251ACI
N052.24.53.387 E016.50.10.787 N052.24.53.662 E016.50.06.382 Color_251ACI
N052.24.53.662 E016.50.06.382 N052.24.53.371 E016.50.05.154 Color_251ACI
N052.24.53.371 E016.50.05.154 N052.24.51.928 E016.49.56.604 Color_251ACI
N052.24.51.928 E016.49.56.604 N052.24.51.581 E016.49.56.698 Color_251ACI
N052.24.51.581 E016.49.56.698 N052.24.51.465 E016.49.55.770 Color_251ACI
N052.24.51.465 E016.49.55.770 N052.24.51.011 E016.49.55.891 Color_251ACI
N052.24.51.011 E016.49.55.891 N052.24.50.904 E016.49.57.105 Color_251ACI
N052.24.50.904 E016.49.57.105 N052.24.50.583 E016.49.57.023 Color_251ACI
N052.24.50.583 E016.49.57.023 N052.24.50.334 E016.49.57.102 Color_251ACI
N052.24.50.334 E016.49.57.102 N052.24.50.089 E016.49.56.687 Color_251ACI
N052.24.50.089 E016.49.56.687 N052.24.50.132 E016.49.55.775 Color_251ACI
N052.24.50.132 E016.49.55.775 N052.24.50.494 E016.49.55.788 Color_251ACI
N052.24.50.494 E016.49.55.788 N052.24.50.593 E016.49.54.188 Color_251ACI
N052.24.50.593 E016.49.54.188 N052.24.49.801 E016.49.54.076 Color_251ACI
N052.24.49.801 E016.49.54.076 N052.24.49.626 E016.49.51.928 Color_251ACI
N052.24.49.626 E016.49.51.928 N052.24.51.451 E016.49.51.225 Color_251ACI
N052.24.51.451 E016.49.51.225 N052.24.51.542 E016.49.51.896 Color_251ACI
N052.24.51.542 E016.49.51.896 N052.24.51.830 E016.49.51.771 Color_251ACI
N052.24.51.830 E016.49.51.771 N052.24.51.789 E016.49.51.458 Color_251ACI
N052.24.51.789 E016.49.51.458 N052.24.52.418 E016.49.51.201 Color_251ACI
N052.24.52.418 E016.49.51.201 N052.24.52.587 E016.49.52.134 Color_251ACI
N052.24.52.587 E016.49.52.134 N052.24.51.746 E016.49.52.487 Color_251ACI
N052.24.51.746 E016.49.52.487 N052.24.52.161 E016.49.54.765 Color_251ACI
N052.24.52.161 E016.49.54.765 N052.24.52.373 E016.49.54.657 Color_251ACI
N052.24.52.373 E016.49.54.657 N052.24.52.412 E016.49.55.007 Color_251ACI
N052.24.52.412 E016.49.55.007 N052.24.53.036 E016.49.54.793 Color_251ACI
N052.24.53.036 E016.49.54.793 N052.24.53.006 E016.49.54.580 Color_251ACI
N052.24.53.006 E016.49.54.580 N052.24.53.408 E016.49.54.441 Color_251ACI
N052.24.53.408 E016.49.54.441 N052.24.53.510 E016.49.55.133 Color_251ACI
N052.24.53.510 E016.49.55.133 N052.24.53.101 E016.49.55.258 Color_251ACI
N052.24.53.101 E016.49.55.258 N052.24.53.077 E016.49.55.107 Color_251ACI
N052.24.53.077 E016.49.55.107 N052.24.52.257 E016.49.55.406 Color_251ACI
N052.24.52.257 E016.49.55.406 N052.24.53.479 E016.50.03.030 Color_251ACI
N052.24.53.479 E016.50.03.030 N052.24.53.600 E016.50.03.209 Color_251ACI
N052.24.53.600 E016.50.03.209 N052.24.54.080 E016.50.00.705 Color_251ACI
N052.24.54.080 E016.50.00.705 N052.24.54.408 E016.49.58.406 Color_251ACI
N052.24.54.408 E016.49.58.406 N052.24.54.583 E016.49.56.092 Color_251ACI
N052.24.54.583 E016.49.56.092 N052.24.54.797 E016.49.44.663 Color_251ACI
N052.24.54.797 E016.49.44.663 N052.24.54.873 E016.49.41.726 Color_251ACI
N052.24.54.873 E016.49.41.726 N052.24.55.554 E016.49.32.375 Color_251ACI
N052.24.55.554 E016.49.32.375 N052.25.04.732 E016.49.33.297 Color_251ACI
N052.25.04.732 E016.49.33.297 N052.25.04.845 E016.49.42.307 Color_251ACI
N052.25.04.845 E016.49.42.307 N052.25.04.870 E016.49.42.838 Color_251ACI
N052.25.04.870 E016.49.42.838 N052.25.04.934 E016.49.43.168 Color_251ACI
N052.25.04.934 E016.49.43.168 N052.25.05.029 E016.49.43.389 Color_251ACI
N052.25.05.029 E016.49.43.389 N052.25.05.102 E016.49.43.489 Color_251ACI
N052.25.05.102 E016.49.43.489 N052.25.05.179 E016.49.43.524 Color_251ACI
N052.25.05.179 E016.49.43.524 N052.25.05.883 E016.49.43.788 Color_251ACI
N052.25.05.883 E016.49.43.788 N052.25.06.404 E016.49.44.014 Color_251ACI
N052.25.06.404 E016.49.44.014 N052.25.06.785 E016.49.44.119 Color_251ACI
N052.25.06.785 E016.49.44.119 N052.25.06.988 E016.49.44.113 Color_251ACI
N052.25.06.988 E016.49.44.113 N052.25.07.213 E016.49.43.884 Color_251ACI
N052.25.07.213 E016.49.43.884 N052.25.07.404 E016.49.43.541 Color_251ACI
N052.25.07.404 E016.49.43.541 N052.25.07.480 E016.49.43.242 Color_251ACI
N052.25.07.480 E016.49.43.242 N052.25.07.518 E016.49.42.997 Color_251ACI
N052.25.07.518 E016.49.42.997 N052.25.22.945 E016.48.22.161 Color_251ACI
N052.25.22.945 E016.48.22.161 N052.25.23.169 E016.48.20.984 Color_251ACI
N052.25.23.169 E016.48.20.984 N052.25.23.266 E016.48.20.472 Color_251ACI
N052.25.23.266 E016.48.20.472 N052.25.23.474 E016.48.19.915 Color_251ACI
N052.25.23.474 E016.48.19.915 N052.25.23.753 E016.48.19.414 Color_251ACI
N052.25.23.753 E016.48.19.414 N052.25.24.088 E016.48.18.936 Color_251ACI
N052.25.24.088 E016.48.18.936 N052.25.24.421 E016.48.18.690 Color_251ACI
N052.25.24.421 E016.48.18.690 N052.25.24.748 E016.48.18.678 Color_251ACI
N052.25.24.748 E016.48.18.678 N052.25.24.969 E016.48.18.749 Color_251ACI
N052.25.24.969 E016.48.18.749 N052.25.26.673 E016.48.19.463 Color_251ACI
N052.25.26.673 E016.48.19.463 N052.25.28.461 E016.48.20.311 Color_251ACI
N052.25.28.461 E016.48.20.311 N052.25.28.727 E016.48.20.557 Color_251ACI
N052.25.28.727 E016.48.20.557 N052.25.29.123 E016.48.21.267 Color_251ACI
N052.25.30.702 E016.48.21.966 N052.25.29.146 E016.48.21.153 Color_251ACI
N052.25.29.146 E016.48.21.153 N052.25.04.389 E016.50.28.597 Color_251ACI
N052.25.04.389 E016.50.28.597 N052.25.05.941 E016.50.29.408 Color_251ACI
N052.25.05.941 E016.50.29.408 N052.25.30.702 E016.48.21.966 Color_251ACI
N052.24.49.494 E016.50.00.307 N052.24.51.492 E016.49.59.213 Color_16ACI
N052.24.51.492 E016.49.59.213 N052.24.51.705 E016.50.00.256 Color_16ACI
N052.24.51.705 E016.50.00.256 N052.24.49.707 E016.50.01.350 Color_16ACI
N052.24.49.707 E016.50.01.350 N052.24.49.494 E016.50.00.307 Color_16ACI
N052.24.52.331 E016.50.02.940 N052.24.52.480 E016.50.03.769 Color_16ACI
N052.24.52.480 E016.50.03.769 N052.24.50.618 E016.50.04.666 Color_16ACI
N052.24.50.618 E016.50.04.666 N052.24.50.469 E016.50.03.838 Color_16ACI
N052.24.50.469 E016.50.03.838 N052.24.52.331 E016.50.02.940 Color_16ACI
N052.24.51.272 E016.50.05.450 N052.24.51.293 E016.50.08.250 Color_16ACI
N052.24.51.293 E016.50.08.250 N052.24.50.435 E016.50.08.267 Color_16ACI
N052.24.50.435 E016.50.08.267 N052.24.50.414 E016.50.05.467 Color_16ACI
N052.24.50.414 E016.50.05.467 N052.24.51.272 E016.50.05.450 Color_16ACI
N052.24.51.973 E016.50.08.735 N052.24.51.956 E016.50.07.594 Color_16ACI
N052.24.51.956 E016.50.07.594 N052.24.51.725 E016.50.07.603 Color_16ACI
N052.24.51.725 E016.50.07.603 N052.24.51.741 E016.50.08.744 Color_16ACI
N052.24.51.741 E016.50.08.744 N052.24.51.973 E016.50.08.735 Color_16ACI
N052.24.53.280 E016.50.08.536 N052.24.53.289 E016.50.08.897 Color_16ACI
N052.24.53.289 E016.50.08.897 N052.24.52.747 E016.50.08.934 Color_16ACI
N052.24.52.747 E016.50.08.934 N052.24.52.738 E016.50.08.573 Color_16ACI
N052.24.52.738 E016.50.08.573 N052.24.53.280 E016.50.08.536 Color_16ACI
N052.24.52.421 E016.50.09.766 N052.24.52.383 E016.50.10.350 Color_16ACI
N052.24.52.383 E016.50.10.350 N052.24.51.512 E016.50.10.199 Color_16ACI
N052.24.51.512 E016.50.10.199 N052.24.51.550 E016.50.09.614 Color_16ACI
N052.24.51.550 E016.50.09.614 N052.24.52.421 E016.50.09.766 Color_16ACI
N052.24.49.809 E016.50.09.125 N052.24.49.772 E016.50.11.473 Color_16ACI
N052.24.49.772 E016.50.11.473 N052.24.49.529 E016.50.11.463 Color_16ACI
N052.24.49.529 E016.50.11.463 N052.24.49.567 E016.50.09.114 Color_16ACI
N052.24.49.567 E016.50.09.114 N052.24.49.809 E016.50.09.125 Color_16ACI
N052.24.48.705 E016.50.07.845 N052.24.48.644 E016.50.08.256 Color_16ACI
N052.24.48.644 E016.50.08.256 N052.24.47.769 E016.50.07.907 Color_16ACI
N052.24.47.769 E016.50.07.907 N052.24.47.830 E016.50.07.495 Color_16ACI
N052.24.47.830 E016.50.07.495 N052.24.48.705 E016.50.07.845 Color_16ACI
N052.24.51.348 E016.50.20.498 N052.24.51.341 E016.50.22.150 Color_16ACI
N052.24.51.341 E016.50.22.150 N052.24.51.634 E016.50.22.153 Color_16ACI
N052.24.51.634 E016.50.22.153 N052.24.51.642 E016.50.20.502 Color_16ACI
N052.24.51.642 E016.50.20.502 N052.24.51.348 E016.50.20.498 Color_16ACI
N052.24.49.962 E016.50.20.152 N052.24.49.952 E016.50.20.689 Color_16ACI
N052.24.49.952 E016.50.20.689 N052.24.49.799 E016.50.20.655 Color_16ACI
N052.24.49.799 E016.50.20.655 N052.24.49.813 E016.50.21.158 Color_16ACI
N052.24.49.813 E016.50.21.158 N052.24.49.961 E016.50.21.142 Color_16ACI
N052.24.49.961 E016.50.21.142 N052.24.49.933 E016.50.21.777 Color_16ACI
N052.24.49.933 E016.50.21.777 N052.24.49.376 E016.50.21.744 Color_16ACI
N052.24.49.376 E016.50.21.744 N052.24.49.419 E016.50.20.121 Color_16ACI
N052.24.49.419 E016.50.20.121 N052.24.49.962 E016.50.20.152 Color_16ACI
N052.24.50.593 E016.49.54.188 N052.24.49.636 E016.49.54.051 Color_16ACI
N052.24.49.636 E016.49.54.051 N052.24.49.516 E016.49.55.592 Color_16ACI
N052.24.49.516 E016.49.55.592 N052.24.49.750 E016.49.55.644 Color_16ACI
N052.24.49.750 E016.49.55.644 N052.24.49.756 E016.49.56.731 Color_16ACI
N052.24.49.756 E016.49.56.731 N052.24.49.471 E016.49.56.711 Color_16ACI
N052.24.49.471 E016.49.56.711 N052.24.49.457 E016.49.57.530 Color_16ACI
N052.24.49.457 E016.49.57.530 N052.24.50.433 E016.49.57.628 Color_16ACI
N052.24.50.433 E016.49.57.628 N052.24.50.435 E016.49.57.070 Color_16ACI
N052.24.50.435 E016.49.57.070 N052.24.50.334 E016.49.57.102 Color_16ACI
N052.24.50.334 E016.49.57.102 N052.24.50.089 E016.49.56.687 Color_16ACI
N052.24.50.089 E016.49.56.687 N052.24.50.132 E016.49.55.775 Color_16ACI
N052.24.50.132 E016.49.55.775 N052.24.50.494 E016.49.55.788 Color_16ACI
N052.24.50.494 E016.49.55.788 N052.24.50.593 E016.49.54.188 Color_16ACI
N052.24.52.942 E016.49.31.910 N052.24.52.739 E016.49.35.721 Color_16ACI
N052.24.52.739 E016.49.35.721 N052.24.53.715 E016.49.35.964 Color_16ACI
N052.24.53.715 E016.49.35.964 N052.24.53.434 E016.49.41.321 Color_16ACI
N052.24.53.434 E016.49.41.321 N052.24.52.451 E016.49.41.158 Color_16ACI
N052.24.52.451 E016.49.41.158 N052.24.52.425 E016.49.42.709 Color_16ACI
N052.24.52.425 E016.49.42.709 N052.24.51.584 E016.49.42.691 Color_16ACI
N052.24.51.584 E016.49.42.691 N052.24.51.573 E016.49.43.674 Color_16ACI
N052.24.51.573 E016.49.43.674 N052.24.52.322 E016.49.43.720 Color_16ACI
N052.24.52.322 E016.49.43.720 N052.24.52.328 E016.49.45.262 Color_16ACI
N052.24.52.328 E016.49.45.262 N052.24.53.380 E016.49.45.185 Color_16ACI
N052.24.53.380 E016.49.45.185 N052.24.53.683 E016.49.45.761 Color_16ACI
N052.24.53.683 E016.49.45.761 N052.24.53.550 E016.49.45.976 Color_16ACI
N052.24.53.550 E016.49.45.976 N052.24.53.550 E016.49.47.246 Color_16ACI
N052.24.53.550 E016.49.47.246 N052.24.54.099 E016.49.47.222 Color_16ACI
N052.24.54.099 E016.49.47.222 N052.24.54.083 E016.49.46.650 Color_16ACI
N052.24.54.083 E016.49.46.650 N052.24.54.756 E016.49.46.639 Color_16ACI
N052.24.54.756 E016.49.46.639 N052.24.54.851 E016.49.42.029 Color_16ACI
N052.24.54.851 E016.49.42.029 N052.24.55.554 E016.49.32.375 Color_16ACI
N052.24.55.554 E016.49.32.375 N052.24.55.597 E016.49.32.379 Color_16ACI
N052.24.55.597 E016.49.32.379 N052.24.55.607 E016.49.32.215 Color_16ACI
N052.24.55.607 E016.49.32.215 N052.24.52.942 E016.49.31.910 Color_16ACI
N052.24.51.018 E016.50.14.763 N052.24.51.551 E016.50.14.354 Color_16ACI
N052.24.51.551 E016.50.14.354 N052.24.52.118 E016.50.14.536 Color_16ACI
N052.24.52.118 E016.50.14.536 N052.24.52.113 E016.50.15.371 Color_16ACI
N052.24.52.113 E016.50.15.371 N052.24.51.603 E016.50.15.269 Color_16ACI
N052.24.51.603 E016.50.15.269 N052.24.51.414 E016.50.15.553 Color_16ACI
N052.24.51.414 E016.50.15.553 N052.24.51.598 E016.50.15.974 Color_16ACI
N052.24.51.598 E016.50.15.974 N052.24.51.338 E016.50.16.362 Color_16ACI
N052.24.51.338 E016.50.16.362 N052.24.51.463 E016.50.16.542 Color_16ACI
N052.24.51.463 E016.50.16.542 N052.24.52.462 E016.50.16.527 Color_16ACI
N052.24.52.462 E016.50.16.527 N052.24.52.457 E016.50.17.188 Color_16ACI
N052.24.52.457 E016.50.17.188 N052.24.51.760 E016.50.17.174 Color_16ACI
N052.24.51.760 E016.50.17.174 N052.24.51.637 E016.50.17.328 Color_16ACI
N052.24.51.637 E016.50.17.328 N052.24.51.913 E016.50.17.920 Color_16ACI
N052.24.51.913 E016.50.17.920 N052.24.51.861 E016.50.18.787 Color_16ACI
N052.24.51.861 E016.50.18.787 N052.24.51.774 E016.50.18.780 Color_16ACI
N052.24.51.774 E016.50.18.780 N052.24.51.817 E016.50.19.610 Color_16ACI
N052.24.51.817 E016.50.19.610 N052.24.51.529 E016.50.19.162 Color_16ACI
N052.24.51.529 E016.50.19.162 N052.24.51.056 E016.50.18.995 Color_16ACI
N052.24.51.056 E016.50.18.995 N052.24.51.055 E016.50.17.633 Color_16ACI
N052.24.51.055 E016.50.17.633 N052.24.50.896 E016.50.17.351 Color_16ACI
N052.24.50.896 E016.50.17.351 N052.24.50.780 E016.50.17.391 Color_16ACI
N052.24.50.780 E016.50.17.391 N052.24.50.739 E016.50.17.367 Color_16ACI
N052.24.50.739 E016.50.17.367 N052.24.50.561 E016.50.17.031 Color_16ACI
N052.24.50.561 E016.50.17.031 N052.24.50.753 E016.50.16.754 Color_16ACI
N052.24.50.753 E016.50.16.754 N052.24.50.367 E016.50.15.680 Color_16ACI
N052.24.50.367 E016.50.15.680 N052.24.51.058 E016.50.15.696 Color_16ACI
N052.24.51.058 E016.50.15.696 N052.24.51.066 E016.50.15.183 Color_16ACI
N052.24.51.066 E016.50.15.183 N052.24.50.267 E016.50.15.150 Color_16ACI
N052.24.50.267 E016.50.15.150 N052.24.50.260 E016.50.14.357 Color_16ACI
N052.24.50.260 E016.50.14.357 N052.24.50.555 E016.50.14.325 Color_16ACI
N052.24.50.555 E016.50.14.325 N052.24.50.552 E016.50.10.369 Color_16ACI
N052.24.50.552 E016.50.10.369 N052.24.50.898 E016.50.10.324 Color_16ACI
N052.24.50.898 E016.50.10.324 N052.24.50.936 E016.50.10.910 Color_16ACI
N052.24.50.936 E016.50.10.910 N052.24.51.099 E016.50.10.896 Color_16ACI
N052.24.51.099 E016.50.10.896 N052.24.51.101 E016.50.11.509 Color_16ACI
N052.24.51.101 E016.50.11.509 N052.24.50.830 E016.50.11.493 Color_16ACI
N052.24.50.830 E016.50.11.493 N052.24.50.828 E016.50.11.951 Color_16ACI
N052.24.50.828 E016.50.11.951 N052.24.51.091 E016.50.11.991 Color_16ACI
N052.24.51.091 E016.50.11.991 N052.24.51.018 E016.50.14.763 Color_16ACI
N052.25.32.867 E016.50.35.421 N052.25.31.880 E016.50.39.018 Color_16ACI
N052.25.31.880 E016.50.39.018 N052.25.31.282 E016.50.38.577 Color_16ACI
N052.25.31.282 E016.50.38.577 N052.25.32.269 E016.50.34.979 Color_16ACI
N052.25.32.269 E016.50.34.979 N052.25.32.867 E016.50.35.421 Color_16ACI
N052.25.35.734 E016.50.40.443 N052.25.35.434 E016.50.41.524 Color_16ACI
N052.25.35.434 E016.50.41.524 N052.25.32.718 E016.50.39.498 Color_16ACI
N052.25.32.718 E016.50.39.498 N052.25.33.018 E016.50.38.417 Color_16ACI
N052.25.33.018 E016.50.38.417 N052.25.35.734 E016.50.40.443 Color_16ACI
N052.25.31.713 E016.50.39.569 N052.25.30.818 E016.50.42.833 Color_16ACI
N052.25.30.818 E016.50.42.833 N052.25.30.233 E016.50.42.401 Color_16ACI
N052.25.30.233 E016.50.42.401 N052.25.31.128 E016.50.39.137 Color_16ACI
N052.25.31.128 E016.50.39.137 N052.25.31.713 E016.50.39.569 Color_16ACI
N052.25.31.746 E016.50.43.406 N052.25.30.794 E016.50.46.973 Color_16ACI
N052.25.30.794 E016.50.46.973 N052.25.30.407 E016.50.46.695 Color_16ACI
N052.25.30.407 E016.50.46.695 N052.25.31.359 E016.50.43.128 Color_16ACI
N052.25.31.359 E016.50.43.128 N052.25.31.746 E016.50.43.406 Color_16ACI
N052.25.30.479 E016.50.47.790 N052.25.30.051 E016.50.49.293 Color_16ACI
N052.25.30.051 E016.50.49.293 N052.25.29.699 E016.50.49.024 Color_16ACI
N052.25.29.699 E016.50.49.024 N052.25.30.126 E016.50.47.520 Color_16ACI
N052.25.30.126 E016.50.47.520 N052.25.30.479 E016.50.47.790 Color_16ACI
N052.25.25.781 E016.50.36.555 N052.25.25.386 E016.50.38.000 Color_16ACI
N052.25.25.386 E016.50.38.000 N052.25.24.932 E016.50.37.667 Color_16ACI
N052.25.24.932 E016.50.37.667 N052.25.25.327 E016.50.36.222 Color_16ACI
N052.25.25.327 E016.50.36.222 N052.25.25.781 E016.50.36.555 Color_16ACI
N052.25.24.356 E016.50.35.383 N052.25.24.170 E016.50.36.084 Color_16ACI
N052.25.24.170 E016.50.36.084 N052.25.22.806 E016.50.35.111 Color_16ACI
N052.25.22.806 E016.50.35.111 N052.25.22.992 E016.50.34.410 Color_16ACI
N052.25.22.992 E016.50.34.410 N052.25.24.356 E016.50.35.383 Color_16ACI
N052.25.24.770 E016.50.39.287 N052.25.24.501 E016.50.40.206 Color_16ACI
N052.25.24.501 E016.50.40.206 N052.25.22.954 E016.50.38.990 Color_16ACI
N052.25.22.954 E016.50.38.990 N052.25.23.222 E016.50.38.071 Color_16ACI
N052.25.23.222 E016.50.38.071 N052.25.24.770 E016.50.39.287 Color_16ACI
N052.25.23.194 E016.50.41.446 N052.25.22.939 E016.50.42.509 Color_16ACI
N052.25.22.939 E016.50.42.509 N052.25.21.046 E016.50.41.286 Color_16ACI
N052.25.21.046 E016.50.41.286 N052.25.21.301 E016.50.40.223 Color_16ACI
N052.25.21.301 E016.50.40.223 N052.25.23.194 E016.50.41.446 Color_16ACI
N052.25.20.881 E016.50.39.944 N052.25.20.613 E016.50.41.087 Color_16ACI
N052.25.20.613 E016.50.41.087 N052.25.18.593 E016.50.39.814 Color_16ACI
N052.25.18.593 E016.50.39.814 N052.25.18.861 E016.50.38.671 Color_16ACI
N052.25.18.861 E016.50.38.671 N052.25.20.881 E016.50.39.944 Color_16ACI
N052.25.16.958 E016.50.38.797 N052.25.16.473 E016.50.40.907 Color_16ACI
N052.25.16.473 E016.50.40.907 N052.25.15.938 E016.50.40.577 Color_16ACI
N052.25.15.938 E016.50.40.577 N052.25.16.423 E016.50.38.466 Color_16ACI
N052.25.16.423 E016.50.38.466 N052.25.16.958 E016.50.38.797 Color_16ACI
N052.25.18.908 E016.50.57.098 N052.25.18.663 E016.50.58.098 Color_16ACI
N052.25.18.663 E016.50.58.098 N052.25.16.770 E016.50.56.851 Color_16ACI
N052.25.16.770 E016.50.56.851 N052.25.17.016 E016.50.55.850 Color_16ACI
N052.25.17.016 E016.50.55.850 N052.25.18.908 E016.50.57.098 Color_16ACI

;EPLB airport
;apron
LOTNISKA_EPLB N051.14.17.640	E022.42.52.032	N051.14.18.420	E022.42.57.056	Color_251ACI
N051.14.18.420	E022.42.57.056	N051.14.11.299	E022.42.59.461	Color_251ACI
				
N051.14.09.697	E022.42.48.251	N051.14.13.423	E022.42.46.912	Color_251ACI
N051.14.13.423	E022.42.46.912	N051.14.13.754	E022.42.46.969	Color_251ACI
N051.14.13.754	E022.42.46.969	N051.14.14.230	E022.42.50.267	Color_251ACI
N051.14.14.230	E022.42.50.267	N051.14.15.162	E022.42.51.296	Color_251ACI
N051.14.09.719	E022.42.48.244	N051.14.08.984	E022.42.48.452	Color_251ACI
N051.14.08.984	E022.42.48.452	N051.14.09.326	E022.42.51.422	Color_251ACI
N051.14.09.326	E022.42.51.422	N051.14.10.536	E022.43.00.217	Color_251ACI
N051.14.10.536	E022.43.00.217	N051.14.11.324	E022.42.59.465	Color_251ACI
;budynek				
N051.14.06.274	E022.42.29.534	N051.14.04.243	E022.42.30.211	Color_251ACI
N051.14.04.243	E022.42.30.211	N051.14.04.729	E022.42.33.577	Color_251ACI
N051.14.04.729	E022.42.33.577	N051.14.06.781	E022.42.32.900	Color_251ACI
N051.14.06.781	E022.42.32.900	N051.14.06.274	E022.42.29.534	Color_251ACI
;budynek
N051.14.11.224	E022.43.03.223	N051.14.09.193	E022.43.04.062	Color_251ACI
N051.14.09.193	E022.43.04.062	N051.14.09.884	E022.43.08.756	Color_251ACI
N051.14.09.884	E022.43.08.756	N051.14.11.915	E022.43.08.044	Color_251ACI
N051.14.11.915	E022.43.08.044	N051.14.11.224	E022.43.03.223	Color_251ACI
;budynek
N051.14.08.791	E022.42.47.174	N051.14.07.267	E022.42.47.725	Color_251ACI
N051.14.07.267	E022.42.47.725	N051.14.07.876	E022.42.51.959	Color_251ACI
N051.14.07.876	E022.42.51.959	N051.14.09.317	E022.42.51.444	Color_251ACI
N051.14.09.317	E022.42.51.444	N051.14.08.791	E022.42.47.174	Color_251ACI
;budynek
N051.14.09.193	E022.42.57.301	N051.14.09.661	E022.43.00.408	Color_251ACI
N051.14.09.661	E022.43.00.408	N051.14.10.520	E022.42.60.100	Color_251ACI
N051.14.10.520	E022.42.60.100	N051.14.10.070	E022.42.56.912	Color_251ACI
N051.14.10.070	E022.42.56.912	N051.14.09.193	E022.42.57.301	Color_251ACI
;parking zachód
N051.14.03.714	E022.42.34.250	N051.14.04.330	E022.42.36.367	Color_251ACI
N051.14.04.330	E022.42.36.367	N051.14.05.215	E022.42.43.427	Color_251ACI
N051.14.05.215	E022.42.43.427	N051.14.04.326	E022.42.43.700	Color_251ACI
N051.14.04.326	E022.42.43.700	N051.14.03.991	E022.42.40.928	Color_251ACI
N051.14.03.991	E022.42.40.928	N051.14.03.444	E022.42.37.073	Color_251ACI
N051.14.03.444	E022.42.37.073	N051.14.03.307	E022.42.34.466	Color_251ACI
N051.14.03.307	E022.42.34.466	N051.14.03.714	E022.42.34.250	Color_251ACI
;zawrotka rwy 07
N051.14.14.881	E022.41.45.276	N051.14.14.456	E022.41.45.157	Color_253ACI
N051.14.14.456	E022.41.45.157	N051.14.08.963	E022.41.47.036	Color_253ACI
N051.14.08.963	E022.41.47.036	N051.14.09.931	E022.41.53.581	Color_253ACI
N051.14.09.931	E022.41.53.581	N051.14.12.354	E022.41.52.760	Color_253ACI
N051.14.12.354	E022.41.52.760	N051.14.13.488	E022.41.47.861	Color_253ACI
N051.14.13.488	E022.41.47.861	N051.14.13.582	E022.41.47.620	Color_253ACI
N051.14.13.582	E022.41.47.620	N051.14.13.718	E022.41.47.569	Color_253ACI
N051.14.13.718	E022.41.47.569	N051.14.13.927	E022.41.47.497	Color_253ACI
N051.14.13.927	E022.41.47.497	N051.14.14.158	E022.41.47.476	Color_253ACI
N051.14.14.158	E022.41.47.476	N051.14.14.338	E022.41.47.620	Color_253ACI
N051.14.14.338	E022.41.47.620	N051.14.14.806	E022.41.48.415	Color_253ACI
N051.14.14.806	E022.41.48.415	N051.14.15.036	E022.41.49.042	Color_253ACI
N051.14.15.036	E022.41.49.042	N051.14.15.414	E022.41.49.139	Color_253ACI
;parking centralny
N051.14.04.621	E022.42.45.641	N051.14.05.543	E022.42.52.178	Color_251ACI
N051.14.05.543	E022.42.52.178	N051.14.05.255	E022.42.52.265	Color_251ACI
N051.14.05.255	E022.42.52.265	N051.14.04.333	E022.42.45.673	Color_251ACI
N051.14.04.333	E022.42.45.673	N051.14.04.621	E022.42.45.641	Color_251ACI

N051.14.06.245	E022.42.52.373	N051.14.05.806	E022.42.53.248	Color_251ACI
N051.14.05.806	E022.42.53.248	N051.14.05.399	E022.42.53.633	Color_251ACI
N051.14.05.399	E022.42.53.633	N051.14.04.124	E022.42.53.932	Color_251ACI
N051.14.04.124	E022.42.53.932	N051.14.04.686	E022.42.52.124	Color_251ACI
N051.14.04.686	E022.42.52.124	N051.14.04.596	E022.42.51.898	Color_251ACI
N051.14.04.596	E022.42.51.898	N051.14.04.376	E022.42.50.180	Color_251ACI
N051.14.04.376	E022.42.50.180	N051.14.04.510	E022.42.50.004	Color_251ACI
N051.14.04.510	E022.42.50.004	N051.14.04.452	E022.42.49.392	Color_251ACI
N051.14.04.452	E022.42.49.392	N051.14.04.211	E022.42.49.266	Color_251ACI
N051.14.04.211	E022.42.49.266	N051.14.04.049	E022.42.47.639	Color_251ACI
N051.14.04.049	E022.42.47.639	N051.14.04.114	E022.42.47.358	Color_251ACI
N051.14.04.114	E022.42.47.358	N051.14.04.049	E022.42.46.865	Color_251ACI
N051.14.04.049	E022.42.46.865	N051.14.03.862	E022.42.46.901	Color_251ACI
N051.14.03.862	E022.42.46.901	N051.14.03.750	E022.42.46.130	Color_251ACI
N051.14.03.750	E022.42.46.130	N051.14.03.916	E022.42.45.922	Color_251ACI
N051.14.03.916	E022.42.45.922	N051.14.03.826	E022.42.45.166	Color_251ACI
N051.14.03.826	E022.42.45.166	N051.14.04.686	E022.42.45.007	Color_251ACI
N051.14.04.686	E022.42.45.007	N051.14.05.244	E022.42.45.097	Color_251ACI
N051.14.05.244	E022.42.45.097	N051.14.06.223	E022.42.52.373	Color_251ACI
;parking wschod
N051.14.05.906	E022.42.57.352	N051.14.05.197	E022.42.57.604	Color_251ACI
N051.14.05.197	E022.42.57.604	N051.14.05.762	E022.43.00.034	Color_251ACI
N051.14.05.762	E022.43.00.034	N051.14.05.935	E022.43.01.114	Color_251ACI
N051.14.05.935	E022.43.01.114	N051.14.06.187	E022.43.01.135	Color_251ACI
N051.14.06.187	E022.43.01.135	N051.14.06.220	E022.43.01.765	Color_251ACI
N051.14.06.220	E022.43.01.765	N051.14.06.079	E022.43.01.913	Color_251ACI
N051.14.06.079	E022.43.01.913	N051.14.06.313	E022.43.03.569	Color_251ACI
N051.14.06.313	E022.43.03.569	N051.14.06.551	E022.43.03.742	Color_251ACI
N051.14.06.551	E022.43.03.742	N051.14.06.598	E022.43.04.246	Color_251ACI
N051.14.06.598	E022.43.04.246	N051.14.06.425	E022.43.04.548	Color_251ACI
N051.14.06.425	E022.43.04.548	N051.14.06.612	E022.43.05.873	Color_251ACI
N051.14.06.612	E022.43.05.873	N051.14.06.896	E022.43.06.276	Color_251ACI
N051.14.06.896	E022.43.06.276	N051.14.06.832	E022.43.07.154	Color_251ACI
N051.14.06.832	E022.43.07.154	N051.14.08.092	E022.43.05.225	Color_251ACI
N051.14.08.092	E022.43.05.225	N051.14.07.778	E022.43.03.119	Color_251ACI
N051.14.07.134	E022.43.03.241	N051.14.06.864	E022.43.03.443	Color_251ACI
N051.14.06.864	E022.43.03.443	N051.14.06.205	E022.42.59.710	Color_251ACI
N051.14.06.205	E022.42.59.710	N051.14.06.536	E022.42.59.684	Color_251ACI
N051.14.06.958	E022.42.58.457	N051.14.06.126	E022.42.57.377	Color_251ACI
N051.14.06.126	E022.42.57.377	N051.14.05.906	E022.42.57.352	Color_251ACI
N051.14.06.536	E022.42.59.652	N051.14.07.116	E022.43.03.259	Color_251ACI
N051.14.07.825	E022.43.03.061	N051.14.07.476	E022.43.00.527	Color_251ACI
N051.14.07.476	E022.43.00.527	N051.14.06.943	E022.42.58.522	Color_251ACI
;budynek
N051.14.10.554	E022.43.08.566	N051.14.11.123	E022.43.12.767	Color_251ACI
N051.14.11.123	E022.43.12.767	N051.14.12.545	E022.43.12.346	Color_251ACI
N051.14.12.545	E022.43.12.346	N051.14.11.915	E022.43.08.044	Color_251ACI
;zawrotka rwy 25				
N051.14.34.732	E022.43.53.101	N051.14.35.254	E022.43.52.932	Color_253ACI
N051.14.34.105	E022.43.48.698	N051.14.34.883	E022.43.50.405	Color_253ACI
N051.14.34.883	E022.43.50.405	N051.14.35.254	E022.43.52.932	Color_253ACI
;rwy
N051.14.34.105	E022.43.48.698	N051.14.16.440	E022.41.44.740	Color_253ACI
N051.14.16.440	E022.41.44.740	N051.14.14.881	E022.41.45.276	Color_253ACI
N051.14.15.414	E022.41.49.139	N051.14.33.460	E022.43.53.520	Color_253ACI
N051.14.33.460	E022.43.53.520	N051.14.34.732	E022.43.53.101	Color_253ACI

N051.14.15.162	E022.42.51.296	N051.14.24.000	E022.42.48.310	Color_251ACI
N051.14.17.640	E022.42.52.032	N051.14.24.216	E022.42.49.810	Color_251ACI

;stand 1
N051.14.10.390	E022.42.49.600	N051.14.10.382	E022.42.49.650	Color_44ACI
N051.14.10.382	E022.42.49.650	N051.14.10.360	E022.42.49.687	Color_44ACI
N051.14.10.360	E022.42.49.687	N051.14.10.330	E022.42.49.700	Color_44ACI
N051.14.10.330	E022.42.49.700	N051.14.10.300	E022.42.49.687	Color_44ACI
N051.14.10.300	E022.42.49.687	N051.14.10.278	E022.42.49.650	Color_44ACI
N051.14.10.278	E022.42.49.650	N051.14.10.270	E022.42.49.600	Color_44ACI
N051.14.10.270	E022.42.49.600	N051.14.10.278	E022.42.49.550	Color_44ACI
N051.14.10.278	E022.42.49.550	N051.14.10.300	E022.42.49.513	Color_44ACI
N051.14.10.300	E022.42.49.513	N051.14.10.330	E022.42.49.500	Color_44ACI
N051.14.10.330	E022.42.49.500	N051.14.10.360	E022.42.49.513	Color_44ACI
N051.14.10.360	E022.42.49.513	N051.14.10.382	E022.42.49.550	Color_44ACI
N051.14.10.382	E022.42.49.550	N051.14.10.390	E022.42.49.600	Color_44ACI
;stand 2
N051.14.10.650	E022.42.50.580	N051.14.10.642	E022.42.50.630	Color_44ACI
N051.14.10.642	E022.42.50.630	N051.14.10.620	E022.42.50.667	Color_44ACI
N051.14.10.620	E022.42.50.667	N051.14.10.590	E022.42.50.680	Color_44ACI
N051.14.10.590	E022.42.50.680	N051.14.10.560	E022.42.50.667	Color_44ACI
N051.14.10.560	E022.42.50.667	N051.14.10.538	E022.42.50.630	Color_44ACI
N051.14.10.538	E022.42.50.630	N051.14.10.530	E022.42.50.580	Color_44ACI
N051.14.10.530	E022.42.50.580	N051.14.10.538	E022.42.50.530	Color_44ACI
N051.14.10.538	E022.42.50.530	N051.14.10.560	E022.42.50.493	Color_44ACI
N051.14.10.560	E022.42.50.493	N051.14.10.590	E022.42.50.480	Color_44ACI
N051.14.10.590	E022.42.50.480	N051.14.10.620	E022.42.50.493	Color_44ACI
N051.14.10.620	E022.42.50.493	N051.14.10.642	E022.42.50.530	Color_44ACI
N051.14.10.642	E022.42.50.530	N051.14.10.650	E022.42.50.580	Color_44ACI
;stand 3
N051.14.10.680	E022.42.51.640	N051.14.10.672	E022.42.51.690	Color_44ACI
N051.14.10.672	E022.42.51.690	N051.14.10.650	E022.42.51.727	Color_44ACI
N051.14.10.650	E022.42.51.727	N051.14.10.620	E022.42.51.740	Color_44ACI
N051.14.10.620	E022.42.51.740	N051.14.10.590	E022.42.51.727	Color_44ACI
N051.14.10.590	E022.42.51.727	N051.14.10.568	E022.42.51.690	Color_44ACI
N051.14.10.568	E022.42.51.690	N051.14.10.560	E022.42.51.640	Color_44ACI
N051.14.10.560	E022.42.51.640	N051.14.10.568	E022.42.51.590	Color_44ACI
N051.14.10.568	E022.42.51.590	N051.14.10.590	E022.42.51.553	Color_44ACI
N051.14.10.590	E022.42.51.553	N051.14.10.620	E022.42.51.540	Color_44ACI
N051.14.10.620	E022.42.51.540	N051.14.10.650	E022.42.51.553	Color_44ACI
N051.14.10.650	E022.42.51.553	N051.14.10.672	E022.42.51.590	Color_44ACI
N051.14.10.672	E022.42.51.590	N051.14.10.680	E022.42.51.640	Color_44ACI
;stand 4
N051.14.10.940	E022.42.52.610	N051.14.10.932	E022.42.52.660	Color_44ACI
N051.14.10.932	E022.42.52.660	N051.14.10.910	E022.42.52.697	Color_44ACI
N051.14.10.910	E022.42.52.697	N051.14.10.880	E022.42.52.710	Color_44ACI
N051.14.10.880	E022.42.52.710	N051.14.10.850	E022.42.52.697	Color_44ACI
N051.14.10.850	E022.42.52.697	N051.14.10.828	E022.42.52.660	Color_44ACI
N051.14.10.828	E022.42.52.660	N051.14.10.820	E022.42.52.610	Color_44ACI
N051.14.10.820	E022.42.52.610	N051.14.10.828	E022.42.52.560	Color_44ACI
N051.14.10.828	E022.42.52.560	N051.14.10.850	E022.42.52.523	Color_44ACI
N051.14.10.850	E022.42.52.523	N051.14.10.880	E022.42.52.510	Color_44ACI
N051.14.10.880	E022.42.52.510	N051.14.10.910	E022.42.52.523	Color_44ACI
N051.14.10.910	E022.42.52.523	N051.14.10.932	E022.42.52.560	Color_44ACI
N051.14.10.932	E022.42.52.560	N051.14.10.940	E022.42.52.610	Color_44ACI
;stand 5
N051.14.10.980	E022.42.53.670	N051.14.10.972	E022.42.53.720	Color_44ACI
N051.14.10.972	E022.42.53.720	N051.14.10.950	E022.42.53.757	Color_44ACI
N051.14.10.950	E022.42.53.757	N051.14.10.920	E022.42.53.770	Color_44ACI
N051.14.10.920	E022.42.53.770	N051.14.10.890	E022.42.53.757	Color_44ACI
N051.14.10.890	E022.42.53.757	N051.14.10.868	E022.42.53.720	Color_44ACI
N051.14.10.868	E022.42.53.720	N051.14.10.860	E022.42.53.670	Color_44ACI
N051.14.10.860	E022.42.53.670	N051.14.10.868	E022.42.53.620	Color_44ACI
N051.14.10.868	E022.42.53.620	N051.14.10.890	E022.42.53.583	Color_44ACI
N051.14.10.890	E022.42.53.583	N051.14.10.920	E022.42.53.570	Color_44ACI
N051.14.10.920	E022.42.53.570	N051.14.10.950	E022.42.53.583	Color_44ACI
N051.14.10.950	E022.42.53.583	N051.14.10.972	E022.42.53.620	Color_44ACI
N051.14.10.972	E022.42.53.620	N051.14.10.980	E022.42.53.670	Color_44ACI
;stand 6
N051.14.11.230	E022.42.54.650	N051.14.11.222	E022.42.54.700	Color_44ACI
N051.14.11.222	E022.42.54.700	N051.14.11.200	E022.42.54.737	Color_44ACI
N051.14.11.200	E022.42.54.737	N051.14.11.170	E022.42.54.750	Color_44ACI
N051.14.11.170	E022.42.54.750	N051.14.11.140	E022.42.54.737	Color_44ACI
N051.14.11.140	E022.42.54.737	N051.14.11.118	E022.42.54.700	Color_44ACI
N051.14.11.118	E022.42.54.700	N051.14.11.110	E022.42.54.650	Color_44ACI
N051.14.11.110	E022.42.54.650	N051.14.11.118	E022.42.54.600	Color_44ACI
N051.14.11.118	E022.42.54.600	N051.14.11.140	E022.42.54.563	Color_44ACI
N051.14.11.140	E022.42.54.563	N051.14.11.170	E022.42.54.550	Color_44ACI
N051.14.11.170	E022.42.54.550	N051.14.11.200	E022.42.54.563	Color_44ACI
N051.14.11.200	E022.42.54.563	N051.14.11.222	E022.42.54.600	Color_44ACI
N051.14.11.222	E022.42.54.600	N051.14.11.230	E022.42.54.650	Color_44ACI
;stand 7
N051.14.11.270	E022.42.55.710	N051.14.11.262	E022.42.55.760	Color_44ACI
N051.14.11.262	E022.42.55.760	N051.14.11.240	E022.42.55.797	Color_44ACI
N051.14.11.240	E022.42.55.797	N051.14.11.210	E022.42.55.810	Color_44ACI
N051.14.11.210	E022.42.55.810	N051.14.11.180	E022.42.55.797	Color_44ACI
N051.14.11.180	E022.42.55.797	N051.14.11.158	E022.42.55.760	Color_44ACI
N051.14.11.158	E022.42.55.760	N051.14.11.150	E022.42.55.710	Color_44ACI
N051.14.11.150	E022.42.55.710	N051.14.11.158	E022.42.55.660	Color_44ACI
N051.14.11.158	E022.42.55.660	N051.14.11.180	E022.42.55.623	Color_44ACI
N051.14.11.180	E022.42.55.623	N051.14.11.210	E022.42.55.610	Color_44ACI
N051.14.11.210	E022.42.55.610	N051.14.11.240	E022.42.55.623	Color_44ACI
N051.14.11.240	E022.42.55.623	N051.14.11.262	E022.42.55.660	Color_44ACI
N051.14.11.262	E022.42.55.660	N051.14.11.270	E022.42.55.710	Color_44ACI
;stand 8
N051.14.11.520	E022.42.56.690	N051.14.11.512	E022.42.56.740	Color_44ACI
N051.14.11.512	E022.42.56.740	N051.14.11.490	E022.42.56.777	Color_44ACI
N051.14.11.490	E022.42.56.777	N051.14.11.460	E022.42.56.790	Color_44ACI
N051.14.11.460	E022.42.56.790	N051.14.11.430	E022.42.56.777	Color_44ACI
N051.14.11.430	E022.42.56.777	N051.14.11.408	E022.42.56.740	Color_44ACI
N051.14.11.408	E022.42.56.740	N051.14.11.400	E022.42.56.690	Color_44ACI
N051.14.11.400	E022.42.56.690	N051.14.11.408	E022.42.56.640	Color_44ACI
N051.14.11.408	E022.42.56.640	N051.14.11.430	E022.42.56.603	Color_44ACI
N051.14.11.430	E022.42.56.603	N051.14.11.460	E022.42.56.590	Color_44ACI
N051.14.11.460	E022.42.56.590	N051.14.11.490	E022.42.56.603	Color_44ACI
N051.14.11.490	E022.42.56.603	N051.14.11.512	E022.42.56.640	Color_44ACI
N051.14.11.512	E022.42.56.640	N051.14.11.520	E022.42.56.690	Color_44ACI
;stand 9
N051.14.11.560	E022.42.57.740	N051.14.11.552	E022.42.57.790	Color_44ACI
N051.14.11.552	E022.42.57.790	N051.14.11.530	E022.42.57.827	Color_44ACI
N051.14.11.530	E022.42.57.827	N051.14.11.500	E022.42.57.840	Color_44ACI
N051.14.11.500	E022.42.57.840	N051.14.11.470	E022.42.57.827	Color_44ACI
N051.14.11.470	E022.42.57.827	N051.14.11.448	E022.42.57.790	Color_44ACI
N051.14.11.448	E022.42.57.790	N051.14.11.440	E022.42.57.740	Color_44ACI
N051.14.11.440	E022.42.57.740	N051.14.11.448	E022.42.57.690	Color_44ACI
N051.14.11.448	E022.42.57.690	N051.14.11.470	E022.42.57.653	Color_44ACI
N051.14.11.470	E022.42.57.653	N051.14.11.500	E022.42.57.640	Color_44ACI
N051.14.11.500	E022.42.57.640	N051.14.11.530	E022.42.57.653	Color_44ACI
N051.14.11.530	E022.42.57.653	N051.14.11.552	E022.42.57.690	Color_44ACI
N051.14.11.552	E022.42.57.690	N051.14.11.560	E022.42.57.740	Color_44ACI
;stand 10
N051.14.17.750	E022.42.55.060	N051.14.17.742	E022.42.55.110	Color_44ACI
N051.14.17.742	E022.42.55.110	N051.14.17.720	E022.42.55.147	Color_44ACI
N051.14.17.720	E022.42.55.147	N051.14.17.690	E022.42.55.160	Color_44ACI
N051.14.17.690	E022.42.55.160	N051.14.17.660	E022.42.55.147	Color_44ACI
N051.14.17.660	E022.42.55.147	N051.14.17.638	E022.42.55.110	Color_44ACI
N051.14.17.638	E022.42.55.110	N051.14.17.630	E022.42.55.060	Color_44ACI
N051.14.17.630	E022.42.55.060	N051.14.17.638	E022.42.55.010	Color_44ACI
N051.14.17.638	E022.42.55.010	N051.14.17.660	E022.42.54.973	Color_44ACI
N051.14.17.660	E022.42.54.973	N051.14.17.690	E022.42.54.960	Color_44ACI
N051.14.17.690	E022.42.54.960	N051.14.17.720	E022.42.54.973	Color_44ACI
N051.14.17.720	E022.42.54.973	N051.14.17.742	E022.42.55.010	Color_44ACI
N051.14.17.742	E022.42.55.010	N051.14.17.750	E022.42.55.060	Color_44ACI
;twy lines
;poprzeczka
N051.14.13.421	E022.42.48.492	N051.14.14.591	E022.42.56.632	Color_44ACI
;1
N051.14.10.395	E022.42.49.581	N051.14.13.421	E022.42.48.492	Color_44ACI
;2
N051.14.10.655	E022.42.50.561	N051.14.13.568	E022.42.49.513	Color_44ACI
;3
N051.14.10.685	E022.42.51.621	N051.14.13.711	E022.42.50.532	Color_44ACI
;4
N051.14.10.945	E022.42.52.591	N051.14.13.858	E022.42.51.543	Color_44ACI
;5
N051.14.10.985	E022.42.53.651	N051.14.14.011	E022.42.52.562	Color_44ACI
;6
N051.14.11.235	E022.42.54.631	N051.14.14.148	E022.42.53.583	Color_44ACI
;7
N051.14.11.275	E022.42.55.691	N051.14.14.301	E022.42.54.602	Color_44ACI
;8
N051.14.11.515	E022.42.56.671	N051.14.14.438	E022.42.55.623	Color_44ACI
;9
N051.14.11.555	E022.42.57.721	N051.14.14.591	E022.42.56.632	Color_44ACI
;9
N051.14.14.555	E022.42.56.171	N051.14.17.591	E022.42.55.082	Color_44ACI
;twy
N051.14.14.011	E022.42.52.562	N051.14.23.011	E022.42.49.425	Color_44ACI

;EPRA	
LOTNISKA_EPRA N051.23.29.065 E021.13.31.428 N051.23.12.365 E021.11.51.480 runway
N051.23.12.365 E021.11.51.480 N051.23.10.520 E021.11.52.272 runway
N051.23.10.520 E021.11.52.272 N051.23.27.220 E021.13.32.219 runway
N051.23.27.220 E021.13.32.219 N051.23.29.065 E021.13.31.428 runway
N051.23.21.491 E021.11.54.981 N051.23.21.881 E021.11.57.351 Color_44ACI
N051.23.21.881 E021.11.57.351 N051.23.21.889 E021.11.57.344 Color_44ACI
N051.23.21.853 E021.11.54.740 N051.23.21.703 E021.11.54.328 Color_44ACI
N051.23.21.889 E021.11.57.344 N051.23.25.680 E021.12.21.574 Color_44ACI
N051.23.22.257 E021.11.57.192 N051.23.21.853 E021.11.54.740 Color_44ACI
N051.23.26.157 E021.12.22.171 N051.23.36.544 E021.12.22.207 Color_44ACI
N051.23.25.773 E021.12.22.170 N051.23.30.949 E021.12.55.315 Color_44ACI
N051.23.25.680 E021.12.21.574 N051.23.24.482 E021.12.21.576 Color_44ACI
N051.23.26.063 E021.12.21.574 N051.23.22.250 E021.11.57.199 Color_44ACI
N051.23.22.250 E021.11.57.199 N051.23.22.257 E021.11.57.192 Color_44ACI
N051.23.31.043 E021.12.55.919 N051.23.33.733 E021.13.13.129 Color_44ACI
N051.23.33.733 E021.13.13.129 N051.23.33.725 E021.13.13.132 Color_44ACI
N051.23.30.949 E021.12.55.315 N051.23.25.473 E021.12.57.657 Color_44ACI
N051.23.31.309 E021.12.55.161 N051.23.26.157 E021.12.22.171 Color_44ACI
N051.23.31.403 E021.12.55.765 N051.23.33.336 E021.12.54.939 Color_44ACI
N051.23.19.452 E021.12.22.157 N051.23.24.482 E021.12.22.173 Color_44ACI
N051.23.19.453 E021.12.21.560 N051.23.17.871 E021.12.21.555 Color_44ACI
N051.23.17.871 E021.12.21.555 N051.23.17.390 E021.12.21.552 Color_44ACI
N051.23.17.969 E021.12.22.152 N051.23.19.452 E021.12.22.157 Color_44ACI
N051.23.17.492 E021.12.22.161 N051.23.17.969 E021.12.22.152 Color_44ACI
N051.23.25.473 E021.12.57.657 N051.23.24.020 E021.12.58.278 Color_44ACI
N051.23.25.574 E021.12.58.258 N051.23.31.043 E021.12.55.919 Color_44ACI
N051.23.24.020 E021.12.58.278 N051.23.23.559 E021.12.58.475 Color_44ACI
N051.23.24.120 E021.12.58.879 N051.23.25.574 E021.12.58.258 Color_44ACI
N051.23.23.659 E021.12.59.076 N051.23.24.120 E021.12.58.879 Color_44ACI
N051.23.28.826 E021.13.20.226 N051.23.27.877 E021.13.20.601 Color_44ACI
N051.23.28.912 E021.13.20.779 N051.23.32.247 E021.13.19.433 Color_44ACI
N051.23.27.924 E021.13.21.170 N051.23.28.912 E021.13.20.779 Color_44ACI
N051.23.32.147 E021.13.18.884 N051.23.28.826 E021.13.20.226 Color_44ACI
N051.23.32.247 E021.13.19.433 N051.23.32.828 E021.13.19.127 Color_44ACI
N051.23.32.679 E021.13.18.605 N051.23.32.147 E021.13.18.884 Color_44ACI
N051.23.32.828 E021.13.19.127 N051.23.33.196 E021.13.18.771 Color_44ACI
N051.23.32.987 E021.13.18.307 N051.23.32.679 E021.13.18.605 Color_44ACI
N051.23.33.196 E021.13.18.771 N051.23.33.583 E021.13.18.239 Color_44ACI
N051.23.33.322 E021.13.17.845 N051.23.32.987 E021.13.18.307 Color_44ACI
N051.23.33.583 E021.13.18.239 N051.23.33.980 E021.13.17.402 Color_44ACI
N051.23.33.671 E021.13.17.110 N051.23.33.322 E021.13.17.845 Color_44ACI
N051.23.34.621 E021.13.27.313 N051.23.34.567 E021.13.27.839 Color_44ACI
N051.23.34.567 E021.13.27.839 N051.23.34.425 E021.13.28.222 Color_44ACI
N051.23.34.425 E021.13.28.222 N051.23.34.060 E021.13.28.600 Color_44ACI
N051.23.34.060 E021.13.28.600 N051.23.30.989 E021.13.29.918 Color_44ACI
N051.23.34.206 E021.13.29.128 N051.23.34.688 E021.13.28.629 Color_44ACI
N051.23.30.989 E021.13.29.918 N051.23.29.531 E021.13.30.532 Color_44ACI
N051.23.31.080 E021.13.30.470 N051.23.34.206 E021.13.29.128 Color_44ACI
N051.23.29.531 E021.13.30.532 N051.23.28.917 E021.13.30.540 Color_44ACI
N051.23.29.579 E021.13.31.102 N051.23.31.080 E021.13.30.470 Color_44ACI
N051.23.28.958 E021.13.31.110 N051.23.29.579 E021.13.31.102 Color_44ACI
N051.23.34.089 E021.13.17.003 N051.23.34.104 E021.13.17.285 Color_44ACI
N051.23.34.104 E021.13.17.285 N051.23.34.140 E021.13.17.991 Color_44ACI
N051.23.34.140 E021.13.17.991 N051.23.34.179 E021.13.18.733 Color_44ACI	
N051.23.34.179 E021.13.18.733 N051.23.34.245 E021.13.20.029 Color_44ACI
N051.23.36.557 E021.12.22.419 N051.23.36.376 E021.12.28.458 Color_44ACI
N051.23.36.928 E021.12.22.451 N051.23.36.948 E021.12.21.924 Color_44ACI
N051.23.36.958 E021.12.21.616 N051.23.36.948 E021.12.21.924 Color_44ACI
N051.23.36.958 E021.12.21.616 N051.23.36.594 E021.12.21.610 Color_44ACI
N051.23.36.376 E021.12.28.458 N051.23.36.344 E021.12.28.890 Color_44ACI
N051.23.36.747 E021.12.28.507 N051.23.36.928 E021.12.22.451 Color_44ACI
N051.23.36.344 E021.12.28.890 N051.23.33.905 E021.12.52.951 Color_44ACI
N051.23.33.905 E021.12.52.951 N051.23.33.182 E021.12.54.361 Color_44ACI
N051.23.36.713 E021.12.28.973 N051.23.36.747 E021.12.28.507 Color_44ACI
N051.23.33.182 E021.12.54.361 N051.23.31.309 E021.12.55.161 Color_44ACI
N051.23.34.073 E021.13.12.851 N051.23.31.403 E021.12.55.765 Color_44ACI
N051.23.34.319 E021.13.21.443 N051.23.34.394 E021.13.22.890 Color_44ACI
N051.23.34.245 E021.13.20.029 N051.23.34.319 E021.13.21.443 Color_44ACI
N051.23.34.394 E021.13.22.890 N051.23.34.467 E021.13.24.332 Color_44ACI
N051.23.34.467 E021.13.24.332 N051.23.34.543 E021.13.25.813 Color_44ACI
N051.23.34.543 E021.13.25.813 N051.23.34.581 E021.13.26.519 Color_44ACI
N051.23.34.581 E021.13.26.519 N051.23.34.621 E021.13.27.313 Color_44ACI
N051.23.24.482 E021.12.21.576 N051.23.19.453 E021.12.21.560 Color_44ACI
N051.23.24.482 E021.12.22.173 N051.23.25.773 E021.12.22.170 Color_44ACI
N051.23.36.543 E021.12.21.610 N051.23.26.063 E021.12.21.574 Color_44ACI
N051.23.36.544 E021.12.22.207 N051.23.36.564 E021.12.22.207 Color_44ACI
N051.23.36.564 E021.12.22.207 N051.23.36.557 E021.12.22.419 Color_44ACI
N051.23.36.594 E021.12.21.610 N051.23.36.543 E021.12.21.610 Color_44ACI
N051.23.34.272 E021.12.53.047 N051.23.36.713 E021.12.28.973 Color_44ACI
N051.23.14.904 E021.11.55.834 N051.23.13.212 E021.11.56.560 olive
N051.23.21.398 E021.11.54.109 N051.23.21.672 E021.11.54.861 olive
N051.23.21.119 E021.11.53.747 N051.23.21.398 E021.11.54.109 olive
N051.23.20.218 E021.11.53.563 N051.23.20.827 E021.11.53.562 olive
N051.23.21.672 E021.11.54.861 N051.23.22.069 E021.11.57.271 olive
N051.23.22.069 E021.11.57.271 N051.23.25.918 E021.12.21.871 olive
N051.23.25.918 E021.12.21.871 N051.23.31.176 E021.12.55.540 olive
N051.23.19.452 E021.12.21.859 N051.23.17.871 E021.12.21.854 olive
N051.23.17.871 E021.12.21.854 N051.23.17.439 E021.12.21.849 olive
N051.23.31.176 E021.12.55.540 N051.23.25.523 E021.12.57.957 olive
N051.23.25.523 E021.12.57.957 N051.23.24.070 E021.12.58.579 olive
N051.23.24.070 E021.12.58.579 N051.23.23.609 E021.12.58.776 olive
N051.23.28.869 E021.13.20.502 N051.23.27.900 E021.13.20.885 olive
N051.23.27.900 E021.13.20.885 N051.23.27.324 E021.13.20.905 olive
N051.23.28.869 E021.13.20.502 N051.23.32.197 E021.13.19.159 olive
N051.23.32.197 E021.13.19.159 N051.23.32.753 E021.13.18.866 olive
N051.23.32.753 E021.13.18.866 N051.23.33.091 E021.13.18.539 olive
N051.23.33.091 E021.13.18.539 N051.23.33.452 E021.13.18.042 olive
N051.23.33.452 E021.13.18.042 N051.23.33.825 E021.13.17.256 olive
N051.23.33.825 E021.13.17.256 N051.23.34.057 E021.13.16.413 olive
N051.23.34.057 E021.13.16.413 N051.23.34.185 E021.13.15.388 olive
N051.23.34.099 E021.13.14.249 N051.23.34.185 E021.13.15.388 olive
N051.23.34.800 E021.13.27.324 N051.23.34.738 E021.13.27.939 olive
N051.23.34.738 E021.13.27.939 N051.23.34.557 E021.13.28.425 olive
N051.23.34.557 E021.13.28.425 N051.23.34.133 E021.13.28.864 olive
N051.23.34.133 E021.13.28.864 N051.23.31.035 E021.13.30.194 olive
N051.23.31.035 E021.13.30.194 N051.23.29.555 E021.13.30.817 olive
N051.23.29.555 E021.13.30.817 N051.23.28.988 E021.13.30.825 olive
N051.23.34.726 E021.13.10.101 N051.23.34.797 E021.13.09.403 olive
N051.23.34.726 E021.13.10.101 N051.23.35.628 E021.13.10.336 olive
N051.23.34.650 E021.13.10.840 N051.23.34.726 E021.13.10.101 olive
N051.23.34.650 E021.13.10.840 N051.23.35.552 E021.13.11.065 olive
N051.23.34.578 E021.13.11.535 N051.23.34.650 E021.13.10.840 olive
N051.23.34.578 E021.13.11.535 N051.23.35.482 E021.13.11.753 olive
N051.23.34.506 E021.13.12.251 N051.23.34.578 E021.13.11.535 olive
N051.23.34.506 E021.13.12.251 N051.23.35.404 E021.13.12.496 olive
N051.23.34.432 E021.13.12.963 N051.23.34.506 E021.13.12.251 olive
N051.23.34.432 E021.13.12.963 N051.23.35.332 E021.13.13.198 olive
N051.23.34.360 E021.13.13.682 N051.23.34.432 E021.13.12.963 olive
N051.23.34.360 E021.13.13.682 N051.23.35.257 E021.13.13.917 olive
N051.23.34.185 E021.13.15.388 N051.23.34.286 E021.13.14.398 olive
N051.23.34.286 E021.13.14.398 N051.23.34.360 E021.13.13.682 olive
N051.23.34.286 E021.13.14.398 N051.23.35.183 E021.13.14.633 olive
N051.23.34.185 E021.13.15.388 N051.23.34.207 E021.13.15.811 olive
N051.23.34.207 E021.13.15.811 N051.23.35.045 E021.13.15.707 olive
N051.23.34.207 E021.13.15.811 N051.23.34.243 E021.13.16.524 olive
N051.23.34.243 E021.13.16.524 N051.23.35.082 E021.13.16.423 olive
N051.23.34.243 E021.13.16.524 N051.23.34.281 E021.13.17.261 olive
N051.23.34.281 E021.13.17.261 N051.23.35.119 E021.13.17.147 olive
N051.23.34.281 E021.13.17.261 N051.23.34.318 E021.13.17.968 olive
N051.23.34.318 E021.13.17.968 N051.23.35.159 E021.13.17.863 olive
N051.23.34.318 E021.13.17.968 N051.23.34.356 E021.13.18.710 olive
N051.23.34.356 E021.13.18.710 N051.23.35.196 E021.13.18.595 olive
N051.23.36.742 E021.12.22.435 N051.23.36.561 E021.12.28.483 olive
N051.23.36.561 E021.12.28.483 N051.23.36.529 E021.12.28.932 olive
N051.23.33.901 E021.12.53.839 N051.23.33.697 E021.12.54.222 olive
N051.23.33.697 E021.12.54.222 N051.23.33.259 E021.12.54.650 olive
N051.23.33.259 E021.12.54.650 N051.23.31.176 E021.12.55.540 olive
N051.23.20.218 E021.11.53.563 N051.23.20.286 E021.11.52.854 olive
N051.23.20.286 E021.11.52.854 N051.23.20.106 E021.11.51.798 olive
N051.23.20.106 E021.11.51.798 N051.23.19.549 E021.11.51.595 olive
N051.23.19.549 E021.11.51.595 N051.23.19.084 E021.11.52.532 olive
N051.23.20.218 E021.11.53.563 N051.23.19.295 E021.11.53.958 olive
N051.23.19.295 E021.11.53.958 N051.23.19.084 E021.11.52.532 olive
N051.23.19.295 E021.11.53.958 N051.23.18.450 E021.11.54.318 olive
N051.23.18.450 E021.11.54.318 N051.23.18.197 E021.11.52.875 olive
N051.23.18.197 E021.11.52.875 N051.23.17.665 E021.11.52.411 olive
N051.23.17.665 E021.11.52.411 N051.23.17.351 E021.11.53.285 olive
N051.23.18.450 E021.11.54.318 N051.23.17.590 E021.11.54.687 olive
N051.23.17.590 E021.11.54.687 N051.23.14.904 E021.11.55.834 olive
N051.23.17.590 E021.11.54.687 N051.23.17.351 E021.11.53.285 olive
N051.23.31.176 E021.12.55.540 N051.23.33.913 E021.13.13.056 olive
N051.23.33.913 E021.13.13.056 N051.23.34.099 E021.13.14.249 olive
N051.23.34.356 E021.13.18.710 N051.23.34.423 E021.13.20.005 olive
N051.23.34.423 E021.13.20.005 N051.23.34.496 E021.13.21.420 olive
N051.23.34.423 E021.13.20.005 N051.23.35.272 E021.13.19.912 olive
N051.23.34.496 E021.13.21.420 N051.23.34.571 E021.13.22.867 olive
N051.23.34.571 E021.13.22.867 N051.23.35.418 E021.13.22.751 olive
N051.23.34.571 E021.13.22.867 N051.23.34.645 E021.13.24.308 olive
N051.23.34.645 E021.13.24.308 N051.23.35.494 E021.13.24.193 olive
N051.23.34.645 E021.13.24.308 N051.23.34.721 E021.13.25.789 olive
N051.23.34.721 E021.13.25.789 N051.23.35.610 E021.13.25.641 olive
N051.23.34.721 E021.13.25.789 N051.23.34.758 E021.13.26.496 olive
N051.23.34.758 E021.13.26.496 N051.23.35.649 E021.13.26.375 olive
N051.23.34.758 E021.13.26.496 N051.23.34.800 E021.13.27.324 olive
N051.23.34.800 E021.13.27.324 N051.23.35.686 E021.13.27.089 olive
N051.23.34.738 E021.13.27.939 N051.23.35.723 E021.13.27.793 olive
N051.23.25.918 E021.12.21.871 N051.23.24.482 E021.12.21.875 olive
N051.23.24.482 E021.12.21.875 N051.23.19.452 E021.12.21.859 olive
N051.23.25.918 E021.12.21.871 N051.23.36.543 E021.12.21.908 olive
N051.23.36.742 E021.12.22.435 N051.23.36.762 E021.12.21.907 olive
N051.23.36.543 E021.12.21.908 N051.23.36.762 E021.12.21.907 olive
N051.23.20.827 E021.11.53.562 N051.23.21.119 E021.11.53.747 olive
N051.23.36.529 E021.12.28.932 N051.23.34.088 E021.12.52.999 olive
N051.23.33.901 E021.12.53.839 N051.23.34.048 E021.12.53.348 olive
N051.23.34.048 E021.12.53.348 N051.23.34.088 E021.12.52.999 olive
N051.23.37.306 E021.12.55.453 N051.23.37.083 E021.12.54.953 apron
N051.23.37.083 E021.12.54.953 N051.23.36.438 E021.12.54.781 apron
N051.23.36.438 E021.12.54.781 N051.23.36.529 E021.12.53.939 apron
N051.23.36.529 E021.12.53.939 N051.23.36.689 E021.12.54.422 apron
N051.23.36.689 E021.12.54.422 N051.23.37.136 E021.12.54.541 apron
N051.23.37.136 E021.12.54.541 N051.23.37.440 E021.12.54.188 apron
N051.23.37.440 E021.12.54.188 N051.23.37.306 E021.12.55.453 apron
N051.23.37.068 E021.12.57.553 N051.23.37.647 E021.12.52.193 apron
N051.23.37.647 E021.12.52.193 N051.23.41.010 E021.12.53.092 apron
N051.23.41.010 E021.12.53.092 N051.23.40.459 E021.12.58.410 apron
N051.23.40.459 E021.12.58.410 N051.23.37.068 E021.12.57.553 apron
N051.23.27.924 E021.13.21.170 N051.23.27.529 E021.13.22.232 apron
N051.23.27.145 E021.13.19.932 N051.23.27.877 E021.13.20.601 apron
N051.23.24.210 E021.12.58.844 N051.23.24.210 E021.12.58.841 apron
N051.23.27.209 E021.13.32.160 N051.23.24.490 E021.13.35.760 apron
N051.23.24.490 E021.13.35.760 N051.23.20.009 E021.13.37.700 apron
N051.23.20.009 E021.13.37.700 N051.23.19.524 E021.13.34.784 apron
N051.23.19.524 E021.13.34.784 N051.23.26.020 E021.13.31.987 apron
N051.23.26.020 E021.13.31.987 N051.23.26.809 E021.13.29.766 apron
N051.23.35.114 E021.13.28.420 N051.23.36.391 E021.13.28.259 apron
N051.23.36.391 E021.13.28.259 N051.23.35.754 E021.13.15.464 apron
N051.23.35.754 E021.13.15.464 N051.23.36.314 E021.13.09.997 apron
N051.23.36.314 E021.13.09.997 N051.23.34.962 E021.13.09.638 apron
N051.23.34.962 E021.13.09.638 N051.23.34.992 E021.13.09.316 apron
N051.23.34.992 E021.13.09.316 N051.23.34.610 E021.13.09.236 apron
N051.23.34.610 E021.13.09.236 N051.23.34.239 E021.13.12.903 apron
N051.23.34.239 E021.13.12.903 N051.23.34.073 E021.13.12.851 apron
N051.23.33.711 E021.13.12.989 N051.23.33.707 E021.13.12.990 apron
N051.23.33.707 E021.13.12.990 N051.23.34.021 E021.13.14.997 apron
N051.23.34.021 E021.13.14.997 N051.23.33.900 E021.13.16.178 apron
N051.23.33.900 E021.13.16.178 N051.23.33.671 E021.13.17.110 apron
N051.23.33.462 E021.13.18.054 N051.23.33.460 E021.13.18.056 apron	
N051.23.33.980 E021.13.17.402 N051.23.34.089 E021.13.17.003 apron
N051.23.34.378 E021.13.20.011 N051.23.34.378 E021.13.20.011 apron
N051.23.34.556 E021.13.21.412 N051.23.34.556 E021.13.21.412 apron
N051.23.34.812 E021.13.26.488 N051.23.34.812 E021.13.26.489 apron
N051.23.34.688 E021.13.28.629 N051.23.35.114 E021.13.28.420 apron
N051.23.12.825 E021.11.54.242 N051.23.20.910 E021.11.50.779 apron
N051.23.20.910 E021.11.50.779 N051.23.20.950 E021.11.51.027 apron
N051.23.20.950 E021.11.51.027 N051.23.20.837 E021.11.51.504 apron
N051.23.20.837 E021.11.51.504 N051.23.21.153 E021.11.53.433 apron
N051.23.20.889 E021.11.54.550 N051.23.21.491 E021.11.54.981 apron
N051.23.20.889 E021.11.54.550 N051.23.20.441 E021.11.54.339 apron
N051.23.20.441 E021.11.54.339 N051.23.19.962 E021.11.54.336 apron
N051.23.19.962 E021.11.54.336 N051.23.14.438 E021.11.56.703 apron
N051.23.14.438 E021.11.56.703 N051.23.13.610 E021.11.58.940 apron
N051.23.34.221 E021.12.53.327 N051.23.34.465 E021.12.53.842 apron
N051.23.34.465 E021.12.53.842 N051.23.35.896 E021.12.54.224 apron
N051.23.35.896 E021.12.54.224 N051.23.36.197 E021.12.53.842 apron
N051.23.36.197 E021.12.53.842 N051.23.36.083 E021.12.54.731 apron
N051.23.36.083 E021.12.54.731 N051.23.34.411 E021.12.54.278 apron
N051.23.34.411 E021.12.54.278 N051.23.34.087 E021.12.54.670 apron
N051.23.21.703 E021.11.54.328 N051.23.21.153 E021.11.53.433 apron
N051.23.34.272 E021.12.53.047 N051.23.34.221 E021.12.53.327 apron
N051.23.34.087 E021.12.54.670 N051.23.33.336 E021.12.54.939 apron
N051.23.35.276 E021.12.43.143 N051.23.35.586 E021.12.42.809 apron
N051.23.35.586 E021.12.42.809 N051.23.37.016 E021.12.43.184 apron
N051.23.37.016 E021.12.43.184 N051.23.37.239 E021.12.43.638 apron
N051.23.37.239 E021.12.43.638 N051.23.37.367 E021.12.42.376 apron
N051.23.37.367 E021.12.42.376 N051.23.37.064 E021.12.42.711 apron
N051.23.37.064 E021.12.42.711 N051.23.35.634 E021.12.42.336 apron
N051.23.35.634 E021.12.42.336 N051.23.35.407 E021.12.41.853 apron
N051.23.35.506 E021.12.40.881 N051.23.35.819 E021.12.40.533 apron
N051.23.35.819 E021.12.40.533 N051.23.37.251 E021.12.40.892 apron
N051.23.37.251 E021.12.40.892 N051.23.37.457 E021.12.41.344 apron
N051.23.37.457 E021.12.41.344 N051.23.37.578 E021.12.40.107 apron
N051.23.37.578 E021.12.40.107 N051.23.37.301 E021.12.40.411 apron
N051.23.37.301 E021.12.40.411 N051.23.35.871 E021.12.40.055 apron
N051.23.35.871 E021.12.40.055 N051.23.35.640 E021.12.39.552 apron
N051.23.35.744 E021.12.38.530 N051.23.36.050 E021.12.38.214 apron
N051.23.36.050 E021.12.38.214 N051.23.37.487 E021.12.38.544 apron
N051.23.37.487 E021.12.38.544 N051.23.37.694 E021.12.38.995 apron
N051.23.37.694 E021.12.38.995 N051.23.37.811 E021.12.37.805 apron
N051.23.37.811 E021.12.37.805 N051.23.37.535 E021.12.38.137 apron
N051.23.37.535 E021.12.38.137 N051.23.36.099 E021.12.37.762 apron
N051.23.36.099 E021.12.37.762 N051.23.35.872 E021.12.37.272 apron
N051.23.35.972 E021.12.36.283 N051.23.36.285 E021.12.35.939 apron
N051.23.36.285 E021.12.35.939 N051.23.37.717 E021.12.36.297 apron
N051.23.37.717 E021.12.36.297 N051.23.37.922 E021.12.36.748 apron
N051.23.37.922 E021.12.36.748 N051.23.38.042 E021.12.35.512 apron
N051.23.38.042 E021.12.35.512 N051.23.37.767 E021.12.35.816 apron
N051.23.37.767 E021.12.35.816 N051.23.36.336 E021.12.35.459 apron
N051.23.36.336 E021.12.35.459 N051.23.36.106 E021.12.34.960 apron
N051.23.36.205 E021.12.33.986 N051.23.36.519 E021.12.33.639 apron
N051.23.36.519 E021.12.33.639 N051.23.37.951 E021.12.33.998 apron
N051.23.37.951 E021.12.33.998 N051.23.38.157 E021.12.34.448 apron
N051.23.38.157 E021.12.34.448 N051.23.38.495 E021.12.30.990 apron
N051.23.37.829 E021.12.33.478 N051.23.36.559 E021.12.33.156 apron
N051.23.36.559 E021.12.33.156 N051.23.36.340 E021.12.32.656 apron
N051.23.36.438 E021.12.31.688 N051.23.36.751 E021.12.31.342 apron
N051.23.36.751 E021.12.31.342 N051.23.38.010 E021.12.31.656 apron
N051.23.38.010 E021.12.31.656 N051.23.37.822 E021.12.33.481 apron
N051.23.38.495 E021.12.30.990 N051.23.38.230 E021.12.31.236 apron
N051.23.38.230 E021.12.31.236 N051.23.36.798 E021.12.30.876 apron
N051.23.36.798 E021.12.30.876 N051.23.36.572 E021.12.30.364 apron
N051.23.36.671 E021.12.29.388 N051.23.36.983 E021.12.29.044 apron
N051.23.36.983 E021.12.29.044 N051.23.38.414 E021.12.29.403 apron
N051.23.38.414 E021.12.29.403 N051.23.38.621 E021.12.29.855 apron
N051.23.38.621 E021.12.29.855 N051.23.38.741 E021.12.28.618 apron
N051.23.38.741 E021.12.28.618 N051.23.38.459 E021.12.28.965 apron
N051.23.38.459 E021.12.28.965 N051.23.37.019 E021.12.28.595 apron
N051.23.37.019 E021.12.28.595 N051.23.36.759 E021.12.28.105 apron
N051.23.36.709 E021.12.28.494 N051.23.36.709 E021.12.28.510 apron
N051.23.36.687 E021.12.28.961 N051.23.36.687 E021.12.28.973 apron
N051.23.37.685 E021.12.42.661 N051.23.38.000 E021.12.42.324 apron
N051.23.38.000 E021.12.42.324 N051.23.38.662 E021.12.42.489 apron
N051.23.38.662 E021.12.42.489 N051.23.38.508 E021.12.44.091 apron
N051.23.38.508 E021.12.44.091 N051.23.40.665 E021.12.44.619 apron
N051.23.40.665 E021.12.44.619 N051.23.41.024 E021.12.40.902 apron
N051.23.41.024 E021.12.40.902 N051.23.38.895 E021.12.40.343 apron
N051.23.38.895 E021.12.40.343 N051.23.38.733 E021.12.41.938 apron
N051.23.38.733 E021.12.41.938 N051.23.38.045 E021.12.41.748 apron
N051.23.38.045 E021.12.41.748 N051.23.37.826 E021.12.41.248 apron
N051.23.37.826 E021.12.41.248 N051.23.37.685 E021.12.42.661 apron
N051.23.39.131 E021.12.28.108 N051.23.40.098 E021.12.28.367 apron
N051.23.40.098 E021.12.28.367 N051.23.39.956 E021.12.29.781 apron
N051.23.39.956 E021.12.29.781 N051.23.40.991 E021.12.30.052 apron
N051.23.40.991 E021.12.30.052 N051.23.41.375 E021.12.26.358 apron
N051.23.41.375 E021.12.26.358 N051.23.40.353 E021.12.26.094 apron
N051.23.40.353 E021.12.26.094 N051.23.40.207 E021.12.27.498 apron
N051.23.40.207 E021.12.27.498 N051.23.38.946 E021.12.27.158 apron
N051.23.38.946 E021.12.27.158 N051.23.39.131 E021.12.28.108 apron
N051.23.14.065 E021.12.01.653 N051.23.12.220 E021.12.02.444 offset_threshold

[GEO]
LOTNISKA_EPKK_LITE N000.00.00.000 E000.00.00.000 N000.00.00.000 E000.00.00.000
N050.04.25.896 E019.47.24.660 N050.04.26.024 E019.47.24.880 Color_251ACI
N050.04.26.024 E019.47.24.880 N050.04.27.312 E019.47.24.370 Color_251ACI
N050.04.27.312 E019.47.24.370 N050.04.27.650 E019.47.24.240 Color_251ACI
N050.04.27.650 E019.47.24.240 N050.04.28.572 E019.47.23.604 Color_251ACI
N050.04.28.617 E019.47.23.298 N050.04.28.634 E019.47.23.356 Color_251ACI
N050.04.28.634 E019.47.23.356 N050.04.28.623 E019.47.23.397 Color_251ACI
N050.04.28.623 E019.47.23.397 N050.04.28.613 E019.47.23.439 Color_251ACI
N050.04.28.613 E019.47.23.439 N050.04.28.592 E019.47.23.522 Color_251ACI
N050.04.28.592 E019.47.23.522 N050.04.28.582 E019.47.23.563 Color_251ACI
N050.04.28.582 E019.47.23.563 N050.04.28.582 E019.47.23.563 Color_251ACI
N050.04.30.810 E019.46.09.141 N050.04.30.808 E019.46.08.902 Color_251ACI
N050.04.30.808 E019.46.08.902 N050.04.30.786 E019.46.08.746 Color_251ACI
N050.04.47.292 E019.48.07.162 N050.04.47.279 E019.48.06.964 Color_251ACI
N050.04.37.173 E019.46.54.592 N050.04.37.093 E019.46.53.925 Color_251ACI
N050.04.21.879 E019.46.07.812 N050.04.23.798 E019.46.21.396 Color_251ACI
N050.04.32.855 E019.47.44.660 N050.04.35.316 E019.47.43.856 Color_251ACI
N050.04.34.315 E019.47.27.681 N050.04.33.856 E019.47.24.357 Color_251ACI
N050.04.34.628 E019.47.29.870 N050.04.34.936 E019.47.29.246 Color_251ACI
N050.04.34.936 E019.47.29.246 N050.04.35.546 E019.47.28.756 Color_251ACI
N050.04.35.546 E019.47.28.756 N050.04.40.060 E019.47.27.188 Color_251ACI
N050.04.40.060 E019.47.27.188 N050.04.40.844 E019.47.27.232 Color_251ACI
N050.04.40.844 E019.47.27.232 N050.04.41.666 E019.47.28.107 Color_251ACI
N050.04.41.666 E019.47.28.107 N050.04.42.035 E019.47.29.330 Color_251ACI
N050.04.29.479 E019.46.52.959 N050.04.31.147 E019.47.04.964 Color_251ACI
N050.04.31.360 E019.47.31.093 N050.04.31.401 E019.47.31.546 Color_251ACI
N050.04.31.401 E019.47.31.546 N050.04.31.777 E019.47.31.630 Color_251ACI
N050.04.31.777 E019.47.31.630 N050.04.32.318 E019.47.31.051 Color_251ACI
N050.04.32.318 E019.47.31.051 N050.04.32.455 E019.47.30.990 Color_251ACI
N050.04.32.455 E019.47.30.990 N050.04.32.443 E019.47.30.793 Color_251ACI
N050.04.32.443 E019.47.30.793 N050.04.32.670 E019.47.30.739 Color_251ACI
N050.04.32.670 E019.47.30.739 N050.04.32.693 E019.47.30.895 Color_251ACI
N050.04.32.693 E019.47.30.895 N050.04.32.793 E019.47.30.860 Color_251ACI
N050.04.32.793 E019.47.30.860 N050.04.33.520 E019.47.31.012 Color_251ACI
N050.04.32.017 E019.47.57.775 N050.04.29.994 E019.47.58.414 Color_251ACI
N050.04.36.441 E019.47.42.771 N050.04.34.628 E019.47.29.870 Color_251ACI
N050.04.30.741 E019.46.51.814 N050.04.29.944 E019.46.52.192 Color_251ACI
N050.04.29.944 E019.46.52.192 N050.04.29.479 E019.46.52.959 Color_251ACI
N050.04.30.741 E019.46.51.814 N050.04.32.711 E019.46.52.001 Color_251ACI
N050.04.32.711 E019.46.52.001 N050.04.34.639 E019.46.52.114 Color_251ACI
N050.04.34.639 E019.46.52.114 N050.04.35.439 E019.46.52.215 Color_251ACI
N050.04.35.439 E019.46.52.215 N050.04.35.869 E019.46.52.331 Color_251ACI
N050.04.35.869 E019.46.52.331 N050.04.36.299 E019.46.52.447 Color_251ACI
N050.04.36.299 E019.46.52.447 N050.04.36.577 E019.46.52.804 Color_251ACI
N050.04.36.577 E019.46.52.804 N050.04.36.775 E019.46.53.114 Color_251ACI
N050.04.36.775 E019.46.53.114 N050.04.37.093 E019.46.53.925 Color_251ACI
N050.04.47.279 E019.48.06.964 N050.04.46.848 E019.48.08.705 Color_251ACI
N050.04.46.848 E019.48.08.705 N050.04.45.987 E019.48.09.710 Color_251ACI
N050.04.45.987 E019.48.09.710 N050.04.41.520 E019.48.11.211 Color_251ACI
N050.04.41.520 E019.48.11.211 N050.04.40.804 E019.48.11.018 Color_251ACI
N050.04.40.804 E019.48.11.018 N050.04.40.671 E019.48.10.938 Color_251ACI
N050.04.40.671 E019.48.10.938 N050.04.40.240 E019.48.09.964 Color_251ACI
N050.04.40.240 E019.48.09.964 N050.04.38.601 E019.47.58.215 Color_251ACI
N050.04.38.601 E019.47.58.215 N050.04.37.560 E019.47.50.826 Color_251ACI
N050.04.37.560 E019.47.50.826 N050.04.36.453 E019.47.42.969 Color_251ACI
N050.04.30.810 E019.46.09.141 N050.04.29.972 E019.46.07.589 Color_251ACI
N050.04.29.972 E019.46.07.589 N050.04.28.880 E019.46.07.312 Color_251ACI
N050.04.28.880 E019.46.07.312 N050.04.24.265 E019.46.08.915 Color_251ACI
N050.04.24.265 E019.46.08.915 N050.04.23.720 E019.46.09.634 Color_251ACI
N050.04.23.720 E019.46.09.634 N050.04.23.591 E019.46.10.890 Color_251ACI
N050.04.23.591 E019.46.10.890 N050.04.24.537 E019.46.17.555 Color_251ACI
N050.04.24.537 E019.46.17.555 N050.04.28.732 E019.46.17.890 Color_251ACI
N050.04.28.732 E019.46.17.890 N050.04.28.698 E019.46.19.013 Color_251ACI
N050.04.28.698 E019.46.19.013 N050.04.29.154 E019.46.19.763 Color_251ACI
N050.04.29.154 E019.46.19.763 N050.04.31.135 E019.46.19.908 Color_251ACI
N050.04.31.135 E019.46.19.908 N050.04.31.856 E019.46.19.342 Color_251ACI
N050.04.31.856 E019.46.19.342 N050.04.32.080 E019.46.18.192 Color_251ACI
N050.04.32.827 E019.47.57.834 N050.04.32.748 E019.47.57.786 Color_251ACI
N050.04.32.748 E019.47.57.786 N050.04.32.557 E019.47.57.814 Color_251ACI
N050.04.32.557 E019.47.57.814 N050.04.32.017 E019.47.57.775 Color_251ACI
N050.04.36.553 E019.47.52.791 N050.04.36.336 E019.47.51.327 Color_251ACI
N050.04.36.336 E019.47.51.327 N050.04.36.161 E019.47.49.936 Color_251ACI
N050.04.36.161 E019.47.49.936 N050.04.36.035 E019.47.49.336 Color_251ACI
N050.04.36.035 E019.47.49.336 N050.04.36.019 E019.47.49.279 Color_251ACI
N050.04.36.019 E019.47.49.279 N050.04.35.976 E019.47.49.205 Color_251ACI
N050.04.35.976 E019.47.49.205 N050.04.35.939 E019.47.49.231 Color_251ACI
N050.04.35.939 E019.47.49.231 N050.04.35.929 E019.47.49.272 Color_251ACI
N050.04.26.766 E019.47.08.088 N050.04.26.407 E019.47.08.301 Color_251ACI
N050.04.26.407 E019.47.08.301 N050.04.26.360 E019.47.08.368 Color_251ACI
N050.04.26.360 E019.47.08.368 N050.04.26.323 E019.47.08.393 Color_251ACI
N050.04.26.323 E019.47.08.393 N050.04.26.276 E019.47.08.460 Color_251ACI
N050.04.26.276 E019.47.08.460 N050.04.26.256 E019.47.08.543 Color_251ACI
N050.04.26.256 E019.47.08.543 N050.04.26.245 E019.47.08.584 Color_251ACI
N050.04.26.245 E019.47.08.584 N050.04.26.225 E019.47.08.667 Color_251ACI
N050.04.26.225 E019.47.08.667 N050.04.26.204 E019.47.08.750 Color_251ACI
N050.04.26.204 E019.47.08.750 N050.04.26.210 E019.47.08.849 Color_251ACI
N050.04.26.210 E019.47.08.849 N050.04.26.245 E019.47.09.203 Color_251ACI
N050.04.26.054 E019.47.09.231 N050.04.25.973 E019.47.08.944 Color_251ACI
N050.04.27.909 E019.47.07.300 N050.04.30.116 E019.47.06.534 Color_251ACI
N050.04.31.320 E019.47.06.116 N050.04.38.142 E019.47.03.747 Color_251ACI
N050.04.38.356 E019.47.04.114 N050.04.31.344 E019.47.06.511 Color_251ACI
N050.04.30.140 E019.47.06.929 N050.04.28.033 E019.47.07.661 Color_251ACI
N050.04.38.142 E019.47.03.747 N050.04.38.178 E019.47.03.721 Color_251ACI
N050.04.38.178 E019.47.03.721 N050.04.38.252 E019.47.03.671 Color_251ACI
N050.04.38.252 E019.47.03.671 N050.04.38.289 E019.47.03.645 Color_251ACI
N050.04.38.289 E019.47.03.645 N050.04.38.310 E019.47.03.562 Color_251ACI
N050.04.38.310 E019.47.03.562 N050.04.38.371 E019.47.03.314 Color_251ACI
N050.04.38.371 E019.47.03.314 N050.04.38.392 E019.47.03.231 Color_251ACI
N050.04.26.705 E019.47.07.718 N050.04.26.154 E019.47.07.720 Color_251ACI
N050.04.26.705 E019.47.07.718 N050.04.27.116 E019.47.07.537 Color_251ACI
N050.04.26.766 E019.47.08.088 N050.04.26.940 E019.47.08.003 Color_251ACI
N050.04.38.356 E019.47.04.114 N050.04.38.393 E019.47.04.089 Color_251ACI
N050.04.38.393 E019.47.04.089 N050.04.38.446 E019.47.04.121 Color_251ACI
N050.04.38.446 E019.47.04.121 N050.04.38.456 E019.47.04.079 Color_251ACI
N050.04.38.456 E019.47.04.079 N050.04.38.483 E019.47.04.095 Color_251ACI
N050.04.38.483 E019.47.04.095 N050.04.38.499 E019.47.04.153 Color_251ACI
N050.04.38.499 E019.47.04.153 N050.04.38.499 E019.47.04.153 Color_251ACI
N050.04.38.499 E019.47.04.153 N050.04.38.516 E019.47.04.210 Color_251ACI
N050.04.31.175 E019.47.05.219 N050.04.31.320 E019.47.06.116 Color_251ACI
N050.04.31.344 E019.47.06.511 N050.04.33.856 E019.47.24.357 Color_251ACI
N050.04.28.084 E019.46.51.929 N050.04.30.116 E019.47.06.534 Color_251ACI
N050.04.30.140 E019.47.06.929 N050.04.32.501 E019.47.23.780 Color_251ACI
N050.04.32.690 E019.46.22.511 N050.04.32.408 E019.46.21.675 Color_251ACI
N050.04.32.408 E019.46.21.675 N050.04.31.783 E019.46.20.870 Color_251ACI
N050.04.31.783 E019.46.20.870 N050.04.31.267 E019.46.20.607 Color_251ACI
N050.04.31.267 E019.46.20.607 N050.04.28.566 E019.46.20.409 Color_251ACI
N050.04.28.566 E019.46.20.409 N050.04.25.864 E019.46.20.211 Color_251ACI
N050.04.25.864 E019.46.20.211 N050.04.25.117 E019.46.20.761 Color_251ACI
N050.04.25.117 E019.46.20.761 N050.04.25.018 E019.46.21.035 Color_251ACI
N050.04.25.018 E019.46.21.035 N050.04.29.170 E019.46.50.631 Color_251ACI
N050.04.36.553 E019.47.52.791 N050.04.36.316 E019.47.52.887 Color_251ACI
N050.04.36.316 E019.47.52.887 N050.04.36.087 E019.47.52.701 Color_251ACI
N050.04.36.087 E019.47.52.701 N050.04.36.171 E019.47.52.609 Color_251ACI
N050.04.36.171 E019.47.52.609 N050.04.36.142 E019.47.52.354 Color_251ACI
N050.04.36.142 E019.47.52.354 N050.04.35.999 E019.47.52.315 Color_251ACI
N050.04.35.999 E019.47.52.315 N050.04.35.832 E019.47.51.262 Color_251ACI
N050.04.35.832 E019.47.51.262 N050.04.35.953 E019.47.51.144 Color_251ACI
N050.04.35.953 E019.47.51.144 N050.04.35.915 E019.47.50.931 Color_251ACI
N050.04.35.915 E019.47.50.931 N050.04.35.808 E019.47.50.867 Color_251ACI
N050.04.35.808 E019.47.50.867 N050.04.36.028 E019.47.50.475 Color_251ACI
N050.04.36.028 E019.47.50.475 N050.04.35.971 E019.47.49.964 Color_251ACI
N050.04.35.971 E019.47.49.964 N050.04.35.891 E019.47.49.916 Color_251ACI
N050.04.35.891 E019.47.49.916 N050.04.35.709 E019.47.50.283 Color_251ACI
N050.04.35.709 E019.47.50.283 N050.04.35.122 E019.47.51.787 Color_251ACI
N050.04.35.122 E019.47.51.787 N050.04.35.347 E019.47.53.589 Color_251ACI
N050.04.35.347 E019.47.53.589 N050.04.35.504 E019.47.54.683 Color_251ACI
N050.04.35.504 E019.47.54.683 N050.04.35.650 E019.47.55.819 Color_251ACI
N050.04.35.650 E019.47.55.819 N050.04.35.873 E019.47.57.382 Color_251ACI
N050.04.35.873 E019.47.57.382 N050.04.36.137 E019.47.57.303 Color_251ACI
N050.04.36.137 E019.47.57.303 N050.04.36.359 E019.47.57.150 Color_251ACI
N050.04.36.359 E019.47.57.150 N050.04.36.693 E019.47.56.542 Color_251ACI
N050.04.36.693 E019.47.56.542 N050.04.36.698 E019.47.55.783 Color_251ACI
N050.04.36.698 E019.47.55.783 N050.04.36.485 E019.47.55.655 Color_251ACI
N050.04.36.485 E019.47.55.655 N050.04.36.579 E019.47.55.521 Color_251ACI
N050.04.36.579 E019.47.55.521 N050.04.36.541 E019.47.55.308 Color_251ACI
N050.04.36.541 E019.47.55.308 N050.04.36.397 E019.47.55.269 Color_251ACI
N050.04.36.397 E019.47.55.269 N050.04.36.267 E019.47.54.191 Color_251ACI
N050.04.36.267 E019.47.54.191 N050.04.36.388 E019.47.54.073 Color_251ACI
N050.04.36.388 E019.47.54.073 N050.04.36.360 E019.47.53.818 Color_251ACI
N050.04.36.360 E019.47.53.818 N050.04.36.243 E019.47.53.795 Color_251ACI
N050.04.36.243 E019.47.53.795 N050.04.36.426 E019.47.53.429 Color_251ACI
N050.04.36.426 E019.47.53.429 N050.04.36.626 E019.47.53.359 Color_251ACI
N050.04.21.366 E019.47.59.314 N050.04.22.724 E019.47.58.894 Color_251ACI
N050.04.21.879 E019.46.07.812 N050.04.28.237 E019.46.05.592 Color_251ACI
N050.04.28.237 E019.46.05.592 N050.04.28.675 E019.46.05.427 Color_251ACI
N050.04.25.147 E019.47.05.495 N050.04.25.757 E019.47.07.719 Color_251ACI
N050.04.34.666 E019.46.51.511 N050.04.35.168 E019.46.51.337 Color_251ACI
N050.04.35.168 E019.46.51.337 N050.04.35.643 E019.46.51.147 Color_251ACI
N050.04.35.643 E019.46.51.147 N050.04.36.264 E019.46.49.997 Color_251ACI
N050.04.36.264 E019.46.49.997 N050.04.36.338 E019.46.48.470 Color_251ACI
N050.04.34.666 E019.46.51.511 N050.04.29.984 E019.46.51.168 Color_251ACI
N050.04.23.347 E019.46.59.077 N050.04.24.811 E019.47.04.387 Color_251ACI
N050.04.24.811 E019.47.04.387 N050.04.24.925 E019.47.04.789 Color_251ACI
N050.04.28.084 E019.46.51.929 N050.04.27.589 E019.46.51.583 Color_251ACI
N050.04.27.589 E019.46.51.583 N050.04.24.734 E019.46.51.388 Color_251ACI
N050.04.24.734 E019.46.51.388 N050.04.24.162 E019.46.52.092 Color_251ACI
N050.04.24.162 E019.46.52.092 N050.04.23.952 E019.46.53.061 Color_251ACI
N050.04.23.952 E019.46.53.061 N050.04.27.909 E019.47.07.300 Color_251ACI
N050.04.31.175 E019.47.05.219 N050.04.33.229 E019.47.04.456 Color_251ACI
N050.04.33.229 E019.47.04.456 N050.04.33.309 E019.47.04.504 Color_251ACI
N050.04.33.309 E019.47.04.504 N050.04.33.388 E019.47.04.552 Color_251ACI
N050.04.33.388 E019.47.04.552 N050.04.33.513 E019.47.04.912 Color_251ACI
N050.04.33.513 E019.47.04.912 N050.04.33.761 E019.47.04.776 Color_251ACI
N050.04.33.761 E019.47.04.776 N050.04.33.653 E019.47.04.473 Color_251ACI
N050.04.33.653 E019.47.04.473 N050.04.34.074 E019.47.04.250 Color_251ACI
N050.04.34.074 E019.47.04.250 N050.04.33.864 E019.47.03.743 Color_251ACI
N050.04.33.864 E019.47.03.743 N050.04.33.553 E019.47.03.889 Color_251ACI
N050.04.33.553 E019.47.03.889 N050.04.33.120 E019.47.02.676 Color_251ACI
N050.04.33.120 E019.47.02.676 N050.04.32.979 E019.47.02.876 Color_251ACI
N050.04.32.979 E019.47.02.876 N050.04.33.277 E019.47.03.770 Color_251ACI
N050.04.33.277 E019.47.03.770 N050.04.33.283 E019.47.03.869 Color_251ACI
N050.04.33.283 E019.47.03.869 N050.04.33.268 E019.47.04.051 Color_251ACI
N050.04.33.268 E019.47.04.051 N050.04.33.237 E019.47.04.175 Color_251ACI
N050.04.33.237 E019.47.04.175 N050.04.33.164 E019.47.04.226 Color_251ACI
N050.04.33.164 E019.47.04.226 N050.04.31.147 E019.47.04.964 Color_251ACI
N050.04.27.116 E019.47.07.537 N050.04.27.153 E019.47.07.512 Color_251ACI
N050.04.27.153 E019.47.07.512 N050.04.27.200 E019.47.07.445 Color_251ACI
N050.04.27.200 E019.47.07.445 N050.04.27.258 E019.47.07.337 Color_251ACI
N050.04.27.258 E019.47.07.337 N050.04.27.299 E019.47.07.171 Color_251ACI
N050.04.27.299 E019.47.07.171 N050.04.27.293 E019.47.07.072 Color_251ACI
N050.04.27.293 E019.47.07.072 N050.04.27.297 E019.47.06.932 Color_251ACI
N050.04.27.297 E019.47.06.932 N050.04.27.281 E019.47.06.874 Color_251ACI
N050.04.26.940 E019.47.08.003 N050.04.27.358 E019.47.07.921 Color_251ACI
N050.04.27.358 E019.47.07.921 N050.04.27.490 E019.47.08.001 Color_251ACI
N050.04.27.490 E019.47.08.001 N050.04.27.544 E019.47.08.033 Color_251ACI
N050.04.27.544 E019.47.08.033 N050.04.27.570 E019.47.08.049 Color_251ACI
N050.04.27.570 E019.47.08.049 N050.04.27.613 E019.47.08.122 Color_251ACI
N050.04.27.613 E019.47.08.122 N050.04.27.629 E019.47.08.180 Color_251ACI
N050.04.27.629 E019.47.08.180 N050.04.27.672 E019.47.08.253 Color_251ACI
N050.04.27.727 E019.47.09.143 N050.04.27.248 E019.47.09.473 Color_251ACI
N050.04.27.248 E019.47.09.473 N050.04.27.323 E019.47.09.662 Color_251ACI
N050.04.27.323 E019.47.09.662 N050.04.26.965 E019.47.09.875 Color_251ACI
N050.04.26.965 E019.47.09.875 N050.04.26.808 E019.47.09.399 Color_251ACI
N050.04.26.808 E019.47.09.399 N050.04.27.645 E019.47.08.856 Color_251ACI
N050.04.27.645 E019.47.08.856 N050.04.27.748 E019.47.08.441 Color_251ACI
N050.04.27.748 E019.47.08.441 N050.04.27.672 E019.47.08.253 Color_251ACI
N050.04.28.619 E019.47.11.585 N050.04.28.512 E019.47.11.521 Color_251ACI
N050.04.28.512 E019.47.11.521 N050.04.27.959 E019.47.11.902 Color_251ACI
N050.04.27.959 E019.47.11.902 N050.04.27.868 E019.47.11.656 Color_251ACI
N050.04.27.868 E019.47.11.656 N050.04.28.447 E019.47.11.291 Color_251ACI
N050.04.28.447 E019.47.11.291 N050.04.28.488 E019.47.11.125 Color_251ACI
N050.04.28.545 E019.47.09.540 N050.04.28.625 E019.47.09.588 Color_251ACI
N050.04.28.625 E019.47.09.588 N050.04.29.204 E019.47.09.223 Color_251ACI
N050.04.29.204 E019.47.09.223 N050.04.29.286 E019.47.09.510 Color_251ACI
N050.04.29.286 E019.47.09.510 N050.04.28.680 E019.47.09.860 Color_251ACI
N050.04.28.680 E019.47.09.860 N050.04.28.676 E019.47.10.000 Color_251ACI
N050.04.28.741 E019.47.10.230 N050.04.28.980 E019.47.10.374 Color_251ACI
N050.04.28.980 E019.47.10.374 N050.04.29.459 E019.47.10.043 Color_251ACI
N050.04.29.459 E019.47.10.043 N050.04.29.568 E019.47.10.347 Color_251ACI
N050.04.29.568 E019.47.10.347 N050.04.29.078 E019.47.10.718 Color_251ACI
N050.04.29.078 E019.47.10.718 N050.04.28.975 E019.47.11.133 Color_251ACI
N050.04.29.041 E019.47.11.363 N050.04.29.120 E019.47.11.411 Color_251ACI
N050.04.29.120 E019.47.11.411 N050.04.29.737 E019.47.11.020 Color_251ACI
N050.04.29.737 E019.47.11.020 N050.04.29.792 E019.47.11.291 Color_251ACI
N050.04.29.792 E019.47.11.291 N050.04.29.212 E019.47.11.656 Color_251ACI
N050.04.29.212 E019.47.11.656 N050.04.29.181 E019.47.11.781 Color_251ACI
N050.04.28.033 E019.47.07.661 N050.04.28.545 E019.47.09.540 Color_251ACI
N050.04.28.676 E019.47.10.000 N050.04.28.741 E019.47.10.230 Color_251ACI
N050.04.28.975 E019.47.11.133 N050.04.29.041 E019.47.11.363 Color_251ACI
N050.04.29.279 E019.47.12.125 N050.04.29.359 E019.47.12.173 Color_251ACI
N050.04.29.359 E019.47.12.173 N050.04.29.939 E019.47.11.808 Color_251ACI
N050.04.29.939 E019.47.11.808 N050.04.30.020 E019.47.12.095 Color_251ACI
N050.04.30.020 E019.47.12.095 N050.04.29.414 E019.47.12.445 Color_251ACI
N050.04.29.414 E019.47.12.445 N050.04.29.383 E019.47.12.569 Color_251ACI
N050.04.29.481 E019.47.12.914 N050.04.29.561 E019.47.12.962 Color_251ACI
N050.04.29.561 E019.47.12.962 N050.04.30.177 E019.47.12.571 Color_251ACI
N050.04.30.177 E019.47.12.571 N050.04.30.232 E019.47.12.842 Color_251ACI
N050.04.30.232 E019.47.12.842 N050.04.29.653 E019.47.13.207 Color_251ACI
N050.04.29.653 E019.47.13.207 N050.04.29.601 E019.47.13.415 Color_251ACI
N050.04.29.181 E019.47.11.781 N050.04.29.279 E019.47.12.125 Color_251ACI
N050.04.29.383 E019.47.12.569 N050.04.29.481 E019.47.12.914 Color_251ACI
N050.04.29.824 E019.47.14.120 N050.04.31.037 E019.47.18.470 Color_251ACI
N050.04.31.037 E019.47.18.470 N050.04.32.501 E019.47.23.780 Color_251ACI
N050.04.28.886 E019.47.12.603 N050.04.28.793 E019.47.12.976 Color_251ACI
N050.04.28.793 E019.47.12.976 N050.04.27.972 E019.47.13.576 Color_251ACI
N050.04.27.972 E019.47.13.576 N050.04.28.054 E019.47.13.864 Color_251ACI
N050.04.28.054 E019.47.13.864 N050.04.28.891 E019.47.13.320 Color_251ACI
N050.04.28.891 E019.47.13.320 N050.04.29.098 E019.47.13.350 Color_251ACI
N050.04.29.098 E019.47.13.350 N050.04.28.852 E019.47.13.725 Color_251ACI
N050.04.28.852 E019.47.13.725 N050.04.27.683 E019.47.14.497 Color_251ACI
N050.04.27.683 E019.47.14.497 N050.04.27.322 E019.47.14.471 Color_251ACI
N050.04.27.322 E019.47.14.471 N050.04.27.153 E019.47.13.798 Color_251ACI
N050.04.27.153 E019.47.13.798 N050.04.27.356 E019.47.13.348 Color_251ACI
N050.04.27.356 E019.47.13.348 N050.04.28.536 E019.47.12.535 Color_251ACI
N050.04.28.536 E019.47.12.535 N050.04.28.886 E019.47.12.603 Color_251ACI
N050.04.29.424 E019.47.14.498 N050.04.29.283 E019.47.14.699 Color_251ACI
N050.04.29.283 E019.47.14.699 N050.04.28.814 E019.47.14.988 Color_251ACI
N050.04.28.814 E019.47.14.988 N050.04.28.836 E019.47.15.144 Color_251ACI
N050.04.28.836 E019.47.15.144 N050.04.28.869 E019.47.15.259 Color_251ACI
N050.04.28.869 E019.47.15.259 N050.04.29.364 E019.47.14.986 Color_251ACI
N050.04.29.364 E019.47.14.986 N050.04.29.528 E019.47.14.942 Color_251ACI
N050.04.29.693 E019.47.13.660 N050.04.29.789 E019.47.13.766 Color_251ACI
N050.04.29.789 E019.47.13.766 N050.04.30.379 E019.47.13.359 Color_251ACI
N050.04.30.379 E019.47.13.359 N050.04.30.461 E019.47.13.646 Color_251ACI
N050.04.30.461 E019.47.13.646 N050.04.29.855 E019.47.13.996 Color_251ACI
N050.04.29.855 E019.47.13.996 N050.04.29.824 E019.47.14.120 Color_251ACI
N050.04.29.601 E019.47.13.415 N050.04.29.693 E019.47.13.660 Color_251ACI
N050.04.30.491 E019.47.18.331 N050.04.30.278 E019.47.18.822 Color_251ACI
N050.04.30.278 E019.47.18.822 N050.04.29.946 E019.47.19.051 Color_251ACI
N050.04.29.946 E019.47.19.051 N050.04.29.931 E019.47.19.232 Color_251ACI
N050.04.30.475 E019.47.18.274 N050.04.30.491 E019.47.18.331 Color_251ACI
N050.04.29.931 E019.47.19.232 N050.04.29.120 E019.47.19.792 Color_251ACI
N050.04.29.120 E019.47.19.792 N050.04.28.791 E019.47.19.641 Color_251ACI
N050.04.28.791 E019.47.19.641 N050.04.28.628 E019.47.19.066 Color_251ACI
N050.04.28.628 E019.47.19.066 N050.04.28.841 E019.47.18.576 Color_251ACI
N050.04.28.841 E019.47.18.576 N050.04.30.010 E019.47.17.804 Color_251ACI
N050.04.30.010 E019.47.17.804 N050.04.30.360 E019.47.17.872 Color_251ACI
N050.04.29.238 E019.47.22.767 N050.04.29.119 E019.47.23.124 Color_251ACI
N050.04.29.119 E019.47.23.124 N050.04.28.877 E019.47.23.360 Color_251ACI
N050.04.28.877 E019.47.23.360 N050.04.28.814 E019.47.23.369 Color_251ACI
N050.04.28.814 E019.47.23.369 N050.04.28.787 E019.47.23.353 Color_251ACI
N050.04.28.787 E019.47.23.353 N050.04.28.754 E019.47.23.238 Color_251ACI
N050.04.28.754 E019.47.23.238 N050.04.28.683 E019.47.22.909 Color_251ACI
N050.04.28.683 E019.47.22.909 N050.04.28.376 E019.47.21.439 Color_251ACI
N050.04.28.376 E019.47.21.439 N050.04.28.380 E019.47.21.298 Color_251ACI
N050.04.28.380 E019.47.21.298 N050.04.28.437 E019.47.21.190 Color_251ACI
N050.04.28.437 E019.47.21.190 N050.04.28.658 E019.47.21.037 Color_251ACI
N050.04.28.658 E019.47.21.037 N050.04.28.748 E019.47.21.044 Color_251ACI
N050.04.28.049 E019.47.20.908 N050.04.28.212 E019.47.20.864 Color_251ACI
N050.04.28.212 E019.47.20.864 N050.04.28.308 E019.47.20.970 Color_251ACI
N050.04.28.308 E019.47.20.970 N050.04.28.388 E019.47.21.018 Color_251ACI
N050.04.28.388 E019.47.21.018 N050.04.28.452 E019.47.21.008 Color_251ACI
N050.04.28.452 E019.47.21.008 N050.04.28.626 E019.47.20.923 Color_251ACI
N050.04.28.626 E019.47.20.923 N050.04.28.683 E019.47.20.814 Color_251ACI
N050.04.26.054 E019.47.09.231 N050.04.26.067 E019.47.09.429 Color_251ACI
N050.04.26.067 E019.47.09.429 N050.04.26.175 E019.47.11.209 Color_251ACI
N050.04.26.175 E019.47.11.209 N050.04.26.087 E019.47.11.441 Color_251ACI
N050.04.26.087 E019.47.11.441 N050.04.26.915 E019.47.14.511 Color_251ACI
N050.04.26.915 E019.47.14.511 N050.04.28.683 E019.47.20.814 Color_251ACI
N050.04.28.748 E019.47.21.044 N050.04.29.238 E019.47.22.767 Color_251ACI
N050.04.27.514 E019.47.25.158 N050.04.27.476 E019.47.24.944 Color_251ACI
N050.04.27.476 E019.47.24.944 N050.04.27.584 E019.47.24.629 Color_251ACI
N050.04.27.584 E019.47.24.629 N050.04.28.000 E019.47.24.308 Color_251ACI
N050.04.28.000 E019.47.24.308 N050.04.28.197 E019.47.24.378 Color_251ACI
N050.04.28.197 E019.47.24.378 N050.04.28.256 E019.47.24.509 Color_251ACI
N050.04.28.256 E019.47.24.509 N050.04.28.331 E019.47.24.698 Color_251ACI
N050.04.28.331 E019.47.24.698 N050.04.28.397 E019.47.24.927 Color_251ACI
N050.04.28.397 E019.47.24.927 N050.04.28.376 E019.47.25.010 Color_251ACI
N050.04.28.376 E019.47.25.010 N050.04.28.202 E019.47.25.096 Color_251ACI
N050.04.28.202 E019.47.25.096 N050.04.28.294 E019.47.25.342 Color_251ACI
N050.04.28.294 E019.47.25.342 N050.04.28.009 E019.47.25.504 Color_251ACI
N050.04.26.681 E019.47.24.942 N050.04.26.845 E019.47.24.898 Color_251ACI
N050.04.26.845 E019.47.24.898 N050.04.26.828 E019.47.25.459 Color_251ACI
N050.04.26.501 E019.47.25.548 N050.04.26.495 E019.47.25.449 Color_251ACI
N050.04.26.495 E019.47.25.449 N050.04.26.489 E019.47.25.350 Color_251ACI
N050.04.26.489 E019.47.25.350 N050.04.26.509 E019.47.25.267 Color_251ACI
N050.04.26.509 E019.47.25.267 N050.04.26.550 E019.47.25.102 Color_251ACI
N050.04.26.550 E019.47.25.102 N050.04.26.597 E019.47.25.035 Color_251ACI
N050.04.26.597 E019.47.25.035 N050.04.26.645 E019.47.24.968 Color_251ACI
N050.04.26.645 E019.47.24.968 N050.04.26.681 E019.47.24.942 Color_251ACI
N050.04.33.424 E019.47.30.288 N050.04.33.318 E019.47.30.224 Color_251ACI
N050.04.33.318 E019.47.30.224 N050.04.32.759 E019.47.29.888 Color_251ACI
N050.04.32.759 E019.47.29.888 N050.04.31.975 E019.47.29.844 Color_251ACI
N050.04.31.975 E019.47.29.844 N050.04.31.545 E019.47.30.347 Color_251ACI
N050.04.31.545 E019.47.30.347 N050.04.31.364 E019.47.30.953 Color_251ACI
N050.04.31.364 E019.47.30.953 N050.04.31.360 E019.47.31.093 Color_251ACI
N050.04.40.727 E019.47.43.971 N050.04.40.717 E019.47.44.012 Color_251ACI
N050.04.40.717 E019.47.44.012 N050.04.40.690 E019.47.43.996 Color_251ACI
N050.04.40.690 E019.47.43.996 N050.04.40.690 E019.47.43.996 Color_251ACI
N050.04.40.690 E019.47.43.996 N050.04.40.557 E019.47.43.916 Color_251ACI
N050.04.40.557 E019.47.43.916 N050.04.40.557 E019.47.43.916 Color_251ACI
N050.04.40.557 E019.47.43.916 N050.04.40.557 E019.47.43.916 Color_251ACI
N050.04.40.557 E019.47.43.916 N050.04.40.425 E019.47.43.218 Color_251ACI
N050.04.40.425 E019.47.43.218 N050.04.40.251 E019.47.43.303 Color_251ACI
N050.04.40.251 E019.47.43.303 N050.04.40.198 E019.47.43.271 Color_251ACI
N050.04.40.198 E019.47.43.271 N050.04.40.144 E019.47.43.239 Color_251ACI
N050.04.40.144 E019.47.43.239 N050.04.40.102 E019.47.43.166 Color_251ACI
N050.04.40.102 E019.47.43.166 N050.04.39.993 E019.47.42.863 Color_251ACI
N050.04.39.993 E019.47.42.863 N050.04.39.928 E019.47.42.633 Color_251ACI
N050.04.39.928 E019.47.42.633 N050.04.39.826 E019.47.42.428 Color_251ACI
N050.04.39.826 E019.47.42.428 N050.04.39.767 E019.47.42.298 Color_251ACI
N050.04.39.767 E019.47.42.298 N050.04.39.634 E019.47.42.218 Color_251ACI
N050.04.39.634 E019.47.42.218 N050.04.39.581 E019.47.42.185 Color_251ACI
N050.04.39.581 E019.47.42.185 N050.04.39.459 E019.47.41.445 Color_251ACI
N050.04.39.459 E019.47.41.445 N050.04.39.358 E019.47.41.480 Color_251ACI
N050.04.39.358 E019.47.41.480 N050.04.39.458 E019.47.42.064 Color_251ACI
N050.04.39.458 E019.47.42.064 N050.04.39.395 E019.47.42.073 Color_251ACI
N050.04.39.395 E019.47.42.073 N050.04.39.390 E019.47.42.214 Color_251ACI
N050.04.39.390 E019.47.42.214 N050.04.37.704 E019.47.42.484 Color_251ACI
N050.04.37.704 E019.47.42.484 N050.04.36.895 E019.47.42.664 Color_251ACI
N050.04.36.895 E019.47.42.664 N050.04.36.567 E019.47.42.752 Color_251ACI
N050.04.36.567 E019.47.42.752 N050.04.36.441 E019.47.42.771 Color_251ACI
N050.04.36.453 E019.47.42.969 N050.04.37.351 E019.47.42.796 Color_251ACI
N050.04.37.351 E019.47.42.796 N050.04.38.731 E019.47.42.531 Color_251ACI
N050.04.38.731 E019.47.42.531 N050.04.39.366 E019.47.42.437 Color_251ACI
N050.04.39.366 E019.47.42.437 N050.04.39.546 E019.47.42.450 Color_251ACI
N050.04.39.546 E019.47.42.450 N050.04.39.636 E019.47.42.457 Color_251ACI
N050.04.39.636 E019.47.42.457 N050.04.39.732 E019.47.42.562 Color_251ACI
N050.04.39.732 E019.47.42.562 N050.04.39.818 E019.47.42.709 Color_251ACI
N050.04.39.818 E019.47.42.709 N050.04.39.883 E019.47.42.939 Color_251ACI
N050.04.39.883 E019.47.42.939 N050.04.39.911 E019.47.43.194 Color_251ACI
N050.04.39.911 E019.47.43.194 N050.04.39.907 E019.47.43.334 Color_251ACI
N050.04.39.907 E019.47.43.334 N050.04.39.892 E019.47.43.516 Color_251ACI
N050.04.39.892 E019.47.43.516 N050.04.39.868 E019.47.43.739 Color_251ACI
N050.04.39.868 E019.47.43.739 N050.04.39.763 E019.47.43.914 Color_251ACI
N050.04.39.763 E019.47.43.914 N050.04.39.716 E019.47.43.981 Color_251ACI
N050.04.39.716 E019.47.43.981 N050.04.39.749 E019.47.44.096 Color_251ACI
N050.04.39.749 E019.47.44.096 N050.04.39.822 E019.47.44.045 Color_251ACI
N050.04.39.822 E019.47.44.045 N050.04.39.912 E019.47.44.052 Color_251ACI
N050.04.39.912 E019.47.44.052 N050.04.39.992 E019.47.44.100 Color_251ACI
N050.04.39.992 E019.47.44.100 N050.04.40.035 E019.47.44.173 Color_251ACI
N050.04.40.035 E019.47.44.173 N050.04.40.068 E019.47.44.288 Color_251ACI
N050.04.40.068 E019.47.44.288 N050.04.40.084 E019.47.44.346 Color_251ACI
N050.04.40.084 E019.47.44.346 N050.04.40.090 E019.47.44.445 Color_251ACI
N050.04.40.090 E019.47.44.445 N050.04.40.190 E019.47.44.410 Color_251ACI
N050.04.40.190 E019.47.44.410 N050.04.40.221 E019.47.44.285 Color_251ACI
N050.04.40.221 E019.47.44.285 N050.04.40.258 E019.47.44.260 Color_251ACI
N050.04.40.258 E019.47.44.260 N050.04.40.739 E019.47.44.169 Color_251ACI
N050.04.40.739 E019.47.44.169 N050.04.40.727 E019.47.43.971 Color_251ACI
N050.04.47.279 E019.48.06.964 N050.04.47.292 E019.48.07.162 Color_251ACI
N050.04.47.850 E019.48.11.070 N050.04.47.185 E019.48.11.289 Color_251ACI
N050.04.47.185 E019.48.11.289 N050.04.46.520 E019.48.11.507 Color_251ACI
N050.04.46.520 E019.48.11.507 N050.04.39.745 E019.48.13.809 Color_251ACI
N050.04.29.994 E019.47.58.414 N050.04.30.073 E019.47.59.081 Color_251ACI
N050.04.30.073 E019.47.59.081 N050.04.30.342 E019.48.00.956 Color_251ACI
N050.04.30.342 E019.48.00.956 N050.04.30.559 E019.48.02.421 Color_251ACI
N050.04.30.559 E019.48.02.421 N050.04.30.577 E019.48.02.717 Color_251ACI
N050.04.30.577 E019.48.02.717 N050.04.30.600 E019.48.02.874 Color_251ACI
N050.04.30.600 E019.48.02.874 N050.04.30.612 E019.48.03.071 Color_251ACI
N050.04.30.612 E019.48.03.071 N050.04.30.581 E019.48.03.196 Color_251ACI
N050.04.30.581 E019.48.03.196 N050.04.30.509 E019.48.03.486 Color_251ACI
N050.04.30.509 E019.48.03.486 N050.04.30.478 E019.48.03.610 Color_251ACI
N050.04.30.478 E019.48.03.610 N050.04.30.347 E019.48.03.769 Color_251ACI
N050.04.30.347 E019.48.03.769 N050.04.30.300 E019.48.03.836 Color_251ACI
N050.04.30.300 E019.48.03.836 N050.04.30.216 E019.48.03.928 Color_251ACI
N050.04.30.216 E019.48.03.928 N050.04.29.941 E019.48.04.049 Color_251ACI
N050.04.29.941 E019.48.04.049 N050.04.28.948 E019.48.04.356 Color_251ACI
N050.04.28.948 E019.48.04.356 N050.04.28.811 E019.48.04.416 Color_251ACI
N050.04.28.811 E019.48.04.416 N050.04.28.738 E019.48.04.467 Color_251ACI
N050.04.28.738 E019.48.04.467 N050.04.28.701 E019.48.04.492 Color_251ACI
N050.04.28.701 E019.48.04.492 N050.04.28.617 E019.48.04.585 Color_251ACI
N050.04.28.617 E019.48.04.585 N050.04.28.559 E019.48.04.693 Color_251ACI
N050.04.28.559 E019.48.04.693 N050.04.28.282 E019.48.05.812 Color_251ACI
N050.04.28.282 E019.48.05.812 N050.04.28.194 E019.48.06.044 Color_251ACI
N050.04.28.194 E019.48.06.044 N050.04.28.132 E019.48.06.293 Color_251ACI
N050.04.28.132 E019.48.06.293 N050.04.28.054 E019.48.06.484 Color_251ACI
N050.04.28.054 E019.48.06.484 N050.04.27.955 E019.48.06.758 Color_251ACI
N050.04.27.955 E019.48.06.758 N050.04.28.029 E019.48.07.326 Color_251ACI
N050.04.28.029 E019.48.07.326 N050.04.27.786 E019.48.08.180 Color_251ACI
N050.04.27.786 E019.48.08.180 N050.04.27.953 E019.48.09.233 Color_251ACI
N050.04.27.953 E019.48.09.233 N050.04.28.054 E019.48.10.056 Color_251ACI
N050.04.28.054 E019.48.10.056 N050.04.28.470 E019.48.10.353 Color_251ACI
N050.04.28.470 E019.48.10.353 N050.04.28.494 E019.48.10.749 Color_251ACI
N050.04.28.494 E019.48.10.749 N050.04.28.539 E019.48.11.061 Color_251ACI
N050.04.28.539 E019.48.11.061 N050.04.28.587 E019.48.11.234 Color_251ACI
N050.04.28.587 E019.48.11.234 N050.04.28.663 E019.48.11.422 Color_251ACI
N050.04.28.663 E019.48.11.422 N050.04.28.749 E019.48.11.569 Color_251ACI
N050.04.28.749 E019.48.11.569 N050.04.28.872 E019.48.11.690 Color_251ACI
N050.04.28.872 E019.48.11.690 N050.04.29.690 E019.48.12.088 Color_251ACI
N050.04.29.690 E019.48.12.088 N050.04.29.716 E019.48.12.104 Color_251ACI
N050.04.30.523 E019.48.15.875 N050.04.30.233 E019.48.17.415 Color_251ACI
N050.04.30.233 E019.48.17.415 N050.04.29.815 E019.48.19.592 Color_251ACI
N050.04.29.815 E019.48.19.592 N050.04.28.678 E019.48.19.003 Color_251ACI
N050.04.28.678 E019.48.19.003 N050.04.23.811 E019.48.16.691 Color_251ACI
N050.04.23.811 E019.48.16.691 N050.04.23.677 E019.48.15.754 Color_251ACI
N050.04.45.963 E019.47.43.314 N050.04.46.892 E019.47.43.017 Color_251ACI
N050.04.49.300 E019.47.42.180 N050.04.49.437 E019.47.42.120 Color_251ACI
N050.04.49.437 E019.47.42.120 N050.04.49.500 E019.47.42.111 Color_251ACI
N050.04.49.500 E019.47.42.111 N050.04.49.547 E019.47.42.044 Color_251ACI
N050.04.49.547 E019.47.42.044 N050.04.49.584 E019.47.42.019 Color_251ACI
N050.04.49.584 E019.47.42.019 N050.04.49.625 E019.47.41.853 Color_251ACI
N050.04.49.625 E019.47.41.853 N050.04.49.619 E019.47.41.754 Color_251ACI
N050.04.49.619 E019.47.41.754 N050.04.49.757 E019.47.41.694 Color_251ACI
N050.04.49.757 E019.47.41.694 N050.04.49.816 E019.47.41.825 Color_251ACI
N050.04.49.816 E019.47.41.825 N050.04.49.832 E019.47.41.882 Color_251ACI
N050.04.49.832 E019.47.41.882 N050.04.49.912 E019.47.41.930 Color_251ACI
N050.04.49.912 E019.47.41.930 N050.04.49.992 E019.47.41.978 Color_251ACI
N050.04.49.992 E019.47.41.978 N050.04.50.065 E019.47.41.927 Color_251ACI
N050.04.50.065 E019.47.41.927 N050.04.50.067 E019.47.42.166 Color_251ACI
N050.04.50.067 E019.47.42.166 N050.04.49.465 E019.47.42.375 Color_251ACI
N050.04.49.465 E019.47.42.375 N050.04.45.991 E019.47.43.569 Color_251ACI
N050.04.28.675 E019.46.05.427 N050.04.30.243 E019.46.04.895 Color_251ACI
N050.04.30.243 E019.46.04.895 N050.04.30.288 E019.46.05.208 Color_251ACI
N050.04.47.800 E019.48.10.659 N050.04.47.850 E019.48.11.070 Color_251ACI
N050.04.23.798 E019.46.21.396 N050.04.23.765 E019.46.23.376 Color_251ACI
N050.04.29.170 E019.46.50.631 N050.04.29.984 E019.46.51.168 Color_251ACI
N050.04.23.625 E019.46.26.530 N050.04.23.178 E019.46.41.642 Color_251ACI
N050.04.23.178 E019.46.41.642 N050.04.22.901 E019.46.50.523 Color_251ACI
N050.04.22.992 E019.46.51.387 N050.04.22.736 E019.46.51.186 Color_251ACI
N050.04.22.736 E019.46.51.186 N050.04.22.683 E019.46.51.154 Color_251ACI
N050.04.22.683 E019.46.51.154 N050.04.21.541 E019.46.51.323 Color_251ACI
N050.04.21.541 E019.46.51.323 N050.04.21.485 E019.46.51.671 Color_251ACI
N050.04.21.485 E019.46.51.671 N050.04.21.969 E019.46.53.295 Color_251ACI
N050.04.21.969 E019.46.53.295 N050.04.22.018 E019.46.53.467 Color_251ACI
N050.04.22.018 E019.46.53.467 N050.04.22.140 E019.46.53.589 Color_251ACI
N050.04.24.188 E019.46.24.012 N050.04.23.389 E019.46.49.293 Color_251ACI
N050.04.23.389 E019.46.49.293 N050.04.23.603 E019.46.50.279 Color_251ACI
N050.04.23.603 E019.46.50.279 N050.04.24.141 E019.46.50.698 Color_251ACI
N050.04.24.141 E019.46.50.698 N050.04.26.986 E019.46.50.935 Color_251ACI
N050.04.26.986 E019.46.50.935 N050.04.27.696 E019.46.50.410 Color_251ACI
N050.04.27.696 E019.46.50.410 N050.04.27.809 E019.46.49.954 Color_251ACI
N050.04.27.809 E019.46.49.954 N050.04.24.188 E019.46.24.012 Color_251ACI
N050.04.22.140 E019.46.53.589 N050.04.22.241 E019.46.53.554 Color_251ACI
N050.04.22.241 E019.46.53.554 N050.04.22.931 E019.46.53.112 Color_251ACI
N050.04.22.931 E019.46.53.112 N050.04.23.152 E019.46.52.960 Color_251ACI
N050.04.23.152 E019.46.52.960 N050.04.23.210 E019.46.52.852 Color_251ACI
N050.04.23.210 E019.46.52.852 N050.04.23.318 E019.46.52.536 Color_251ACI
N050.04.23.318 E019.46.52.536 N050.04.22.992 E019.46.51.387 Color_251ACI
N050.04.23.567 E019.46.53.876 N050.04.22.534 E019.46.54.588 Color_251ACI
N050.04.22.534 E019.46.54.588 N050.04.22.401 E019.46.54.508 Color_251ACI
N050.04.22.401 E019.46.54.508 N050.04.22.342 E019.46.54.377 Color_251ACI
N050.04.22.342 E019.46.54.377 N050.04.22.320 E019.46.54.221 Color_251ACI
N050.04.22.320 E019.46.54.221 N050.04.22.382 E019.46.53.972 Color_251ACI
N050.04.22.382 E019.46.53.972 N050.04.22.466 E019.46.53.880 Color_251ACI
N050.04.22.466 E019.46.53.880 N050.04.23.240 E019.46.53.346 Color_251ACI
N050.04.23.240 E019.46.53.346 N050.04.23.330 E019.46.53.353 Color_251ACI
N050.04.23.330 E019.46.53.353 N050.04.23.430 E019.46.53.318 Color_251ACI
N050.04.23.430 E019.46.53.318 N050.04.23.563 E019.46.53.398 Color_251ACI
N050.04.23.563 E019.46.53.398 N050.04.23.661 E019.46.53.742 Color_251ACI
N050.04.23.661 E019.46.53.742 N050.04.23.567 E019.46.53.876 Color_251ACI
N050.04.23.863 E019.46.54.531 N050.04.23.928 E019.46.54.760 Color_251ACI
N050.04.23.928 E019.46.54.760 N050.04.23.819 E019.46.55.076 Color_251ACI
N050.04.23.819 E019.46.55.076 N050.04.23.762 E019.46.55.184 Color_251ACI
N050.04.23.762 E019.46.55.184 N050.04.22.988 E019.46.55.718 Color_251ACI
N050.04.22.988 E019.46.55.718 N050.04.22.898 E019.46.55.711 Color_251ACI
N050.04.22.898 E019.46.55.711 N050.04.22.711 E019.46.55.599 Color_251ACI
N050.04.22.711 E019.46.55.599 N050.04.22.642 E019.46.55.510 Color_251ACI
N050.04.22.642 E019.46.55.510 N050.04.22.620 E019.46.55.354 Color_251ACI
N050.04.22.620 E019.46.55.354 N050.04.22.671 E019.46.55.146 Color_251ACI
N050.04.22.671 E019.46.55.146 N050.04.23.703 E019.46.54.435 Color_251ACI
N050.04.23.703 E019.46.54.435 N050.04.23.863 E019.46.54.531 Color_251ACI
N050.04.24.173 E019.46.55.622 N050.04.24.228 E019.46.55.893 Color_251ACI
N050.04.24.228 E019.46.55.893 N050.04.24.166 E019.46.56.142 Color_251ACI
N050.04.24.166 E019.46.56.142 N050.04.23.634 E019.46.56.440 Color_251ACI
N050.04.23.634 E019.46.56.440 N050.04.23.144 E019.46.56.812 Color_251ACI
N050.04.23.144 E019.46.56.812 N050.04.23.011 E019.46.56.732 Color_251ACI
N050.04.23.011 E019.46.56.732 N050.04.22.952 E019.46.56.601 Color_251ACI
N050.04.22.952 E019.46.56.601 N050.04.22.930 E019.46.56.445 Color_251ACI
N050.04.22.930 E019.46.56.445 N050.04.22.991 E019.46.56.196 Color_251ACI
N050.04.22.991 E019.46.56.196 N050.04.23.086 E019.46.56.063 Color_251ACI
N050.04.23.086 E019.46.56.063 N050.04.23.555 E019.46.55.774 Color_251ACI
N050.04.23.555 E019.46.55.774 N050.04.23.860 E019.46.55.529 Color_251ACI
N050.04.23.860 E019.46.55.529 N050.04.23.976 E019.46.55.551 Color_251ACI
N050.04.23.976 E019.46.55.551 N050.04.24.173 E019.46.55.622 Color_251ACI
N050.04.24.473 E019.46.56.755 N050.04.24.538 E019.46.56.985 Color_251ACI
N050.04.24.538 E019.46.56.985 N050.04.24.466 E019.46.57.275 Color_251ACI
N050.04.24.466 E019.46.57.275 N050.04.24.372 E019.46.57.408 Color_251ACI
N050.04.24.372 E019.46.57.408 N050.04.23.597 E019.46.57.942 Color_251ACI
N050.04.23.597 E019.46.57.942 N050.04.23.481 E019.46.57.920 Color_251ACI
N050.04.23.481 E019.46.57.920 N050.04.23.321 E019.46.57.824 Color_251ACI
N050.04.23.321 E019.46.57.824 N050.04.23.252 E019.46.57.734 Color_251ACI
N050.04.23.252 E019.46.57.734 N050.04.23.246 E019.46.57.635 Color_251ACI
N050.04.23.246 E019.46.57.635 N050.04.23.256 E019.46.57.594 Color_251ACI
N050.04.23.256 E019.46.57.594 N050.04.23.318 E019.46.57.345 Color_251ACI
N050.04.23.318 E019.46.57.345 N050.04.24.313 E019.46.56.659 Color_251ACI
N050.04.24.313 E019.46.56.659 N050.04.24.473 E019.46.56.755 Color_251ACI
N050.04.24.783 E019.46.57.846 N050.04.24.874 E019.46.58.092 Color_251ACI
N050.04.24.874 E019.46.58.092 N050.04.24.796 E019.46.58.283 Color_251ACI
N050.04.24.796 E019.46.58.283 N050.04.23.865 E019.46.58.960 Color_251ACI
N050.04.23.865 E019.46.58.960 N050.04.23.727 E019.46.59.021 Color_251ACI
N050.04.23.727 E019.46.59.021 N050.04.23.621 E019.46.58.957 Color_251ACI
N050.04.23.621 E019.46.58.957 N050.04.23.562 E019.46.58.826 Color_251ACI
N050.04.23.562 E019.46.58.826 N050.04.23.539 E019.46.58.669 Color_251ACI
N050.04.23.539 E019.46.58.669 N050.04.23.607 E019.46.58.520 Color_251ACI
N050.04.23.607 E019.46.58.520 N050.04.23.638 E019.46.58.395 Color_251ACI
N050.04.23.638 E019.46.58.395 N050.04.23.695 E019.46.58.287 Color_251ACI
N050.04.23.695 E019.46.58.287 N050.04.23.917 E019.46.58.134 Color_251ACI
N050.04.23.917 E019.46.58.134 N050.04.24.496 E019.46.57.769 Color_251ACI
N050.04.24.496 E019.46.57.769 N050.04.24.596 E019.46.57.734 Color_251ACI
N050.04.24.596 E019.46.57.734 N050.04.24.783 E019.46.57.846 Color_251ACI
N050.04.25.093 E019.46.58.938 N050.04.25.174 E019.46.59.225 Color_251ACI
N050.04.25.174 E019.46.59.225 N050.04.25.076 E019.46.59.499 Color_251ACI
N050.04.25.076 E019.46.59.499 N050.04.24.992 E019.46.59.591 Color_251ACI
N050.04.24.992 E019.46.59.591 N050.04.24.207 E019.47.00.167 Color_251ACI
N050.04.24.207 E019.47.00.167 N050.04.24.117 E019.47.00.160 Color_251ACI
N050.04.24.117 E019.47.00.160 N050.04.23.931 E019.47.00.048 Color_251ACI
N050.04.23.931 E019.47.00.048 N050.04.23.872 E019.46.59.917 Color_251ACI
N050.04.23.872 E019.46.59.917 N050.04.23.849 E019.46.59.761 Color_251ACI
N050.04.23.849 E019.46.59.761 N050.04.23.901 E019.46.59.554 Color_251ACI
N050.04.23.901 E019.46.59.554 N050.04.24.296 E019.46.59.315 Color_251ACI
N050.04.24.296 E019.46.59.315 N050.04.24.802 E019.46.59.001 Color_251ACI
N050.04.24.802 E019.46.59.001 N050.04.24.976 E019.46.58.915 Color_251ACI
N050.04.24.976 E019.46.58.915 N050.04.25.093 E019.46.58.938 Color_251ACI
N050.04.25.419 E019.47.00.087 N050.04.25.484 E019.47.00.316 Color_251ACI
N050.04.25.484 E019.47.00.316 N050.04.25.406 E019.47.00.508 Color_251ACI
N050.04.25.406 E019.47.00.508 N050.04.24.990 E019.47.00.829 Color_251ACI
N050.04.24.990 E019.47.00.829 N050.04.24.374 E019.47.01.219 Color_251ACI
N050.04.24.374 E019.47.01.219 N050.04.24.241 E019.47.01.139 Color_251ACI
N050.04.24.241 E019.47.01.139 N050.04.24.171 E019.47.01.050 Color_251ACI
N050.04.24.171 E019.47.01.050 N050.04.24.186 E019.47.00.868 Color_251ACI
N050.04.24.186 E019.47.00.868 N050.04.24.248 E019.47.00.620 Color_251ACI
N050.04.24.248 E019.47.00.620 N050.04.24.305 E019.47.00.511 Color_251ACI
N050.04.24.305 E019.47.00.511 N050.04.25.106 E019.46.59.993 Color_251ACI
N050.04.25.106 E019.46.59.993 N050.04.25.206 E019.46.59.959 Color_251ACI
N050.04.25.206 E019.46.59.959 N050.04.25.419 E019.47.00.087 Color_251ACI
N050.04.25.702 E019.47.01.162 N050.04.25.794 E019.47.01.408 Color_251ACI
N050.04.25.794 E019.47.01.408 N050.04.25.696 E019.47.01.682 Color_251ACI
N050.04.25.696 E019.47.01.682 N050.04.25.628 E019.47.01.832 Color_251ACI
N050.04.25.628 E019.47.01.832 N050.04.25.222 E019.47.02.111 Color_251ACI
N050.04.25.222 E019.47.02.111 N050.04.24.827 E019.47.02.349 Color_251ACI
N050.04.24.827 E019.47.02.349 N050.04.24.727 E019.47.02.384 Color_251ACI
N050.04.24.727 E019.47.02.384 N050.04.24.567 E019.47.02.288 Color_251ACI
N050.04.24.567 E019.47.02.288 N050.04.24.508 E019.47.02.157 Color_251ACI
N050.04.24.508 E019.47.02.157 N050.04.24.486 E019.47.02.001 Color_251ACI
N050.04.24.486 E019.47.02.001 N050.04.24.537 E019.47.01.794 Color_251ACI
N050.04.24.537 E019.47.01.794 N050.04.24.721 E019.47.01.667 Color_251ACI
N050.04.24.721 E019.47.01.667 N050.04.25.533 E019.47.01.107 Color_251ACI
N050.04.25.533 E019.47.01.107 N050.04.25.702 E019.47.01.162 Color_251ACI
N050.04.26.012 E019.47.02.254 N050.04.26.094 E019.47.02.541 Color_251ACI
N050.04.26.094 E019.47.02.541 N050.04.26.026 E019.47.02.690 Color_251ACI
N050.04.26.026 E019.47.02.690 N050.04.26.016 E019.47.02.732 Color_251ACI
N050.04.26.016 E019.47.02.732 N050.04.25.010 E019.47.03.460 Color_251ACI
N050.04.25.010 E019.47.03.460 N050.04.24.851 E019.47.03.364 Color_251ACI
N050.04.24.851 E019.47.03.364 N050.04.24.792 E019.47.03.233 Color_251ACI
N050.04.24.792 E019.47.03.233 N050.04.24.796 E019.47.03.092 Color_251ACI
N050.04.24.796 E019.47.03.092 N050.04.24.857 E019.47.02.844 Color_251ACI
N050.04.24.857 E019.47.02.844 N050.04.24.915 E019.47.02.736 Color_251ACI
N050.04.24.915 E019.47.02.736 N050.04.25.726 E019.47.02.176 Color_251ACI
N050.04.25.726 E019.47.02.176 N050.04.25.816 E019.47.02.183 Color_251ACI
N050.04.25.816 E019.47.02.183 N050.04.26.012 E019.47.02.254 Color_251ACI
N050.04.26.322 E019.47.03.345 N050.04.26.404 E019.47.03.632 Color_251ACI
N050.04.26.404 E019.47.03.632 N050.04.26.305 E019.47.03.906 Color_251ACI
N050.04.26.305 E019.47.03.906 N050.04.26.248 E019.47.04.014 Color_251ACI
N050.04.26.248 E019.47.04.014 N050.04.25.621 E019.47.04.447 Color_251ACI
N050.04.25.621 E019.47.04.447 N050.04.25.447 E019.47.04.532 Color_251ACI
N050.04.25.447 E019.47.04.532 N050.04.25.347 E019.47.04.567 Color_251ACI
N050.04.25.347 E019.47.04.567 N050.04.25.187 E019.47.04.471 Color_251ACI
N050.04.25.187 E019.47.04.471 N050.04.25.102 E019.47.04.324 Color_251ACI
N050.04.25.102 E019.47.04.324 N050.04.25.106 E019.47.04.184 Color_251ACI
N050.04.25.106 E019.47.04.184 N050.04.25.147 E019.47.04.018 Color_251ACI
N050.04.25.147 E019.47.04.018 N050.04.25.911 E019.47.03.526 Color_251ACI
N050.04.25.911 E019.47.03.526 N050.04.26.179 E019.47.03.306 Color_251ACI
N050.04.26.179 E019.47.03.306 N050.04.26.322 E019.47.03.345 Color_251ACI
N050.04.26.622 E019.47.04.478 N050.04.26.714 E019.47.04.724 Color_251ACI
N050.04.26.714 E019.47.04.724 N050.04.26.673 E019.47.04.889 Color_251ACI
N050.04.26.673 E019.47.04.889 N050.04.26.605 E019.47.05.039 Color_251ACI
N050.04.26.605 E019.47.05.039 N050.04.26.548 E019.47.05.147 Color_251ACI
N050.04.26.548 E019.47.05.147 N050.04.25.847 E019.47.05.630 Color_251ACI
N050.04.25.847 E019.47.05.630 N050.04.25.747 E019.47.05.665 Color_251ACI
N050.04.25.747 E019.47.05.665 N050.04.25.683 E019.47.05.675 Color_251ACI
N050.04.25.683 E019.47.05.675 N050.04.25.657 E019.47.05.659 Color_251ACI
N050.04.25.657 E019.47.05.659 N050.04.25.497 E019.47.05.563 Color_251ACI
N050.04.25.497 E019.47.05.563 N050.04.25.428 E019.47.05.473 Color_251ACI
N050.04.25.428 E019.47.05.473 N050.04.25.405 E019.47.05.317 Color_251ACI
N050.04.25.405 E019.47.05.317 N050.04.25.477 E019.47.05.027 Color_251ACI
N050.04.25.477 E019.47.05.027 N050.04.25.561 E019.47.04.934 Color_251ACI
N050.04.25.561 E019.47.04.934 N050.04.26.336 E019.47.04.401 Color_251ACI
N050.04.26.336 E019.47.04.401 N050.04.26.373 E019.47.04.375 Color_251ACI
N050.04.26.373 E019.47.04.375 N050.04.26.426 E019.47.04.407 Color_251ACI
N050.04.26.426 E019.47.04.407 N050.04.26.622 E019.47.04.478 Color_251ACI
N050.04.26.959 E019.47.05.585 N050.04.27.014 E019.47.05.856 Color_251ACI
N050.04.27.014 E019.47.05.856 N050.04.26.915 E019.47.06.130 Color_251ACI
N050.04.26.915 E019.47.06.130 N050.04.26.858 E019.47.06.239 Color_251ACI
N050.04.26.858 E019.47.06.239 N050.04.26.057 E019.47.06.757 Color_251ACI
N050.04.26.057 E019.47.06.757 N050.04.25.957 E019.47.06.791 Color_251ACI
N050.04.25.957 E019.47.06.791 N050.04.25.797 E019.47.06.695 Color_251ACI
N050.04.25.797 E019.47.06.695 N050.04.25.738 E019.47.06.565 Color_251ACI
N050.04.25.738 E019.47.06.565 N050.04.25.716 E019.47.06.408 Color_251ACI
N050.04.25.716 E019.47.06.408 N050.04.25.777 E019.47.06.160 Color_251ACI
N050.04.25.777 E019.47.06.160 N050.04.25.835 E019.47.06.051 Color_251ACI
N050.04.25.835 E019.47.06.051 N050.04.26.635 E019.47.05.533 Color_251ACI
N050.04.26.635 E019.47.05.533 N050.04.26.736 E019.47.05.499 Color_251ACI
N050.04.26.736 E019.47.05.499 N050.04.26.852 E019.47.05.521 Color_251ACI
N050.04.26.852 E019.47.05.521 N050.04.26.959 E019.47.05.585 Color_251ACI
N050.04.27.281 E019.47.06.874 N050.04.27.258 E019.47.06.718 Color_251ACI
N050.04.27.258 E019.47.06.718 N050.04.27.072 E019.47.06.606 Color_251ACI
N050.04.27.072 E019.47.06.606 N050.04.26.945 E019.47.06.625 Color_251ACI
N050.04.26.945 E019.47.06.625 N050.04.26.145 E019.47.07.143 Color_251ACI
N050.04.26.145 E019.47.07.143 N050.04.26.087 E019.47.07.251 Color_251ACI
N050.04.26.087 E019.47.07.251 N050.04.26.015 E019.47.07.541 Color_251ACI
N050.04.26.015 E019.47.07.541 N050.04.26.032 E019.47.07.598 Color_251ACI
N050.04.26.032 E019.47.07.598 N050.04.26.154 E019.47.07.720 Color_251ACI
N050.04.26.245 E019.47.09.203 N050.04.26.397 E019.47.11.056 Color_251ACI
N050.04.26.397 E019.47.11.056 N050.04.26.499 E019.47.11.261 Color_251ACI
N050.04.26.499 E019.47.11.261 N050.04.27.236 E019.47.10.752 Color_251ACI
N050.04.27.236 E019.47.10.752 N050.04.27.900 E019.47.10.295 Color_251ACI
N050.04.27.900 E019.47.10.295 N050.04.28.129 E019.47.09.861 Color_251ACI
N050.04.28.129 E019.47.09.861 N050.04.27.993 E019.47.09.303 Color_251ACI
N050.04.27.993 E019.47.09.303 N050.04.27.727 E019.47.09.143 Color_251ACI
N050.04.28.619 E019.47.11.585 N050.04.28.389 E019.47.12.018 Color_251ACI
N050.04.28.389 E019.47.12.018 N050.04.27.230 E019.47.12.749 Color_251ACI
N050.04.27.230 E019.47.12.749 N050.04.26.859 E019.47.12.764 Color_251ACI
N050.04.26.859 E019.47.12.764 N050.04.26.664 E019.47.12.074 Color_251ACI
N050.04.26.664 E019.47.12.074 N050.04.26.920 E019.47.11.657 Color_251ACI
N050.04.26.920 E019.47.11.657 N050.04.28.063 E019.47.10.869 Color_251ACI
N050.04.28.063 E019.47.10.869 N050.04.28.423 E019.47.10.895 Color_251ACI
N050.04.28.423 E019.47.10.895 N050.04.28.488 E019.47.11.125 Color_251ACI
N050.04.29.375 E019.47.14.326 N050.04.29.424 E019.47.14.498 Color_251ACI
N050.04.29.528 E019.47.14.942 N050.04.29.571 E019.47.15.015 Color_251ACI
N050.04.29.571 E019.47.15.015 N050.04.29.315 E019.47.15.433 Color_251ACI
N050.04.29.315 E019.47.15.433 N050.04.28.172 E019.47.16.221 Color_251ACI
N050.04.28.172 E019.47.16.221 N050.04.27.812 E019.47.16.194 Color_251ACI
N050.04.27.812 E019.47.16.194 N050.04.27.616 E019.47.15.505 Color_251ACI
N050.04.27.616 E019.47.15.505 N050.04.27.856 E019.47.15.030 Color_251ACI
N050.04.27.856 E019.47.15.030 N050.04.29.025 E019.47.14.258 Color_251ACI
N050.04.29.025 E019.47.14.258 N050.04.29.375 E019.47.14.326 Color_251ACI
N050.04.29.865 E019.47.16.049 N050.04.29.824 E019.47.16.215 Color_251ACI
N050.04.29.824 E019.47.16.215 N050.04.29.260 E019.47.16.638 Color_251ACI
N050.04.29.260 E019.47.16.638 N050.04.29.299 E019.47.16.852 Color_251ACI
N050.04.29.299 E019.47.16.852 N050.04.29.905 E019.47.16.502 Color_251ACI
N050.04.29.905 E019.47.16.502 N050.04.30.012 E019.47.16.566 Color_251ACI
N050.04.30.012 E019.47.16.566 N050.04.30.067 E019.47.16.838 Color_251ACI
N050.04.30.067 E019.47.16.838 N050.04.29.837 E019.47.17.271 Color_251ACI
N050.04.29.837 E019.47.17.271 N050.04.28.678 E019.47.18.001 Color_251ACI
N050.04.28.678 E019.47.18.001 N050.04.28.318 E019.47.17.975 Color_251ACI
N050.04.28.318 E019.47.17.975 N050.04.28.105 E019.47.17.228 Color_251ACI
N050.04.28.105 E019.47.17.228 N050.04.28.335 E019.47.16.795 Color_251ACI
N050.04.28.335 E019.47.16.795 N050.04.29.488 E019.47.15.966 Color_251ACI
N050.04.29.488 E019.47.15.966 N050.04.29.848 E019.47.15.992 Color_251ACI
N050.04.29.848 E019.47.15.992 N050.04.29.865 E019.47.16.049 Color_251ACI
N050.04.30.360 E019.47.17.872 N050.04.30.330 E019.47.17.996 Color_251ACI
N050.04.30.330 E019.47.17.996 N050.04.29.740 E019.47.18.403 Color_251ACI
N050.04.29.740 E019.47.18.403 N050.04.29.821 E019.47.18.690 Color_251ACI
N050.04.29.821 E019.47.18.690 N050.04.30.401 E019.47.18.325 Color_251ACI
N050.04.30.401 E019.47.18.325 N050.04.30.475 E019.47.18.274 Color_251ACI
N050.04.28.575 E019.47.24.083 N050.04.28.633 E019.47.23.975 Color_251ACI
N050.04.28.633 E019.47.23.975 N050.04.28.690 E019.47.23.866 Color_251ACI
N050.04.28.690 E019.47.23.866 N050.04.28.959 E019.47.23.647 Color_251ACI
N050.04.28.959 E019.47.23.647 N050.04.29.096 E019.47.23.587 Color_251ACI
N050.04.29.096 E019.47.23.587 N050.04.29.133 E019.47.23.561 Color_251ACI
N050.04.29.133 E019.47.23.561 N050.04.29.233 E019.47.23.526 Color_251ACI
N050.04.29.233 E019.47.23.526 N050.04.29.339 E019.47.23.590 Color_251ACI
N050.04.29.339 E019.47.23.590 N050.04.29.515 E019.47.23.744 Color_251ACI
N050.04.28.009 E019.47.25.504 N050.04.28.760 E019.47.28.146 Color_251ACI
N050.04.28.760 E019.47.28.146 N050.04.28.981 E019.47.27.994 Color_251ACI
N050.04.28.981 E019.47.27.994 N050.04.29.020 E019.47.28.207 Color_251ACI
N050.04.29.020 E019.47.28.207 N050.04.29.267 E019.47.28.071 Color_251ACI
N050.04.29.267 E019.47.28.071 N050.04.29.404 E019.47.28.629 Color_251ACI
N050.04.29.404 E019.47.28.629 N050.04.29.353 E019.47.28.836 Color_251ACI
N050.04.29.353 E019.47.28.836 N050.04.29.232 E019.47.28.954 Color_251ACI
N050.04.29.232 E019.47.28.954 N050.04.29.037 E019.47.29.123 Color_251ACI
N050.04.29.515 E019.47.23.744 N050.04.30.621 E019.47.27.790 Color_251ACI
N050.04.30.621 E019.47.27.790 N050.04.30.908 E019.47.28.725 Color_251ACI
N050.04.30.908 E019.47.28.725 N050.04.30.742 E019.47.29.149 Color_251ACI
N050.04.30.742 E019.47.29.149 N050.04.29.974 E019.47.29.163 Color_251ACI
N050.04.29.037 E019.47.29.123 N050.04.28.125 E019.47.28.240 Color_251ACI
N050.04.28.125 E019.47.28.240 N050.04.27.893 E019.47.26.958 Color_251ACI
N050.04.27.893 E019.47.26.958 N050.04.26.939 E019.47.27.478 Color_251ACI
N050.04.26.939 E019.47.27.478 N050.04.26.501 E019.47.25.548 Color_251ACI
N050.04.21.311 E019.46.51.756 N050.04.21.856 E019.46.53.751 Color_251ACI
N050.04.21.856 E019.46.53.751 N050.04.22.928 E019.46.57.682 Color_251ACI
N050.04.22.928 E019.46.57.682 N050.04.23.265 E019.46.58.790 Color_251ACI
N050.04.32.855 E019.47.44.660 N050.04.30.930 E019.47.30.977 Color_251ACI
N050.04.30.930 E019.47.30.977 N050.04.30.657 E019.47.30.479 Color_251ACI
N050.04.30.657 E019.47.30.479 N050.04.30.459 E019.47.30.169 Color_251ACI
N050.04.30.459 E019.47.30.169 N050.04.30.054 E019.47.29.830 Color_251ACI
N050.04.30.054 E019.47.29.830 N050.04.29.714 E019.47.29.721 Color_251ACI
N050.04.29.714 E019.47.29.721 N050.04.29.333 E019.47.29.777 Color_251ACI
N050.04.29.333 E019.47.29.777 N050.04.29.122 E019.47.29.888 Color_251ACI
N050.04.29.122 E019.47.29.888 N050.04.28.874 E019.47.30.025 Color_251ACI
N050.04.28.874 E019.47.30.025 N050.04.28.598 E019.47.30.525 Color_251ACI
N050.04.28.598 E019.47.30.525 N050.04.28.856 E019.47.31.823 Color_251ACI
N050.04.28.856 E019.47.31.823 N050.04.27.337 E019.47.32.528 Color_251ACI
N050.04.32.787 E019.47.26.571 N050.04.32.417 E019.47.26.586 Color_251ACI
N050.04.32.417 E019.47.26.586 N050.04.31.237 E019.47.27.400 Color_251ACI
N050.04.31.237 E019.47.27.400 N050.04.31.054 E019.47.27.766 Color_251ACI
N050.04.31.054 E019.47.27.766 N050.04.31.158 E019.47.28.209 Color_251ACI
N050.04.31.158 E019.47.28.209 N050.04.31.377 E019.47.28.436 Color_251ACI
N050.04.31.377 E019.47.28.436 N050.04.31.682 E019.47.28.810 Color_251ACI
N050.04.31.682 E019.47.28.810 N050.04.32.203 E019.47.29.172 Color_251ACI
N050.04.32.203 E019.47.29.172 N050.04.32.789 E019.47.28.905 Color_251ACI
N050.04.32.789 E019.47.28.905 N050.04.33.017 E019.47.28.233 Color_251ACI
N050.04.33.017 E019.47.28.233 N050.04.33.087 E019.47.27.704 Color_251ACI
N050.04.33.087 E019.47.27.704 N050.04.32.787 E019.47.26.571 Color_251ACI
N050.04.41.257 E019.47.23.718 N050.04.41.239 E019.47.24.898 Color_251ACI
N050.04.41.239 E019.47.24.898 N050.04.40.772 E019.47.26.045 Color_251ACI
N050.04.40.772 E019.47.26.045 N050.04.39.987 E019.47.26.620 Color_251ACI
N050.04.39.987 E019.47.26.620 N050.04.35.473 E019.47.28.188 Color_251ACI
N050.04.35.473 E019.47.28.188 N050.04.34.779 E019.47.28.151 Color_251ACI
N050.04.34.779 E019.47.28.151 N050.04.34.315 E019.47.27.681 Color_251ACI
N050.04.35.316 E019.47.43.856 N050.04.33.520 E019.47.31.012 Color_251ACI
N050.04.33.520 E019.47.31.012 N050.04.33.424 E019.47.30.288 Color_251ACI
N050.04.31.446 E019.47.55.764 N050.04.30.766 E019.47.56.164 Color_251ACI
N050.04.30.766 E019.47.56.164 N050.04.29.261 E019.47.56.687 Color_251ACI
N050.04.35.929 E019.47.49.272 N050.04.33.298 E019.47.55.689 Color_251ACI
N050.04.33.298 E019.47.55.689 N050.04.33.376 E019.47.56.116 Color_251ACI
N050.04.39.032 E019.48.10.523 N050.04.37.846 E019.48.01.998 Color_251ACI
N050.04.37.846 E019.48.01.998 N050.04.37.629 E019.48.01.392 Color_251ACI
N050.04.37.629 E019.48.01.392 N050.04.37.202 E019.48.00.897 Color_251ACI
N050.04.37.202 E019.48.00.897 N050.04.33.322 E019.47.58.180 Color_251ACI
N050.04.33.376 E019.47.56.116 N050.04.35.462 E019.47.57.563 Color_251ACI
N050.04.35.462 E019.47.57.563 N050.04.36.262 E019.47.57.664 Color_251ACI
N050.04.36.262 E019.47.57.664 N050.04.36.844 E019.47.56.919 Color_251ACI
N050.04.36.844 E019.47.56.919 N050.04.36.978 E019.47.55.762 Color_251ACI
N050.04.36.978 E019.47.55.762 N050.04.36.626 E019.47.53.359 Color_251ACI
N050.04.33.322 E019.47.58.180 N050.04.33.228 E019.47.58.313 Color_251ACI
N050.04.33.228 E019.47.58.313 N050.04.33.160 E019.47.58.463 Color_251ACI
N050.04.33.160 E019.47.58.463 N050.04.33.021 E019.47.58.903 Color_251ACI
N050.04.33.021 E019.47.58.903 N050.04.33.702 E019.47.59.360 Color_251ACI
N050.04.33.702 E019.47.59.360 N050.04.33.769 E019.47.59.829 Color_251ACI
N050.04.33.769 E019.47.59.829 N050.04.33.728 E019.47.59.995 Color_251ACI
N050.04.33.728 E019.47.59.995 N050.04.33.570 E019.48.00.138 Color_251ACI
N050.04.33.570 E019.48.00.138 N050.04.33.303 E019.48.01.216 Color_251ACI
N050.04.33.303 E019.48.01.216 N050.04.32.814 E019.48.00.969 Color_251ACI
N050.04.32.814 E019.48.00.969 N050.04.32.670 E019.48.01.549 Color_251ACI
N050.04.32.670 E019.48.01.549 N050.04.32.527 E019.48.01.510 Color_251ACI
N050.04.32.527 E019.48.01.510 N050.04.32.447 E019.48.01.462 Color_251ACI
N050.04.32.108 E019.48.01.353 N050.04.31.964 E019.48.01.314 Color_251ACI
N050.04.31.964 E019.48.01.314 N050.04.32.076 E019.48.00.619 Color_251ACI
N050.04.32.076 E019.48.00.619 N050.04.32.135 E019.48.00.132 Color_251ACI
N050.04.32.135 E019.48.00.132 N050.04.32.247 E019.47.59.437 Color_251ACI
N050.04.32.247 E019.47.59.437 N050.04.32.329 E019.47.59.105 Color_251ACI
N050.04.32.675 E019.47.58.695 N050.04.32.846 E019.47.58.131 Color_251ACI
N050.04.32.846 E019.47.58.131 N050.04.32.856 E019.47.58.089 Color_251ACI
N050.04.32.856 E019.47.58.089 N050.04.32.876 E019.47.58.006 Color_251ACI
N050.04.32.876 E019.47.58.006 N050.04.32.860 E019.47.57.949 Color_251ACI
N050.04.32.860 E019.47.57.949 N050.04.32.860 E019.47.57.949 Color_251ACI
N050.04.32.860 E019.47.57.949 N050.04.32.827 E019.47.57.834 Color_251ACI
N050.04.21.366 E019.47.59.314 N050.04.21.596 E019.48.00.976 Color_251ACI
N050.04.21.596 E019.48.00.976 N050.04.22.047 E019.48.03.963 Color_251ACI
N050.04.22.047 E019.48.03.963 N050.04.22.289 E019.48.05.822 Color_251ACI
N050.04.22.289 E019.48.05.822 N050.04.22.474 E019.48.07.172 Color_251ACI
N050.04.22.474 E019.48.07.172 N050.04.22.766 E019.48.09.443 Color_251ACI
N050.04.22.766 E019.48.09.443 N050.04.22.872 E019.48.10.126 Color_251ACI
N050.04.22.872 E019.48.10.126 N050.04.22.949 E019.48.10.553 Color_251ACI
N050.04.22.949 E019.48.10.553 N050.04.23.234 E019.48.12.487 Color_251ACI
N050.04.23.234 E019.48.12.487 N050.04.23.329 E019.48.13.211 Color_251ACI
N050.04.23.329 E019.48.13.211 N050.04.23.386 E019.48.13.721 Color_251ACI
N050.04.23.386 E019.48.13.721 N050.04.23.403 E019.48.13.779 Color_251ACI
N050.04.23.403 E019.48.13.779 N050.04.23.677 E019.48.15.754 Color_251ACI
N050.04.35.316 E019.47.43.856 N050.04.35.389 E019.47.44.424 Color_251ACI
N050.04.35.389 E019.47.44.424 N050.04.35.411 E019.47.45.199 Color_251ACI
N050.04.35.411 E019.47.45.199 N050.04.35.490 E019.47.45.865 Color_251ACI
N050.04.35.490 E019.47.45.865 N050.04.35.395 E019.47.46.618 Color_251ACI
N050.04.35.395 E019.47.46.618 N050.04.35.003 E019.47.47.953 Color_251ACI
N050.04.35.003 E019.47.47.953 N050.04.32.752 E019.47.53.455 Color_251ACI
N050.04.32.752 E019.47.53.455 N050.04.32.450 E019.47.54.178 Color_251ACI
N050.04.32.450 E019.47.54.178 N050.04.31.835 E019.47.55.427 Color_251ACI
N050.04.31.835 E019.47.55.427 N050.04.31.714 E019.47.55.545 Color_251ACI
N050.04.22.852 E019.47.57.637 N050.04.22.890 E019.47.57.851 Color_251ACI
N050.04.22.890 E019.47.57.851 N050.04.23.429 E019.47.57.652 Color_251ACI
N050.04.23.429 E019.47.57.652 N050.04.23.621 E019.47.57.862 Color_251ACI
N050.04.23.621 E019.47.57.862 N050.04.23.660 E019.47.58.076 Color_251ACI
N050.04.23.660 E019.47.58.076 N050.04.23.682 E019.47.58.233 Color_251ACI
N050.04.23.682 E019.47.58.233 N050.04.23.516 E019.47.58.656 Color_251ACI
N050.04.23.516 E019.47.58.656 N050.04.22.724 E019.47.58.894 Color_251ACI
N050.04.29.261 E019.47.56.687 N050.04.24.255 E019.47.58.387 Color_251ACI
N050.04.24.255 E019.47.58.387 N050.04.24.030 E019.47.58.061 Color_251ACI
N050.04.24.030 E019.47.58.061 N050.04.23.987 E019.47.57.988 Color_251ACI
N050.04.23.987 E019.47.57.988 N050.04.23.949 E019.47.57.774 Color_251ACI
N050.04.23.949 E019.47.57.774 N050.04.24.068 E019.47.57.417 Color_251ACI
N050.04.24.068 E019.47.57.417 N050.04.24.617 E019.47.57.176 Color_251ACI
N050.04.24.617 E019.47.57.176 N050.04.24.444 E019.47.56.024 Color_251ACI
N050.04.24.444 E019.47.56.024 N050.04.22.695 E019.47.56.543 Color_251ACI
N050.04.22.695 E019.47.56.543 N050.04.22.558 E019.47.56.603 Color_251ACI
N050.04.22.558 E019.47.56.603 N050.04.22.615 E019.47.57.114 Color_251ACI
N050.04.39.032 E019.48.10.523 N050.04.38.183 E019.48.10.868 Color_251ACI
N050.04.38.183 E019.48.10.868 N050.04.37.758 E019.48.07.898 Color_251ACI
N050.04.37.758 E019.48.07.898 N050.04.32.715 E019.48.09.624 Color_251ACI
N050.04.32.715 E019.48.09.624 N050.04.33.112 E019.48.12.339 Color_251ACI
N050.04.33.112 E019.48.12.339 N050.04.32.108 E019.48.12.687 Color_251ACI
N050.04.32.108 E019.48.12.687 N050.04.30.908 E019.48.12.107 Color_251ACI
N050.04.30.908 E019.48.12.107 N050.04.30.795 E019.48.12.563 Color_251ACI
N050.04.30.795 E019.48.12.563 N050.04.29.716 E019.48.12.104 Color_251ACI
N050.04.38.494 E019.48.14.913 N050.04.36.197 E019.48.15.672 Color_251ACI
N050.04.36.197 E019.48.15.672 N050.04.36.156 E019.48.15.219 Color_251ACI
N050.04.36.156 E019.48.15.219 N050.04.32.090 E019.48.16.581 Color_251ACI
N050.04.32.090 E019.48.16.581 N050.04.30.523 E019.48.15.875 Color_251ACI
N050.04.39.745 E019.48.13.809 N050.04.39.778 E019.48.13.924 Color_251ACI
N050.04.39.778 E019.48.13.924 N050.04.38.691 E019.48.14.365 Color_251ACI
N050.04.38.691 E019.48.14.365 N050.04.38.731 E019.48.14.818 Color_251ACI
N050.04.38.731 E019.48.14.818 N050.04.38.631 E019.48.14.852 Color_251ACI
N050.04.38.631 E019.48.14.852 N050.04.38.664 E019.48.14.967 Color_251ACI
N050.04.38.664 E019.48.14.967 N050.04.38.526 E019.48.15.028 Color_251ACI
N050.04.38.526 E019.48.15.028 N050.04.38.494 E019.48.14.913 Color_251ACI
N050.04.23.765 E019.46.23.376 N050.04.23.625 E019.46.26.530 Color_251ACI
N050.04.23.265 E019.46.58.790 N050.04.23.347 E019.46.59.077 Color_251ACI
N050.04.24.925 E019.47.04.789 N050.04.25.147 E019.47.05.495 Color_251ACI
N050.04.25.757 E019.47.07.719 N050.04.25.973 E019.47.08.944 Color_251ACI
N050.04.32.108 E019.48.01.353 N050.04.32.447 E019.48.01.462 Color_251ACI
N050.04.31.714 E019.47.55.545 N050.04.31.446 E019.47.55.764 Color_251ACI
N050.04.32.675 E019.47.58.695 N050.04.32.329 E019.47.59.105 Color_251ACI
N050.04.22.615 E019.47.57.114 N050.04.22.679 E019.47.57.709 Color_251ACI
N050.04.22.679 E019.47.57.709 N050.04.22.853 E019.47.57.643 Color_251ACI
N050.04.22.901 E019.46.50.523 N050.04.22.692 E019.46.50.873 Color_251ACI
N050.04.22.692 E019.46.50.873 N050.04.21.182 E019.46.51.104 Color_251ACI
N050.04.21.182 E019.46.51.104 N050.04.21.311 E019.46.51.756 Color_251ACI
N050.04.27.526 E019.47.23.879 N050.04.28.617 E019.47.23.298 Color_18ACI
N050.04.28.617 E019.47.23.298 N050.04.28.202 E019.47.23.001 Color_18ACI
N050.04.28.202 E019.47.23.001 N050.04.27.616 E019.47.23.267 Color_18ACI
N050.04.27.616 E019.47.23.267 N050.04.27.221 E019.47.21.410 Color_18ACI
N050.04.27.221 E019.47.21.410 N050.04.27.817 E019.47.21.102 Color_18ACI
N050.04.27.817 E019.47.21.102 N050.04.28.202 E019.47.23.001 Color_18ACI
N050.04.28.202 E019.47.23.001 N050.04.28.617 E019.47.23.298 Color_18ACI
N050.04.28.617 E019.47.23.298 N050.04.28.177 E019.47.21.129 Color_18ACI
N050.04.28.177 E019.47.21.129 N050.04.28.067 E019.47.21.205 Color_18ACI
N050.04.28.067 E019.47.21.205 N050.04.27.951 E019.47.20.564 Color_18ACI
N050.04.27.951 E019.47.20.564 N050.04.26.816 E019.47.21.071 Color_18ACI
N050.04.26.816 E019.47.21.071 N050.04.27.246 E019.47.23.282 Color_18ACI
N050.04.27.246 E019.47.23.282 N050.04.27.357 E019.47.23.206 Color_18ACI
N050.04.27.357 E019.47.23.206 N050.04.27.526 E019.47.23.879 Color_18ACI
N050.04.24.073 E019.47.54.563 N050.04.22.678 E019.47.55.009 Color_18ACI
N050.04.22.678 E019.47.55.009 N050.04.22.723 E019.47.55.322 Color_18ACI
N050.04.22.723 E019.47.55.322 N050.04.22.559 E019.47.55.366 Color_18ACI
N050.04.22.559 E019.47.55.366 N050.04.22.695 E019.47.56.543 Color_18ACI
N050.04.22.695 E019.47.56.543 N050.04.24.444 E019.47.56.024 Color_18ACI
N050.04.24.444 E019.47.56.024 N050.04.24.291 E019.47.54.790 Color_18ACI
N050.04.24.291 E019.47.54.790 N050.04.24.101 E019.47.54.818 Color_18ACI
N050.04.24.101 E019.47.54.818 N050.04.24.073 E019.47.54.563 Color_18ACI
N050.04.24.842 E019.47.26.692 N050.04.25.149 E019.47.28.163 Color_18ACI
N050.04.25.149 E019.47.28.163 N050.04.24.791 E019.47.28.376 Color_18ACI
N050.04.24.791 E019.47.28.376 N050.04.24.457 E019.47.26.889 Color_18ACI
N050.04.24.457 E019.47.26.889 N050.04.24.842 E019.47.26.692 Color_18ACI
N050.04.21.400 E019.48.14.954 N050.04.20.644 E019.48.15.166 Color_18ACI
N050.04.20.644 E019.48.15.166 N050.04.20.638 E019.48.15.067 Color_18ACI
N050.04.20.638 E019.48.15.067 N050.04.20.310 E019.48.15.155 Color_18ACI
N050.04.20.310 E019.48.15.155 N050.04.20.479 E019.48.16.447 Color_18ACI
N050.04.20.479 E019.48.16.447 N050.04.20.780 E019.48.16.343 Color_18ACI
N050.04.20.780 E019.48.16.343 N050.04.20.786 E019.48.16.442 Color_18ACI
N050.04.20.786 E019.48.16.442 N050.04.21.589 E019.48.16.163 Color_18ACI
N050.04.21.589 E019.48.16.163 N050.04.21.400 E019.48.14.954 Color_18ACI
N050.04.22.740 E019.48.12.999 N050.04.21.071 E019.48.13.566 Color_18ACI
N050.04.21.071 E019.48.13.566 N050.04.20.949 E019.48.12.826 Color_18ACI
N050.04.20.949 E019.48.12.826 N050.04.21.203 E019.48.12.788 Color_18ACI
N050.04.21.203 E019.48.12.788 N050.04.20.980 E019.48.11.225 Color_18ACI
N050.04.20.980 E019.48.11.225 N050.04.22.184 E019.48.10.807 Color_18ACI
N050.04.22.184 E019.48.10.807 N050.04.22.407 E019.48.12.370 Color_18ACI
N050.04.22.407 E019.48.12.370 N050.04.22.645 E019.48.12.275 Color_18ACI
N050.04.22.645 E019.48.12.275 N050.04.22.740 E019.48.12.999 Color_18ACI
N050.04.21.406 E019.48.10.862 N050.04.20.101 E019.48.11.315 Color_18ACI
N050.04.20.101 E019.48.11.315 N050.04.20.034 E019.48.10.846 Color_18ACI
N050.04.20.034 E019.48.10.846 N050.04.21.064 E019.48.10.514 Color_18ACI
N050.04.21.064 E019.48.10.514 N050.04.21.026 E019.48.10.300 Color_18ACI
N050.04.21.026 E019.48.10.300 N050.04.21.290 E019.48.10.221 Color_18ACI
N050.04.21.290 E019.48.10.221 N050.04.21.406 E019.48.10.862 Color_18ACI
N050.04.20.914 E019.48.09.518 N050.04.19.910 E019.48.09.867 Color_18ACI
N050.04.19.910 E019.48.09.867 N050.04.19.849 E019.48.09.497 Color_18ACI
N050.04.19.849 E019.48.09.497 N050.04.20.842 E019.48.09.190 Color_18ACI
N050.04.20.842 E019.48.09.190 N050.04.20.914 E019.48.09.518 Color_18ACI
N050.04.21.463 E019.48.09.277 N050.04.22.509 E019.48.09.003 Color_18ACI
N050.04.22.509 E019.48.09.003 N050.04.22.553 E019.48.09.315 Color_18ACI
N050.04.22.553 E019.48.09.315 N050.04.21.507 E019.48.09.590 Color_18ACI
N050.04.21.507 E019.48.09.590 N050.04.21.463 E019.48.09.277 Color_18ACI
N050.04.22.468 E019.48.08.550 N050.04.21.506 E019.48.08.732 Color_18ACI
N050.04.21.506 E019.48.08.732 N050.04.21.439 E019.48.08.263 Color_18ACI
N050.04.21.439 E019.48.08.263 N050.04.21.793 E019.48.08.191 Color_18ACI
N050.04.21.793 E019.48.08.191 N050.04.21.726 E019.48.07.722 Color_18ACI
N050.04.21.726 E019.48.07.722 N050.04.22.381 E019.48.07.545 Color_18ACI
N050.04.22.381 E019.48.07.545 N050.04.22.468 E019.48.08.550 Color_18ACI
N050.04.20.783 E019.48.07.582 N050.04.19.716 E019.48.07.940 Color_18ACI
N050.04.19.716 E019.48.07.940 N050.04.19.773 E019.48.08.451 Color_18ACI
N050.04.19.773 E019.48.08.451 N050.04.20.201 E019.48.08.327 Color_18ACI
N050.04.20.201 E019.48.08.327 N050.04.20.284 E019.48.08.854 Color_18ACI
N050.04.20.284 E019.48.08.854 N050.04.20.395 E019.48.08.777 Color_18ACI
N050.04.20.395 E019.48.08.777 N050.04.20.328 E019.48.08.308 Color_18ACI
N050.04.20.328 E019.48.08.308 N050.04.20.555 E019.48.08.255 Color_18ACI
N050.04.20.555 E019.48.08.255 N050.04.20.587 E019.48.08.370 Color_18ACI
N050.04.20.587 E019.48.08.370 N050.04.20.878 E019.48.08.306 Color_18ACI
N050.04.20.878 E019.48.08.306 N050.04.20.783 E019.48.07.582 Color_18ACI
N050.04.18.643 E019.47.59.818 N050.04.19.438 E019.48.05.487 Color_18ACI
N050.04.19.438 E019.48.05.487 N050.04.19.886 E019.48.05.281 Color_18ACI
N050.04.19.886 E019.48.05.281 N050.04.19.915 E019.48.05.536 Color_18ACI
N050.04.19.915 E019.48.05.536 N050.04.20.380 E019.48.05.387 Color_18ACI
N050.04.20.380 E019.48.05.387 N050.04.20.325 E019.48.05.116 Color_18ACI
N050.04.20.325 E019.48.05.116 N050.04.20.789 E019.48.04.967 Color_18ACI
N050.04.20.789 E019.48.04.967 N050.04.20.924 E019.48.05.905 Color_18ACI
N050.04.20.924 E019.48.05.905 N050.04.21.124 E019.48.05.836 Color_18ACI
N050.04.21.124 E019.48.05.836 N050.04.20.602 E019.48.01.902 Color_18ACI
N050.04.20.602 E019.48.01.902 N050.04.20.338 E019.48.01.981 Color_18ACI
N050.04.20.338 E019.48.01.981 N050.04.20.180 E019.48.00.648 Color_18ACI
N050.04.20.180 E019.48.00.648 N050.04.21.421 E019.48.00.204 Color_18ACI
N050.04.21.421 E019.48.00.204 N050.04.21.268 E019.47.58.970 Color_18ACI
N050.04.21.268 E019.47.58.970 N050.04.20.001 E019.47.59.397 Color_18ACI
N050.04.20.001 E019.47.59.397 N050.04.19.985 E019.47.59.340 Color_18ACI
N050.04.19.985 E019.47.59.340 N050.04.19.082 E019.47.59.653 Color_18ACI
N050.04.19.082 E019.47.59.653 N050.04.19.037 E019.47.59.341 Color_18ACI
N050.04.19.037 E019.47.59.341 N050.04.18.736 E019.47.59.445 Color_18ACI
N050.04.18.736 E019.47.59.445 N050.04.18.781 E019.47.59.758 Color_18ACI
N050.04.18.781 E019.47.59.758 N050.04.18.643 E019.47.59.818 Color_18ACI
N050.04.22.067 E019.47.54.641 N050.04.21.491 E019.47.54.866 Color_18ACI
N050.04.21.491 E019.47.54.866 N050.04.21.412 E019.47.54.199 Color_18ACI
N050.04.21.412 E019.47.54.199 N050.04.22.004 E019.47.54.032 Color_18ACI
N050.04.22.004 E019.47.54.032 N050.04.22.067 E019.47.54.641 Color_18ACI
N050.04.21.638 E019.47.58.097 N050.04.21.526 E019.47.57.315 Color_18ACI
N050.04.21.526 E019.47.57.315 N050.04.21.352 E019.47.57.401 Color_18ACI
N050.04.21.352 E019.47.57.401 N050.04.21.447 E019.47.58.125 Color_18ACI
N050.04.21.447 E019.47.58.125 N050.04.21.638 E019.47.58.097 Color_18ACI
N050.04.21.065 E019.47.57.942 N050.04.20.674 E019.47.58.040 Color_18ACI
N050.04.20.674 E019.47.58.040 N050.04.20.692 E019.47.58.337 Color_18ACI
N050.04.20.692 E019.47.58.337 N050.04.21.120 E019.47.58.214 Color_18ACI
N050.04.21.120 E019.47.58.214 N050.04.21.065 E019.47.57.942 Color_18ACI
N050.04.21.532 E019.47.56.795 N050.04.21.264 E019.47.57.015 Color_18ACI
N050.04.21.264 E019.47.57.015 N050.04.21.074 E019.47.56.424 Color_18ACI
N050.04.21.074 E019.47.56.424 N050.04.21.369 E019.47.56.221 Color_18ACI
N050.04.21.369 E019.47.56.221 N050.04.21.532 E019.47.56.795 Color_18ACI
N050.04.26.023 E019.47.26.118 N050.04.26.441 E019.47.28.131 Color_18ACI
N050.04.26.441 E019.47.28.131 N050.04.25.982 E019.47.28.379 Color_18ACI
N050.04.25.982 E019.47.28.379 N050.04.25.911 E019.47.28.050 Color_18ACI
N050.04.25.911 E019.47.28.050 N050.04.26.085 E019.47.27.964 Color_18ACI
N050.04.26.085 E019.47.27.964 N050.04.25.712 E019.47.26.264 Color_18ACI
N050.04.25.712 E019.47.26.264 N050.04.26.023 E019.47.26.118 Color_18ACI
N050.04.24.578 E019.48.21.487 N050.04.24.644 E019.48.21.098 Color_18ACI
N050.04.24.644 E019.48.21.098 N050.04.24.867 E019.48.21.184 Color_18ACI
N050.04.24.867 E019.48.21.184 N050.04.24.902 E019.48.20.920 Color_18ACI
N050.04.24.902 E019.48.20.920 N050.04.24.994 E019.48.20.547 Color_18ACI
N050.04.24.994 E019.48.20.547 N050.04.25.060 E019.48.20.158 Color_18ACI
N050.04.25.060 E019.48.20.158 N050.04.25.492 E019.48.17.799 Color_18ACI
N050.04.25.492 E019.48.17.799 N050.04.26.311 E019.48.18.196 Color_18ACI
N050.04.26.311 E019.48.18.196 N050.04.25.658 E019.48.21.566 Color_18ACI
N050.04.25.658 E019.48.21.566 N050.04.26.450 E019.48.21.947 Color_18ACI
N050.04.26.450 E019.48.21.947 N050.04.27.109 E019.48.22.249 Color_18ACI
N050.04.27.109 E019.48.22.249 N050.04.27.761 E019.48.18.879 Color_18ACI
N050.04.27.761 E019.48.18.879 N050.04.28.579 E019.48.19.277 Color_18ACI
N050.04.28.579 E019.48.19.277 N050.04.27.927 E019.48.22.646 Color_18ACI
N050.04.27.927 E019.48.22.646 N050.04.28.017 E019.48.22.653 Color_18ACI
N050.04.28.017 E019.48.22.653 N050.04.27.951 E019.48.23.041 Color_18ACI
N050.04.27.951 E019.48.23.041 N050.04.24.578 E019.48.21.487 Color_18ACI
N050.04.25.435 E019.47.53.383 N050.04.25.677 E019.47.55.243 Color_18ACI
N050.04.25.677 E019.47.55.243 N050.04.25.978 E019.47.55.138 Color_18ACI
N050.04.25.978 E019.47.55.138 N050.04.25.709 E019.47.53.263 Color_18ACI
N050.04.25.709 E019.47.53.263 N050.04.25.435 E019.47.53.383 Color_18ACI
N050.04.24.994 E019.47.29.403 N050.04.25.616 E019.47.32.444 Color_18ACI
N050.04.25.616 E019.47.32.444 N050.04.27.156 E019.47.31.657 Color_18ACI
N050.04.27.156 E019.47.31.657 N050.04.26.561 E019.47.28.632 Color_18ACI
N050.04.26.561 E019.47.28.632 N050.04.24.994 E019.47.29.403 Color_18ACI
N050.04.27.207 E019.47.23.687 N050.04.26.621 E019.47.23.954 Color_18ACI
N050.04.26.621 E019.47.23.954 N050.04.26.666 E019.47.24.266 Color_18ACI
N050.04.26.666 E019.47.24.266 N050.04.27.278 E019.47.24.016 Color_18ACI
N050.04.27.278 E019.47.24.016 N050.04.27.207 E019.47.23.687 Color_18ACI
N050.04.25.851 E019.47.24.347 N050.04.25.667 E019.47.24.474 Color_18ACI
N050.04.25.667 E019.47.24.474 N050.04.25.722 E019.47.24.746 Color_18ACI
N050.04.25.722 E019.47.24.746 N050.04.25.896 E019.47.24.660 Color_18ACI
N050.04.25.896 E019.47.24.660 N050.04.25.851 E019.47.24.347 Color_18ACI
N050.04.24.359 E019.47.26.544 N050.04.24.390 E019.47.26.420 Color_18ACI
N050.04.24.390 E019.47.26.420 N050.04.24.443 E019.47.26.452 Color_18ACI
N050.04.24.443 E019.47.26.452 N050.04.24.603 E019.47.25.929 Color_18ACI
N050.04.24.603 E019.47.25.929 N050.04.24.736 E019.47.26.009 Color_18ACI
N050.04.24.736 E019.47.26.009 N050.04.24.592 E019.47.26.589 Color_18ACI
N050.04.24.592 E019.47.26.589 N050.04.24.619 E019.47.26.605 Color_18ACI
N050.04.24.619 E019.47.26.605 N050.04.24.598 E019.47.26.688 Color_18ACI
N050.04.24.598 E019.47.26.688 N050.04.24.359 E019.47.26.544 Color_18ACI
N050.04.23.686 E019.47.22.234 N050.04.23.946 E019.47.23.772 Color_18ACI
N050.04.23.946 E019.47.23.772 N050.04.23.809 E019.47.23.832 Color_18ACI
N050.04.23.809 E019.47.23.832 N050.04.23.548 E019.47.22.294 Color_18ACI
N050.04.23.548 E019.47.22.294 N050.04.23.686 E019.47.22.234 Color_18ACI
N050.04.26.035 E019.47.32.601 N050.04.26.497 E019.47.34.927 Color_18ACI
N050.04.26.497 E019.47.34.927 N050.04.26.983 E019.47.34.695 Color_18ACI
N050.04.26.983 E019.47.34.695 N050.04.26.917 E019.47.34.466 Color_18ACI
N050.04.26.917 E019.47.34.466 N050.04.27.714 E019.47.34.088 Color_18ACI
N050.04.27.714 E019.47.34.088 N050.04.27.516 E019.47.33.160 Color_18ACI
N050.04.27.516 E019.47.33.160 N050.04.27.379 E019.47.33.220 Color_18ACI
N050.04.27.379 E019.47.33.220 N050.04.27.253 E019.47.32.620 Color_18ACI
N050.04.27.253 E019.47.32.620 N050.04.27.179 E019.47.32.671 Color_18ACI
N050.04.27.179 E019.47.32.671 N050.04.27.026 E019.47.32.055 Color_18ACI
N050.04.27.026 E019.47.32.055 N050.04.26.557 E019.47.32.344 Color_18ACI
N050.04.26.557 E019.47.32.344 N050.04.26.486 E019.47.32.015 Color_18ACI
N050.04.26.486 E019.47.32.015 N050.04.26.285 E019.47.32.085 Color_18ACI
N050.04.26.285 E019.47.32.085 N050.04.26.346 E019.47.32.455 Color_18ACI
N050.04.26.346 E019.47.32.455 N050.04.26.035 E019.47.32.601 Color_18ACI
N050.04.28.156 E019.47.32.306 N050.04.28.567 E019.47.32.126 Color_18ACI
N050.04.28.567 E019.47.32.126 N050.04.28.689 E019.47.32.866 Color_18ACI
N050.04.28.689 E019.47.32.866 N050.04.28.278 E019.47.33.047 Color_18ACI
N050.04.28.278 E019.47.33.047 N050.04.28.156 E019.47.32.306 Color_18ACI
N050.04.22.484 E019.47.57.273 N050.04.22.311 E019.47.56.121 Color_18ACI
N050.04.22.311 E019.47.56.121 N050.04.21.920 E019.47.56.219 Color_18ACI
N050.04.21.920 E019.47.56.219 N050.04.21.999 E019.47.56.886 Color_18ACI
N050.04.21.999 E019.47.56.886 N050.04.22.200 E019.47.56.816 Color_18ACI
N050.04.22.200 E019.47.56.816 N050.04.22.283 E019.47.57.343 Color_18ACI
N050.04.22.283 E019.47.57.343 N050.04.22.484 E019.47.57.273 Color_18ACI
N050.04.21.046 E019.48.18.598 N050.04.21.277 E019.48.18.404 Color_18ACI
N050.04.21.277 E019.48.18.404 N050.04.21.326 E019.48.18.577 Color_18ACI
N050.04.21.326 E019.48.18.577 N050.04.21.484 E019.48.18.433 Color_18ACI
N050.04.21.484 E019.48.18.433 N050.04.21.539 E019.48.18.705 Color_18ACI
N050.04.21.539 E019.48.18.705 N050.04.21.641 E019.48.18.909 Color_18ACI
N050.04.21.641 E019.48.18.909 N050.04.21.743 E019.48.19.113 Color_18ACI
N050.04.21.743 E019.48.19.113 N050.04.21.882 E019.48.19.292 Color_18ACI
N050.04.21.882 E019.48.19.292 N050.04.21.995 E019.48.19.455 Color_18ACI
N050.04.21.995 E019.48.19.455 N050.04.22.101 E019.48.19.519 Color_18ACI
N050.04.22.101 E019.48.19.519 N050.04.22.171 E019.48.19.609 Color_18ACI
N050.04.22.171 E019.48.19.609 N050.04.22.224 E019.48.19.641 Color_18ACI
N050.04.22.224 E019.48.19.641 N050.04.22.320 E019.48.19.746 Color_18ACI
N050.04.22.320 E019.48.19.746 N050.04.22.373 E019.48.19.778 Color_18ACI
N050.04.22.373 E019.48.19.778 N050.04.22.463 E019.48.19.785 Color_18ACI
N050.04.22.463 E019.48.19.785 N050.04.22.418 E019.48.20.091 Color_18ACI
N050.04.22.418 E019.48.20.091 N050.04.22.614 E019.48.20.161 Color_18ACI
N050.04.22.614 E019.48.20.161 N050.04.22.670 E019.48.19.814 Color_18ACI
N050.04.22.670 E019.48.19.814 N050.04.23.266 E019.48.16.792 Color_18ACI
N050.04.23.266 E019.48.16.792 N050.04.24.068 E019.48.17.132 Color_18ACI
N050.04.24.068 E019.48.17.132 N050.04.23.433 E019.48.20.559 Color_18ACI
N050.04.23.433 E019.48.20.559 N050.04.23.629 E019.48.20.630 Color_18ACI
N050.04.23.629 E019.48.20.630 N050.04.23.563 E019.48.21.018 Color_18ACI
N050.04.23.563 E019.48.21.018 N050.04.23.101 E019.48.20.788 Color_18ACI
N050.04.23.101 E019.48.20.788 N050.04.22.336 E019.48.20.422 Color_18ACI
N050.04.22.336 E019.48.20.422 N050.04.22.246 E019.48.20.416 Color_18ACI
N050.04.22.246 E019.48.20.416 N050.04.22.113 E019.48.20.336 Color_18ACI
N050.04.22.113 E019.48.20.336 N050.04.21.990 E019.48.20.214 Color_18ACI
N050.04.21.990 E019.48.20.214 N050.04.21.894 E019.48.20.109 Color_18ACI
N050.04.21.894 E019.48.20.109 N050.04.21.787 E019.48.20.045 Color_18ACI
N050.04.21.787 E019.48.20.045 N050.04.21.675 E019.48.19.882 Color_18ACI
N050.04.21.675 E019.48.19.882 N050.04.21.552 E019.48.19.760 Color_18ACI
N050.04.21.552 E019.48.19.760 N050.04.21.467 E019.48.19.613 Color_18ACI
N050.04.21.467 E019.48.19.613 N050.04.21.338 E019.48.19.393 Color_18ACI
N050.04.21.338 E019.48.19.393 N050.04.21.262 E019.48.19.205 Color_18ACI
N050.04.21.262 E019.48.19.205 N050.04.21.160 E019.48.19.000 Color_18ACI
N050.04.21.160 E019.48.19.000 N050.04.21.095 E019.48.18.770 Color_18ACI
N050.04.21.095 E019.48.18.770 N050.04.21.046 E019.48.18.598 Color_18ACI
N050.04.24.644 E019.48.21.098 N050.04.23.629 E019.48.20.630 Color_18ACI
N050.04.23.629 E019.48.20.630 N050.04.23.563 E019.48.21.018 Color_18ACI
N050.04.23.563 E019.48.21.018 N050.04.24.578 E019.48.21.487 Color_18ACI
N050.04.24.578 E019.48.21.487 N050.04.24.644 E019.48.21.098 Color_18ACI
N050.04.21.734 E019.48.02.393 N050.04.21.421 E019.48.00.204 Color_18ACI
N050.04.21.421 E019.48.00.204 N050.04.20.180 E019.48.00.648 Color_18ACI
N050.04.20.180 E019.48.00.648 N050.04.20.338 E019.48.01.981 Color_18ACI
N050.04.20.338 E019.48.01.981 N050.04.20.714 E019.48.02.684 Color_18ACI
N050.04.20.714 E019.48.02.684 N050.04.21.734 E019.48.02.393 Color_18ACI
N050.04.22.913 E019.47.19.435 N050.04.23.165 E019.47.21.254 Color_18ACI
N050.04.23.165 E019.47.21.254 N050.04.23.566 E019.47.21.114 Color_18ACI
N050.04.23.566 E019.47.21.114 N050.04.23.304 E019.47.19.337 Color_18ACI
N050.04.23.304 E019.47.19.337 N050.04.22.913 E019.47.19.435 Color_18ACI
N050.04.16.897 E019.47.59.957 N050.04.17.726 E019.48.05.980 Color_18ACI
N050.04.17.726 E019.48.05.980 N050.04.15.967 E019.48.06.541 Color_18ACI
N050.04.15.967 E019.48.06.541 N050.04.15.128 E019.48.00.559 Color_18ACI
N050.04.15.128 E019.48.00.559 N050.04.16.897 E019.47.59.957 Color_18ACI
N050.04.22.411 E019.47.07.657 N050.04.22.648 E019.47.07.562 Color_18ACI
N050.04.22.648 E019.47.07.562 N050.04.22.599 E019.47.07.389 Color_18ACI
N050.04.22.599 E019.47.07.389 N050.04.23.091 E019.47.07.256 Color_18ACI
N050.04.23.091 E019.47.07.256 N050.04.23.113 E019.47.07.413 Color_18ACI
N050.04.23.113 E019.47.07.413 N050.04.23.314 E019.47.07.343 Color_18ACI
N050.04.23.314 E019.47.07.343 N050.04.23.732 E019.47.10.214 Color_18ACI
N050.04.23.732 E019.47.10.214 N050.04.22.829 E019.47.10.528 Color_18ACI
N050.04.22.829 E019.47.10.528 N050.04.22.411 E019.47.07.657 Color_18ACI
N050.04.26.437 E019.47.24.081 N050.04.26.508 E019.47.24.409 Color_18ACI
N050.04.26.508 E019.47.24.409 N050.04.26.655 E019.47.24.308 Color_18ACI
N050.04.26.655 E019.47.24.308 N050.04.26.600 E019.47.24.037 Color_18ACI
N050.04.26.600 E019.47.24.037 N050.04.26.437 E019.47.24.081 Color_18ACI
N050.04.25.503 E019.47.26.614 N050.04.25.596 E019.47.27.099 Color_18ACI
N050.04.25.596 E019.47.27.099 N050.04.25.396 E019.47.27.168 Color_18ACI
N050.04.25.396 E019.47.27.168 N050.04.25.292 E019.47.26.725 Color_18ACI
N050.04.25.292 E019.47.26.725 N050.04.25.503 E019.47.26.614 Color_18ACI
N050.04.27.514 E019.47.25.158 N050.04.26.992 E019.47.25.415 Color_18ACI
N050.04.26.992 E019.47.25.415 N050.04.27.047 E019.47.25.686 Color_18ACI
N050.04.27.047 E019.47.25.686 N050.04.27.158 E019.47.25.610 Color_18ACI
N050.04.27.158 E019.47.25.610 N050.04.27.152 E019.47.25.511 Color_18ACI
N050.04.27.152 E019.47.25.511 N050.04.27.563 E019.47.25.330 Color_18ACI
N050.04.27.563 E019.47.25.330 N050.04.27.514 E019.47.25.158 Color_18ACI
N050.04.26.965 E019.47.25.399 N050.04.27.010 E019.47.25.712 Color_18ACI
N050.04.27.010 E019.47.25.712 N050.04.26.900 E019.47.25.788 Color_18ACI
N050.04.26.900 E019.47.25.788 N050.04.26.828 E019.47.25.459 Color_18ACI
N050.04.26.828 E019.47.25.459 N050.04.26.965 E019.47.25.399 Color_18ACI
N050.04.27.671 E019.47.32.538 N050.04.28.082 E019.47.32.357 Color_18ACI
N050.04.28.082 E019.47.32.357 N050.04.28.241 E019.47.33.072 Color_18ACI
N050.04.28.241 E019.47.33.072 N050.04.27.829 E019.47.33.253 Color_18ACI
N050.04.27.829 E019.47.33.253 N050.04.27.671 E019.47.32.538 Color_18ACI
N050.04.34.746 E019.47.28.669 N050.04.34.598 E019.47.28.757 Color_44ACI
N050.04.34.598 E019.47.28.757 N050.04.34.468 E019.47.28.836 Color_44ACI
N050.04.34.468 E019.47.28.836 N050.04.34.330 E019.47.28.976 Color_44ACI
N050.04.34.330 E019.47.28.976 N050.04.34.225 E019.47.29.151 Color_44ACI
N050.04.34.225 E019.47.29.151 N050.04.34.127 E019.47.29.425 Color_44ACI
N050.04.34.127 E019.47.29.425 N050.04.34.028 E019.47.29.699 Color_44ACI
N050.04.34.028 E019.47.29.699 N050.04.34.020 E019.47.29.980 Color_44ACI
N050.04.34.020 E019.47.29.980 N050.04.34.038 E019.47.30.277 Color_44ACI
N050.04.28.677 E019.47.59.906 N050.04.28.791 E019.47.59.690 Color_44ACI
N050.04.28.791 E019.47.59.690 N050.04.28.880 E019.47.59.457 Color_44ACI
N050.04.28.880 E019.47.59.457 N050.04.28.915 E019.47.59.192 Color_44ACI
N050.04.28.915 E019.47.59.192 N050.04.28.950 E019.47.58.928 Color_44ACI
N050.04.28.950 E019.47.58.928 N050.04.28.932 E019.47.58.631 Color_44ACI
N050.04.28.932 E019.47.58.631 N050.04.28.903 E019.47.58.376 Color_44ACI
N050.04.28.903 E019.47.58.376 N050.04.28.822 E019.47.58.089 Color_44ACI
N050.04.28.822 E019.47.58.089 N050.04.28.693 E019.47.57.868 Color_44ACI
N050.04.28.703 E019.47.59.922 N050.04.28.517 E019.47.59.810 Color_44ACI
N050.04.28.517 E019.47.59.810 N050.04.28.378 E019.47.59.631 Color_44ACI
N050.04.28.378 E019.47.59.631 N050.04.28.249 E019.47.59.411 Color_44ACI
N050.04.28.249 E019.47.59.411 N050.04.28.158 E019.47.59.165 Color_44ACI
N050.04.28.158 E019.47.59.165 N050.04.28.092 E019.47.58.935 Color_44ACI
N050.04.28.092 E019.47.58.935 N050.04.28.048 E019.47.58.623 Color_44ACI
N050.04.28.048 E019.47.58.623 N050.04.28.083 E019.47.58.358 Color_44ACI
N050.04.28.083 E019.47.58.358 N050.04.28.091 E019.47.58.077 Color_44ACI
N050.04.28.677 E019.47.59.906 N050.04.29.146 E019.48.03.189 Color_44ACI
N050.04.26.177 E019.48.01.733 N050.04.26.043 E019.48.01.654 Color_44ACI
N050.04.26.043 E019.48.01.654 N050.04.25.926 E019.48.01.631 Color_44ACI
N050.04.25.926 E019.48.01.631 N050.04.25.809 E019.48.01.609 Color_44ACI
N050.04.25.809 E019.48.01.609 N050.04.25.656 E019.48.01.611 Color_44ACI
N050.04.25.656 E019.48.01.611 N050.04.25.545 E019.48.01.688 Color_44ACI
N050.04.25.545 E019.48.01.688 N050.04.25.435 E019.48.01.764 Color_44ACI
N050.04.25.435 E019.48.01.764 N050.04.25.340 E019.48.01.898 Color_44ACI
N050.04.25.340 E019.48.01.898 N050.04.25.263 E019.48.02.089 Color_44ACI
N050.04.26.177 E019.48.01.733 N050.04.26.071 E019.48.01.909 Color_44ACI
N050.04.26.071 E019.48.01.909 N050.04.25.987 E019.48.02.001 Color_44ACI
N050.04.25.987 E019.48.02.001 N050.04.25.866 E019.48.02.119 Color_44ACI
N050.04.25.866 E019.48.02.119 N050.04.25.756 E019.48.02.195 Color_44ACI
N050.04.25.756 E019.48.02.195 N050.04.25.602 E019.48.02.198 Color_44ACI
N050.04.25.602 E019.48.02.198 N050.04.25.486 E019.48.02.176 Color_44ACI
N050.04.25.486 E019.48.02.176 N050.04.25.369 E019.48.02.153 Color_44ACI
N050.04.25.369 E019.48.02.153 N050.04.25.246 E019.48.02.031 Color_44ACI
N050.04.25.525 E019.48.03.866 N050.04.25.592 E019.48.03.716 Color_44ACI
N050.04.25.592 E019.48.03.716 N050.04.25.713 E019.48.03.598 Color_44ACI
N050.04.25.713 E019.48.03.598 N050.04.25.808 E019.48.03.465 Color_44ACI
N050.04.25.808 E019.48.03.465 N050.04.25.945 E019.48.03.404 Color_44ACI
N050.04.25.945 E019.48.03.404 N050.04.26.061 E019.48.03.427 Color_44ACI
N050.04.26.061 E019.48.03.427 N050.04.26.188 E019.48.03.408 Color_44ACI
N050.04.26.188 E019.48.03.408 N050.04.26.295 E019.48.03.472 Color_44ACI
N050.04.26.295 E019.48.03.472 N050.04.26.428 E019.48.03.552 Color_44ACI
N050.04.25.777 E019.48.05.684 N050.04.25.844 E019.48.05.535 Color_44ACI
N050.04.25.844 E019.48.05.535 N050.04.25.965 E019.48.05.417 Color_44ACI
N050.04.25.965 E019.48.05.417 N050.04.26.049 E019.48.05.325 Color_44ACI
N050.04.26.049 E019.48.05.325 N050.04.26.187 E019.48.05.264 Color_44ACI
N050.04.26.187 E019.48.05.264 N050.04.26.313 E019.48.05.245 Color_44ACI
N050.04.26.313 E019.48.05.245 N050.04.26.430 E019.48.05.268 Color_44ACI
N050.04.26.430 E019.48.05.268 N050.04.26.547 E019.48.05.291 Color_44ACI
N050.04.26.547 E019.48.05.291 N050.04.26.680 E019.48.05.371 Color_44ACI
N050.04.25.525 E019.48.03.866 N050.04.25.631 E019.48.03.930 Color_44ACI
N050.04.25.631 E019.48.03.930 N050.04.25.764 E019.48.04.010 Color_44ACI
N050.04.25.764 E019.48.04.010 N050.04.25.881 E019.48.04.033 Color_44ACI
N050.04.25.881 E019.48.04.033 N050.04.26.008 E019.48.04.014 Color_44ACI
N050.04.26.008 E019.48.04.014 N050.04.26.145 E019.48.03.953 Color_44ACI
N050.04.26.145 E019.48.03.953 N050.04.26.239 E019.48.03.820 Color_44ACI
N050.04.26.239 E019.48.03.820 N050.04.26.323 E019.48.03.727 Color_44ACI
N050.04.26.323 E019.48.03.727 N050.04.26.428 E019.48.03.552 Color_44ACI
N050.04.25.777 E019.48.05.684 N050.04.25.899 E019.48.05.806 Color_44ACI
N050.04.25.899 E019.48.05.806 N050.04.26.016 E019.48.05.828 Color_44ACI
N050.04.26.016 E019.48.05.828 N050.04.26.133 E019.48.05.851 Color_44ACI
N050.04.26.133 E019.48.05.851 N050.04.26.260 E019.48.05.832 Color_44ACI
N050.04.26.260 E019.48.05.832 N050.04.26.397 E019.48.05.772 Color_44ACI
N050.04.26.397 E019.48.05.772 N050.04.26.481 E019.48.05.680 Color_44ACI
N050.04.26.481 E019.48.05.680 N050.04.26.602 E019.48.05.562 Color_44ACI
N050.04.26.602 E019.48.05.562 N050.04.26.680 E019.48.05.371 Color_44ACI
N050.04.26.176 E019.48.01.734 N050.04.27.443 E019.48.01.306 Color_44ACI
N050.04.26.428 E019.48.03.552 N050.04.27.668 E019.48.03.109 Color_44ACI
N050.04.26.680 E019.48.05.371 N050.04.27.947 E019.48.04.943 Color_44ACI
N050.04.24.917 E019.47.59.785 N050.04.23.850 E019.48.00.143 Color_44ACI
N050.04.24.236 E019.48.02.900 N050.04.24.298 E019.48.02.651 Color_44ACI
N050.04.24.298 E019.48.02.651 N050.04.24.402 E019.48.02.476 Color_44ACI
N050.04.24.402 E019.48.02.476 N050.04.24.534 E019.48.02.317 Color_44ACI
N050.04.24.534 E019.48.02.317 N050.04.24.655 E019.48.02.199 Color_44ACI
N050.04.24.655 E019.48.02.199 N050.04.24.802 E019.48.02.097 Color_44ACI
N050.04.24.802 E019.48.02.097 N050.04.24.966 E019.48.02.053 Color_44ACI
N050.04.24.966 E019.48.02.053 N050.04.25.119 E019.48.02.050 Color_44ACI
N050.04.25.119 E019.48.02.050 N050.04.25.279 E019.48.02.146 Color_44ACI
N050.04.25.374 E019.48.02.870 N050.04.25.270 E019.48.03.046 Color_44ACI
N050.04.25.270 E019.48.03.046 N050.04.25.122 E019.48.03.147 Color_44ACI
N050.04.25.122 E019.48.03.147 N050.04.24.948 E019.48.03.233 Color_44ACI
N050.04.24.948 E019.48.03.233 N050.04.24.795 E019.48.03.236 Color_44ACI
N050.04.24.795 E019.48.03.236 N050.04.24.651 E019.48.03.197 Color_44ACI
N050.04.24.651 E019.48.03.197 N050.04.24.508 E019.48.03.159 Color_44ACI
N050.04.24.508 E019.48.03.159 N050.04.24.359 E019.48.03.021 Color_44ACI
N050.04.24.359 E019.48.03.021 N050.04.24.236 E019.48.02.900 Color_44ACI
N050.04.25.675 E019.48.04.861 N050.04.25.505 E019.48.04.807 Color_44ACI
N050.04.25.505 E019.48.04.807 N050.04.25.362 E019.48.04.768 Color_44ACI
N050.04.25.362 E019.48.04.768 N050.04.25.198 E019.48.04.812 Color_44ACI
N050.04.25.198 E019.48.04.812 N050.04.25.024 E019.48.04.898 Color_44ACI
N050.04.25.024 E019.48.04.898 N050.04.24.903 E019.48.05.016 Color_44ACI
N050.04.24.903 E019.48.05.016 N050.04.24.762 E019.48.05.216 Color_44ACI
N050.04.24.762 E019.48.05.216 N050.04.24.684 E019.48.05.407 Color_44ACI
N050.04.24.684 E019.48.05.407 N050.04.24.633 E019.48.05.614 Color_44ACI
N050.04.25.760 E019.48.05.627 N050.04.25.629 E019.48.05.786 Color_44ACI
N050.04.25.629 E019.48.05.786 N050.04.25.508 E019.48.05.904 Color_44ACI
N050.04.25.508 E019.48.05.904 N050.04.25.345 E019.48.05.948 Color_44ACI
N050.04.25.345 E019.48.05.948 N050.04.25.181 E019.48.05.992 Color_44ACI
N050.04.25.181 E019.48.05.992 N050.04.25.038 E019.48.05.954 Color_44ACI
N050.04.25.038 E019.48.05.954 N050.04.24.868 E019.48.05.899 Color_44ACI
N050.04.24.868 E019.48.05.899 N050.04.24.745 E019.48.05.777 Color_44ACI
N050.04.24.745 E019.48.05.777 N050.04.24.633 E019.48.05.614 Color_44ACI
N050.04.23.850 E019.48.00.143 N050.04.23.949 E019.47.59.869 Color_44ACI
N050.04.23.949 E019.47.59.869 N050.04.24.100 E019.47.59.627 Color_44ACI
N050.04.24.100 E019.47.59.627 N050.04.24.295 E019.47.59.459 Color_44ACI
N050.04.24.295 E019.47.59.459 N050.04.24.506 E019.47.59.348 Color_44ACI
N050.04.24.506 E019.47.59.348 N050.04.24.723 E019.47.59.335 Color_44ACI
N050.04.24.723 E019.47.59.335 N050.04.24.919 E019.47.59.406 Color_44ACI
N050.04.24.919 E019.47.59.406 N050.04.25.122 E019.47.59.576 Color_44ACI
N050.04.25.122 E019.47.59.576 N050.04.25.250 E019.47.59.796 Color_44ACI
N050.04.23.850 E019.48.00.143 N050.04.22.218 E019.48.00.685 Color_44ACI
N050.04.22.974 E019.48.06.140 N050.04.24.633 E019.48.05.614 Color_44ACI
N050.04.22.615 E019.48.03.400 N050.04.24.236 E019.48.02.900 Color_44ACI
N050.04.25.108 E019.48.08.996 N050.04.23.476 E019.48.09.537 Color_44ACI
N050.04.25.494 E019.48.11.752 N050.04.23.846 E019.48.12.236 Color_44ACI
N050.04.25.098 E019.48.09.038 N050.04.25.160 E019.48.08.789 Color_44ACI
N050.04.25.160 E019.48.08.789 N050.04.25.274 E019.48.08.572 Color_44ACI
N050.04.25.274 E019.48.08.572 N050.04.25.395 E019.48.08.455 Color_44ACI
N050.04.25.395 E019.48.08.455 N050.04.25.526 E019.48.08.296 Color_44ACI
N050.04.25.526 E019.48.08.296 N050.04.25.664 E019.48.08.235 Color_44ACI
N050.04.25.664 E019.48.08.235 N050.04.25.827 E019.48.08.191 Color_44ACI
N050.04.25.827 E019.48.08.191 N050.04.26.008 E019.48.08.204 Color_44ACI
N050.04.26.008 E019.48.08.204 N050.04.26.151 E019.48.08.243 Color_44ACI
N050.04.26.263 E019.48.09.024 N050.04.26.131 E019.48.09.184 Color_44ACI
N050.04.26.131 E019.48.09.184 N050.04.25.984 E019.48.09.285 Color_44ACI
N050.04.25.984 E019.48.09.285 N050.04.25.810 E019.48.09.371 Color_44ACI
N050.04.25.810 E019.48.09.371 N050.04.25.656 E019.48.09.374 Color_44ACI
N050.04.25.656 E019.48.09.374 N050.04.25.503 E019.48.09.377 Color_44ACI
N050.04.25.503 E019.48.09.377 N050.04.25.370 E019.48.09.297 Color_44ACI
N050.04.25.370 E019.48.09.297 N050.04.25.210 E019.48.09.200 Color_44ACI
N050.04.25.210 E019.48.09.200 N050.04.25.098 E019.48.09.038 Color_44ACI
N050.04.26.537 E019.48.10.999 N050.04.26.377 E019.48.10.903 Color_44ACI
N050.04.26.377 E019.48.10.903 N050.04.26.197 E019.48.10.890 Color_44ACI
N050.04.26.197 E019.48.10.890 N050.04.26.070 E019.48.10.909 Color_44ACI
N050.04.26.070 E019.48.10.909 N050.04.25.896 E019.48.10.994 Color_44ACI
N050.04.25.896 E019.48.10.994 N050.04.25.765 E019.48.11.154 Color_44ACI
N050.04.25.765 E019.48.11.154 N050.04.25.634 E019.48.11.313 Color_44ACI
N050.04.25.634 E019.48.11.313 N050.04.25.556 E019.48.11.504 Color_44ACI
N050.04.25.556 E019.48.11.504 N050.04.25.468 E019.48.11.736 Color_44ACI
N050.04.25.494 E019.48.11.752 N050.04.25.607 E019.48.11.915 Color_44ACI
N050.04.25.607 E019.48.11.915 N050.04.25.740 E019.48.11.995 Color_44ACI
N050.04.25.740 E019.48.11.995 N050.04.25.899 E019.48.12.091 Color_44ACI
N050.04.25.899 E019.48.12.091 N050.04.26.079 E019.48.12.105 Color_44ACI
N050.04.26.079 E019.48.12.105 N050.04.26.233 E019.48.12.102 Color_44ACI
N050.04.26.233 E019.48.12.102 N050.04.26.380 E019.48.12.000 Color_44ACI
N050.04.26.380 E019.48.12.000 N050.04.26.501 E019.48.11.882 Color_44ACI
N050.04.26.501 E019.48.11.882 N050.04.26.632 E019.48.11.723 Color_44ACI
N050.04.26.528 E019.48.07.525 N050.04.26.442 E019.48.07.561 Color_44ACI
N050.04.26.442 E019.48.07.561 N050.04.26.344 E019.48.07.612 Color_44ACI
N050.04.26.344 E019.48.07.612 N050.04.26.262 E019.48.07.709 Color_44ACI
N050.04.26.262 E019.48.07.709 N050.04.26.170 E019.48.07.921 Color_44ACI
N050.04.26.170 E019.48.07.921 N050.04.26.144 E019.48.08.082 Color_44ACI
N050.04.26.144 E019.48.08.082 N050.04.26.157 E019.48.08.342 Color_44ACI
N050.04.26.542 E019.48.07.526 N050.04.26.452 E019.48.07.520 Color_44ACI
N050.04.26.452 E019.48.07.520 N050.04.26.362 E019.48.07.513 Color_44ACI
N050.04.26.362 E019.48.07.513 N050.04.26.272 E019.48.07.506 Color_44ACI
N050.04.26.272 E019.48.07.506 N050.04.26.192 E019.48.07.458 Color_44ACI
N050.04.26.192 E019.48.07.458 N050.04.26.123 E019.48.07.369 Color_44ACI
N050.04.26.123 E019.48.07.369 N050.04.26.053 E019.48.07.279 Color_44ACI
N050.04.26.053 E019.48.07.279 N050.04.26.005 E019.48.07.107 Color_44ACI
N050.04.26.005 E019.48.07.107 N050.04.25.972 E019.48.06.992 Color_44ACI
N050.04.26.460 E019.48.10.572 N050.04.26.508 E019.48.10.744 Color_44ACI
N050.04.26.508 E019.48.10.744 N050.04.26.541 E019.48.10.859 Color_44ACI
N050.04.26.541 E019.48.10.859 N050.04.26.611 E019.48.10.948 Color_44ACI
N050.04.26.611 E019.48.10.948 N050.04.26.670 E019.48.11.079 Color_44ACI
N050.04.26.670 E019.48.11.079 N050.04.26.856 E019.48.11.191 Color_44ACI
N050.04.26.856 E019.48.11.191 N050.04.26.956 E019.48.11.156 Color_44ACI
N050.04.26.956 E019.48.11.156 N050.04.27.046 E019.48.11.163 Color_44ACI
N050.04.27.046 E019.48.11.163 N050.04.26.973 E019.48.11.214 Color_44ACI
N050.04.26.973 E019.48.11.214 N050.04.26.899 E019.48.11.265 Color_44ACI
N050.04.26.899 E019.48.11.265 N050.04.26.815 E019.48.11.357 Color_44ACI
N050.04.26.815 E019.48.11.357 N050.04.26.747 E019.48.11.507 Color_44ACI
N050.04.26.747 E019.48.11.507 N050.04.26.675 E019.48.11.797 Color_44ACI
N050.04.26.675 E019.48.11.797 N050.04.26.671 E019.48.11.937 Color_44ACI
N050.04.26.671 E019.48.11.937 N050.04.26.693 E019.48.12.093 Color_44ACI
N050.04.27.046 E019.48.11.163 N050.04.28.140 E019.48.10.821 Color_44ACI
N050.04.26.542 E019.48.07.526 N050.04.27.630 E019.48.07.086 Color_44ACI
N050.04.24.917 E019.47.59.785 N050.04.25.081 E019.47.59.741 Color_44ACI
N050.04.25.081 E019.47.59.741 N050.04.25.202 E019.47.59.624 Color_44ACI
N050.04.25.202 E019.47.59.624 N050.04.25.286 E019.47.59.531 Color_44ACI
N050.04.25.286 E019.47.59.531 N050.04.25.485 E019.47.59.349 Color_44ACI
N050.04.33.288 E019.47.59.921 N050.04.33.216 E019.48.00.211 Color_44ACI
N050.04.33.216 E019.48.00.211 N050.04.33.128 E019.48.00.443 Color_44ACI
N050.04.33.128 E019.48.00.443 N050.04.32.986 E019.48.00.644 Color_44ACI
N050.04.32.986 E019.48.00.644 N050.04.32.743 E019.48.00.640 Color_44ACI
N050.04.32.743 E019.48.00.640 N050.04.32.524 E019.48.00.413 Color_44ACI
N050.04.32.524 E019.48.00.413 N050.04.32.516 E019.48.00.075 Color_44ACI
N050.04.32.516 E019.48.00.075 N050.04.32.697 E019.47.59.470 Color_44ACI
N050.04.32.697 E019.47.59.470 N050.04.33.312 E019.47.57.167 Color_44ACI
N050.04.26.450 E019.46.36.088 N050.04.24.849 E019.46.24.552 Color_44ACI
N050.04.24.849 E019.46.24.552 N050.04.23.266 E019.46.13.313 Color_44ACI
N050.04.33.903 E019.47.52.386 N050.04.35.026 E019.47.49.586 Color_44ACI
N050.04.35.026 E019.47.49.586 N050.04.35.707 E019.47.47.948 Color_44ACI
N050.04.35.707 E019.47.47.948 N050.04.35.857 E019.47.47.467 Color_44ACI
N050.04.35.857 E019.47.47.467 N050.04.36.060 E019.47.47.018 Color_44ACI
N050.04.36.060 E019.47.47.018 N050.04.36.111 E019.47.46.811 Color_44ACI
N050.04.36.111 E019.47.46.811 N050.04.36.173 E019.47.46.562 Color_44ACI
N050.04.36.173 E019.47.46.562 N050.04.36.208 E019.47.46.298 Color_44ACI
N050.04.36.208 E019.47.46.298 N050.04.36.216 E019.47.46.017 Color_44ACI
N050.04.36.216 E019.47.46.017 N050.04.36.193 E019.47.45.644 Color_44ACI
N050.04.42.719 E019.48.11.187 N050.04.42.876 E019.48.12.323 Color_44ACI
N050.04.42.571 E019.48.11.235 N050.04.42.729 E019.48.12.372 Color_44ACI
N050.04.42.850 E019.48.11.144 N050.04.42.895 E019.48.11.464 Color_44ACI
N050.04.42.956 E019.48.11.905 N050.04.43.007 E019.48.12.278 Color_44ACI
N050.04.39.185 E019.47.26.899 N050.04.39.258 E019.47.27.467 Color_44ACI
N050.04.39.422 E019.47.26.804 N050.04.39.461 E019.47.27.018 Color_44ACI
N050.04.39.473 E019.47.27.216 N050.04.39.522 E019.47.27.388 Color_44ACI
N050.04.29.105 E019.47.57.688 N050.04.29.807 E019.47.57.444 Color_44ACI
N050.04.29.807 E019.47.57.444 N050.04.31.011 E019.47.57.026 Color_44ACI
N050.04.34.343 E019.46.51.488 N050.04.34.333 E019.46.52.096 Color_44ACI
N050.04.27.945 E019.46.06.039 N050.04.28.111 E019.46.07.216 Color_44ACI
N050.04.28.081 E019.46.05.991 N050.04.28.138 E019.46.06.380 Color_44ACI
N050.04.28.182 E019.46.06.797 N050.04.28.235 E019.46.07.173 Color_44ACI
N050.04.39.295 E019.47.26.823 N050.04.39.385 E019.47.27.448 Color_44ACI
N050.04.36.077 E019.47.28.218 N050.04.37.006 E019.47.27.921 Color_44ACI
N050.04.37.006 E019.47.27.921 N050.04.38.210 E019.47.27.503 Color_44ACI
N050.04.38.210 E019.47.27.503 N050.04.39.176 E019.47.27.180 Color_44ACI
N050.04.39.559 E019.47.26.744 N050.04.39.571 E019.47.26.942 Color_44ACI
N050.04.39.610 E019.47.27.155 N050.04.39.622 E019.47.27.353 Color_44ACI
N050.04.34.198 E019.46.51.477 N050.04.34.180 E019.46.52.087 Color_44ACI
N050.04.31.263 E019.46.51.557 N050.04.33.011 E019.46.51.657 Color_44ACI
N050.04.33.011 E019.46.51.657 N050.04.34.144 E019.46.51.768 Color_44ACI
N050.04.34.470 E019.46.51.497 N050.04.34.468 E019.46.51.684 Color_44ACI
N050.04.34.461 E019.46.51.901 N050.04.34.456 E019.46.52.103 Color_44ACI
N050.04.34.587 E019.46.51.506 N050.04.34.581 E019.46.51.701 Color_44ACI
N050.04.34.584 E019.46.51.935 N050.04.34.583 E019.46.52.111 Color_44ACI
N050.04.34.631 E019.46.51.776 N050.04.35.315 E019.46.51.854 Color_44ACI
N050.04.35.315 E019.46.51.854 N050.04.35.982 E019.46.51.875 Color_44ACI
N050.04.27.806 E019.46.06.095 N050.04.27.978 E019.46.07.267 Color_44ACI
N050.04.28.208 E019.46.05.955 N050.04.28.263 E019.46.06.328 Color_44ACI
N050.04.28.321 E019.46.06.736 N050.04.28.375 E019.46.07.115 Color_44ACI
N050.04.25.388 E019.46.07.591 N050.04.26.702 E019.46.07.096 Color_44ACI
N050.04.26.702 E019.46.07.096 N050.04.27.304 E019.46.06.887 Color_44ACI
N050.04.27.304 E019.46.06.887 N050.04.27.843 E019.46.06.688 Color_44ACI
N050.04.42.963 E019.48.11.107 N050.04.43.008 E019.48.11.428 Color_44ACI
N050.04.43.068 E019.48.11.860 N050.04.43.121 E019.48.12.240 Color_44ACI
N050.04.36.133 E019.47.53.253 N050.04.37.220 E019.47.52.839 Color_44ACI
N050.04.36.133 E019.47.53.253 N050.04.35.785 E019.47.53.424 Color_44ACI
N050.04.35.785 E019.47.53.424 N050.04.35.646 E019.47.53.618 Color_44ACI
N050.04.35.646 E019.47.53.618 N050.04.35.569 E019.47.53.916 Color_44ACI
N050.04.35.569 E019.47.53.916 N050.04.35.662 E019.47.54.624 Color_44ACI
N050.04.45.129 E019.48.10.955 N050.04.43.122 E019.48.11.652 Color_44ACI
N050.04.42.594 E019.48.11.810 N050.04.42.066 E019.48.11.968 Color_44ACI
N050.04.42.066 E019.48.11.968 N050.04.41.662 E019.48.12.108 Color_44ACI
N050.04.39.732 E019.48.10.966 N050.04.39.848 E019.48.11.299 Color_44ACI
N050.04.39.848 E019.48.11.299 N050.04.39.967 E019.48.11.561 Color_44ACI
N050.04.39.967 E019.48.11.561 N050.04.40.149 E019.48.11.814 Color_44ACI
N050.04.40.149 E019.48.11.814 N050.04.40.314 E019.48.12.009 Color_44ACI
N050.04.40.314 E019.48.12.009 N050.04.40.517 E019.48.12.178 Color_44ACI
N050.04.40.517 E019.48.12.178 N050.04.40.740 E019.48.12.265 Color_44ACI
N050.04.40.740 E019.48.12.265 N050.04.41.057 E019.48.12.311 Color_44ACI
N050.04.39.732 E019.48.10.966 N050.04.39.758 E019.48.11.293 Color_44ACI
N050.04.39.758 E019.48.11.293 N050.04.39.729 E019.48.11.656 Color_44ACI
N050.04.39.729 E019.48.11.656 N050.04.39.684 E019.48.11.962 Color_44ACI
N050.04.39.684 E019.48.11.962 N050.04.39.575 E019.48.12.278 Color_44ACI
N050.04.39.575 E019.48.12.278 N050.04.39.450 E019.48.12.536 Color_44ACI
N050.04.39.450 E019.48.12.536 N050.04.39.272 E019.48.12.762 Color_44ACI
N050.04.39.272 E019.48.12.762 N050.04.39.077 E019.48.12.930 Color_44ACI
N050.04.39.077 E019.48.12.930 N050.04.38.866 E019.48.13.042 Color_44ACI
N050.04.24.667 E019.48.15.826 N050.04.26.209 E019.48.13.802 Color_44ACI
N050.04.27.006 E019.48.12.805 N050.04.26.954 E019.48.13.012 Color_44ACI
N050.04.26.954 E019.48.13.012 N050.04.26.903 E019.48.13.220 Color_44ACI
N050.04.26.903 E019.48.13.220 N050.04.26.835 E019.48.13.369 Color_44ACI
N050.04.26.835 E019.48.13.369 N050.04.26.731 E019.48.13.545 Color_44ACI
N050.04.26.731 E019.48.13.545 N050.04.26.610 E019.48.13.662 Color_44ACI
N050.04.26.610 E019.48.13.662 N050.04.26.499 E019.48.13.738 Color_44ACI
N050.04.26.499 E019.48.13.738 N050.04.26.362 E019.48.13.799 Color_44ACI
N050.04.26.362 E019.48.13.799 N050.04.26.209 E019.48.13.802 Color_44ACI
N050.04.26.996 E019.48.12.847 N050.04.26.879 E019.48.12.824 Color_44ACI
N050.04.26.879 E019.48.12.824 N050.04.26.742 E019.48.12.884 Color_44ACI
N050.04.26.742 E019.48.12.884 N050.04.26.621 E019.48.13.002 Color_44ACI
N050.04.26.621 E019.48.13.002 N050.04.26.500 E019.48.13.120 Color_44ACI
N050.04.26.500 E019.48.13.120 N050.04.26.406 E019.48.13.254 Color_44ACI
N050.04.26.406 E019.48.13.254 N050.04.26.328 E019.48.13.445 Color_44ACI
N050.04.26.328 E019.48.13.445 N050.04.26.260 E019.48.13.594 Color_44ACI
N050.04.26.260 E019.48.13.594 N050.04.26.209 E019.48.13.802 Color_44ACI
N050.04.26.693 E019.48.12.093 N050.04.26.769 E019.48.12.282 Color_44ACI
N050.04.26.769 E019.48.12.282 N050.04.26.818 E019.48.12.454 Color_44ACI
N050.04.26.818 E019.48.12.454 N050.04.26.893 E019.48.12.642 Color_44ACI
N050.04.26.893 E019.48.12.642 N050.04.26.990 E019.48.12.748 Color_44ACI
N050.04.26.990 E019.48.12.748 N050.04.27.075 E019.48.12.895 Color_44ACI
N050.04.27.075 E019.48.12.895 N050.04.27.198 E019.48.13.016 Color_44ACI
N050.04.27.198 E019.48.13.016 N050.04.27.294 E019.48.13.122 Color_44ACI
N050.04.27.294 E019.48.13.122 N050.04.27.427 E019.48.13.202 Color_44ACI
N050.04.32.419 E019.48.15.255 N050.04.32.255 E019.48.15.299 Color_44ACI
N050.04.32.255 E019.48.15.299 N050.04.32.065 E019.48.15.327 Color_44ACI
N050.04.32.065 E019.48.15.327 N050.04.31.975 E019.48.15.321 Color_44ACI
N050.04.31.975 E019.48.15.321 N050.04.31.699 E019.48.15.202 Color_44ACI
N050.04.28.774 E019.48.13.441 N050.04.25.727 E019.48.14.512 Color_44ACI
N050.04.25.727 E019.48.14.512 N050.04.24.232 E019.48.14.993 Color_44ACI
N050.04.29.053 E019.48.18.229 N050.04.29.533 E019.48.15.803 Color_44ACI
N050.04.27.799 E019.48.17.616 N050.04.28.268 E019.48.15.232 Color_44ACI
N050.04.27.427 E019.48.13.202 N050.04.27.449 E019.48.13.358 Color_44ACI
N050.04.27.449 E019.48.13.358 N050.04.27.461 E019.48.13.556 Color_44ACI
N050.04.27.461 E019.48.13.556 N050.04.27.444 E019.48.13.745 Color_44ACI
N050.04.27.444 E019.48.13.745 N050.04.27.433 E019.48.13.872 Color_44ACI
N050.04.27.433 E019.48.13.872 N050.04.27.391 E019.48.14.085 Color_44ACI
N050.04.27.391 E019.48.14.085 N050.04.27.324 E019.48.14.235 Color_44ACI
N050.04.27.324 E019.48.14.235 N050.04.27.266 E019.48.14.343 Color_44ACI
N050.04.27.266 E019.48.14.343 N050.04.27.172 E019.48.14.477 Color_44ACI
N050.04.27.427 E019.48.13.202 N050.04.27.306 E019.48.13.320 Color_44ACI
N050.04.27.306 E019.48.13.320 N050.04.27.212 E019.48.13.453 Color_44ACI
N050.04.27.212 E019.48.13.453 N050.04.27.134 E019.48.13.644 Color_44ACI
N050.04.27.134 E019.48.13.644 N050.04.27.083 E019.48.13.852 Color_44ACI
N050.04.27.083 E019.48.13.852 N050.04.27.031 E019.48.14.059 Color_44ACI
N050.04.27.031 E019.48.14.059 N050.04.27.033 E019.48.14.298 Color_44ACI
N050.04.27.033 E019.48.14.298 N050.04.27.055 E019.48.14.454 Color_44ACI
N050.04.27.055 E019.48.14.454 N050.04.27.121 E019.48.14.684 Color_44ACI
N050.04.28.548 E019.48.13.734 N050.04.28.624 E019.48.13.922 Color_44ACI
N050.04.28.624 E019.48.13.922 N050.04.28.636 E019.48.14.120 Color_44ACI
N050.04.28.636 E019.48.14.120 N050.04.28.638 E019.48.14.359 Color_44ACI
N050.04.28.638 E019.48.14.359 N050.04.28.586 E019.48.14.566 Color_44ACI
N050.04.28.586 E019.48.14.566 N050.04.28.535 E019.48.14.774 Color_44ACI
N050.04.28.535 E019.48.14.774 N050.04.28.494 E019.48.14.939 Color_44ACI
N050.04.28.494 E019.48.14.939 N050.04.28.363 E019.48.15.098 Color_44ACI
N050.04.28.363 E019.48.15.098 N050.04.28.268 E019.48.15.232 Color_44ACI
N050.04.28.575 E019.48.13.750 N050.04.28.454 E019.48.13.868 Color_44ACI
N050.04.28.454 E019.48.13.868 N050.04.28.360 E019.48.14.001 Color_44ACI
N050.04.28.360 E019.48.14.001 N050.04.28.282 E019.48.14.193 Color_44ACI
N050.04.28.282 E019.48.14.193 N050.04.28.230 E019.48.14.400 Color_44ACI
N050.04.28.230 E019.48.14.400 N050.04.28.179 E019.48.14.607 Color_44ACI
N050.04.28.179 E019.48.14.607 N050.04.28.181 E019.48.14.846 Color_44ACI
N050.04.28.181 E019.48.14.846 N050.04.28.219 E019.48.15.060 Color_44ACI
N050.04.28.219 E019.48.15.060 N050.04.28.268 E019.48.15.232 Color_44ACI
N050.04.29.839 E019.48.14.321 N050.04.29.878 E019.48.14.534 Color_44ACI
N050.04.29.878 E019.48.14.534 N050.04.29.916 E019.48.14.748 Color_44ACI
N050.04.29.916 E019.48.14.748 N050.04.29.928 E019.48.14.946 Color_44ACI
N050.04.29.928 E019.48.14.946 N050.04.29.877 E019.48.15.153 Color_44ACI
N050.04.29.877 E019.48.15.153 N050.04.29.826 E019.48.15.360 Color_44ACI
N050.04.29.826 E019.48.15.360 N050.04.29.748 E019.48.15.551 Color_44ACI
N050.04.29.748 E019.48.15.551 N050.04.29.653 E019.48.15.685 Color_44ACI
N050.04.29.653 E019.48.15.685 N050.04.29.533 E019.48.15.803 Color_44ACI
N050.04.29.839 E019.48.14.321 N050.04.29.708 E019.48.14.480 Color_44ACI
N050.04.29.708 E019.48.14.480 N050.04.29.614 E019.48.14.614 Color_44ACI
N050.04.29.614 E019.48.14.614 N050.04.29.536 E019.48.14.805 Color_44ACI
N050.04.29.536 E019.48.14.805 N050.04.29.495 E019.48.14.970 Color_44ACI
N050.04.29.495 E019.48.14.970 N050.04.29.443 E019.48.15.178 Color_44ACI
N050.04.29.443 E019.48.15.178 N050.04.29.455 E019.48.15.375 Color_44ACI
N050.04.29.455 E019.48.15.375 N050.04.29.484 E019.48.15.631 Color_44ACI
N050.04.29.484 E019.48.15.631 N050.04.29.533 E019.48.15.803 Color_44ACI
N050.04.36.889 E019.48.09.184 N050.04.37.291 E019.48.11.998 Color_44ACI
N050.04.35.622 E019.48.09.612 N050.04.36.024 E019.48.12.425 Color_44ACI
N050.04.34.354 E019.48.10.039 N050.04.34.757 E019.48.12.853 Color_44ACI
N050.04.37.291 E019.48.11.998 N050.04.37.240 E019.48.12.205 Color_44ACI
N050.04.37.240 E019.48.12.205 N050.04.37.215 E019.48.12.428 Color_44ACI
N050.04.37.215 E019.48.12.428 N050.04.37.201 E019.48.12.610 Color_44ACI
N050.04.37.201 E019.48.12.610 N050.04.37.239 E019.48.12.824 Color_44ACI
N050.04.37.239 E019.48.12.824 N050.04.37.278 E019.48.13.038 Color_44ACI
N050.04.37.278 E019.48.13.038 N050.04.37.327 E019.48.13.210 Color_44ACI
N050.04.37.327 E019.48.13.210 N050.04.37.402 E019.48.13.398 Color_44ACI
N050.04.37.402 E019.48.13.398 N050.04.37.525 E019.48.13.520 Color_44ACI
N050.04.37.291 E019.48.11.998 N050.04.37.414 E019.48.12.120 Color_44ACI
N050.04.37.414 E019.48.12.120 N050.04.37.489 E019.48.12.308 Color_44ACI
N050.04.37.489 E019.48.12.308 N050.04.37.565 E019.48.12.496 Color_44ACI
N050.04.37.565 E019.48.12.496 N050.04.37.641 E019.48.12.685 Color_44ACI
N050.04.37.641 E019.48.12.685 N050.04.37.653 E019.48.12.882 Color_44ACI
N050.04.37.653 E019.48.12.882 N050.04.37.628 E019.48.13.105 Color_44ACI
N050.04.37.628 E019.48.13.105 N050.04.37.613 E019.48.13.287 Color_44ACI
N050.04.37.613 E019.48.13.287 N050.04.37.562 E019.48.13.494 Color_44ACI
N050.04.36.024 E019.48.12.425 N050.04.36.147 E019.48.12.547 Color_44ACI
N050.04.36.147 E019.48.12.547 N050.04.36.249 E019.48.12.751 Color_44ACI
N050.04.36.249 E019.48.12.751 N050.04.36.298 E019.48.12.924 Color_44ACI
N050.04.36.298 E019.48.12.924 N050.04.36.363 E019.48.13.153 Color_44ACI
N050.04.36.363 E019.48.13.153 N050.04.36.375 E019.48.13.351 Color_44ACI
N050.04.36.375 E019.48.13.351 N050.04.36.350 E019.48.13.574 Color_44ACI
N050.04.36.350 E019.48.13.574 N050.04.36.299 E019.48.13.782 Color_44ACI
N050.04.36.299 E019.48.13.782 N050.04.36.248 E019.48.13.989 Color_44ACI
N050.04.36.024 E019.48.12.425 N050.04.35.921 E019.48.12.840 Color_44ACI
N050.04.35.921 E019.48.12.840 N050.04.35.923 E019.48.13.079 Color_44ACI
N050.04.35.923 E019.48.13.079 N050.04.35.935 E019.48.13.277 Color_44ACI
N050.04.35.935 E019.48.13.277 N050.04.35.974 E019.48.13.491 Color_44ACI
N050.04.35.974 E019.48.13.491 N050.04.36.049 E019.48.13.679 Color_44ACI
N050.04.36.049 E019.48.13.679 N050.04.36.135 E019.48.13.826 Color_44ACI
N050.04.36.135 E019.48.13.826 N050.04.36.221 E019.48.13.973 Color_44ACI
N050.04.34.757 E019.48.12.853 N050.04.34.842 E019.48.13.000 Color_44ACI
N050.04.34.842 E019.48.13.000 N050.04.34.955 E019.48.13.163 Color_44ACI
N050.04.34.955 E019.48.13.163 N050.04.35.030 E019.48.13.351 Color_44ACI
N050.04.35.030 E019.48.13.351 N050.04.35.069 E019.48.13.565 Color_44ACI
N050.04.35.069 E019.48.13.565 N050.04.35.081 E019.48.13.763 Color_44ACI
N050.04.35.081 E019.48.13.763 N050.04.35.083 E019.48.14.002 Color_44ACI
N050.04.35.083 E019.48.14.002 N050.04.35.032 E019.48.14.209 Color_44ACI
N050.04.35.032 E019.48.14.209 N050.04.34.954 E019.48.14.400 Color_44ACI
N050.04.34.757 E019.48.12.853 N050.04.34.679 E019.48.13.044 Color_44ACI
N050.04.34.679 E019.48.13.044 N050.04.34.644 E019.48.13.309 Color_44ACI
N050.04.34.644 E019.48.13.309 N050.04.34.629 E019.48.13.490 Color_44ACI
N050.04.34.629 E019.48.13.490 N050.04.34.631 E019.48.13.730 Color_44ACI
N050.04.34.631 E019.48.13.730 N050.04.34.680 E019.48.13.902 Color_44ACI
N050.04.34.680 E019.48.13.902 N050.04.34.755 E019.48.14.090 Color_44ACI
N050.04.34.755 E019.48.14.090 N050.04.34.858 E019.48.14.295 Color_44ACI
N050.04.34.858 E019.48.14.295 N050.04.34.954 E019.48.14.400 Color_44ACI
N050.04.31.967 E019.47.56.744 N050.04.32.067 E019.47.56.709 Color_44ACI
N050.04.32.067 E019.47.56.709 N050.04.32.194 E019.47.56.691 Color_44ACI
N050.04.32.194 E019.47.56.691 N050.04.32.321 E019.47.56.672 Color_44ACI
N050.04.32.321 E019.47.56.672 N050.04.32.438 E019.47.56.694 Color_44ACI
N050.04.32.438 E019.47.56.694 N050.04.32.554 E019.47.56.717 Color_44ACI
N050.04.32.554 E019.47.56.717 N050.04.32.697 E019.47.56.756 Color_44ACI
N050.04.32.697 E019.47.56.756 N050.04.32.804 E019.47.56.820 Color_44ACI
N050.04.32.804 E019.47.56.820 N050.04.32.910 E019.47.56.884 Color_44ACI
N050.04.35.970 E019.47.58.964 N050.04.36.023 E019.47.58.996 Color_44ACI
N050.04.36.023 E019.47.58.996 N050.04.36.076 E019.47.59.028 Color_44ACI
N050.04.36.076 E019.47.59.028 N050.04.36.156 E019.47.59.076 Color_44ACI
N050.04.36.156 E019.47.59.076 N050.04.36.336 E019.47.59.089 Color_44ACI
N050.04.36.336 E019.47.59.089 N050.04.36.400 E019.47.59.080 Color_44ACI
N050.04.36.400 E019.47.59.080 N050.04.36.653 E019.47.59.042 Color_44ACI
N050.04.36.653 E019.47.59.042 N050.04.36.928 E019.47.58.922 Color_44ACI
N050.04.36.928 E019.47.58.922 N050.04.37.170 E019.47.58.686 Color_44ACI
N050.04.37.170 E019.47.58.686 N050.04.37.385 E019.47.58.435 Color_44ACI
N050.04.37.385 E019.47.58.435 N050.04.37.557 E019.47.58.110 Color_44ACI
N050.04.37.557 E019.47.58.110 N050.04.37.686 E019.47.57.712 Color_44ACI
N050.04.37.686 E019.47.57.712 N050.04.37.752 E019.47.57.323 Color_44ACI
N050.04.37.752 E019.47.57.323 N050.04.37.781 E019.47.56.867 Color_44ACI
N050.04.36.400 E019.47.59.080 N050.04.36.993 E019.47.59.152 Color_44ACI
N050.04.36.993 E019.47.59.152 N050.04.37.200 E019.47.59.181 Color_44ACI
N050.04.37.200 E019.47.59.181 N050.04.37.396 E019.47.59.251 Color_44ACI
N050.04.37.396 E019.47.59.251 N050.04.37.582 E019.47.59.364 Color_44ACI
N050.04.37.582 E019.47.59.364 N050.04.37.732 E019.47.59.501 Color_44ACI
N050.04.37.732 E019.47.59.501 N050.04.37.924 E019.47.59.712 Color_44ACI
N050.04.37.924 E019.47.59.712 N050.04.38.052 E019.47.59.932 Color_44ACI
N050.04.38.052 E019.47.59.932 N050.04.38.171 E019.48.00.194 Color_44ACI
N050.04.38.171 E019.48.00.194 N050.04.38.290 E019.48.00.513 Color_44ACI
N050.04.29.613 E019.46.51.414 N050.04.29.425 E019.46.51.451 Color_44ACI
N050.04.29.425 E019.46.51.451 N050.04.29.277 E019.46.51.552 Color_44ACI
N050.04.29.277 E019.46.51.552 N050.04.29.146 E019.46.51.712 Color_44ACI
N050.04.29.146 E019.46.51.712 N050.04.29.025 E019.46.51.829 Color_44ACI
N050.04.29.025 E019.46.51.829 N050.04.28.937 E019.46.52.062 Color_44ACI
N050.04.28.937 E019.46.52.062 N050.04.28.886 E019.46.52.269 Color_44ACI
N050.04.28.886 E019.46.52.269 N050.04.28.824 E019.46.52.518 Color_44ACI
N050.04.28.824 E019.46.52.518 N050.04.28.816 E019.46.52.798 Color_44ACI
N050.04.37.393 E019.46.49.391 N050.04.37.370 E019.46.49.853 Color_44ACI
N050.04.37.370 E019.46.49.853 N050.04.37.267 E019.46.50.268 Color_44ACI
N050.04.37.267 E019.46.50.268 N050.04.37.138 E019.46.50.666 Color_44ACI
N050.04.37.138 E019.46.50.666 N050.04.36.982 E019.46.51.048 Color_44ACI
N050.04.36.982 E019.46.51.048 N050.04.36.756 E019.46.51.341 Color_44ACI
N050.04.36.756 E019.46.51.341 N050.04.36.514 E019.46.51.576 Color_44ACI
N050.04.36.514 E019.46.51.576 N050.04.36.256 E019.46.51.754 Color_44ACI
N050.04.36.256 E019.46.51.754 N050.04.35.982 E019.46.51.875 Color_44ACI
N050.04.35.982 E019.46.51.875 N050.04.36.729 E019.46.51.944 Color_44ACI
N050.04.36.729 E019.46.51.944 N050.04.36.925 E019.46.52.014 Color_44ACI
N050.04.36.925 E019.46.52.014 N050.04.37.112 E019.46.52.126 Color_44ACI
N050.04.37.112 E019.46.52.126 N050.04.37.287 E019.46.52.280 Color_44ACI
N050.04.37.287 E019.46.52.280 N050.04.37.453 E019.46.52.475 Color_44ACI
N050.04.37.453 E019.46.52.475 N050.04.37.592 E019.46.52.654 Color_44ACI
N050.04.37.592 E019.46.52.654 N050.04.37.721 E019.46.52.874 Color_44ACI
N050.04.37.721 E019.46.52.874 N050.04.37.849 E019.46.53.095 Color_44ACI
N050.04.37.849 E019.46.53.095 N050.04.37.941 E019.46.53.340 Color_44ACI
N050.04.29.411 E019.46.06.156 N050.04.29.702 E019.46.06.093 Color_44ACI
N050.04.29.702 E019.46.06.093 N050.04.29.972 E019.46.06.113 Color_44ACI
N050.04.29.972 E019.46.06.113 N050.04.30.089 E019.46.06.135 Color_44ACI
N050.04.30.089 E019.46.06.135 N050.04.30.232 E019.46.06.174 Color_44ACI
N050.04.30.232 E019.46.06.174 N050.04.30.348 E019.46.06.196 Color_44ACI
N050.04.30.348 E019.46.06.196 N050.04.30.481 E019.46.06.276 Color_44ACI
N050.04.29.411 E019.46.06.156 N050.04.28.307 E019.46.06.539 Color_44ACI
N050.04.23.266 E019.46.13.313 N050.04.23.087 E019.46.12.063 Color_44ACI
N050.04.23.087 E019.46.12.063 N050.04.22.934 E019.46.10.828 Color_44ACI
N050.04.22.934 E019.46.10.828 N050.04.22.873 E019.46.10.458 Color_44ACI
N050.04.22.873 E019.46.10.458 N050.04.22.855 E019.46.10.161 Color_44ACI
N050.04.23.783 E019.46.08.148 N050.04.24.321 E019.46.07.948 Color_44ACI
N050.04.24.321 E019.46.07.948 N050.04.25.388 E019.46.07.591 Color_44ACI
N050.04.22.855 E019.46.10.161 N050.04.22.847 E019.46.09.823 Color_44ACI
N050.04.22.847 E019.46.09.823 N050.04.22.893 E019.46.09.517 Color_44ACI
N050.04.22.893 E019.46.09.517 N050.04.22.975 E019.46.09.186 Color_44ACI
N050.04.22.975 E019.46.09.186 N050.04.23.074 E019.46.08.912 Color_44ACI
N050.04.23.074 E019.46.08.912 N050.04.23.236 E019.46.08.628 Color_44ACI
N050.04.23.236 E019.46.08.628 N050.04.23.377 E019.46.08.428 Color_44ACI
N050.04.23.377 E019.46.08.428 N050.04.23.572 E019.46.08.259 Color_44ACI
N050.04.23.572 E019.46.08.259 N050.04.23.783 E019.46.08.148 Color_44ACI
N050.04.39.631 E019.47.27.072 N050.04.41.099 E019.47.26.575 Color_44ACI
N050.04.42.273 E019.47.24.426 N050.04.42.218 E019.47.24.773 Color_44ACI
N050.04.42.218 E019.47.24.773 N050.04.42.125 E019.47.25.146 Color_44ACI
N050.04.42.125 E019.47.25.146 N050.04.42.017 E019.47.25.461 Color_44ACI
N050.04.42.017 E019.47.25.461 N050.04.41.881 E019.47.25.761 Color_44ACI
N050.04.41.881 E019.47.25.761 N050.04.41.693 E019.47.26.028 Color_44ACI
N050.04.41.693 E019.47.26.028 N050.04.41.514 E019.47.26.254 Color_44ACI
N050.04.41.514 E019.47.26.254 N050.04.41.320 E019.47.26.423 Color_44ACI
N050.04.41.320 E019.47.26.423 N050.04.41.099 E019.47.26.575 Color_44ACI
N050.04.41.099 E019.47.26.575 N050.04.41.326 E019.47.26.522 Color_44ACI
N050.04.41.326 E019.47.26.522 N050.04.41.549 E019.47.26.608 Color_44ACI
N050.04.41.549 E019.47.26.608 N050.04.41.782 E019.47.26.654 Color_44ACI
N050.04.41.782 E019.47.26.654 N050.04.41.995 E019.47.26.782 Color_44ACI
N050.04.41.995 E019.47.26.782 N050.04.42.197 E019.47.26.951 Color_44ACI
N050.04.42.197 E019.47.26.951 N050.04.42.389 E019.47.27.162 Color_44ACI
N050.04.42.389 E019.47.27.162 N050.04.42.534 E019.47.27.440 Color_44ACI
N050.04.42.534 E019.47.27.440 N050.04.42.679 E019.47.27.718 Color_44ACI
N050.04.48.274 E019.48.07.515 N050.04.48.281 E019.48.07.853 Color_44ACI
N050.04.48.281 E019.48.07.853 N050.04.48.226 E019.48.08.201 Color_44ACI
N050.04.48.226 E019.48.08.201 N050.04.48.154 E019.48.08.491 Color_44ACI
N050.04.48.154 E019.48.08.491 N050.04.48.082 E019.48.08.781 Color_44ACI
N050.04.48.082 E019.48.08.781 N050.04.47.973 E019.48.09.096 Color_44ACI
N050.04.47.973 E019.48.09.096 N050.04.47.875 E019.48.09.371 Color_44ACI
N050.04.47.875 E019.48.09.371 N050.04.47.723 E019.48.09.613 Color_44ACI
N050.04.47.723 E019.48.09.613 N050.04.47.571 E019.48.09.855 Color_44ACI
N050.04.47.571 E019.48.09.855 N050.04.47.487 E019.48.09.947 Color_44ACI
N050.04.47.487 E019.48.09.947 N050.04.47.403 E019.48.10.039 Color_44ACI
N050.04.47.403 E019.48.10.039 N050.04.47.319 E019.48.10.131 Color_44ACI
N050.04.47.319 E019.48.10.131 N050.04.47.246 E019.48.10.182 Color_44ACI
N050.04.47.246 E019.48.10.182 N050.04.47.135 E019.48.10.258 Color_44ACI
N050.04.47.135 E019.48.10.258 N050.04.47.061 E019.48.10.309 Color_44ACI
N050.04.47.061 E019.48.10.309 N050.04.46.961 E019.48.10.344 Color_44ACI
N050.04.46.961 E019.48.10.344 N050.04.46.861 E019.48.10.379 Color_44ACI
N050.04.46.861 E019.48.10.379 N050.04.45.129 E019.48.10.955 Color_44ACI
N050.04.34.415 E019.48.14.600 N050.04.32.419 E019.48.15.255 Color_44ACI
N050.04.30.290 E019.46.51.191 N050.04.30.287 E019.46.51.303 Color_44ACI
N050.04.30.284 E019.46.51.406 N050.04.30.280 E019.46.51.537 Color_44ACI
N050.04.30.277 E019.46.51.625 N050.04.30.272 E019.46.51.784 Color_44ACI
N050.04.30.270 E019.46.51.864 N050.04.30.266 E019.46.52.005 Color_44ACI
N050.04.28.625 E019.46.51.350 N050.04.30.219 E019.46.51.453 Color_44ACI
N050.04.30.336 E019.46.51.475 N050.04.31.263 E019.46.51.557 Color_44ACI
N050.04.28.643 E019.46.53.972 N050.04.28.722 E019.46.53.945 Color_44ACI
N050.04.28.782 E019.46.53.924 N050.04.28.882 E019.46.53.890 Color_44ACI
N050.04.28.945 E019.46.53.868 N050.04.29.022 E019.46.53.841 Color_44ACI
N050.04.29.083 E019.46.53.820 N050.04.29.146 E019.46.53.799 Color_44ACI
N050.04.29.207 E019.46.53.777 N050.04.29.284 E019.46.53.751 Color_44ACI
N050.04.27.863 E019.46.48.524 N050.04.27.941 E019.46.48.497 Color_44ACI
N050.04.28.002 E019.46.48.475 N050.04.28.103 E019.46.48.440 Color_44ACI
N050.04.28.164 E019.46.48.418 N050.04.28.242 E019.46.48.390 Color_44ACI
N050.04.28.302 E019.46.48.370 N050.04.28.389 E019.46.48.339 Color_44ACI
N050.04.28.427 E019.46.48.326 N050.04.28.527 E019.46.48.290 Color_44ACI
N050.04.28.816 E019.46.52.798 N050.04.28.216 E019.46.48.437 Color_44ACI
N050.04.28.210 E019.46.48.338 N050.04.26.450 E019.46.36.088 Color_44ACI
N050.04.31.231 E019.47.12.639 N050.04.31.309 E019.47.12.612 Color_44ACI
N050.04.31.369 E019.47.12.592 N050.04.31.469 E019.47.12.557 Color_44ACI
N050.04.31.533 E019.47.12.535 N050.04.31.610 E019.47.12.509 Color_44ACI
N050.04.31.672 E019.47.12.488 N050.04.31.757 E019.47.12.458 Color_44ACI
N050.04.31.797 E019.47.12.445 N050.04.31.895 E019.47.12.411 Color_44ACI
N050.04.33.384 E019.47.25.644 N050.04.32.488 E019.47.19.152 Color_44ACI
N050.04.32.488 E019.47.19.152 N050.04.31.575 E019.47.12.603 Color_44ACI
N050.04.33.891 E019.47.31.750 N050.04.33.988 E019.47.31.715 Color_44ACI
N050.04.34.040 E019.47.31.696 N050.04.34.135 E019.47.31.661 Color_44ACI
N050.04.34.184 E019.47.31.643 N050.04.34.285 E019.47.31.606 Color_44ACI
N050.04.34.346 E019.47.31.584 N050.04.34.420 E019.47.31.557 Color_44ACI
N050.04.34.476 E019.47.31.537 N050.04.34.554 E019.47.31.509 Color_44ACI
N050.04.35.637 E019.47.44.235 N050.04.35.728 E019.47.44.201 Color_44ACI
N050.04.35.795 E019.47.44.176 N050.04.35.884 E019.47.44.142 Color_44ACI
N050.04.35.935 E019.47.44.123 N050.04.36.022 E019.47.44.090 Color_44ACI
N050.04.36.073 E019.47.44.071 N050.04.36.160 E019.47.44.038 Color_44ACI
N050.04.36.227 E019.47.44.013 N050.04.36.318 E019.47.43.979 Color_44ACI
N050.04.37.235 E019.47.55.616 N050.04.37.335 E019.47.55.582 Color_44ACI
N050.04.37.385 E019.47.55.564 N050.04.37.481 E019.47.55.531 Color_44ACI
N050.04.37.524 E019.47.55.516 N050.04.37.628 E019.47.55.480 Color_44ACI
N050.04.37.676 E019.47.55.464 N050.04.37.757 E019.47.55.436 Color_44ACI
N050.04.37.808 E019.47.55.418 N050.04.37.892 E019.47.55.389 Color_44ACI
N050.04.39.378 E019.48.10.840 N050.04.39.449 E019.48.10.813 Color_44ACI
N050.04.39.515 E019.48.10.789 N050.04.39.600 E019.48.10.758 Color_44ACI
N050.04.39.658 E019.48.10.736 N050.04.39.733 E019.48.10.708 Color_44ACI
N050.04.39.794 E019.48.10.686 N050.04.39.896 E019.48.10.649 Color_44ACI
N050.04.40.085 E019.48.10.579 N050.04.40.162 E019.48.10.550 Color_44ACI
N050.04.39.238 E019.48.10.892 N050.04.39.310 E019.48.10.865 Color_44ACI
N050.04.38.415 E019.48.12.528 N050.04.38.432 E019.48.12.657 Color_44ACI
N050.04.38.450 E019.48.12.780 N050.04.38.463 E019.48.12.879 Color_44ACI
N050.04.38.480 E019.48.12.999 N050.04.38.493 E019.48.13.096 Color_44ACI
N050.04.38.510 E019.48.13.216 N050.04.38.528 E019.48.13.344 Color_44ACI
N050.04.38.538 E019.48.13.416 N050.04.38.559 E019.48.13.566 Color_44ACI
N050.04.38.572 E019.48.13.659 N050.04.38.590 E019.48.13.788 Color_44ACI
N050.04.38.385 E019.48.12.313 N050.04.38.398 E019.48.12.407 Color_44ACI
N050.04.31.504 E019.47.56.331 N050.04.31.523 E019.47.56.469 Color_44ACI
N050.04.31.539 E019.47.56.588 N050.04.31.557 E019.47.56.721 Color_44ACI
N050.04.31.569 E019.47.56.815 N050.04.31.587 E019.47.56.947 Color_44ACI
N050.04.31.600 E019.47.57.041 N050.04.31.620 E019.47.57.193 Color_44ACI
N050.04.31.628 E019.47.57.253 N050.04.31.649 E019.47.57.410 Color_44ACI
N050.04.35.335 E019.47.28.196 N050.04.35.353 E019.47.28.324 Color_44ACI
N050.04.35.364 E019.47.28.403 N050.04.35.387 E019.47.28.559 Color_44ACI
N050.04.35.395 E019.47.28.619 N050.04.35.416 E019.47.28.769 Color_44ACI
N050.04.28.966 E019.46.53.794 N050.04.28.883 E019.46.53.267 Color_44ACI
N050.04.28.883 E019.46.53.267 N050.04.28.816 E019.46.52.798 Color_44ACI
N050.04.31.553 E019.47.12.447 N050.04.30.092 E019.47.01.948 Color_44ACI
N050.04.30.092 E019.47.01.948 N050.04.28.988 E019.46.53.950 Color_44ACI
N050.04.33.703 E019.47.27.932 N050.04.33.805 E019.47.28.136 Color_44ACI
N050.04.33.805 E019.47.28.136 N050.04.33.880 E019.47.28.324 Color_44ACI
N050.04.33.880 E019.47.28.324 N050.04.34.019 E019.47.28.503 Color_44ACI
N050.04.34.019 E019.47.28.503 N050.04.34.169 E019.47.28.641 Color_44ACI
N050.04.34.169 E019.47.28.641 N050.04.34.445 E019.47.28.760 Color_44ACI
N050.04.34.445 E019.47.28.760 N050.04.34.709 E019.47.28.681 Color_44ACI
N050.04.34.709 E019.47.28.681 N050.04.35.337 E019.47.28.488 Color_44ACI
N050.04.35.401 E019.47.28.478 N050.04.35.739 E019.47.28.348 Color_44ACI
N050.04.35.739 E019.47.28.348 N050.04.36.077 E019.47.28.218 Color_44ACI
N050.04.34.207 E019.47.31.569 N050.04.33.808 E019.47.28.615 Color_44ACI
N050.04.33.808 E019.47.28.615 N050.04.33.384 E019.47.25.644 Color_44ACI
N050.04.35.263 E019.47.39.015 N050.04.34.906 E019.47.36.513 Color_44ACI
N050.04.34.906 E019.47.36.513 N050.04.34.581 E019.47.34.127 Color_44ACI
N050.04.34.581 E019.47.34.127 N050.04.34.239 E019.47.31.683 Color_44ACI
N050.04.35.979 E019.47.44.017 N050.04.35.621 E019.47.41.516 Color_44ACI
N050.04.35.621 E019.47.41.516 N050.04.35.263 E019.47.39.015 Color_44ACI
N050.04.37.182 E019.47.52.598 N050.04.36.517 E019.47.48.008 Color_44ACI
N050.04.36.517 E019.47.48.008 N050.04.36.147 E019.47.45.309 Color_44ACI
N050.04.36.147 E019.47.45.309 N050.04.36.074 E019.47.44.741 Color_44ACI
N050.04.36.074 E019.47.44.741 N050.04.36.001 E019.47.44.173 Color_44ACI
N050.04.37.584 E019.47.55.412 N050.04.37.383 E019.47.54.005 Color_44ACI
N050.04.37.383 E019.47.54.005 N050.04.37.182 E019.47.52.598 Color_44ACI
N050.04.39.102 E019.48.06.422 N050.04.38.620 E019.48.02.941 Color_44ACI
N050.04.38.620 E019.48.02.941 N050.04.38.295 E019.48.00.555 Color_44ACI
N050.04.38.295 E019.48.00.555 N050.04.37.993 E019.47.58.325 Color_44ACI
N050.04.37.993 E019.47.58.325 N050.04.37.663 E019.47.56.079 Color_44ACI
N050.04.37.663 E019.47.56.079 N050.04.37.635 E019.47.55.824 Color_44ACI
N050.04.37.635 E019.47.55.824 N050.04.37.607 E019.47.55.569 Color_44ACI
N050.04.39.679 E019.48.10.626 N050.04.39.500 E019.48.09.376 Color_44ACI
N050.04.39.500 E019.48.09.376 N050.04.39.321 E019.48.08.125 Color_44ACI
N050.04.39.321 E019.48.08.125 N050.04.39.203 E019.48.07.245 Color_44ACI
N050.04.39.203 E019.48.07.245 N050.04.39.102 E019.48.06.422 Color_44ACI
N050.04.39.732 E019.48.10.966 N050.04.39.701 E019.48.10.782 Color_44ACI
N050.04.28.774 E019.48.13.441 N050.04.28.853 E019.48.13.489 Color_44ACI
N050.04.28.853 E019.48.13.489 N050.04.28.976 E019.48.13.611 Color_44ACI
N050.04.28.976 E019.48.13.611 N050.04.29.046 E019.48.13.700 Color_44ACI
N050.04.29.046 E019.48.13.700 N050.04.29.115 E019.48.13.790 Color_44ACI
N050.04.29.115 E019.48.13.790 N050.04.29.158 E019.48.13.863 Color_44ACI
N050.04.29.158 E019.48.13.863 N050.04.29.201 E019.48.13.936 Color_44ACI
N050.04.29.201 E019.48.13.936 N050.04.29.233 E019.48.14.051 Color_44ACI
N050.04.27.427 E019.48.13.202 N050.04.28.575 E019.48.13.750 Color_44ACI
N050.04.28.575 E019.48.13.750 N050.04.29.260 E019.48.14.067 Color_44ACI
N050.04.29.260 E019.48.14.067 N050.04.29.839 E019.48.14.321 Color_44ACI
N050.04.29.839 E019.48.14.321 N050.04.31.699 E019.48.15.202 Color_44ACI
N050.04.26.616 E019.48.17.333 N050.04.27.121 E019.48.14.684 Color_44ACI
N050.04.27.121 E019.48.14.684 N050.04.27.172 E019.48.14.477 Color_44ACI
N050.04.29.105 E019.47.57.688 N050.04.27.626 E019.47.58.226 Color_44ACI
N050.04.27.626 E019.47.58.226 N050.04.26.121 E019.47.58.749 Color_44ACI
N050.04.26.121 E019.47.58.749 N050.04.25.874 E019.47.58.885 Color_44ACI
N050.04.25.874 E019.47.58.885 N050.04.25.632 E019.47.59.121 Color_44ACI
N050.04.25.632 E019.47.59.121 N050.04.25.433 E019.47.59.430 Color_44ACI
N050.04.25.433 E019.47.59.430 N050.04.25.250 E019.47.59.796 Color_44ACI
N050.04.25.250 E019.47.59.796 N050.04.25.179 E019.48.00.086 Color_44ACI
N050.04.25.179 E019.48.00.086 N050.04.25.123 E019.48.00.433 Color_44ACI
N050.04.25.123 E019.48.00.433 N050.04.25.121 E019.48.00.813 Color_44ACI
N050.04.25.121 E019.48.00.813 N050.04.25.128 E019.48.01.151 Color_44ACI
N050.04.25.128 E019.48.01.151 N050.04.25.340 E019.48.02.516 Color_44ACI
N050.04.25.340 E019.48.02.516 N050.04.25.525 E019.48.03.866 Color_44ACI
N050.04.25.525 E019.48.03.866 N050.04.25.827 E019.48.06.096 Color_44ACI
N050.04.25.827 E019.48.06.096 N050.04.26.157 E019.48.08.342 Color_44ACI
N050.04.26.157 E019.48.08.342 N050.04.26.269 E019.48.09.123 Color_44ACI
N050.04.26.269 E019.48.09.123 N050.04.26.354 E019.48.09.889 Color_44ACI
N050.04.26.354 E019.48.09.889 N050.04.26.415 E019.48.10.259 Color_44ACI
N050.04.26.415 E019.48.10.259 N050.04.26.553 E019.48.11.057 Color_44ACI
N050.04.26.553 E019.48.11.057 N050.04.26.665 E019.48.11.838 Color_44ACI
N050.04.26.665 E019.48.11.838 N050.04.26.693 E019.48.12.093 Color_44ACI
N050.04.31.011 E019.47.57.026 N050.04.31.502 E019.47.56.893 Color_44ACI
N050.04.31.629 E019.47.56.874 N050.04.31.893 E019.47.56.795 Color_44ACI
N050.04.31.893 E019.47.56.795 N050.04.32.077 E019.47.56.668 Color_44ACI
N050.04.32.077 E019.47.56.668 N050.04.32.229 E019.47.56.426 Color_44ACI
N050.04.32.229 E019.47.56.426 N050.04.32.391 E019.47.56.143 Color_44ACI
N050.04.32.391 E019.47.56.143 N050.04.32.557 E019.47.55.719 Color_44ACI
N050.04.32.557 E019.47.55.719 N050.04.32.713 E019.47.55.337 Color_44ACI
N050.04.32.713 E019.47.55.337 N050.04.33.327 E019.47.53.849 Color_44ACI
N050.04.33.327 E019.47.53.849 N050.04.33.903 E019.47.52.386 Color_44ACI
N050.04.41.665 E019.48.12.108 N050.04.38.866 E019.48.13.042 Color_44ACI
N050.04.38.866 E019.48.13.042 N050.04.38.528 E019.48.13.171 Color_44ACI
N050.04.38.428 E019.48.13.206 N050.04.37.525 E019.48.13.520 Color_44ACI
N050.04.37.525 E019.48.13.520 N050.04.36.221 E019.48.13.973 Color_44ACI
N050.04.36.221 E019.48.13.973 N050.04.34.954 E019.48.14.400 Color_44ACI
N050.04.34.954 E019.48.14.400 N050.04.34.415 E019.48.14.600 Color_44ACI
N050.04.32.910 E019.47.56.884 N050.04.34.900 E019.47.58.225 Color_44ACI
N050.04.34.900 E019.47.58.225 N050.04.35.970 E019.47.58.964 Color_44ACI
N050.04.39.935 E019.48.10.637 N050.04.40.036 E019.48.10.600 Color_44ACI
N050.04.46.902 E019.47.42.975 N050.04.49.273 E019.47.42.164 Color_88ACI
N050.04.49.273 E019.47.42.164 N050.04.35.539 E019.46.03.750 Color_88ACI
N050.04.35.539 E019.46.03.750 N050.04.33.168 E019.46.04.561 Color_88ACI
N050.04.33.168 E019.46.04.561 N050.04.46.902 E019.47.42.975 Color_88ACI
N050.04.32.080 E019.46.18.192 N050.04.30.810 E019.46.09.141 Color_251ACI
N050.04.30.786 E019.46.08.746 N050.04.30.288 E019.46.05.208 Color_251ACI
N050.04.30.288 E019.46.05.208 N050.04.32.184 E019.46.04.587 Color_251ACI
N050.04.32.184 E019.46.04.587 N050.04.49.679 E019.48.09.981 Color_251ACI
N050.04.49.679 E019.48.09.981 N050.04.47.800 E019.48.10.659 Color_251ACI
N050.04.47.800 E019.48.10.659 N050.04.47.292 E019.48.07.162 Color_251ACI
N050.04.47.279 E019.48.06.964 N050.04.42.035 E019.47.29.330 Color_251ACI
N050.04.42.035 E019.47.29.330 N050.04.41.257 E019.47.23.718 Color_251ACI
N050.04.41.257 E019.47.23.718 N050.04.38.516 E019.47.04.210 Color_251ACI
N050.04.38.516 E019.47.04.210 N050.04.38.392 E019.47.03.231 Color_251ACI
N050.04.38.392 E019.47.03.231 N050.04.37.173 E019.46.54.592 Color_251ACI
N050.04.37.093 E019.46.53.925 N050.04.36.338 E019.46.48.470 Color_251ACI
N050.04.36.338 E019.46.48.470 N050.04.32.690 E019.46.22.511 Color_251ACI
N050.04.32.690 E019.46.22.511 N050.04.32.080 E019.46.18.192 Color_251ACI
N050.04.37.093 E019.46.53.925 N050.04.37.173 E019.46.54.592 Color_251ACI
N050.04.30.786 E019.46.08.746 N050.04.30.808 E019.46.08.902 Color_251ACI
N050.04.30.808 E019.46.08.902 N050.04.30.810 E019.46.09.141 Color_251ACI


LOTNISKA_EPKK N000.00.00.000 E000.00.00.000 N000.00.00.000 E000.00.00.000
N050.04.26.441 E019.47.28.131 N050.04.26.353 E019.47.27.745 Color_251ACI
N050.04.25.574 E019.47.24.847 N050.04.25.590 E019.47.24.905 Color_251ACI
N050.04.25.590 E019.47.24.905 N050.04.25.590 E019.47.24.905 Color_251ACI
N050.04.25.590 E019.47.24.905 N050.04.25.617 E019.47.24.921 Color_251ACI
N050.04.25.617 E019.47.24.921 N050.04.25.723 E019.47.24.985 Color_251ACI
N050.04.25.722 E019.47.24.746 N050.04.25.723 E019.47.24.985 Color_251ACI
N050.04.25.896 E019.47.24.660 N050.04.26.024 E019.47.24.880 Color_251ACI
N050.04.26.024 E019.47.24.880 N050.04.27.312 E019.47.24.370 Color_251ACI
N050.04.27.312 E019.47.24.370 N050.04.27.650 E019.47.24.240 Color_251ACI
N050.04.27.650 E019.47.24.240 N050.04.28.572 E019.47.23.604 Color_251ACI
N050.04.28.617 E019.47.23.298 N050.04.28.634 E019.47.23.356 Color_251ACI
N050.04.28.634 E019.47.23.356 N050.04.28.623 E019.47.23.397 Color_251ACI
N050.04.28.623 E019.47.23.397 N050.04.28.613 E019.47.23.439 Color_251ACI
N050.04.28.613 E019.47.23.439 N050.04.28.592 E019.47.23.522 Color_251ACI
N050.04.28.592 E019.47.23.522 N050.04.28.582 E019.47.23.563 Color_251ACI
N050.04.28.582 E019.47.23.563 N050.04.28.582 E019.47.23.563 Color_251ACI
N050.04.26.023 E019.47.26.118 N050.04.26.107 E019.47.26.025 Color_251ACI
N050.04.26.107 E019.47.26.025 N050.04.26.165 E019.47.25.917 Color_251ACI
N050.04.26.165 E019.47.25.917 N050.04.26.206 E019.47.25.751 Color_251ACI
N050.04.26.206 E019.47.25.751 N050.04.26.183 E019.47.25.595 Color_251ACI
N050.04.26.183 E019.47.25.595 N050.04.26.124 E019.47.25.464 Color_251ACI
N050.04.26.124 E019.47.25.464 N050.04.26.055 E019.47.25.375 Color_251ACI
N050.04.26.055 E019.47.25.375 N050.04.25.948 E019.47.25.311 Color_251ACI
N050.04.25.948 E019.47.25.311 N050.04.25.848 E019.47.25.345 Color_251ACI
N050.04.24.842 E019.47.26.692 N050.04.24.732 E019.47.26.150 Color_251ACI
N050.04.24.732 E019.47.26.150 N050.04.24.593 E019.47.25.971 Color_251ACI
N050.04.24.593 E019.47.25.971 N050.04.24.486 E019.47.25.907 Color_251ACI
N050.04.24.486 E019.47.25.907 N050.04.24.396 E019.47.25.900 Color_251ACI
N050.04.23.519 E019.47.25.372 N050.04.23.562 E019.47.25.445 Color_251ACI
N050.04.23.562 E019.47.25.445 N050.04.23.605 E019.47.25.519 Color_251ACI
N050.04.23.605 E019.47.25.519 N050.04.23.647 E019.47.25.592 Color_251ACI
N050.04.23.647 E019.47.25.592 N050.04.23.834 E019.47.25.704 Color_251ACI
N050.04.23.834 E019.47.25.704 N050.04.23.913 E019.47.25.752 Color_251ACI
N050.04.23.913 E019.47.25.752 N050.04.23.977 E019.47.25.743 Color_251ACI
N050.04.46.902 E019.47.42.975 N050.04.49.273 E019.47.42.164 Color_251ACI
N050.04.49.273 E019.47.42.164 N050.04.35.539 E019.46.03.750 Color_251ACI
N050.04.35.539 E019.46.03.750 N050.04.33.168 E019.46.04.561 Color_251ACI
N050.04.33.168 E019.46.04.561 N050.04.46.902 E019.47.42.975 Color_251ACI
N050.04.32.080 E019.46.18.192 N050.04.30.810 E019.46.09.141 Color_251ACI
N050.04.30.810 E019.46.09.141 N050.04.30.808 E019.46.08.902 Color_251ACI
N050.04.30.808 E019.46.08.902 N050.04.30.786 E019.46.08.746 Color_251ACI
N050.04.30.786 E019.46.08.746 N050.04.30.288 E019.46.05.208 Color_251ACI
N050.04.30.288 E019.46.05.208 N050.04.32.184 E019.46.04.587 Color_251ACI
N050.04.32.184 E019.46.04.587 N050.04.49.679 E019.48.09.981 Color_251ACI
N050.04.49.679 E019.48.09.981 N050.04.47.800 E019.48.10.659 Color_251ACI
N050.04.47.800 E019.48.10.659 N050.04.47.292 E019.48.07.162 Color_251ACI
N050.04.47.292 E019.48.07.162 N050.04.47.279 E019.48.06.964 Color_251ACI
N050.04.47.279 E019.48.06.964 N050.04.42.035 E019.47.29.330 Color_251ACI
N050.04.42.035 E019.47.29.330 N050.04.41.257 E019.47.23.718 Color_251ACI
N050.04.41.257 E019.47.23.718 N050.04.38.516 E019.47.04.210 Color_251ACI
N050.04.38.516 E019.47.04.210 N050.04.38.392 E019.47.03.231 Color_251ACI
N050.04.38.392 E019.47.03.231 N050.04.37.173 E019.46.54.592 Color_251ACI
N050.04.37.173 E019.46.54.592 N050.04.37.093 E019.46.53.925 Color_251ACI
N050.04.37.093 E019.46.53.925 N050.04.36.338 E019.46.48.470 Color_251ACI
N050.04.36.338 E019.46.48.470 N050.04.32.690 E019.46.22.511 Color_251ACI
N050.04.32.690 E019.46.22.511 N050.04.32.080 E019.46.18.192 Color_251ACI
N050.04.18.202 E019.47.59.504 N050.04.18.370 E019.48.00.796 Color_251ACI
N050.04.18.370 E019.48.00.796 N050.04.18.771 E019.48.00.657 Color_251ACI
N050.04.21.879 E019.46.07.812 N050.04.23.798 E019.46.21.396 Color_251ACI
N050.04.32.855 E019.47.44.660 N050.04.35.316 E019.47.43.856 Color_251ACI
N050.04.22.178 E019.46.08.087 N050.04.30.288 E019.46.05.208 Color_251ACI
N050.04.22.178 E019.46.08.087 N050.04.23.863 E019.46.20.149 Color_251ACI
N050.04.23.863 E019.46.20.149 N050.04.23.798 E019.46.21.396 Color_251ACI
N050.04.27.809 E019.46.49.954 N050.04.28.037 E019.46.49.901 Color_251ACI
N050.04.28.037 E019.46.49.901 N050.04.24.344 E019.46.23.629 Color_251ACI
N050.04.24.344 E019.46.23.629 N050.04.24.243 E019.46.22.806 Color_251ACI
N050.04.24.243 E019.46.22.806 N050.04.24.188 E019.46.24.012 Color_251ACI
N050.04.34.315 E019.47.27.681 N050.04.33.856 E019.47.24.357 Color_251ACI
N050.04.34.470 E019.47.30.632 N050.04.34.628 E019.47.29.870 Color_251ACI
N050.04.34.628 E019.47.29.870 N050.04.34.936 E019.47.29.246 Color_251ACI
N050.04.34.936 E019.47.29.246 N050.04.35.546 E019.47.28.756 Color_251ACI
N050.04.35.546 E019.47.28.756 N050.04.40.060 E019.47.27.188 Color_251ACI
N050.04.40.060 E019.47.27.188 N050.04.40.844 E019.47.27.232 Color_251ACI
N050.04.40.844 E019.47.27.232 N050.04.41.666 E019.47.28.107 Color_251ACI
N050.04.41.666 E019.47.28.107 N050.04.42.035 E019.47.29.330 Color_251ACI
N050.04.33.937 E019.47.26.740 N050.04.33.618 E019.47.24.452 Color_251ACI
N050.04.36.238 E019.47.48.887 N050.04.35.782 E019.47.48.755 Color_251ACI
N050.04.35.782 E019.47.48.755 N050.04.32.991 E019.47.55.694 Color_251ACI
N050.04.32.991 E019.47.55.694 N050.04.33.177 E019.47.56.425 Color_251ACI
N050.04.33.177 E019.47.56.425 N050.04.35.422 E019.47.57.968 Color_251ACI
N050.04.35.422 E019.47.57.968 N050.04.36.349 E019.47.58.050 Color_251ACI
N050.04.36.349 E019.47.58.050 N050.04.37.073 E019.47.57.104 Color_251ACI
N050.04.37.073 E019.47.57.104 N050.04.37.216 E019.47.55.666 Color_251ACI
N050.04.37.216 E019.47.55.666 N050.04.36.600 E019.47.51.248 Color_251ACI
N050.04.36.600 E019.47.51.248 N050.04.36.238 E019.47.48.887 Color_251ACI
N050.04.47.292 E019.48.07.162 N050.04.47.056 E019.48.08.973 Color_251ACI
N050.04.47.056 E019.48.08.973 N050.04.46.075 E019.48.10.096 Color_251ACI
N050.04.46.075 E019.48.10.096 N050.04.41.555 E019.48.11.565 Color_251ACI
N050.04.41.555 E019.48.11.565 N050.04.40.542 E019.48.11.336 Color_251ACI
N050.04.40.542 E019.48.11.336 N050.04.39.993 E019.48.10.101 Color_251ACI
N050.04.29.479 E019.46.52.959 N050.04.31.147 E019.47.04.964 Color_251ACI
N050.04.31.360 E019.47.31.093 N050.04.31.401 E019.47.31.546 Color_251ACI
N050.04.31.401 E019.47.31.546 N050.04.31.777 E019.47.31.630 Color_251ACI
N050.04.31.777 E019.47.31.630 N050.04.32.318 E019.47.31.051 Color_251ACI
N050.04.32.318 E019.47.31.051 N050.04.32.455 E019.47.30.990 Color_251ACI
N050.04.32.455 E019.47.30.990 N050.04.32.443 E019.47.30.793 Color_251ACI
N050.04.32.443 E019.47.30.793 N050.04.32.670 E019.47.30.739 Color_251ACI
N050.04.32.670 E019.47.30.739 N050.04.32.693 E019.47.30.895 Color_251ACI
N050.04.32.693 E019.47.30.895 N050.04.32.793 E019.47.30.860 Color_251ACI
N050.04.32.793 E019.47.30.860 N050.04.33.520 E019.47.31.012 Color_251ACI
N050.04.32.017 E019.47.57.775 N050.04.29.994 E019.47.58.414 Color_251ACI
N050.04.29.933 E019.47.58.044 N050.04.29.994 E019.47.58.414 Color_251ACI
N050.04.19.481 E019.48.07.656 N050.04.19.609 E019.48.08.495 Color_251ACI
N050.04.19.609 E019.48.08.495 N050.04.19.615 E019.48.08.594 Color_251ACI
N050.04.19.615 E019.48.08.594 N050.04.19.631 E019.48.08.651 Color_251ACI
N050.04.19.631 E019.48.08.651 N050.04.19.754 E019.48.08.773 Color_251ACI
N050.04.19.754 E019.48.08.773 N050.04.19.723 E019.48.08.897 Color_251ACI
N050.04.19.723 E019.48.08.897 N050.04.19.694 E019.48.09.260 Color_251ACI
N050.04.19.694 E019.48.09.260 N050.04.19.700 E019.48.09.359 Color_251ACI
N050.04.19.700 E019.48.09.359 N050.04.19.729 E019.48.09.614 Color_251ACI
N050.04.19.729 E019.48.09.614 N050.04.19.757 E019.48.09.870 Color_251ACI
N050.04.19.757 E019.48.09.870 N050.04.19.910 E019.48.09.867 Color_251ACI
N050.04.36.441 E019.47.42.771 N050.04.34.628 E019.47.29.870 Color_251ACI
N050.04.25.018 E019.46.21.035 N050.04.24.781 E019.46.21.130 Color_251ACI
N050.04.24.781 E019.46.21.130 N050.04.28.896 E019.46.50.751 Color_251ACI
N050.04.30.741 E019.46.51.814 N050.04.29.944 E019.46.52.192 Color_251ACI
N050.04.29.257 E019.46.53.112 N050.04.29.479 E019.46.52.959 Color_251ACI
N050.04.29.257 E019.46.53.112 N050.04.33.618 E019.47.24.452 Color_251ACI
N050.04.29.944 E019.46.52.192 N050.04.29.479 E019.46.52.959 Color_251ACI
N050.04.30.741 E019.46.51.814 N050.04.32.711 E019.46.52.001 Color_251ACI
N050.04.32.711 E019.46.52.001 N050.04.34.639 E019.46.52.114 Color_251ACI
N050.04.34.639 E019.46.52.114 N050.04.35.439 E019.46.52.215 Color_251ACI
N050.04.35.439 E019.46.52.215 N050.04.35.869 E019.46.52.331 Color_251ACI
N050.04.35.869 E019.46.52.331 N050.04.36.299 E019.46.52.447 Color_251ACI
N050.04.36.299 E019.46.52.447 N050.04.36.577 E019.46.52.804 Color_251ACI
N050.04.36.577 E019.46.52.804 N050.04.36.775 E019.46.53.114 Color_251ACI
N050.04.36.775 E019.46.53.114 N050.04.37.093 E019.46.53.925 Color_251ACI
N050.04.39.993 E019.48.10.101 N050.04.37.318 E019.47.51.062 Color_251ACI
N050.04.37.318 E019.47.51.062 N050.04.36.323 E019.47.43.986 Color_251ACI
N050.04.36.323 E019.47.43.986 N050.04.34.470 E019.47.30.632 Color_251ACI
N050.04.47.279 E019.48.06.964 N050.04.46.848 E019.48.08.705 Color_251ACI
N050.04.46.848 E019.48.08.705 N050.04.45.987 E019.48.09.710 Color_251ACI
N050.04.45.987 E019.48.09.710 N050.04.41.520 E019.48.11.211 Color_251ACI
N050.04.41.520 E019.48.11.211 N050.04.40.804 E019.48.11.018 Color_251ACI
N050.04.40.804 E019.48.11.018 N050.04.40.671 E019.48.10.938 Color_251ACI
N050.04.40.671 E019.48.10.938 N050.04.40.240 E019.48.09.964 Color_251ACI
N050.04.40.240 E019.48.09.964 N050.04.38.601 E019.47.58.215 Color_251ACI
N050.04.38.601 E019.47.58.215 N050.04.37.560 E019.47.50.826 Color_251ACI
N050.04.37.560 E019.47.50.826 N050.04.36.453 E019.47.42.969 Color_251ACI
N050.04.30.810 E019.46.09.141 N050.04.29.972 E019.46.07.589 Color_251ACI
N050.04.29.972 E019.46.07.589 N050.04.28.880 E019.46.07.312 Color_251ACI
N050.04.28.880 E019.46.07.312 N050.04.24.265 E019.46.08.915 Color_251ACI
N050.04.24.265 E019.46.08.915 N050.04.23.720 E019.46.09.634 Color_251ACI
N050.04.23.720 E019.46.09.634 N050.04.23.591 E019.46.10.890 Color_251ACI
N050.04.23.591 E019.46.10.890 N050.04.24.537 E019.46.17.555 Color_251ACI
N050.04.24.537 E019.46.17.555 N050.04.28.732 E019.46.17.890 Color_251ACI
N050.04.28.732 E019.46.17.890 N050.04.28.698 E019.46.19.013 Color_251ACI
N050.04.28.698 E019.46.19.013 N050.04.29.154 E019.46.19.763 Color_251ACI
N050.04.29.154 E019.46.19.763 N050.04.31.135 E019.46.19.908 Color_251ACI
N050.04.31.135 E019.46.19.908 N050.04.31.856 E019.46.19.342 Color_251ACI
N050.04.31.856 E019.46.19.342 N050.04.32.080 E019.46.18.192 Color_251ACI
N050.04.18.128 E019.47.58.937 N050.04.18.161 E019.47.59.051 Color_251ACI
N050.04.18.161 E019.47.59.051 N050.04.18.853 E019.47.58.849 Color_251ACI
N050.04.25.202 E019.47.28.195 N050.04.25.335 E019.47.28.894 Color_251ACI
N050.04.24.817 E019.47.28.392 N050.04.24.976 E019.47.29.106 Color_251ACI
N050.04.18.937 E019.47.58.757 N050.04.18.980 E019.47.58.830 Color_251ACI
N050.04.18.980 E019.47.58.830 N050.04.19.138 E019.47.58.687 Color_251ACI
N050.04.19.138 E019.47.58.687 N050.04.19.089 E019.47.58.515 Color_251ACI
N050.04.19.089 E019.47.58.515 N050.04.19.771 E019.47.58.354 Color_251ACI
N050.04.19.771 E019.47.58.354 N050.04.19.815 E019.47.58.666 Color_251ACI
N050.04.19.815 E019.47.58.666 N050.04.21.463 E019.47.58.183 Color_251ACI
N050.04.21.463 E019.47.58.183 N050.04.21.627 E019.47.58.138 Color_251ACI
N050.04.39.566 E019.47.40.891 N050.04.39.967 E019.47.40.751 Color_251ACI
N050.04.39.967 E019.47.40.751 N050.04.40.089 E019.47.41.492 Color_251ACI
N050.04.40.089 E019.47.41.492 N050.04.39.661 E019.47.41.615 Color_251ACI
N050.04.39.661 E019.47.41.615 N050.04.39.566 E019.47.40.891 Color_251ACI
N050.04.35.539 E019.46.03.750 N050.04.49.273 E019.47.42.164 Color_251ACI
N050.04.49.273 E019.47.42.164 N050.04.46.902 E019.47.42.975 Color_251ACI
N050.04.46.902 E019.47.42.975 N050.04.33.168 E019.46.04.561 Color_251ACI
N050.04.33.168 E019.46.04.561 N050.04.35.539 E019.46.03.750 Color_251ACI
N050.04.28.856 E019.47.31.823 N050.04.28.969 E019.47.31.986 Color_251ACI
N050.04.32.827 E019.47.57.834 N050.04.32.748 E019.47.57.786 Color_251ACI
N050.04.32.748 E019.47.57.786 N050.04.32.557 E019.47.57.814 Color_251ACI
N050.04.32.557 E019.47.57.814 N050.04.32.017 E019.47.57.775 Color_251ACI
N050.04.36.553 E019.47.52.791 N050.04.36.336 E019.47.51.327 Color_251ACI
N050.04.36.336 E019.47.51.327 N050.04.36.161 E019.47.49.936 Color_251ACI
N050.04.36.161 E019.47.49.936 N050.04.36.035 E019.47.49.336 Color_251ACI
N050.04.36.035 E019.47.49.336 N050.04.36.019 E019.47.49.279 Color_251ACI
N050.04.36.019 E019.47.49.279 N050.04.35.976 E019.47.49.205 Color_251ACI
N050.04.35.976 E019.47.49.205 N050.04.35.939 E019.47.49.231 Color_251ACI
N050.04.35.939 E019.47.49.231 N050.04.35.929 E019.47.49.272 Color_251ACI
N050.04.26.766 E019.47.08.088 N050.04.26.407 E019.47.08.301 Color_251ACI
N050.04.26.407 E019.47.08.301 N050.04.26.360 E019.47.08.368 Color_251ACI
N050.04.26.360 E019.47.08.368 N050.04.26.323 E019.47.08.393 Color_251ACI
N050.04.26.323 E019.47.08.393 N050.04.26.276 E019.47.08.460 Color_251ACI
N050.04.26.276 E019.47.08.460 N050.04.26.256 E019.47.08.543 Color_251ACI
N050.04.26.256 E019.47.08.543 N050.04.26.245 E019.47.08.584 Color_251ACI
N050.04.26.245 E019.47.08.584 N050.04.26.225 E019.47.08.667 Color_251ACI
N050.04.26.225 E019.47.08.667 N050.04.26.204 E019.47.08.750 Color_251ACI
N050.04.26.204 E019.47.08.750 N050.04.26.210 E019.47.08.849 Color_251ACI
N050.04.26.210 E019.47.08.849 N050.04.26.245 E019.47.09.203 Color_251ACI
N050.04.26.054 E019.47.09.231 N050.04.25.973 E019.47.08.944 Color_251ACI
N050.04.25.963 E019.47.08.986 N050.04.25.946 E019.47.08.928 Color_251ACI
N050.04.25.946 E019.47.08.928 N050.04.25.903 E019.47.08.855 Color_251ACI
N050.04.25.903 E019.47.08.855 N050.04.25.797 E019.47.08.791 Color_251ACI
N050.04.25.797 E019.47.08.791 N050.04.25.734 E019.47.08.800 Color_251ACI
N050.04.25.734 E019.47.08.800 N050.04.25.707 E019.47.08.784 Color_251ACI
N050.04.25.707 E019.47.08.784 N050.04.25.644 E019.47.08.793 Color_251ACI
N050.04.25.644 E019.47.08.793 N050.04.25.607 E019.47.08.819 Color_251ACI
N050.04.27.909 E019.47.07.300 N050.04.30.116 E019.47.06.534 Color_251ACI
N050.04.31.320 E019.47.06.116 N050.04.38.142 E019.47.03.747 Color_251ACI
N050.04.38.356 E019.47.04.114 N050.04.31.344 E019.47.06.511 Color_251ACI
N050.04.30.140 E019.47.06.929 N050.04.28.033 E019.47.07.661 Color_251ACI
N050.04.38.142 E019.47.03.747 N050.04.38.178 E019.47.03.721 Color_251ACI
N050.04.38.178 E019.47.03.721 N050.04.38.252 E019.47.03.671 Color_251ACI
N050.04.38.252 E019.47.03.671 N050.04.38.289 E019.47.03.645 Color_251ACI
N050.04.38.289 E019.47.03.645 N050.04.38.310 E019.47.03.562 Color_251ACI
N050.04.38.310 E019.47.03.562 N050.04.38.371 E019.47.03.314 Color_251ACI
N050.04.38.371 E019.47.03.314 N050.04.38.392 E019.47.03.231 Color_251ACI
N050.04.26.705 E019.47.07.718 N050.04.26.154 E019.47.07.720 Color_251ACI
N050.04.26.705 E019.47.07.718 N050.04.27.116 E019.47.07.537 Color_251ACI
N050.04.26.766 E019.47.08.088 N050.04.26.940 E019.47.08.003 Color_251ACI
N050.04.38.356 E019.47.04.114 N050.04.38.393 E019.47.04.089 Color_251ACI
N050.04.38.393 E019.47.04.089 N050.04.38.446 E019.47.04.121 Color_251ACI
N050.04.38.446 E019.47.04.121 N050.04.38.456 E019.47.04.079 Color_251ACI
N050.04.38.456 E019.47.04.079 N050.04.38.483 E019.47.04.095 Color_251ACI
N050.04.38.483 E019.47.04.095 N050.04.38.499 E019.47.04.153 Color_251ACI
N050.04.38.499 E019.47.04.153 N050.04.38.499 E019.47.04.153 Color_251ACI
N050.04.38.499 E019.47.04.153 N050.04.38.516 E019.47.04.210 Color_251ACI
N050.04.19.797 E019.48.17.227 N050.04.19.813 E019.48.17.284 Color_251ACI
N050.04.19.813 E019.48.17.284 N050.04.19.840 E019.48.17.300 Color_251ACI
N050.04.19.840 E019.48.17.300 N050.04.19.876 E019.48.17.275 Color_251ACI
N050.04.19.876 E019.48.17.275 N050.04.19.903 E019.48.17.291 Color_251ACI
N050.04.19.903 E019.48.17.291 N050.04.19.934 E019.48.17.167 Color_251ACI
N050.04.14.841 E019.48.13.672 N050.04.14.804 E019.48.13.697 Color_251ACI
N050.04.14.804 E019.48.13.697 N050.04.14.763 E019.48.13.863 Color_251ACI
N050.04.14.763 E019.48.13.863 N050.04.14.779 E019.48.13.920 Color_251ACI
N050.04.18.736 E019.47.59.445 N050.04.18.736 E019.47.59.445 Color_251ACI
N050.04.31.175 E019.47.05.219 N050.04.31.320 E019.47.06.116 Color_251ACI
N050.04.31.344 E019.47.06.511 N050.04.33.856 E019.47.24.357 Color_251ACI
N050.04.28.084 E019.46.51.929 N050.04.30.116 E019.47.06.534 Color_251ACI
N050.04.30.140 E019.47.06.929 N050.04.32.501 E019.47.23.780 Color_251ACI
N050.04.32.690 E019.46.22.511 N050.04.32.408 E019.46.21.675 Color_251ACI
N050.04.32.408 E019.46.21.675 N050.04.31.783 E019.46.20.870 Color_251ACI
N050.04.31.783 E019.46.20.870 N050.04.31.267 E019.46.20.607 Color_251ACI
N050.04.31.267 E019.46.20.607 N050.04.28.566 E019.46.20.409 Color_251ACI
N050.04.28.566 E019.46.20.409 N050.04.25.864 E019.46.20.211 Color_251ACI
N050.04.25.864 E019.46.20.211 N050.04.25.117 E019.46.20.761 Color_251ACI
N050.04.25.117 E019.46.20.761 N050.04.25.018 E019.46.21.035 Color_251ACI
N050.04.25.018 E019.46.21.035 N050.04.29.170 E019.46.50.631 Color_251ACI
N050.04.38.347 E019.48.12.300 N050.04.38.795 E019.48.12.094 Color_251ACI
N050.04.38.795 E019.48.12.094 N050.04.38.843 E019.48.12.027 Color_251ACI
N050.04.38.843 E019.48.12.027 N050.04.38.916 E019.48.11.976 Color_251ACI
N050.04.38.916 E019.48.11.976 N050.04.38.963 E019.48.11.910 Color_251ACI
N050.04.38.963 E019.48.11.910 N050.04.39.011 E019.48.11.843 Color_251ACI
N050.04.39.011 E019.48.11.843 N050.04.39.058 E019.48.11.776 Color_251ACI
N050.04.39.058 E019.48.11.776 N050.04.39.078 E019.48.11.693 Color_251ACI
N050.04.39.078 E019.48.11.693 N050.04.39.130 E019.48.11.486 Color_251ACI
N050.04.36.553 E019.47.52.791 N050.04.36.316 E019.47.52.887 Color_251ACI
N050.04.36.316 E019.47.52.887 N050.04.36.087 E019.47.52.701 Color_251ACI
N050.04.36.087 E019.47.52.701 N050.04.36.171 E019.47.52.609 Color_251ACI
N050.04.36.171 E019.47.52.609 N050.04.36.142 E019.47.52.354 Color_251ACI
N050.04.36.142 E019.47.52.354 N050.04.35.999 E019.47.52.315 Color_251ACI
N050.04.35.999 E019.47.52.315 N050.04.35.832 E019.47.51.262 Color_251ACI
N050.04.35.832 E019.47.51.262 N050.04.35.953 E019.47.51.144 Color_251ACI
N050.04.35.953 E019.47.51.144 N050.04.35.915 E019.47.50.931 Color_251ACI
N050.04.35.915 E019.47.50.931 N050.04.35.808 E019.47.50.867 Color_251ACI
N050.04.35.808 E019.47.50.867 N050.04.36.028 E019.47.50.475 Color_251ACI
N050.04.36.028 E019.47.50.475 N050.04.35.971 E019.47.49.964 Color_251ACI
N050.04.35.971 E019.47.49.964 N050.04.35.891 E019.47.49.916 Color_251ACI
N050.04.35.891 E019.47.49.916 N050.04.35.709 E019.47.50.283 Color_251ACI
N050.04.35.709 E019.47.50.283 N050.04.35.122 E019.47.51.787 Color_251ACI
N050.04.35.122 E019.47.51.787 N050.04.35.347 E019.47.53.589 Color_251ACI
N050.04.35.347 E019.47.53.589 N050.04.35.504 E019.47.54.683 Color_251ACI
N050.04.35.504 E019.47.54.683 N050.04.35.650 E019.47.55.819 Color_251ACI
N050.04.35.650 E019.47.55.819 N050.04.35.873 E019.47.57.382 Color_251ACI
N050.04.35.873 E019.47.57.382 N050.04.36.137 E019.47.57.303 Color_251ACI
N050.04.36.137 E019.47.57.303 N050.04.36.359 E019.47.57.150 Color_251ACI
N050.04.36.359 E019.47.57.150 N050.04.36.693 E019.47.56.542 Color_251ACI
N050.04.36.693 E019.47.56.542 N050.04.36.698 E019.47.55.783 Color_251ACI
N050.04.36.698 E019.47.55.783 N050.04.36.485 E019.47.55.655 Color_251ACI
N050.04.36.485 E019.47.55.655 N050.04.36.579 E019.47.55.521 Color_251ACI
N050.04.36.579 E019.47.55.521 N050.04.36.541 E019.47.55.308 Color_251ACI
N050.04.36.541 E019.47.55.308 N050.04.36.397 E019.47.55.269 Color_251ACI
N050.04.36.397 E019.47.55.269 N050.04.36.267 E019.47.54.191 Color_251ACI
N050.04.36.267 E019.47.54.191 N050.04.36.388 E019.47.54.073 Color_251ACI
N050.04.36.388 E019.47.54.073 N050.04.36.360 E019.47.53.818 Color_251ACI
N050.04.36.360 E019.47.53.818 N050.04.36.243 E019.47.53.795 Color_251ACI
N050.04.36.243 E019.47.53.795 N050.04.36.426 E019.47.53.429 Color_251ACI
N050.04.36.426 E019.47.53.429 N050.04.36.626 E019.47.53.359 Color_251ACI
N050.04.19.771 E019.47.58.354 N050.04.20.626 E019.47.58.107 Color_251ACI
N050.04.20.626 E019.47.58.107 N050.04.21.282 E019.47.57.311 Color_251ACI
N050.04.21.282 E019.47.57.311 N050.04.20.917 E019.47.56.567 Color_251ACI
N050.04.20.917 E019.47.56.567 N050.04.21.132 E019.47.56.316 Color_251ACI
N050.04.21.366 E019.47.59.314 N050.04.22.724 E019.47.58.894 Color_251ACI
N050.04.19.457 E019.48.08.737 N050.04.19.485 E019.48.07.515 Color_251ACI
N050.04.19.485 E019.48.07.515 N050.04.19.473 E019.48.07.318 Color_251ACI
N050.04.19.473 E019.48.07.318 N050.04.19.567 E019.48.07.184 Color_251ACI
N050.04.19.567 E019.48.07.184 N050.04.20.159 E019.48.07.016 Color_251ACI
N050.04.20.159 E019.48.07.016 N050.04.20.114 E019.48.06.704 Color_251ACI
N050.04.19.739 E019.48.11.668 N050.04.19.727 E019.48.11.470 Color_251ACI
N050.04.19.727 E019.48.11.470 N050.04.19.457 E019.48.08.737 Color_251ACI
N050.04.19.418 E019.48.07.046 N050.04.20.137 E019.48.06.860 Color_251ACI
N050.04.21.879 E019.46.07.812 N050.04.28.237 E019.46.05.592 Color_251ACI
N050.04.28.237 E019.46.05.592 N050.04.28.675 E019.46.05.427 Color_251ACI
N050.04.30.786 E019.46.08.746 N050.04.30.102 E019.46.07.191 Color_251ACI
N050.04.30.102 E019.46.07.191 N050.04.28.845 E019.46.06.958 Color_251ACI
N050.04.28.845 E019.46.06.958 N050.04.24.157 E019.46.08.611 Color_251ACI
N050.04.24.157 E019.46.08.611 N050.04.23.517 E019.46.09.465 Color_251ACI
N050.04.23.517 E019.46.09.465 N050.04.23.354 E019.46.10.985 Color_251ACI
N050.04.23.354 E019.46.10.985 N050.04.24.272 E019.46.17.634 Color_251ACI
N050.04.24.272 E019.46.17.634 N050.04.24.537 E019.46.17.555 Color_251ACI
N050.04.25.147 E019.47.05.495 N050.04.25.757 E019.47.07.719 Color_251ACI
N050.04.34.666 E019.46.51.511 N050.04.35.168 E019.46.51.337 Color_251ACI
N050.04.35.168 E019.46.51.337 N050.04.35.643 E019.46.51.147 Color_251ACI
N050.04.35.643 E019.46.51.147 N050.04.36.264 E019.46.49.997 Color_251ACI
N050.04.36.264 E019.46.49.997 N050.04.36.338 E019.46.48.470 Color_251ACI
N050.04.34.666 E019.46.51.511 N050.04.29.984 E019.46.51.168 Color_251ACI
N050.04.23.347 E019.46.59.077 N050.04.24.811 E019.47.04.387 Color_251ACI
N050.04.24.811 E019.47.04.387 N050.04.24.925 E019.47.04.789 Color_251ACI
N050.04.28.084 E019.46.51.929 N050.04.27.589 E019.46.51.583 Color_251ACI
N050.04.27.589 E019.46.51.583 N050.04.24.734 E019.46.51.388 Color_251ACI
N050.04.24.734 E019.46.51.388 N050.04.24.162 E019.46.52.092 Color_251ACI
N050.04.24.162 E019.46.52.092 N050.04.23.952 E019.46.53.061 Color_251ACI
N050.04.23.952 E019.46.53.061 N050.04.27.909 E019.47.07.300 Color_251ACI
N050.04.31.175 E019.47.05.219 N050.04.33.229 E019.47.04.456 Color_251ACI
N050.04.33.229 E019.47.04.456 N050.04.33.309 E019.47.04.504 Color_251ACI
N050.04.33.309 E019.47.04.504 N050.04.33.388 E019.47.04.552 Color_251ACI
N050.04.33.388 E019.47.04.552 N050.04.33.513 E019.47.04.912 Color_251ACI
N050.04.33.513 E019.47.04.912 N050.04.33.761 E019.47.04.776 Color_251ACI
N050.04.33.761 E019.47.04.776 N050.04.33.653 E019.47.04.473 Color_251ACI
N050.04.33.653 E019.47.04.473 N050.04.34.074 E019.47.04.250 Color_251ACI
N050.04.34.074 E019.47.04.250 N050.04.33.864 E019.47.03.743 Color_251ACI
N050.04.33.864 E019.47.03.743 N050.04.33.553 E019.47.03.889 Color_251ACI
N050.04.33.553 E019.47.03.889 N050.04.33.120 E019.47.02.676 Color_251ACI
N050.04.33.120 E019.47.02.676 N050.04.32.979 E019.47.02.876 Color_251ACI
N050.04.32.979 E019.47.02.876 N050.04.33.277 E019.47.03.770 Color_251ACI
N050.04.33.277 E019.47.03.770 N050.04.33.283 E019.47.03.869 Color_251ACI
N050.04.33.283 E019.47.03.869 N050.04.33.268 E019.47.04.051 Color_251ACI
N050.04.33.268 E019.47.04.051 N050.04.33.237 E019.47.04.175 Color_251ACI
N050.04.33.237 E019.47.04.175 N050.04.33.164 E019.47.04.226 Color_251ACI
N050.04.33.164 E019.47.04.226 N050.04.31.147 E019.47.04.964 Color_251ACI
N050.04.37.093 E019.46.53.925 N050.04.37.173 E019.46.54.592 Color_251ACI
N050.04.37.173 E019.46.54.592 N050.04.38.392 E019.47.03.231 Color_251ACI
N050.04.20.645 E019.47.06.641 N050.04.20.662 E019.47.06.699 Color_251ACI
N050.04.20.662 E019.47.06.699 N050.04.20.678 E019.47.06.756 Color_251ACI
N050.04.20.678 E019.47.06.756 N050.04.20.705 E019.47.06.772 Color_251ACI
N050.04.20.705 E019.47.06.772 N050.04.20.747 E019.47.06.846 Color_251ACI
N050.04.20.747 E019.47.06.846 N050.04.20.774 E019.47.06.862 Color_251ACI
N050.04.20.774 E019.47.06.862 N050.04.20.827 E019.47.06.894 Color_251ACI
N050.04.20.827 E019.47.06.894 N050.04.20.854 E019.47.06.910 Color_251ACI
N050.04.20.854 E019.47.06.910 N050.04.20.917 E019.47.06.900 Color_251ACI
N050.04.22.451 E019.47.06.633 N050.04.22.488 E019.47.06.608 Color_251ACI
N050.04.22.488 E019.47.06.608 N050.04.22.514 E019.47.06.624 Color_251ACI
N050.04.22.514 E019.47.06.624 N050.04.22.504 E019.47.06.665 Color_251ACI
N050.04.22.504 E019.47.06.665 N050.04.22.520 E019.47.06.722 Color_251ACI
N050.04.27.116 E019.47.07.537 N050.04.27.153 E019.47.07.512 Color_251ACI
N050.04.27.153 E019.47.07.512 N050.04.27.200 E019.47.07.445 Color_251ACI
N050.04.27.200 E019.47.07.445 N050.04.27.258 E019.47.07.337 Color_251ACI
N050.04.27.258 E019.47.07.337 N050.04.27.299 E019.47.07.171 Color_251ACI
N050.04.27.299 E019.47.07.171 N050.04.27.293 E019.47.07.072 Color_251ACI
N050.04.27.293 E019.47.07.072 N050.04.27.297 E019.47.06.932 Color_251ACI
N050.04.27.297 E019.47.06.932 N050.04.27.281 E019.47.06.874 Color_251ACI
N050.04.26.940 E019.47.08.003 N050.04.27.358 E019.47.07.921 Color_251ACI
N050.04.27.358 E019.47.07.921 N050.04.27.490 E019.47.08.001 Color_251ACI
N050.04.27.490 E019.47.08.001 N050.04.27.544 E019.47.08.033 Color_251ACI
N050.04.27.544 E019.47.08.033 N050.04.27.570 E019.47.08.049 Color_251ACI
N050.04.27.570 E019.47.08.049 N050.04.27.613 E019.47.08.122 Color_251ACI
N050.04.27.613 E019.47.08.122 N050.04.27.629 E019.47.08.180 Color_251ACI
N050.04.27.629 E019.47.08.180 N050.04.27.672 E019.47.08.253 Color_251ACI
N050.04.27.727 E019.47.09.143 N050.04.27.248 E019.47.09.473 Color_251ACI
N050.04.27.248 E019.47.09.473 N050.04.27.323 E019.47.09.662 Color_251ACI
N050.04.27.323 E019.47.09.662 N050.04.26.965 E019.47.09.875 Color_251ACI
N050.04.26.965 E019.47.09.875 N050.04.26.808 E019.47.09.399 Color_251ACI
N050.04.26.808 E019.47.09.399 N050.04.27.645 E019.47.08.856 Color_251ACI
N050.04.27.645 E019.47.08.856 N050.04.27.748 E019.47.08.441 Color_251ACI
N050.04.27.748 E019.47.08.441 N050.04.27.672 E019.47.08.253 Color_251ACI
N050.04.28.619 E019.47.11.585 N050.04.28.512 E019.47.11.521 Color_251ACI
N050.04.28.512 E019.47.11.521 N050.04.27.959 E019.47.11.902 Color_251ACI
N050.04.27.959 E019.47.11.902 N050.04.27.868 E019.47.11.656 Color_251ACI
N050.04.27.868 E019.47.11.656 N050.04.28.447 E019.47.11.291 Color_251ACI
N050.04.28.447 E019.47.11.291 N050.04.28.488 E019.47.11.125 Color_251ACI
N050.04.28.545 E019.47.09.540 N050.04.28.625 E019.47.09.588 Color_251ACI
N050.04.28.625 E019.47.09.588 N050.04.29.204 E019.47.09.223 Color_251ACI
N050.04.29.204 E019.47.09.223 N050.04.29.286 E019.47.09.510 Color_251ACI
N050.04.29.286 E019.47.09.510 N050.04.28.680 E019.47.09.860 Color_251ACI
N050.04.28.680 E019.47.09.860 N050.04.28.676 E019.47.10.000 Color_251ACI
N050.04.28.741 E019.47.10.230 N050.04.28.980 E019.47.10.374 Color_251ACI
N050.04.28.980 E019.47.10.374 N050.04.29.459 E019.47.10.043 Color_251ACI
N050.04.29.459 E019.47.10.043 N050.04.29.568 E019.47.10.347 Color_251ACI
N050.04.29.568 E019.47.10.347 N050.04.29.078 E019.47.10.718 Color_251ACI
N050.04.29.078 E019.47.10.718 N050.04.28.975 E019.47.11.133 Color_251ACI
N050.04.29.041 E019.47.11.363 N050.04.29.120 E019.47.11.411 Color_251ACI
N050.04.29.120 E019.47.11.411 N050.04.29.737 E019.47.11.020 Color_251ACI
N050.04.29.737 E019.47.11.020 N050.04.29.792 E019.47.11.291 Color_251ACI
N050.04.29.792 E019.47.11.291 N050.04.29.212 E019.47.11.656 Color_251ACI
N050.04.29.212 E019.47.11.656 N050.04.29.181 E019.47.11.781 Color_251ACI
N050.04.28.033 E019.47.07.661 N050.04.28.545 E019.47.09.540 Color_251ACI
N050.04.28.676 E019.47.10.000 N050.04.28.741 E019.47.10.230 Color_251ACI
N050.04.28.975 E019.47.11.133 N050.04.29.041 E019.47.11.363 Color_251ACI
N050.04.29.279 E019.47.12.125 N050.04.29.359 E019.47.12.173 Color_251ACI
N050.04.29.359 E019.47.12.173 N050.04.29.939 E019.47.11.808 Color_251ACI
N050.04.29.939 E019.47.11.808 N050.04.30.020 E019.47.12.095 Color_251ACI
N050.04.30.020 E019.47.12.095 N050.04.29.414 E019.47.12.445 Color_251ACI
N050.04.29.414 E019.47.12.445 N050.04.29.383 E019.47.12.569 Color_251ACI
N050.04.29.481 E019.47.12.914 N050.04.29.561 E019.47.12.962 Color_251ACI
N050.04.29.561 E019.47.12.962 N050.04.30.177 E019.47.12.571 Color_251ACI
N050.04.30.177 E019.47.12.571 N050.04.30.232 E019.47.12.842 Color_251ACI
N050.04.30.232 E019.47.12.842 N050.04.29.653 E019.47.13.207 Color_251ACI
N050.04.29.653 E019.47.13.207 N050.04.29.601 E019.47.13.415 Color_251ACI
N050.04.29.181 E019.47.11.781 N050.04.29.279 E019.47.12.125 Color_251ACI
N050.04.29.383 E019.47.12.569 N050.04.29.481 E019.47.12.914 Color_251ACI
N050.04.29.824 E019.47.14.120 N050.04.31.037 E019.47.18.470 Color_251ACI
N050.04.31.037 E019.47.18.470 N050.04.32.501 E019.47.23.780 Color_251ACI
N050.04.22.440 E019.47.15.674 N050.04.22.429 E019.47.15.716 Color_251ACI
N050.04.22.429 E019.47.15.716 N050.04.22.429 E019.47.15.716 Color_251ACI
N050.04.22.429 E019.47.15.716 N050.04.22.456 E019.47.15.732 Color_251ACI
N050.04.22.456 E019.47.15.732 N050.04.22.536 E019.47.15.780 Color_251ACI
N050.04.24.054 E019.47.13.599 N050.04.23.975 E019.47.13.551 Color_251ACI
N050.04.23.975 E019.47.13.551 N050.04.23.973 E019.47.13.312 Color_251ACI
N050.04.23.342 E019.47.11.789 N050.04.23.242 E019.47.11.824 Color_251ACI
N050.04.23.558 E019.47.14.490 N050.04.24.128 E019.47.14.167 Color_251ACI
N050.04.24.035 E019.47.14.539 N050.04.23.677 E019.47.14.752 Color_251ACI
N050.04.28.886 E019.47.12.603 N050.04.28.793 E019.47.12.976 Color_251ACI
N050.04.28.793 E019.47.12.976 N050.04.27.972 E019.47.13.576 Color_251ACI
N050.04.27.972 E019.47.13.576 N050.04.28.054 E019.47.13.864 Color_251ACI
N050.04.28.054 E019.47.13.864 N050.04.28.891 E019.47.13.320 Color_251ACI
N050.04.28.891 E019.47.13.320 N050.04.29.098 E019.47.13.350 Color_251ACI
N050.04.29.098 E019.47.13.350 N050.04.28.852 E019.47.13.725 Color_251ACI
N050.04.28.852 E019.47.13.725 N050.04.27.683 E019.47.14.497 Color_251ACI
N050.04.27.683 E019.47.14.497 N050.04.27.322 E019.47.14.471 Color_251ACI
N050.04.27.322 E019.47.14.471 N050.04.27.153 E019.47.13.798 Color_251ACI
N050.04.27.153 E019.47.13.798 N050.04.27.356 E019.47.13.348 Color_251ACI
N050.04.27.356 E019.47.13.348 N050.04.28.536 E019.47.12.535 Color_251ACI
N050.04.28.536 E019.47.12.535 N050.04.28.886 E019.47.12.603 Color_251ACI
N050.04.29.424 E019.47.14.498 N050.04.29.283 E019.47.14.699 Color_251ACI
N050.04.29.283 E019.47.14.699 N050.04.28.814 E019.47.14.988 Color_251ACI
N050.04.28.814 E019.47.14.988 N050.04.28.836 E019.47.15.144 Color_251ACI
N050.04.28.836 E019.47.15.144 N050.04.28.869 E019.47.15.259 Color_251ACI
N050.04.28.869 E019.47.15.259 N050.04.29.364 E019.47.14.986 Color_251ACI
N050.04.29.364 E019.47.14.986 N050.04.29.528 E019.47.14.942 Color_251ACI
N050.04.29.693 E019.47.13.660 N050.04.29.789 E019.47.13.766 Color_251ACI
N050.04.29.789 E019.47.13.766 N050.04.30.379 E019.47.13.359 Color_251ACI
N050.04.30.379 E019.47.13.359 N050.04.30.461 E019.47.13.646 Color_251ACI
N050.04.30.461 E019.47.13.646 N050.04.29.855 E019.47.13.996 Color_251ACI
N050.04.29.855 E019.47.13.996 N050.04.29.824 E019.47.14.120 Color_251ACI
N050.04.29.601 E019.47.13.415 N050.04.29.693 E019.47.13.660 Color_251ACI
N050.04.30.491 E019.47.18.331 N050.04.30.278 E019.47.18.822 Color_251ACI
N050.04.30.278 E019.47.18.822 N050.04.29.946 E019.47.19.051 Color_251ACI
N050.04.29.946 E019.47.19.051 N050.04.29.931 E019.47.19.232 Color_251ACI
N050.04.30.475 E019.47.18.274 N050.04.30.491 E019.47.18.331 Color_251ACI
N050.04.29.931 E019.47.19.232 N050.04.29.120 E019.47.19.792 Color_251ACI
N050.04.29.120 E019.47.19.792 N050.04.28.791 E019.47.19.641 Color_251ACI
N050.04.28.791 E019.47.19.641 N050.04.28.628 E019.47.19.066 Color_251ACI
N050.04.28.628 E019.47.19.066 N050.04.28.841 E019.47.18.576 Color_251ACI
N050.04.28.841 E019.47.18.576 N050.04.30.010 E019.47.17.804 Color_251ACI
N050.04.30.010 E019.47.17.804 N050.04.30.360 E019.47.17.872 Color_251ACI
N050.04.29.238 E019.47.22.767 N050.04.29.119 E019.47.23.124 Color_251ACI
N050.04.29.119 E019.47.23.124 N050.04.28.877 E019.47.23.360 Color_251ACI
N050.04.28.877 E019.47.23.360 N050.04.28.814 E019.47.23.369 Color_251ACI
N050.04.28.814 E019.47.23.369 N050.04.28.787 E019.47.23.353 Color_251ACI
N050.04.28.787 E019.47.23.353 N050.04.28.754 E019.47.23.238 Color_251ACI
N050.04.28.754 E019.47.23.238 N050.04.28.683 E019.47.22.909 Color_251ACI
N050.04.28.683 E019.47.22.909 N050.04.28.376 E019.47.21.439 Color_251ACI
N050.04.28.376 E019.47.21.439 N050.04.28.380 E019.47.21.298 Color_251ACI
N050.04.28.380 E019.47.21.298 N050.04.28.437 E019.47.21.190 Color_251ACI
N050.04.28.437 E019.47.21.190 N050.04.28.658 E019.47.21.037 Color_251ACI
N050.04.28.658 E019.47.21.037 N050.04.28.748 E019.47.21.044 Color_251ACI
N050.04.28.049 E019.47.20.908 N050.04.28.212 E019.47.20.864 Color_251ACI
N050.04.28.212 E019.47.20.864 N050.04.28.308 E019.47.20.970 Color_251ACI
N050.04.28.308 E019.47.20.970 N050.04.28.388 E019.47.21.018 Color_251ACI
N050.04.28.388 E019.47.21.018 N050.04.28.452 E019.47.21.008 Color_251ACI
N050.04.28.452 E019.47.21.008 N050.04.28.626 E019.47.20.923 Color_251ACI
N050.04.28.626 E019.47.20.923 N050.04.28.683 E019.47.20.814 Color_251ACI
N050.04.26.054 E019.47.09.231 N050.04.26.067 E019.47.09.429 Color_251ACI
N050.04.26.067 E019.47.09.429 N050.04.26.175 E019.47.11.209 Color_251ACI
N050.04.26.175 E019.47.11.209 N050.04.26.087 E019.47.11.441 Color_251ACI
N050.04.26.087 E019.47.11.441 N050.04.26.915 E019.47.14.511 Color_251ACI
N050.04.26.915 E019.47.14.511 N050.04.28.683 E019.47.20.814 Color_251ACI
N050.04.28.748 E019.47.21.044 N050.04.29.238 E019.47.22.767 Color_251ACI
N050.04.28.084 E019.46.51.929 N050.04.28.295 E019.46.51.818 Color_251ACI
N050.04.28.295 E019.46.51.818 N050.04.32.975 E019.47.25.446 Color_251ACI
N050.04.32.975 E019.47.25.446 N050.04.32.975 E019.47.25.446 Color_251ACI
N050.04.32.975 E019.47.25.446 N050.04.32.501 E019.47.23.780 Color_251ACI
N050.04.25.323 E019.47.24.505 N050.04.25.427 E019.47.24.949 Color_251ACI
N050.04.25.427 E019.47.24.949 N050.04.25.416 E019.47.24.990 Color_251ACI
N050.04.25.416 E019.47.24.990 N050.04.25.433 E019.47.25.048 Color_251ACI
N050.04.25.433 E019.47.25.048 N050.04.25.422 E019.47.25.089 Color_251ACI
N050.04.25.422 E019.47.25.089 N050.04.25.386 E019.47.25.115 Color_251ACI
N050.04.25.386 E019.47.25.115 N050.04.25.375 E019.47.25.156 Color_251ACI
N050.04.25.375 E019.47.25.156 N050.04.25.338 E019.47.25.182 Color_251ACI
N050.04.25.338 E019.47.25.182 N050.04.25.338 E019.47.25.182 Color_251ACI
N050.04.25.338 E019.47.25.182 N050.04.24.124 E019.47.25.641 Color_251ACI
N050.04.24.124 E019.47.25.641 N050.04.23.977 E019.47.25.743 Color_251ACI
N050.04.23.921 E019.47.26.090 N050.04.24.396 E019.47.25.900 Color_251ACI
N050.04.25.062 E019.47.25.682 N050.04.25.848 E019.47.25.345 Color_251ACI
N050.04.25.396 E019.47.27.168 N050.04.24.974 E019.47.27.391 Color_251ACI
N050.04.25.503 E019.47.26.614 N050.04.25.464 E019.47.26.400 Color_251ACI
N050.04.25.464 E019.47.26.400 N050.04.25.053 E019.47.26.581 Color_251ACI
N050.04.25.053 E019.47.26.581 N050.04.24.943 E019.47.26.038 Color_251ACI
N050.04.24.943 E019.47.26.038 N050.04.25.062 E019.47.25.682 Color_251ACI
N050.04.27.514 E019.47.25.158 N050.04.27.476 E019.47.24.944 Color_251ACI
N050.04.27.476 E019.47.24.944 N050.04.27.584 E019.47.24.629 Color_251ACI
N050.04.27.584 E019.47.24.629 N050.04.28.000 E019.47.24.308 Color_251ACI
N050.04.28.000 E019.47.24.308 N050.04.28.197 E019.47.24.378 Color_251ACI
N050.04.28.197 E019.47.24.378 N050.04.28.256 E019.47.24.509 Color_251ACI
N050.04.28.256 E019.47.24.509 N050.04.28.331 E019.47.24.698 Color_251ACI
N050.04.28.331 E019.47.24.698 N050.04.28.397 E019.47.24.927 Color_251ACI
N050.04.28.397 E019.47.24.927 N050.04.28.376 E019.47.25.010 Color_251ACI
N050.04.28.376 E019.47.25.010 N050.04.28.202 E019.47.25.096 Color_251ACI
N050.04.28.202 E019.47.25.096 N050.04.28.294 E019.47.25.342 Color_251ACI
N050.04.28.294 E019.47.25.342 N050.04.28.009 E019.47.25.504 Color_251ACI
N050.04.26.681 E019.47.24.942 N050.04.26.845 E019.47.24.898 Color_251ACI
N050.04.26.845 E019.47.24.898 N050.04.26.828 E019.47.25.459 Color_251ACI
N050.04.26.501 E019.47.25.548 N050.04.26.495 E019.47.25.449 Color_251ACI
N050.04.26.495 E019.47.25.449 N050.04.26.489 E019.47.25.350 Color_251ACI
N050.04.26.489 E019.47.25.350 N050.04.26.509 E019.47.25.267 Color_251ACI
N050.04.26.509 E019.47.25.267 N050.04.26.550 E019.47.25.102 Color_251ACI
N050.04.26.550 E019.47.25.102 N050.04.26.597 E019.47.25.035 Color_251ACI
N050.04.26.597 E019.47.25.035 N050.04.26.645 E019.47.24.968 Color_251ACI
N050.04.26.645 E019.47.24.968 N050.04.26.681 E019.47.24.942 Color_251ACI
N050.04.25.439 E019.47.32.909 N050.04.25.439 E019.47.32.909 Color_251ACI
N050.04.25.439 E019.47.32.909 N050.04.25.476 E019.47.32.884 Color_251ACI
N050.04.25.476 E019.47.32.884 N050.04.25.582 E019.47.32.948 Color_251ACI
N050.04.25.582 E019.47.32.948 N050.04.25.572 E019.47.32.989 Color_251ACI
N050.04.25.572 E019.47.32.989 N050.04.25.599 E019.47.33.005 Color_251ACI
N050.04.25.599 E019.47.33.005 N050.04.25.599 E019.47.33.005 Color_251ACI
N050.04.25.599 E019.47.33.005 N050.04.25.625 E019.47.33.021 Color_251ACI
N050.04.25.625 E019.47.33.021 N050.04.25.642 E019.47.33.078 Color_251ACI
N050.04.25.642 E019.47.33.078 N050.04.25.642 E019.47.33.078 Color_251ACI
N050.04.26.002 E019.47.35.200 N050.04.26.018 E019.47.35.258 Color_251ACI
N050.04.26.018 E019.47.35.258 N050.04.26.018 E019.47.35.258 Color_251ACI
N050.04.26.018 E019.47.35.258 N050.04.26.008 E019.47.35.299 Color_251ACI
N050.04.26.008 E019.47.35.299 N050.04.25.977 E019.47.35.423 Color_251ACI
N050.04.25.977 E019.47.35.423 N050.04.25.977 E019.47.35.423 Color_251ACI
N050.04.25.977 E019.47.35.423 N050.04.25.956 E019.47.35.506 Color_251ACI
N050.04.25.956 E019.47.35.506 N050.04.25.930 E019.47.35.490 Color_251ACI
N050.04.25.930 E019.47.35.490 N050.04.25.903 E019.47.35.474 Color_251ACI
N050.04.25.903 E019.47.35.474 N050.04.25.893 E019.47.35.516 Color_251ACI
N050.04.25.756 E019.47.35.576 N050.04.25.893 E019.47.35.516 Color_251ACI
N050.04.25.642 E019.47.33.078 N050.04.25.670 E019.47.33.334 Color_251ACI
N050.04.25.670 E019.47.33.334 N050.04.25.656 E019.47.33.515 Color_251ACI
N050.04.25.656 E019.47.33.515 N050.04.26.002 E019.47.35.200 Color_251ACI
N050.04.25.811 E019.47.35.847 N050.04.25.801 E019.47.35.888 Color_251ACI
N050.04.25.801 E019.47.35.888 N050.04.25.774 E019.47.35.872 Color_251ACI
N050.04.25.774 E019.47.35.872 N050.04.25.774 E019.47.35.872 Color_251ACI
N050.04.25.774 E019.47.35.872 N050.04.25.764 E019.47.35.914 Color_251ACI
N050.04.25.764 E019.47.35.914 N050.04.25.743 E019.47.35.997 Color_251ACI
N050.04.25.743 E019.47.35.997 N050.04.25.717 E019.47.35.981 Color_251ACI
N050.04.25.717 E019.47.35.981 N050.04.25.696 E019.47.36.064 Color_251ACI
N050.04.25.696 E019.47.36.064 N050.04.25.723 E019.47.36.080 Color_251ACI
N050.04.25.723 E019.47.36.080 N050.04.25.712 E019.47.36.121 Color_251ACI
N050.04.25.712 E019.47.36.121 N050.04.25.712 E019.47.36.121 Color_251ACI
N050.04.25.712 E019.47.36.121 N050.04.25.702 E019.47.36.163 Color_251ACI
N050.04.25.702 E019.47.36.163 N050.04.25.718 E019.47.36.220 Color_251ACI
N050.04.25.718 E019.47.36.220 N050.04.25.718 E019.47.36.220 Color_251ACI
N050.04.26.335 E019.47.35.211 N050.04.26.536 E019.47.35.141 Color_251ACI
N050.04.26.536 E019.47.35.141 N050.04.26.607 E019.47.35.469 Color_251ACI
N050.04.26.607 E019.47.35.469 N050.04.25.811 E019.47.35.847 Color_251ACI
N050.04.26.186 E019.47.35.073 N050.04.26.186 E019.47.35.073 Color_251ACI
N050.04.26.186 E019.47.35.073 N050.04.26.186 E019.47.35.073 Color_251ACI
N050.04.26.186 E019.47.35.073 N050.04.26.213 E019.47.35.089 Color_251ACI
N050.04.26.213 E019.47.35.089 N050.04.26.229 E019.47.35.146 Color_251ACI
N050.04.26.229 E019.47.35.146 N050.04.26.229 E019.47.35.146 Color_251ACI
N050.04.26.229 E019.47.35.146 N050.04.26.256 E019.47.35.162 Color_251ACI
N050.04.26.256 E019.47.35.162 N050.04.26.335 E019.47.35.211 Color_251ACI
N050.04.26.109 E019.47.34.645 N050.04.26.109 E019.47.34.645 Color_251ACI
N050.04.26.109 E019.47.34.645 N050.04.26.119 E019.47.34.604 Color_251ACI
N050.04.26.119 E019.47.34.604 N050.04.26.103 E019.47.34.547 Color_251ACI
N050.04.26.103 E019.47.34.547 N050.04.26.113 E019.47.34.505 Color_251ACI
N050.04.26.113 E019.47.34.505 N050.04.26.140 E019.47.34.521 Color_251ACI
N050.04.26.140 E019.47.34.521 N050.04.26.160 E019.47.34.438 Color_251ACI
N050.04.26.160 E019.47.34.438 N050.04.26.160 E019.47.34.438 Color_251ACI
N050.04.26.160 E019.47.34.438 N050.04.26.170 E019.47.34.397 Color_251ACI
N050.04.26.170 E019.47.34.397 N050.04.26.197 E019.47.34.413 Color_251ACI
N050.04.26.109 E019.47.34.645 N050.04.26.186 E019.47.35.073 Color_251ACI
N050.04.25.900 E019.47.32.901 N050.04.25.889 E019.47.32.942 Color_251ACI
N050.04.25.889 E019.47.32.942 N050.04.25.863 E019.47.32.926 Color_251ACI
N050.04.25.863 E019.47.32.926 N050.04.25.853 E019.47.32.967 Color_251ACI
N050.04.25.853 E019.47.32.967 N050.04.25.853 E019.47.32.967 Color_251ACI
N050.04.25.853 E019.47.32.967 N050.04.25.811 E019.47.33.133 Color_251ACI
N050.04.25.811 E019.47.33.133 N050.04.25.811 E019.47.33.133 Color_251ACI
N050.04.25.811 E019.47.33.133 N050.04.25.801 E019.47.33.175 Color_251ACI
N050.04.25.801 E019.47.33.175 N050.04.25.828 E019.47.33.191 Color_251ACI
N050.04.25.828 E019.47.33.191 N050.04.25.982 E019.47.34.046 Color_251ACI
N050.04.25.982 E019.47.34.046 N050.04.25.982 E019.47.34.046 Color_251ACI
N050.04.25.982 E019.47.34.046 N050.04.25.999 E019.47.34.103 Color_251ACI
N050.04.25.999 E019.47.34.103 N050.04.26.025 E019.47.34.119 Color_251ACI
N050.04.26.025 E019.47.34.119 N050.04.26.052 E019.47.34.135 Color_251ACI
N050.04.26.052 E019.47.34.135 N050.04.26.042 E019.47.34.177 Color_251ACI
N050.04.26.042 E019.47.34.177 N050.04.26.121 E019.47.34.225 Color_251ACI
N050.04.26.121 E019.47.34.225 N050.04.26.132 E019.47.34.183 Color_251ACI
N050.04.26.132 E019.47.34.183 N050.04.26.185 E019.47.34.215 Color_251ACI
N050.04.26.185 E019.47.34.215 N050.04.26.332 E019.47.34.113 Color_251ACI
N050.04.26.197 E019.47.34.413 N050.04.26.371 E019.47.34.327 Color_251ACI
N050.04.25.900 E019.47.32.901 N050.04.26.074 E019.47.32.815 Color_251ACI
N050.04.27.337 E019.47.32.528 N050.04.27.310 E019.47.32.512 Color_251ACI
N050.04.27.310 E019.47.32.512 N050.04.27.273 E019.47.32.537 Color_251ACI
N050.04.27.273 E019.47.32.537 N050.04.27.247 E019.47.32.521 Color_251ACI
N050.04.27.247 E019.47.32.521 N050.04.27.237 E019.47.32.563 Color_251ACI
N050.04.27.237 E019.47.32.563 N050.04.27.210 E019.47.32.547 Color_251ACI
N050.04.27.210 E019.47.32.547 N050.04.27.183 E019.47.32.531 Color_251ACI
N050.04.27.183 E019.47.32.531 N050.04.27.183 E019.47.32.531 Color_251ACI
N050.04.27.183 E019.47.32.531 N050.04.27.147 E019.47.32.556 Color_251ACI
N050.04.33.424 E019.47.30.288 N050.04.33.318 E019.47.30.224 Color_251ACI
N050.04.33.318 E019.47.30.224 N050.04.32.759 E019.47.29.888 Color_251ACI
N050.04.32.759 E019.47.29.888 N050.04.31.975 E019.47.29.844 Color_251ACI
N050.04.31.975 E019.47.29.844 N050.04.31.545 E019.47.30.347 Color_251ACI
N050.04.31.545 E019.47.30.347 N050.04.31.364 E019.47.30.953 Color_251ACI
N050.04.31.364 E019.47.30.953 N050.04.31.360 E019.47.31.093 Color_251ACI
N050.04.40.727 E019.47.43.971 N050.04.40.717 E019.47.44.012 Color_251ACI
N050.04.40.717 E019.47.44.012 N050.04.40.690 E019.47.43.996 Color_251ACI
N050.04.40.690 E019.47.43.996 N050.04.40.690 E019.47.43.996 Color_251ACI
N050.04.40.690 E019.47.43.996 N050.04.40.557 E019.47.43.916 Color_251ACI
N050.04.40.557 E019.47.43.916 N050.04.40.557 E019.47.43.916 Color_251ACI
N050.04.40.557 E019.47.43.916 N050.04.40.557 E019.47.43.916 Color_251ACI
N050.04.40.557 E019.47.43.916 N050.04.40.425 E019.47.43.218 Color_251ACI
N050.04.40.425 E019.47.43.218 N050.04.40.251 E019.47.43.303 Color_251ACI
N050.04.40.251 E019.47.43.303 N050.04.40.198 E019.47.43.271 Color_251ACI
N050.04.40.198 E019.47.43.271 N050.04.40.144 E019.47.43.239 Color_251ACI
N050.04.40.144 E019.47.43.239 N050.04.40.102 E019.47.43.166 Color_251ACI
N050.04.40.102 E019.47.43.166 N050.04.39.993 E019.47.42.863 Color_251ACI
N050.04.39.993 E019.47.42.863 N050.04.39.928 E019.47.42.633 Color_251ACI
N050.04.39.928 E019.47.42.633 N050.04.39.826 E019.47.42.428 Color_251ACI
N050.04.39.826 E019.47.42.428 N050.04.39.767 E019.47.42.298 Color_251ACI
N050.04.39.767 E019.47.42.298 N050.04.39.634 E019.47.42.218 Color_251ACI
N050.04.39.634 E019.47.42.218 N050.04.39.581 E019.47.42.185 Color_251ACI
N050.04.39.581 E019.47.42.185 N050.04.39.459 E019.47.41.445 Color_251ACI
N050.04.39.459 E019.47.41.445 N050.04.39.358 E019.47.41.480 Color_251ACI
N050.04.39.358 E019.47.41.480 N050.04.39.458 E019.47.42.064 Color_251ACI
N050.04.39.458 E019.47.42.064 N050.04.39.395 E019.47.42.073 Color_251ACI
N050.04.39.395 E019.47.42.073 N050.04.39.390 E019.47.42.214 Color_251ACI
N050.04.39.390 E019.47.42.214 N050.04.37.704 E019.47.42.484 Color_251ACI
N050.04.37.704 E019.47.42.484 N050.04.36.895 E019.47.42.664 Color_251ACI
N050.04.36.895 E019.47.42.664 N050.04.36.567 E019.47.42.752 Color_251ACI
N050.04.36.567 E019.47.42.752 N050.04.36.441 E019.47.42.771 Color_251ACI
N050.04.36.453 E019.47.42.969 N050.04.37.351 E019.47.42.796 Color_251ACI
N050.04.37.351 E019.47.42.796 N050.04.38.731 E019.47.42.531 Color_251ACI
N050.04.38.731 E019.47.42.531 N050.04.39.366 E019.47.42.437 Color_251ACI
N050.04.39.366 E019.47.42.437 N050.04.39.546 E019.47.42.450 Color_251ACI
N050.04.39.546 E019.47.42.450 N050.04.39.636 E019.47.42.457 Color_251ACI
N050.04.39.636 E019.47.42.457 N050.04.39.732 E019.47.42.562 Color_251ACI
N050.04.39.732 E019.47.42.562 N050.04.39.818 E019.47.42.709 Color_251ACI
N050.04.39.818 E019.47.42.709 N050.04.39.883 E019.47.42.939 Color_251ACI
N050.04.39.883 E019.47.42.939 N050.04.39.911 E019.47.43.194 Color_251ACI
N050.04.39.911 E019.47.43.194 N050.04.39.907 E019.47.43.334 Color_251ACI
N050.04.39.907 E019.47.43.334 N050.04.39.892 E019.47.43.516 Color_251ACI
N050.04.39.892 E019.47.43.516 N050.04.39.868 E019.47.43.739 Color_251ACI
N050.04.39.868 E019.47.43.739 N050.04.39.763 E019.47.43.914 Color_251ACI
N050.04.39.763 E019.47.43.914 N050.04.39.716 E019.47.43.981 Color_251ACI
N050.04.39.716 E019.47.43.981 N050.04.39.749 E019.47.44.096 Color_251ACI
N050.04.39.749 E019.47.44.096 N050.04.39.822 E019.47.44.045 Color_251ACI
N050.04.39.822 E019.47.44.045 N050.04.39.912 E019.47.44.052 Color_251ACI
N050.04.39.912 E019.47.44.052 N050.04.39.992 E019.47.44.100 Color_251ACI
N050.04.39.992 E019.47.44.100 N050.04.40.035 E019.47.44.173 Color_251ACI
N050.04.40.035 E019.47.44.173 N050.04.40.068 E019.47.44.288 Color_251ACI
N050.04.40.068 E019.47.44.288 N050.04.40.084 E019.47.44.346 Color_251ACI
N050.04.40.084 E019.47.44.346 N050.04.40.090 E019.47.44.445 Color_251ACI
N050.04.40.090 E019.47.44.445 N050.04.40.190 E019.47.44.410 Color_251ACI
N050.04.40.190 E019.47.44.410 N050.04.40.221 E019.47.44.285 Color_251ACI
N050.04.40.221 E019.47.44.285 N050.04.40.258 E019.47.44.260 Color_251ACI
N050.04.40.258 E019.47.44.260 N050.04.40.739 E019.47.44.169 Color_251ACI
N050.04.40.739 E019.47.44.169 N050.04.40.727 E019.47.43.971 Color_251ACI
N050.04.32.621 E019.47.43.138 N050.04.32.109 E019.47.43.354 Color_251ACI
N050.04.32.109 E019.47.43.354 N050.04.32.227 E019.47.44.234 Color_251ACI
N050.04.32.227 E019.47.44.234 N050.04.32.766 E019.47.44.034 Color_251ACI
N050.04.39.130 E019.48.11.486 N050.04.39.171 E019.48.11.320 Color_251ACI
N050.04.39.171 E019.48.11.320 N050.04.39.264 E019.48.10.329 Color_251ACI
N050.04.39.695 E019.48.13.398 N050.04.39.457 E019.48.13.493 Color_251ACI
N050.04.39.457 E019.48.13.493 N050.04.32.482 E019.48.15.864 Color_251ACI
N050.04.39.745 E019.48.13.809 N050.04.39.492 E019.48.13.847 Color_251ACI
N050.04.39.492 E019.48.13.847 N050.04.39.457 E019.48.13.493 Color_251ACI
N050.04.47.279 E019.48.06.964 N050.04.47.292 E019.48.07.162 Color_251ACI
N050.04.42.035 E019.47.29.330 N050.04.47.279 E019.48.06.964 Color_251ACI
N050.04.38.516 E019.47.04.210 N050.04.41.257 E019.47.23.718 Color_251ACI
N050.04.32.690 E019.46.22.511 N050.04.36.338 E019.46.48.470 Color_251ACI
N050.04.30.786 E019.46.08.746 N050.04.30.808 E019.46.08.902 Color_251ACI
N050.04.30.808 E019.46.08.902 N050.04.30.810 E019.46.09.141 Color_251ACI
N050.04.30.810 E019.46.09.141 N050.04.32.080 E019.46.18.192 Color_251ACI
N050.04.35.744 E019.47.45.828 N050.04.35.628 E019.47.46.663 Color_251ACI
N050.04.35.628 E019.47.46.663 N050.04.35.215 E019.47.48.081 Color_251ACI
N050.04.35.215 E019.47.48.081 N050.04.33.090 E019.47.53.325 Color_251ACI
N050.04.33.090 E019.47.53.325 N050.04.32.259 E019.47.55.444 Color_251ACI
N050.04.32.259 E019.47.55.444 N050.04.31.482 E019.47.56.357 Color_251ACI
N050.04.31.482 E019.47.56.357 N050.04.29.312 E019.47.57.098 Color_251ACI
N050.04.29.312 E019.47.57.098 N050.04.29.261 E019.47.56.687 Color_251ACI
N050.04.47.850 E019.48.11.070 N050.04.47.185 E019.48.11.289 Color_251ACI
N050.04.47.185 E019.48.11.289 N050.04.46.520 E019.48.11.507 Color_251ACI
N050.04.46.520 E019.48.11.507 N050.04.39.745 E019.48.13.809 Color_251ACI
N050.04.35.744 E019.47.45.828 N050.04.35.626 E019.47.44.328 Color_251ACI
N050.04.35.626 E019.47.44.328 N050.04.33.712 E019.47.30.604 Color_251ACI
N050.04.33.712 E019.47.30.604 N050.04.33.424 E019.47.30.288 Color_251ACI
N050.04.39.264 E019.48.10.329 N050.04.38.100 E019.48.01.961 Color_251ACI
N050.04.38.100 E019.48.01.961 N050.04.37.828 E019.48.01.083 Color_251ACI
N050.04.37.828 E019.48.01.083 N050.04.37.348 E019.48.00.556 Color_251ACI
N050.04.37.348 E019.48.00.556 N050.04.33.335 E019.47.57.759 Color_251ACI
N050.04.33.335 E019.47.57.759 N050.04.32.840 E019.47.57.413 Color_251ACI
N050.04.32.840 E019.47.57.413 N050.04.32.003 E019.47.57.338 Color_251ACI
N050.04.32.003 E019.47.57.338 N050.04.29.933 E019.47.58.044 Color_251ACI
N050.04.47.800 E019.48.10.659 N050.04.39.695 E019.48.13.398 Color_251ACI
N050.04.29.994 E019.47.58.414 N050.04.30.073 E019.47.59.081 Color_251ACI
N050.04.30.073 E019.47.59.081 N050.04.30.342 E019.48.00.956 Color_251ACI
N050.04.30.342 E019.48.00.956 N050.04.30.559 E019.48.02.421 Color_251ACI
N050.04.30.559 E019.48.02.421 N050.04.30.577 E019.48.02.717 Color_251ACI
N050.04.30.577 E019.48.02.717 N050.04.30.600 E019.48.02.874 Color_251ACI
N050.04.30.600 E019.48.02.874 N050.04.30.612 E019.48.03.071 Color_251ACI
N050.04.30.612 E019.48.03.071 N050.04.30.581 E019.48.03.196 Color_251ACI
N050.04.30.581 E019.48.03.196 N050.04.30.509 E019.48.03.486 Color_251ACI
N050.04.30.509 E019.48.03.486 N050.04.30.478 E019.48.03.610 Color_251ACI
N050.04.30.478 E019.48.03.610 N050.04.30.347 E019.48.03.769 Color_251ACI
N050.04.30.347 E019.48.03.769 N050.04.30.300 E019.48.03.836 Color_251ACI
N050.04.30.300 E019.48.03.836 N050.04.30.216 E019.48.03.928 Color_251ACI
N050.04.30.216 E019.48.03.928 N050.04.29.941 E019.48.04.049 Color_251ACI
N050.04.29.941 E019.48.04.049 N050.04.28.948 E019.48.04.356 Color_251ACI
N050.04.28.948 E019.48.04.356 N050.04.28.811 E019.48.04.416 Color_251ACI
N050.04.28.811 E019.48.04.416 N050.04.28.738 E019.48.04.467 Color_251ACI
N050.04.28.738 E019.48.04.467 N050.04.28.701 E019.48.04.492 Color_251ACI
N050.04.28.701 E019.48.04.492 N050.04.28.617 E019.48.04.585 Color_251ACI
N050.04.28.617 E019.48.04.585 N050.04.28.559 E019.48.04.693 Color_251ACI
N050.04.28.559 E019.48.04.693 N050.04.28.282 E019.48.05.812 Color_251ACI
N050.04.28.282 E019.48.05.812 N050.04.28.194 E019.48.06.044 Color_251ACI
N050.04.28.194 E019.48.06.044 N050.04.28.132 E019.48.06.293 Color_251ACI
N050.04.28.132 E019.48.06.293 N050.04.28.054 E019.48.06.484 Color_251ACI
N050.04.28.054 E019.48.06.484 N050.04.27.955 E019.48.06.758 Color_251ACI
N050.04.27.955 E019.48.06.758 N050.04.28.029 E019.48.07.326 Color_251ACI
N050.04.28.029 E019.48.07.326 N050.04.27.786 E019.48.08.180 Color_251ACI
N050.04.27.786 E019.48.08.180 N050.04.27.953 E019.48.09.233 Color_251ACI
N050.04.27.953 E019.48.09.233 N050.04.28.054 E019.48.10.056 Color_251ACI
N050.04.28.054 E019.48.10.056 N050.04.28.470 E019.48.10.353 Color_251ACI
N050.04.28.470 E019.48.10.353 N050.04.28.494 E019.48.10.749 Color_251ACI
N050.04.28.494 E019.48.10.749 N050.04.28.539 E019.48.11.061 Color_251ACI
N050.04.28.539 E019.48.11.061 N050.04.28.587 E019.48.11.234 Color_251ACI
N050.04.28.587 E019.48.11.234 N050.04.28.663 E019.48.11.422 Color_251ACI
N050.04.28.663 E019.48.11.422 N050.04.28.749 E019.48.11.569 Color_251ACI
N050.04.28.749 E019.48.11.569 N050.04.28.872 E019.48.11.690 Color_251ACI
N050.04.28.872 E019.48.11.690 N050.04.29.690 E019.48.12.088 Color_251ACI
N050.04.29.690 E019.48.12.088 N050.04.29.716 E019.48.12.104 Color_251ACI
N050.04.30.523 E019.48.15.875 N050.04.30.233 E019.48.17.415 Color_251ACI
N050.04.30.233 E019.48.17.415 N050.04.29.815 E019.48.19.592 Color_251ACI
N050.04.29.815 E019.48.19.592 N050.04.28.678 E019.48.19.003 Color_251ACI
N050.04.28.678 E019.48.19.003 N050.04.23.811 E019.48.16.691 Color_251ACI
N050.04.23.811 E019.48.16.691 N050.04.23.677 E019.48.15.754 Color_251ACI
N050.04.32.482 E019.48.15.864 N050.04.32.392 E019.48.15.858 Color_251ACI
N050.04.32.392 E019.48.15.858 N050.04.32.291 E019.48.15.893 Color_251ACI
N050.04.32.291 E019.48.15.893 N050.04.32.201 E019.48.15.886 Color_251ACI
N050.04.32.201 E019.48.15.886 N050.04.32.101 E019.48.15.921 Color_251ACI
N050.04.32.101 E019.48.15.921 N050.04.32.011 E019.48.15.914 Color_251ACI
N050.04.32.011 E019.48.15.914 N050.04.31.894 E019.48.15.892 Color_251ACI
N050.04.31.894 E019.48.15.892 N050.04.31.815 E019.48.15.844 Color_251ACI
N050.04.31.815 E019.48.15.844 N050.04.31.725 E019.48.15.837 Color_251ACI
N050.04.31.725 E019.48.15.837 N050.04.30.620 E019.48.15.362 Color_251ACI
N050.04.45.963 E019.47.43.314 N050.04.46.892 E019.47.43.017 Color_251ACI
N050.04.49.300 E019.47.42.180 N050.04.49.437 E019.47.42.120 Color_251ACI
N050.04.49.437 E019.47.42.120 N050.04.49.500 E019.47.42.111 Color_251ACI
N050.04.49.500 E019.47.42.111 N050.04.49.547 E019.47.42.044 Color_251ACI
N050.04.49.547 E019.47.42.044 N050.04.49.584 E019.47.42.019 Color_251ACI
N050.04.49.584 E019.47.42.019 N050.04.49.625 E019.47.41.853 Color_251ACI
N050.04.49.625 E019.47.41.853 N050.04.49.619 E019.47.41.754 Color_251ACI
N050.04.49.619 E019.47.41.754 N050.04.49.757 E019.47.41.694 Color_251ACI
N050.04.49.757 E019.47.41.694 N050.04.49.816 E019.47.41.825 Color_251ACI
N050.04.49.816 E019.47.41.825 N050.04.49.832 E019.47.41.882 Color_251ACI
N050.04.49.832 E019.47.41.882 N050.04.49.912 E019.47.41.930 Color_251ACI
N050.04.49.912 E019.47.41.930 N050.04.49.992 E019.47.41.978 Color_251ACI
N050.04.49.992 E019.47.41.978 N050.04.50.065 E019.47.41.927 Color_251ACI
N050.04.50.065 E019.47.41.927 N050.04.50.067 E019.47.42.166 Color_251ACI
N050.04.50.067 E019.47.42.166 N050.04.49.465 E019.47.42.375 Color_251ACI
N050.04.49.465 E019.47.42.375 N050.04.45.991 E019.47.43.569 Color_251ACI
N050.04.28.675 E019.46.05.427 N050.04.30.243 E019.46.04.895 Color_251ACI
N050.04.30.243 E019.46.04.895 N050.04.30.288 E019.46.05.208 Color_251ACI
N050.04.30.288 E019.46.05.208 N050.04.32.184 E019.46.04.587 Color_251ACI
N050.04.32.184 E019.46.04.587 N050.04.49.679 E019.48.09.981 Color_251ACI
N050.04.49.679 E019.48.09.981 N050.04.47.800 E019.48.10.659 Color_251ACI
N050.04.47.800 E019.48.10.659 N050.04.47.850 E019.48.11.070 Color_251ACI
N050.04.23.798 E019.46.21.396 N050.04.23.765 E019.46.23.376 Color_251ACI
N050.04.28.896 E019.46.50.751 N050.04.29.170 E019.46.50.631 Color_251ACI
N050.04.29.170 E019.46.50.631 N050.04.29.984 E019.46.51.168 Color_251ACI
N050.04.23.625 E019.46.26.530 N050.04.23.178 E019.46.41.642 Color_251ACI
N050.04.23.178 E019.46.41.642 N050.04.22.901 E019.46.50.523 Color_251ACI
N050.04.22.992 E019.46.51.387 N050.04.22.736 E019.46.51.186 Color_251ACI
N050.04.22.736 E019.46.51.186 N050.04.22.683 E019.46.51.154 Color_251ACI
N050.04.22.683 E019.46.51.154 N050.04.21.541 E019.46.51.323 Color_251ACI
N050.04.21.541 E019.46.51.323 N050.04.21.485 E019.46.51.671 Color_251ACI
N050.04.21.485 E019.46.51.671 N050.04.21.969 E019.46.53.295 Color_251ACI
N050.04.21.969 E019.46.53.295 N050.04.22.018 E019.46.53.467 Color_251ACI
N050.04.22.018 E019.46.53.467 N050.04.22.140 E019.46.53.589 Color_251ACI
N050.04.24.188 E019.46.24.012 N050.04.23.389 E019.46.49.293 Color_251ACI
N050.04.23.389 E019.46.49.293 N050.04.23.603 E019.46.50.279 Color_251ACI
N050.04.23.603 E019.46.50.279 N050.04.24.141 E019.46.50.698 Color_251ACI
N050.04.24.141 E019.46.50.698 N050.04.26.986 E019.46.50.935 Color_251ACI
N050.04.26.986 E019.46.50.935 N050.04.27.696 E019.46.50.410 Color_251ACI
N050.04.27.696 E019.46.50.410 N050.04.27.809 E019.46.49.954 Color_251ACI
N050.04.27.809 E019.46.49.954 N050.04.24.188 E019.46.24.012 Color_251ACI
N050.04.22.140 E019.46.53.589 N050.04.22.241 E019.46.53.554 Color_251ACI
N050.04.22.241 E019.46.53.554 N050.04.22.931 E019.46.53.112 Color_251ACI
N050.04.22.931 E019.46.53.112 N050.04.23.152 E019.46.52.960 Color_251ACI
N050.04.23.152 E019.46.52.960 N050.04.23.210 E019.46.52.852 Color_251ACI
N050.04.23.210 E019.46.52.852 N050.04.23.318 E019.46.52.536 Color_251ACI
N050.04.23.318 E019.46.52.536 N050.04.22.992 E019.46.51.387 Color_251ACI
N050.04.23.567 E019.46.53.876 N050.04.22.534 E019.46.54.588 Color_251ACI
N050.04.22.534 E019.46.54.588 N050.04.22.401 E019.46.54.508 Color_251ACI
N050.04.22.401 E019.46.54.508 N050.04.22.342 E019.46.54.377 Color_251ACI
N050.04.22.342 E019.46.54.377 N050.04.22.320 E019.46.54.221 Color_251ACI
N050.04.22.320 E019.46.54.221 N050.04.22.382 E019.46.53.972 Color_251ACI
N050.04.22.382 E019.46.53.972 N050.04.22.466 E019.46.53.880 Color_251ACI
N050.04.22.466 E019.46.53.880 N050.04.23.240 E019.46.53.346 Color_251ACI
N050.04.23.240 E019.46.53.346 N050.04.23.330 E019.46.53.353 Color_251ACI
N050.04.23.330 E019.46.53.353 N050.04.23.430 E019.46.53.318 Color_251ACI
N050.04.23.430 E019.46.53.318 N050.04.23.563 E019.46.53.398 Color_251ACI
N050.04.23.563 E019.46.53.398 N050.04.23.661 E019.46.53.742 Color_251ACI
N050.04.23.661 E019.46.53.742 N050.04.23.567 E019.46.53.876 Color_251ACI
N050.04.23.863 E019.46.54.531 N050.04.23.928 E019.46.54.760 Color_251ACI
N050.04.23.928 E019.46.54.760 N050.04.23.819 E019.46.55.076 Color_251ACI
N050.04.23.819 E019.46.55.076 N050.04.23.762 E019.46.55.184 Color_251ACI
N050.04.23.762 E019.46.55.184 N050.04.22.988 E019.46.55.718 Color_251ACI
N050.04.22.988 E019.46.55.718 N050.04.22.898 E019.46.55.711 Color_251ACI
N050.04.22.898 E019.46.55.711 N050.04.22.711 E019.46.55.599 Color_251ACI
N050.04.22.711 E019.46.55.599 N050.04.22.642 E019.46.55.510 Color_251ACI
N050.04.22.642 E019.46.55.510 N050.04.22.620 E019.46.55.354 Color_251ACI
N050.04.22.620 E019.46.55.354 N050.04.22.671 E019.46.55.146 Color_251ACI
N050.04.22.671 E019.46.55.146 N050.04.23.703 E019.46.54.435 Color_251ACI
N050.04.23.703 E019.46.54.435 N050.04.23.863 E019.46.54.531 Color_251ACI
N050.04.24.173 E019.46.55.622 N050.04.24.228 E019.46.55.893 Color_251ACI
N050.04.24.228 E019.46.55.893 N050.04.24.166 E019.46.56.142 Color_251ACI
N050.04.24.166 E019.46.56.142 N050.04.23.634 E019.46.56.440 Color_251ACI
N050.04.23.634 E019.46.56.440 N050.04.23.144 E019.46.56.812 Color_251ACI
N050.04.23.144 E019.46.56.812 N050.04.23.011 E019.46.56.732 Color_251ACI
N050.04.23.011 E019.46.56.732 N050.04.22.952 E019.46.56.601 Color_251ACI
N050.04.22.952 E019.46.56.601 N050.04.22.930 E019.46.56.445 Color_251ACI
N050.04.22.930 E019.46.56.445 N050.04.22.991 E019.46.56.196 Color_251ACI
N050.04.22.991 E019.46.56.196 N050.04.23.086 E019.46.56.063 Color_251ACI
N050.04.23.086 E019.46.56.063 N050.04.23.555 E019.46.55.774 Color_251ACI
N050.04.23.555 E019.46.55.774 N050.04.23.860 E019.46.55.529 Color_251ACI
N050.04.23.860 E019.46.55.529 N050.04.23.976 E019.46.55.551 Color_251ACI
N050.04.23.976 E019.46.55.551 N050.04.24.173 E019.46.55.622 Color_251ACI
N050.04.24.473 E019.46.56.755 N050.04.24.538 E019.46.56.985 Color_251ACI
N050.04.24.538 E019.46.56.985 N050.04.24.466 E019.46.57.275 Color_251ACI
N050.04.24.466 E019.46.57.275 N050.04.24.372 E019.46.57.408 Color_251ACI
N050.04.24.372 E019.46.57.408 N050.04.23.597 E019.46.57.942 Color_251ACI
N050.04.23.597 E019.46.57.942 N050.04.23.481 E019.46.57.920 Color_251ACI
N050.04.23.481 E019.46.57.920 N050.04.23.321 E019.46.57.824 Color_251ACI
N050.04.23.321 E019.46.57.824 N050.04.23.252 E019.46.57.734 Color_251ACI
N050.04.23.252 E019.46.57.734 N050.04.23.246 E019.46.57.635 Color_251ACI
N050.04.23.246 E019.46.57.635 N050.04.23.256 E019.46.57.594 Color_251ACI
N050.04.23.256 E019.46.57.594 N050.04.23.318 E019.46.57.345 Color_251ACI
N050.04.23.318 E019.46.57.345 N050.04.24.313 E019.46.56.659 Color_251ACI
N050.04.24.313 E019.46.56.659 N050.04.24.473 E019.46.56.755 Color_251ACI
N050.04.24.783 E019.46.57.846 N050.04.24.874 E019.46.58.092 Color_251ACI
N050.04.24.874 E019.46.58.092 N050.04.24.796 E019.46.58.283 Color_251ACI
N050.04.24.796 E019.46.58.283 N050.04.23.865 E019.46.58.960 Color_251ACI
N050.04.23.865 E019.46.58.960 N050.04.23.727 E019.46.59.021 Color_251ACI
N050.04.23.727 E019.46.59.021 N050.04.23.621 E019.46.58.957 Color_251ACI
N050.04.23.621 E019.46.58.957 N050.04.23.562 E019.46.58.826 Color_251ACI
N050.04.23.562 E019.46.58.826 N050.04.23.539 E019.46.58.669 Color_251ACI
N050.04.23.539 E019.46.58.669 N050.04.23.607 E019.46.58.520 Color_251ACI
N050.04.23.607 E019.46.58.520 N050.04.23.638 E019.46.58.395 Color_251ACI
N050.04.23.638 E019.46.58.395 N050.04.23.695 E019.46.58.287 Color_251ACI
N050.04.23.695 E019.46.58.287 N050.04.23.917 E019.46.58.134 Color_251ACI
N050.04.23.917 E019.46.58.134 N050.04.24.496 E019.46.57.769 Color_251ACI
N050.04.24.496 E019.46.57.769 N050.04.24.596 E019.46.57.734 Color_251ACI
N050.04.24.596 E019.46.57.734 N050.04.24.783 E019.46.57.846 Color_251ACI
N050.04.25.093 E019.46.58.938 N050.04.25.174 E019.46.59.225 Color_251ACI
N050.04.25.174 E019.46.59.225 N050.04.25.076 E019.46.59.499 Color_251ACI
N050.04.25.076 E019.46.59.499 N050.04.24.992 E019.46.59.591 Color_251ACI
N050.04.24.992 E019.46.59.591 N050.04.24.207 E019.47.00.167 Color_251ACI
N050.04.24.207 E019.47.00.167 N050.04.24.117 E019.47.00.160 Color_251ACI
N050.04.24.117 E019.47.00.160 N050.04.23.931 E019.47.00.048 Color_251ACI
N050.04.23.931 E019.47.00.048 N050.04.23.872 E019.46.59.917 Color_251ACI
N050.04.23.872 E019.46.59.917 N050.04.23.849 E019.46.59.761 Color_251ACI
N050.04.23.849 E019.46.59.761 N050.04.23.901 E019.46.59.554 Color_251ACI
N050.04.23.901 E019.46.59.554 N050.04.24.296 E019.46.59.315 Color_251ACI
N050.04.24.296 E019.46.59.315 N050.04.24.802 E019.46.59.001 Color_251ACI
N050.04.24.802 E019.46.59.001 N050.04.24.976 E019.46.58.915 Color_251ACI
N050.04.24.976 E019.46.58.915 N050.04.25.093 E019.46.58.938 Color_251ACI
N050.04.25.419 E019.47.00.087 N050.04.25.484 E019.47.00.316 Color_251ACI
N050.04.25.484 E019.47.00.316 N050.04.25.406 E019.47.00.508 Color_251ACI
N050.04.25.406 E019.47.00.508 N050.04.24.990 E019.47.00.829 Color_251ACI
N050.04.24.990 E019.47.00.829 N050.04.24.374 E019.47.01.219 Color_251ACI
N050.04.24.374 E019.47.01.219 N050.04.24.241 E019.47.01.139 Color_251ACI
N050.04.24.241 E019.47.01.139 N050.04.24.171 E019.47.01.050 Color_251ACI
N050.04.24.171 E019.47.01.050 N050.04.24.186 E019.47.00.868 Color_251ACI
N050.04.24.186 E019.47.00.868 N050.04.24.248 E019.47.00.620 Color_251ACI
N050.04.24.248 E019.47.00.620 N050.04.24.305 E019.47.00.511 Color_251ACI
N050.04.24.305 E019.47.00.511 N050.04.25.106 E019.46.59.993 Color_251ACI
N050.04.25.106 E019.46.59.993 N050.04.25.206 E019.46.59.959 Color_251ACI
N050.04.25.206 E019.46.59.959 N050.04.25.419 E019.47.00.087 Color_251ACI
N050.04.25.702 E019.47.01.162 N050.04.25.794 E019.47.01.408 Color_251ACI
N050.04.25.794 E019.47.01.408 N050.04.25.696 E019.47.01.682 Color_251ACI
N050.04.25.696 E019.47.01.682 N050.04.25.628 E019.47.01.832 Color_251ACI
N050.04.25.628 E019.47.01.832 N050.04.25.222 E019.47.02.111 Color_251ACI
N050.04.25.222 E019.47.02.111 N050.04.24.827 E019.47.02.349 Color_251ACI
N050.04.24.827 E019.47.02.349 N050.04.24.727 E019.47.02.384 Color_251ACI
N050.04.24.727 E019.47.02.384 N050.04.24.567 E019.47.02.288 Color_251ACI
N050.04.24.567 E019.47.02.288 N050.04.24.508 E019.47.02.157 Color_251ACI
N050.04.24.508 E019.47.02.157 N050.04.24.486 E019.47.02.001 Color_251ACI
N050.04.24.486 E019.47.02.001 N050.04.24.537 E019.47.01.794 Color_251ACI
N050.04.24.537 E019.47.01.794 N050.04.24.721 E019.47.01.667 Color_251ACI
N050.04.24.721 E019.47.01.667 N050.04.25.533 E019.47.01.107 Color_251ACI
N050.04.25.533 E019.47.01.107 N050.04.25.702 E019.47.01.162 Color_251ACI
N050.04.26.012 E019.47.02.254 N050.04.26.094 E019.47.02.541 Color_251ACI
N050.04.26.094 E019.47.02.541 N050.04.26.026 E019.47.02.690 Color_251ACI
N050.04.26.026 E019.47.02.690 N050.04.26.016 E019.47.02.732 Color_251ACI
N050.04.26.016 E019.47.02.732 N050.04.25.010 E019.47.03.460 Color_251ACI
N050.04.25.010 E019.47.03.460 N050.04.24.851 E019.47.03.364 Color_251ACI
N050.04.24.851 E019.47.03.364 N050.04.24.792 E019.47.03.233 Color_251ACI
N050.04.24.792 E019.47.03.233 N050.04.24.796 E019.47.03.092 Color_251ACI
N050.04.24.796 E019.47.03.092 N050.04.24.857 E019.47.02.844 Color_251ACI
N050.04.24.857 E019.47.02.844 N050.04.24.915 E019.47.02.736 Color_251ACI
N050.04.24.915 E019.47.02.736 N050.04.25.726 E019.47.02.176 Color_251ACI
N050.04.25.726 E019.47.02.176 N050.04.25.816 E019.47.02.183 Color_251ACI
N050.04.25.816 E019.47.02.183 N050.04.26.012 E019.47.02.254 Color_251ACI
N050.04.26.322 E019.47.03.345 N050.04.26.404 E019.47.03.632 Color_251ACI
N050.04.26.404 E019.47.03.632 N050.04.26.305 E019.47.03.906 Color_251ACI
N050.04.26.305 E019.47.03.906 N050.04.26.248 E019.47.04.014 Color_251ACI
N050.04.26.248 E019.47.04.014 N050.04.25.621 E019.47.04.447 Color_251ACI
N050.04.25.621 E019.47.04.447 N050.04.25.447 E019.47.04.532 Color_251ACI
N050.04.25.447 E019.47.04.532 N050.04.25.347 E019.47.04.567 Color_251ACI
N050.04.25.347 E019.47.04.567 N050.04.25.187 E019.47.04.471 Color_251ACI
N050.04.25.187 E019.47.04.471 N050.04.25.102 E019.47.04.324 Color_251ACI
N050.04.25.102 E019.47.04.324 N050.04.25.106 E019.47.04.184 Color_251ACI
N050.04.25.106 E019.47.04.184 N050.04.25.147 E019.47.04.018 Color_251ACI
N050.04.25.147 E019.47.04.018 N050.04.25.911 E019.47.03.526 Color_251ACI
N050.04.25.911 E019.47.03.526 N050.04.26.179 E019.47.03.306 Color_251ACI
N050.04.26.179 E019.47.03.306 N050.04.26.322 E019.47.03.345 Color_251ACI
N050.04.26.622 E019.47.04.478 N050.04.26.714 E019.47.04.724 Color_251ACI
N050.04.26.714 E019.47.04.724 N050.04.26.673 E019.47.04.889 Color_251ACI
N050.04.26.673 E019.47.04.889 N050.04.26.605 E019.47.05.039 Color_251ACI
N050.04.26.605 E019.47.05.039 N050.04.26.548 E019.47.05.147 Color_251ACI
N050.04.26.548 E019.47.05.147 N050.04.25.847 E019.47.05.630 Color_251ACI
N050.04.25.847 E019.47.05.630 N050.04.25.747 E019.47.05.665 Color_251ACI
N050.04.25.747 E019.47.05.665 N050.04.25.683 E019.47.05.675 Color_251ACI
N050.04.25.683 E019.47.05.675 N050.04.25.657 E019.47.05.659 Color_251ACI
N050.04.25.657 E019.47.05.659 N050.04.25.497 E019.47.05.563 Color_251ACI
N050.04.25.497 E019.47.05.563 N050.04.25.428 E019.47.05.473 Color_251ACI
N050.04.25.428 E019.47.05.473 N050.04.25.405 E019.47.05.317 Color_251ACI
N050.04.25.405 E019.47.05.317 N050.04.25.477 E019.47.05.027 Color_251ACI
N050.04.25.477 E019.47.05.027 N050.04.25.561 E019.47.04.934 Color_251ACI
N050.04.25.561 E019.47.04.934 N050.04.26.336 E019.47.04.401 Color_251ACI
N050.04.26.336 E019.47.04.401 N050.04.26.373 E019.47.04.375 Color_251ACI
N050.04.26.373 E019.47.04.375 N050.04.26.426 E019.47.04.407 Color_251ACI
N050.04.26.426 E019.47.04.407 N050.04.26.622 E019.47.04.478 Color_251ACI
N050.04.26.959 E019.47.05.585 N050.04.27.014 E019.47.05.856 Color_251ACI
N050.04.27.014 E019.47.05.856 N050.04.26.915 E019.47.06.130 Color_251ACI
N050.04.26.915 E019.47.06.130 N050.04.26.858 E019.47.06.239 Color_251ACI
N050.04.26.858 E019.47.06.239 N050.04.26.057 E019.47.06.757 Color_251ACI
N050.04.26.057 E019.47.06.757 N050.04.25.957 E019.47.06.791 Color_251ACI
N050.04.25.957 E019.47.06.791 N050.04.25.797 E019.47.06.695 Color_251ACI
N050.04.25.797 E019.47.06.695 N050.04.25.738 E019.47.06.565 Color_251ACI
N050.04.25.738 E019.47.06.565 N050.04.25.716 E019.47.06.408 Color_251ACI
N050.04.25.716 E019.47.06.408 N050.04.25.777 E019.47.06.160 Color_251ACI
N050.04.25.777 E019.47.06.160 N050.04.25.835 E019.47.06.051 Color_251ACI
N050.04.25.835 E019.47.06.051 N050.04.26.635 E019.47.05.533 Color_251ACI
N050.04.26.635 E019.47.05.533 N050.04.26.736 E019.47.05.499 Color_251ACI
N050.04.26.736 E019.47.05.499 N050.04.26.852 E019.47.05.521 Color_251ACI
N050.04.26.852 E019.47.05.521 N050.04.26.959 E019.47.05.585 Color_251ACI
N050.04.27.281 E019.47.06.874 N050.04.27.258 E019.47.06.718 Color_251ACI
N050.04.27.258 E019.47.06.718 N050.04.27.072 E019.47.06.606 Color_251ACI
N050.04.27.072 E019.47.06.606 N050.04.26.945 E019.47.06.625 Color_251ACI
N050.04.26.945 E019.47.06.625 N050.04.26.145 E019.47.07.143 Color_251ACI
N050.04.26.145 E019.47.07.143 N050.04.26.087 E019.47.07.251 Color_251ACI
N050.04.26.087 E019.47.07.251 N050.04.26.015 E019.47.07.541 Color_251ACI
N050.04.26.015 E019.47.07.541 N050.04.26.032 E019.47.07.598 Color_251ACI
N050.04.26.032 E019.47.07.598 N050.04.26.154 E019.47.07.720 Color_251ACI
N050.04.26.245 E019.47.09.203 N050.04.26.397 E019.47.11.056 Color_251ACI
N050.04.26.397 E019.47.11.056 N050.04.26.499 E019.47.11.261 Color_251ACI
N050.04.26.499 E019.47.11.261 N050.04.27.236 E019.47.10.752 Color_251ACI
N050.04.27.236 E019.47.10.752 N050.04.27.900 E019.47.10.295 Color_251ACI
N050.04.27.900 E019.47.10.295 N050.04.28.129 E019.47.09.861 Color_251ACI
N050.04.28.129 E019.47.09.861 N050.04.27.993 E019.47.09.303 Color_251ACI
N050.04.27.993 E019.47.09.303 N050.04.27.727 E019.47.09.143 Color_251ACI
N050.04.28.619 E019.47.11.585 N050.04.28.389 E019.47.12.018 Color_251ACI
N050.04.28.389 E019.47.12.018 N050.04.27.230 E019.47.12.749 Color_251ACI
N050.04.27.230 E019.47.12.749 N050.04.26.859 E019.47.12.764 Color_251ACI
N050.04.26.859 E019.47.12.764 N050.04.26.664 E019.47.12.074 Color_251ACI
N050.04.26.664 E019.47.12.074 N050.04.26.920 E019.47.11.657 Color_251ACI
N050.04.26.920 E019.47.11.657 N050.04.28.063 E019.47.10.869 Color_251ACI
N050.04.28.063 E019.47.10.869 N050.04.28.423 E019.47.10.895 Color_251ACI
N050.04.28.423 E019.47.10.895 N050.04.28.488 E019.47.11.125 Color_251ACI
N050.04.29.375 E019.47.14.326 N050.04.29.424 E019.47.14.498 Color_251ACI
N050.04.29.528 E019.47.14.942 N050.04.29.571 E019.47.15.015 Color_251ACI
N050.04.29.571 E019.47.15.015 N050.04.29.315 E019.47.15.433 Color_251ACI
N050.04.29.315 E019.47.15.433 N050.04.28.172 E019.47.16.221 Color_251ACI
N050.04.28.172 E019.47.16.221 N050.04.27.812 E019.47.16.194 Color_251ACI
N050.04.27.812 E019.47.16.194 N050.04.27.616 E019.47.15.505 Color_251ACI
N050.04.27.616 E019.47.15.505 N050.04.27.856 E019.47.15.030 Color_251ACI
N050.04.27.856 E019.47.15.030 N050.04.29.025 E019.47.14.258 Color_251ACI
N050.04.29.025 E019.47.14.258 N050.04.29.375 E019.47.14.326 Color_251ACI
N050.04.29.865 E019.47.16.049 N050.04.29.824 E019.47.16.215 Color_251ACI
N050.04.29.824 E019.47.16.215 N050.04.29.260 E019.47.16.638 Color_251ACI
N050.04.29.260 E019.47.16.638 N050.04.29.299 E019.47.16.852 Color_251ACI
N050.04.29.299 E019.47.16.852 N050.04.29.905 E019.47.16.502 Color_251ACI
N050.04.29.905 E019.47.16.502 N050.04.30.012 E019.47.16.566 Color_251ACI
N050.04.30.012 E019.47.16.566 N050.04.30.067 E019.47.16.838 Color_251ACI
N050.04.30.067 E019.47.16.838 N050.04.29.837 E019.47.17.271 Color_251ACI
N050.04.29.837 E019.47.17.271 N050.04.28.678 E019.47.18.001 Color_251ACI
N050.04.28.678 E019.47.18.001 N050.04.28.318 E019.47.17.975 Color_251ACI
N050.04.28.318 E019.47.17.975 N050.04.28.105 E019.47.17.228 Color_251ACI
N050.04.28.105 E019.47.17.228 N050.04.28.335 E019.47.16.795 Color_251ACI
N050.04.28.335 E019.47.16.795 N050.04.29.488 E019.47.15.966 Color_251ACI
N050.04.29.488 E019.47.15.966 N050.04.29.848 E019.47.15.992 Color_251ACI
N050.04.29.848 E019.47.15.992 N050.04.29.865 E019.47.16.049 Color_251ACI
N050.04.30.360 E019.47.17.872 N050.04.30.330 E019.47.17.996 Color_251ACI
N050.04.30.330 E019.47.17.996 N050.04.29.740 E019.47.18.403 Color_251ACI
N050.04.29.740 E019.47.18.403 N050.04.29.821 E019.47.18.690 Color_251ACI
N050.04.29.821 E019.47.18.690 N050.04.30.401 E019.47.18.325 Color_251ACI
N050.04.30.401 E019.47.18.325 N050.04.30.475 E019.47.18.274 Color_251ACI
N050.04.28.575 E019.47.24.083 N050.04.28.633 E019.47.23.975 Color_251ACI
N050.04.28.633 E019.47.23.975 N050.04.28.690 E019.47.23.866 Color_251ACI
N050.04.28.690 E019.47.23.866 N050.04.28.959 E019.47.23.647 Color_251ACI
N050.04.28.959 E019.47.23.647 N050.04.29.096 E019.47.23.587 Color_251ACI
N050.04.29.096 E019.47.23.587 N050.04.29.133 E019.47.23.561 Color_251ACI
N050.04.29.133 E019.47.23.561 N050.04.29.233 E019.47.23.526 Color_251ACI
N050.04.29.233 E019.47.23.526 N050.04.29.339 E019.47.23.590 Color_251ACI
N050.04.29.339 E019.47.23.590 N050.04.29.515 E019.47.23.744 Color_251ACI
N050.04.28.009 E019.47.25.504 N050.04.28.760 E019.47.28.146 Color_251ACI
N050.04.28.760 E019.47.28.146 N050.04.28.981 E019.47.27.994 Color_251ACI
N050.04.28.981 E019.47.27.994 N050.04.29.020 E019.47.28.207 Color_251ACI
N050.04.29.020 E019.47.28.207 N050.04.29.267 E019.47.28.071 Color_251ACI
N050.04.29.267 E019.47.28.071 N050.04.29.404 E019.47.28.629 Color_251ACI
N050.04.29.404 E019.47.28.629 N050.04.29.353 E019.47.28.836 Color_251ACI
N050.04.29.353 E019.47.28.836 N050.04.29.232 E019.47.28.954 Color_251ACI
N050.04.29.232 E019.47.28.954 N050.04.29.037 E019.47.29.123 Color_251ACI
N050.04.29.515 E019.47.23.744 N050.04.30.621 E019.47.27.790 Color_251ACI
N050.04.30.621 E019.47.27.790 N050.04.30.908 E019.47.28.725 Color_251ACI
N050.04.30.908 E019.47.28.725 N050.04.30.742 E019.47.29.149 Color_251ACI
N050.04.30.742 E019.47.29.149 N050.04.29.974 E019.47.29.163 Color_251ACI
N050.04.26.479 E019.47.28.345 N050.04.25.335 E019.47.28.894 Color_251ACI
N050.04.29.037 E019.47.29.123 N050.04.28.125 E019.47.28.240 Color_251ACI
N050.04.28.125 E019.47.28.240 N050.04.27.893 E019.47.26.958 Color_251ACI
N050.04.27.893 E019.47.26.958 N050.04.26.939 E019.47.27.478 Color_251ACI
N050.04.26.939 E019.47.27.478 N050.04.26.501 E019.47.25.548 Color_251ACI
N050.04.20.906 E019.46.51.417 N050.04.21.060 E019.46.51.414 Color_251ACI
N050.04.21.060 E019.46.51.414 N050.04.21.311 E019.46.51.756 Color_251ACI
N050.04.21.311 E019.46.51.756 N050.04.21.856 E019.46.53.751 Color_251ACI
N050.04.21.856 E019.46.53.751 N050.04.22.928 E019.46.57.682 Color_251ACI
N050.04.22.928 E019.46.57.682 N050.04.23.265 E019.46.58.790 Color_251ACI
N050.04.32.855 E019.47.44.660 N050.04.30.930 E019.47.30.977 Color_251ACI
N050.04.30.930 E019.47.30.977 N050.04.30.657 E019.47.30.479 Color_251ACI
N050.04.30.657 E019.47.30.479 N050.04.30.459 E019.47.30.169 Color_251ACI
N050.04.30.459 E019.47.30.169 N050.04.30.054 E019.47.29.830 Color_251ACI
N050.04.30.054 E019.47.29.830 N050.04.29.714 E019.47.29.721 Color_251ACI
N050.04.29.714 E019.47.29.721 N050.04.29.333 E019.47.29.777 Color_251ACI
N050.04.29.333 E019.47.29.777 N050.04.29.122 E019.47.29.888 Color_251ACI
N050.04.29.122 E019.47.29.888 N050.04.28.874 E019.47.30.025 Color_251ACI
N050.04.28.874 E019.47.30.025 N050.04.28.598 E019.47.30.525 Color_251ACI
N050.04.28.598 E019.47.30.525 N050.04.28.856 E019.47.31.823 Color_251ACI
N050.04.28.856 E019.47.31.823 N050.04.27.337 E019.47.32.528 Color_251ACI
N050.04.32.787 E019.47.26.571 N050.04.32.417 E019.47.26.586 Color_251ACI
N050.04.32.417 E019.47.26.586 N050.04.31.237 E019.47.27.400 Color_251ACI
N050.04.31.237 E019.47.27.400 N050.04.31.054 E019.47.27.766 Color_251ACI
N050.04.31.054 E019.47.27.766 N050.04.31.158 E019.47.28.209 Color_251ACI
N050.04.31.158 E019.47.28.209 N050.04.31.377 E019.47.28.436 Color_251ACI
N050.04.31.377 E019.47.28.436 N050.04.31.682 E019.47.28.810 Color_251ACI
N050.04.31.682 E019.47.28.810 N050.04.32.203 E019.47.29.172 Color_251ACI
N050.04.32.203 E019.47.29.172 N050.04.32.789 E019.47.28.905 Color_251ACI
N050.04.32.789 E019.47.28.905 N050.04.33.017 E019.47.28.233 Color_251ACI
N050.04.33.017 E019.47.28.233 N050.04.33.087 E019.47.27.704 Color_251ACI
N050.04.33.087 E019.47.27.704 N050.04.32.787 E019.47.26.571 Color_251ACI
N050.04.41.257 E019.47.23.718 N050.04.41.239 E019.47.24.898 Color_251ACI
N050.04.41.239 E019.47.24.898 N050.04.40.772 E019.47.26.045 Color_251ACI
N050.04.40.772 E019.47.26.045 N050.04.39.987 E019.47.26.620 Color_251ACI
N050.04.39.987 E019.47.26.620 N050.04.35.473 E019.47.28.188 Color_251ACI
N050.04.35.473 E019.47.28.188 N050.04.34.779 E019.47.28.151 Color_251ACI
N050.04.34.779 E019.47.28.151 N050.04.34.315 E019.47.27.681 Color_251ACI
N050.04.34.315 E019.47.27.681 N050.04.33.990 E019.47.26.772 Color_251ACI
N050.04.33.990 E019.47.26.772 N050.04.33.937 E019.47.26.740 Color_251ACI
N050.04.35.316 E019.47.43.856 N050.04.33.520 E019.47.31.012 Color_251ACI
N050.04.33.520 E019.47.31.012 N050.04.33.424 E019.47.30.288 Color_251ACI
N050.04.31.446 E019.47.55.764 N050.04.30.766 E019.47.56.164 Color_251ACI
N050.04.30.766 E019.47.56.164 N050.04.29.261 E019.47.56.687 Color_251ACI
N050.04.35.929 E019.47.49.272 N050.04.33.298 E019.47.55.689 Color_251ACI
N050.04.33.298 E019.47.55.689 N050.04.33.376 E019.47.56.116 Color_251ACI
N050.04.39.032 E019.48.10.523 N050.04.37.846 E019.48.01.998 Color_251ACI
N050.04.37.846 E019.48.01.998 N050.04.37.629 E019.48.01.392 Color_251ACI
N050.04.37.629 E019.48.01.392 N050.04.37.202 E019.48.00.897 Color_251ACI
N050.04.37.202 E019.48.00.897 N050.04.33.322 E019.47.58.180 Color_251ACI
N050.04.33.376 E019.47.56.116 N050.04.35.462 E019.47.57.563 Color_251ACI
N050.04.35.462 E019.47.57.563 N050.04.36.262 E019.47.57.664 Color_251ACI
N050.04.36.262 E019.47.57.664 N050.04.36.844 E019.47.56.919 Color_251ACI
N050.04.36.844 E019.47.56.919 N050.04.36.978 E019.47.55.762 Color_251ACI
N050.04.36.978 E019.47.55.762 N050.04.36.626 E019.47.53.359 Color_251ACI
N050.04.33.322 E019.47.58.180 N050.04.33.228 E019.47.58.313 Color_251ACI
N050.04.33.228 E019.47.58.313 N050.04.33.160 E019.47.58.463 Color_251ACI
N050.04.33.160 E019.47.58.463 N050.04.33.021 E019.47.58.903 Color_251ACI
N050.04.33.021 E019.47.58.903 N050.04.33.702 E019.47.59.360 Color_251ACI
N050.04.33.702 E019.47.59.360 N050.04.33.769 E019.47.59.829 Color_251ACI
N050.04.33.769 E019.47.59.829 N050.04.33.728 E019.47.59.995 Color_251ACI
N050.04.33.728 E019.47.59.995 N050.04.33.570 E019.48.00.138 Color_251ACI
N050.04.33.570 E019.48.00.138 N050.04.33.303 E019.48.01.216 Color_251ACI
N050.04.33.303 E019.48.01.216 N050.04.32.814 E019.48.00.969 Color_251ACI
N050.04.32.814 E019.48.00.969 N050.04.32.670 E019.48.01.549 Color_251ACI
N050.04.32.670 E019.48.01.549 N050.04.32.527 E019.48.01.510 Color_251ACI
N050.04.32.527 E019.48.01.510 N050.04.32.447 E019.48.01.462 Color_251ACI
N050.04.32.108 E019.48.01.353 N050.04.31.964 E019.48.01.314 Color_251ACI
N050.04.31.964 E019.48.01.314 N050.04.32.076 E019.48.00.619 Color_251ACI
N050.04.32.076 E019.48.00.619 N050.04.32.135 E019.48.00.132 Color_251ACI
N050.04.32.135 E019.48.00.132 N050.04.32.247 E019.47.59.437 Color_251ACI
N050.04.32.247 E019.47.59.437 N050.04.32.329 E019.47.59.105 Color_251ACI
N050.04.32.329 E019.47.59.105 N050.04.32.259 E019.47.59.016 Color_251ACI
N050.04.32.259 E019.47.59.016 N050.04.32.327 E019.47.58.866 Color_251ACI
N050.04.32.327 E019.47.58.866 N050.04.32.354 E019.47.58.882 Color_251ACI
N050.04.32.354 E019.47.58.882 N050.04.32.390 E019.47.58.857 Color_251ACI
N050.04.32.390 E019.47.58.857 N050.04.32.454 E019.47.58.847 Color_251ACI
N050.04.32.454 E019.47.58.847 N050.04.32.464 E019.47.58.806 Color_251ACI
N050.04.32.464 E019.47.58.806 N050.04.32.474 E019.47.58.764 Color_251ACI
N050.04.32.474 E019.47.58.764 N050.04.32.505 E019.47.58.640 Color_251ACI
N050.04.32.505 E019.47.58.640 N050.04.32.489 E019.47.58.583 Color_251ACI
N050.04.32.489 E019.47.58.583 N050.04.32.536 E019.47.58.516 Color_251ACI
N050.04.32.536 E019.47.58.516 N050.04.32.536 E019.47.58.516 Color_251ACI
N050.04.32.536 E019.47.58.516 N050.04.32.563 E019.47.58.532 Color_251ACI
N050.04.32.563 E019.47.58.532 N050.04.32.606 E019.47.58.605 Color_251ACI
N050.04.32.606 E019.47.58.605 N050.04.32.675 E019.47.58.695 Color_251ACI
N050.04.32.675 E019.47.58.695 N050.04.32.846 E019.47.58.131 Color_251ACI
N050.04.32.846 E019.47.58.131 N050.04.32.856 E019.47.58.089 Color_251ACI
N050.04.32.856 E019.47.58.089 N050.04.32.876 E019.47.58.006 Color_251ACI
N050.04.32.876 E019.47.58.006 N050.04.32.860 E019.47.57.949 Color_251ACI
N050.04.32.860 E019.47.57.949 N050.04.32.860 E019.47.57.949 Color_251ACI
N050.04.32.860 E019.47.57.949 N050.04.32.827 E019.47.57.834 Color_251ACI
N050.04.21.366 E019.47.59.314 N050.04.21.596 E019.48.00.976 Color_251ACI
N050.04.21.596 E019.48.00.976 N050.04.22.047 E019.48.03.963 Color_251ACI
N050.04.22.047 E019.48.03.963 N050.04.22.289 E019.48.05.822 Color_251ACI
N050.04.22.289 E019.48.05.822 N050.04.22.474 E019.48.07.172 Color_251ACI
N050.04.22.474 E019.48.07.172 N050.04.22.766 E019.48.09.443 Color_251ACI
N050.04.22.766 E019.48.09.443 N050.04.22.872 E019.48.10.126 Color_251ACI
N050.04.22.872 E019.48.10.126 N050.04.22.949 E019.48.10.553 Color_251ACI
N050.04.22.949 E019.48.10.553 N050.04.23.234 E019.48.12.487 Color_251ACI
N050.04.23.234 E019.48.12.487 N050.04.23.329 E019.48.13.211 Color_251ACI
N050.04.23.329 E019.48.13.211 N050.04.23.386 E019.48.13.721 Color_251ACI
N050.04.23.386 E019.48.13.721 N050.04.23.403 E019.48.13.779 Color_251ACI
N050.04.23.403 E019.48.13.779 N050.04.23.677 E019.48.15.754 Color_251ACI
N050.04.35.316 E019.47.43.856 N050.04.35.389 E019.47.44.424 Color_251ACI
N050.04.35.389 E019.47.44.424 N050.04.35.411 E019.47.45.199 Color_251ACI
N050.04.35.411 E019.47.45.199 N050.04.35.490 E019.47.45.865 Color_251ACI
N050.04.35.490 E019.47.45.865 N050.04.35.395 E019.47.46.618 Color_251ACI
N050.04.35.395 E019.47.46.618 N050.04.35.003 E019.47.47.953 Color_251ACI
N050.04.35.003 E019.47.47.953 N050.04.32.752 E019.47.53.455 Color_251ACI
N050.04.32.752 E019.47.53.455 N050.04.32.450 E019.47.54.178 Color_251ACI
N050.04.32.450 E019.47.54.178 N050.04.31.835 E019.47.55.427 Color_251ACI
N050.04.31.835 E019.47.55.427 N050.04.31.714 E019.47.55.545 Color_251ACI
N050.04.22.524 E019.47.57.726 N050.04.22.852 E019.47.57.637 Color_251ACI
N050.04.22.852 E019.47.57.637 N050.04.22.890 E019.47.57.851 Color_251ACI
N050.04.22.890 E019.47.57.851 N050.04.23.429 E019.47.57.652 Color_251ACI
N050.04.23.429 E019.47.57.652 N050.04.23.621 E019.47.57.862 Color_251ACI
N050.04.23.621 E019.47.57.862 N050.04.23.660 E019.47.58.076 Color_251ACI
N050.04.23.660 E019.47.58.076 N050.04.23.682 E019.47.58.233 Color_251ACI
N050.04.23.682 E019.47.58.233 N050.04.23.516 E019.47.58.656 Color_251ACI
N050.04.23.516 E019.47.58.656 N050.04.22.724 E019.47.58.894 Color_251ACI
N050.04.29.261 E019.47.56.687 N050.04.24.255 E019.47.58.387 Color_251ACI
N050.04.24.255 E019.47.58.387 N050.04.24.030 E019.47.58.061 Color_251ACI
N050.04.24.030 E019.47.58.061 N050.04.23.987 E019.47.57.988 Color_251ACI
N050.04.23.987 E019.47.57.988 N050.04.23.949 E019.47.57.774 Color_251ACI
N050.04.23.949 E019.47.57.774 N050.04.24.068 E019.47.57.417 Color_251ACI
N050.04.24.068 E019.47.57.417 N050.04.24.617 E019.47.57.176 Color_251ACI
N050.04.24.617 E019.47.57.176 N050.04.24.444 E019.47.56.024 Color_251ACI
N050.04.24.444 E019.47.56.024 N050.04.22.695 E019.47.56.543 Color_251ACI
N050.04.22.695 E019.47.56.543 N050.04.22.558 E019.47.56.603 Color_251ACI
N050.04.22.558 E019.47.56.603 N050.04.22.615 E019.47.57.114 Color_251ACI
N050.04.22.641 E019.47.57.130 N050.04.22.580 E019.47.57.378 Color_251ACI
N050.04.22.580 E019.47.57.378 N050.04.22.543 E019.47.57.404 Color_251ACI
N050.04.22.543 E019.47.57.404 N050.04.22.533 E019.47.57.445 Color_251ACI
N050.04.22.533 E019.47.57.445 N050.04.22.469 E019.47.57.455 Color_251ACI
N050.04.22.469 E019.47.57.455 N050.04.22.484 E019.47.57.273 Color_251ACI
N050.04.22.484 E019.47.57.273 N050.04.22.283 E019.47.57.343 Color_251ACI
N050.04.22.283 E019.47.57.343 N050.04.22.200 E019.47.56.816 Color_251ACI
N050.04.22.200 E019.47.56.816 N050.04.21.999 E019.47.56.886 Color_251ACI
N050.04.21.999 E019.47.56.886 N050.04.21.835 E019.47.56.930 Color_251ACI
N050.04.21.835 E019.47.56.930 N050.04.21.593 E019.47.57.166 Color_251ACI
N050.04.21.593 E019.47.57.166 N050.04.21.532 E019.47.56.795 Color_251ACI
N050.04.21.532 E019.47.56.795 N050.04.21.264 E019.47.57.015 Color_251ACI
N050.04.21.264 E019.47.57.015 N050.04.21.352 E019.47.57.401 Color_251ACI
N050.04.21.352 E019.47.57.401 N050.04.21.526 E019.47.57.315 Color_251ACI
N050.04.21.526 E019.47.57.315 N050.04.21.627 E019.47.58.138 Color_251ACI
N050.04.39.264 E019.48.10.329 N050.04.39.032 E019.48.10.523 Color_251ACI
N050.04.39.032 E019.48.10.523 N050.04.38.183 E019.48.10.868 Color_251ACI
N050.04.38.183 E019.48.10.868 N050.04.37.758 E019.48.07.898 Color_251ACI
N050.04.37.758 E019.48.07.898 N050.04.32.715 E019.48.09.624 Color_251ACI
N050.04.32.715 E019.48.09.624 N050.04.33.112 E019.48.12.339 Color_251ACI
N050.04.33.112 E019.48.12.339 N050.04.32.108 E019.48.12.687 Color_251ACI
N050.04.32.108 E019.48.12.687 N050.04.30.908 E019.48.12.107 Color_251ACI
N050.04.30.908 E019.48.12.107 N050.04.30.795 E019.48.12.563 Color_251ACI
N050.04.30.795 E019.48.12.563 N050.04.29.716 E019.48.12.104 Color_251ACI
N050.04.27.964 E019.48.10.049 N050.04.27.864 E019.48.10.084 Color_251ACI
N050.04.27.864 E019.48.10.084 N050.04.27.764 E019.48.09.500 Color_251ACI
N050.04.27.671 E019.48.09.015 N050.04.27.586 E019.48.08.250 Color_251ACI
N050.04.27.715 E019.48.07.851 N050.04.27.787 E019.48.07.561 Color_251ACI
N050.04.27.787 E019.48.07.561 N050.04.27.791 E019.48.07.421 Color_251ACI
N050.04.27.791 E019.48.07.421 N050.04.27.785 E019.48.07.322 Color_251ACI
N050.04.27.785 E019.48.07.322 N050.04.27.773 E019.48.07.124 Color_251ACI
N050.04.27.773 E019.48.07.124 N050.04.27.783 E019.48.07.083 Color_251ACI
N050.04.38.494 E019.48.14.913 N050.04.36.197 E019.48.15.672 Color_251ACI
N050.04.36.197 E019.48.15.672 N050.04.36.156 E019.48.15.219 Color_251ACI
N050.04.36.156 E019.48.15.219 N050.04.32.090 E019.48.16.581 Color_251ACI
N050.04.32.090 E019.48.16.581 N050.04.30.523 E019.48.15.875 Color_251ACI
N050.04.39.745 E019.48.13.809 N050.04.39.778 E019.48.13.924 Color_251ACI
N050.04.39.778 E019.48.13.924 N050.04.38.691 E019.48.14.365 Color_251ACI
N050.04.38.691 E019.48.14.365 N050.04.38.731 E019.48.14.818 Color_251ACI
N050.04.38.731 E019.48.14.818 N050.04.38.631 E019.48.14.852 Color_251ACI
N050.04.38.631 E019.48.14.852 N050.04.38.664 E019.48.14.967 Color_251ACI
N050.04.38.664 E019.48.14.967 N050.04.38.526 E019.48.15.028 Color_251ACI
N050.04.38.526 E019.48.15.028 N050.04.38.494 E019.48.14.913 Color_251ACI
N050.04.30.782 E019.48.06.698 N050.04.31.058 E019.48.05.340 Color_251ACI
N050.04.31.058 E019.48.05.340 N050.04.29.388 E019.48.05.049 Color_251ACI
N050.04.29.388 E019.48.05.049 N050.04.28.741 E019.48.04.945 Color_251ACI
N050.04.28.741 E019.48.04.945 N050.04.28.443 E019.48.06.147 Color_251ACI
N050.04.28.191 E019.48.07.042 N050.04.27.903 E019.48.08.202 Color_251ACI
N050.04.27.903 E019.48.08.202 N050.04.28.500 E019.48.08.752 Color_251ACI
N050.04.28.500 E019.48.08.752 N050.04.28.153 E019.48.09.782 Color_251ACI
N050.04.28.153 E019.48.09.782 N050.04.28.452 E019.48.10.057 Color_251ACI
N050.04.28.452 E019.48.10.057 N050.04.28.783 E019.48.10.447 Color_251ACI
;buildings_lines N000.00.00.000 E000.00.00.000 N000.00.00.000 E000.00.00.000
N050.04.23.250 E019.48.30.783 N050.04.23.634 E019.48.31.823 Color_18ACI
N050.04.23.634 E019.48.31.823 N050.04.24.023 E019.48.31.486 Color_18ACI
N050.04.24.023 E019.48.31.486 N050.04.23.613 E019.48.30.430 Color_18ACI
N050.04.23.613 E019.48.30.430 N050.04.23.250 E019.48.30.783 Color_18ACI
N050.04.57.990 E019.47.28.699 N050.05.00.408 E019.47.27.822 Color_18ACI
N050.05.00.408 E019.47.27.822 N050.05.00.471 E019.47.28.431 Color_18ACI
N050.05.00.471 E019.47.28.431 N050.04.58.106 E019.47.29.340 Color_18ACI
N050.04.58.106 E019.47.29.340 N050.04.57.990 E019.47.28.699 Color_18ACI
N050.04.27.526 E019.47.23.879 N050.04.28.617 E019.47.23.298 Color_18ACI
N050.04.28.617 E019.47.23.298 N050.04.28.202 E019.47.23.001 Color_18ACI
N050.04.28.202 E019.47.23.001 N050.04.27.616 E019.47.23.267 Color_18ACI
N050.04.27.616 E019.47.23.267 N050.04.27.221 E019.47.21.410 Color_18ACI
N050.04.27.221 E019.47.21.410 N050.04.27.817 E019.47.21.102 Color_18ACI
N050.04.27.817 E019.47.21.102 N050.04.28.202 E019.47.23.001 Color_18ACI
N050.04.28.202 E019.47.23.001 N050.04.28.617 E019.47.23.298 Color_18ACI
N050.04.28.617 E019.47.23.298 N050.04.28.177 E019.47.21.129 Color_18ACI
N050.04.28.177 E019.47.21.129 N050.04.28.067 E019.47.21.205 Color_18ACI
N050.04.28.067 E019.47.21.205 N050.04.27.951 E019.47.20.564 Color_18ACI
N050.04.27.951 E019.47.20.564 N050.04.26.816 E019.47.21.071 Color_18ACI
N050.04.26.816 E019.47.21.071 N050.04.27.246 E019.47.23.282 Color_18ACI
N050.04.27.246 E019.47.23.282 N050.04.27.357 E019.47.23.206 Color_18ACI
N050.04.27.357 E019.47.23.206 N050.04.27.526 E019.47.23.879 Color_18ACI
N050.04.24.073 E019.47.54.563 N050.04.22.678 E019.47.55.009 Color_18ACI
N050.04.22.678 E019.47.55.009 N050.04.22.723 E019.47.55.322 Color_18ACI
N050.04.22.723 E019.47.55.322 N050.04.22.559 E019.47.55.366 Color_18ACI
N050.04.22.559 E019.47.55.366 N050.04.22.695 E019.47.56.543 Color_18ACI
N050.04.22.695 E019.47.56.543 N050.04.24.444 E019.47.56.024 Color_18ACI
N050.04.24.444 E019.47.56.024 N050.04.24.291 E019.47.54.790 Color_18ACI
N050.04.24.291 E019.47.54.790 N050.04.24.101 E019.47.54.818 Color_18ACI
N050.04.24.101 E019.47.54.818 N050.04.24.073 E019.47.54.563 Color_18ACI
N050.04.23.770 E019.47.11.665 N050.04.23.973 E019.47.13.312 Color_18ACI
N050.04.23.973 E019.47.13.312 N050.04.23.545 E019.47.13.435 Color_18ACI
N050.04.23.545 E019.47.13.435 N050.04.23.342 E019.47.11.789 Color_18ACI
N050.04.23.342 E019.47.11.789 N050.04.23.770 E019.47.11.665 Color_18ACI
N050.04.24.842 E019.47.26.692 N050.04.25.149 E019.47.28.163 Color_18ACI
N050.04.25.149 E019.47.28.163 N050.04.24.791 E019.47.28.376 Color_18ACI
N050.04.24.791 E019.47.28.376 N050.04.24.457 E019.47.26.889 Color_18ACI
N050.04.24.457 E019.47.26.889 N050.04.24.842 E019.47.26.692 Color_18ACI
N050.04.22.766 E019.47.04.870 N050.04.22.894 E019.47.05.709 Color_18ACI
N050.04.22.894 E019.47.05.709 N050.04.22.593 E019.47.05.814 Color_18ACI
N050.04.22.593 E019.47.05.814 N050.04.22.465 E019.47.04.975 Color_18ACI
N050.04.22.465 E019.47.04.975 N050.04.22.766 E019.47.04.870 Color_18ACI
N050.04.22.636 E019.47.03.792 N050.04.22.703 E019.47.04.261 Color_18ACI
N050.04.22.703 E019.47.04.261 N050.04.22.502 E019.47.04.331 Color_18ACI
N050.04.22.502 E019.47.04.331 N050.04.22.435 E019.47.03.862 Color_18ACI
N050.04.22.435 E019.47.03.862 N050.04.22.636 E019.47.03.792 Color_18ACI
N050.04.20.467 E019.46.52.819 N050.04.19.652 E019.46.52.900 Color_18ACI
N050.04.19.652 E019.46.52.900 N050.04.19.626 E019.46.52.266 Color_18ACI
N050.04.19.626 E019.46.52.266 N050.04.20.414 E019.46.52.169 Color_18ACI
N050.04.20.414 E019.46.52.169 N050.04.20.467 E019.46.52.819 Color_18ACI
N050.04.21.400 E019.48.14.954 N050.04.20.644 E019.48.15.166 Color_18ACI
N050.04.20.644 E019.48.15.166 N050.04.20.638 E019.48.15.067 Color_18ACI
N050.04.20.638 E019.48.15.067 N050.04.20.310 E019.48.15.155 Color_18ACI
N050.04.20.310 E019.48.15.155 N050.04.20.479 E019.48.16.447 Color_18ACI
N050.04.20.479 E019.48.16.447 N050.04.20.780 E019.48.16.343 Color_18ACI
N050.04.20.780 E019.48.16.343 N050.04.20.786 E019.48.16.442 Color_18ACI
N050.04.20.786 E019.48.16.442 N050.04.21.589 E019.48.16.163 Color_18ACI
N050.04.21.589 E019.48.16.163 N050.04.21.400 E019.48.14.954 Color_18ACI
N050.04.22.740 E019.48.12.999 N050.04.21.071 E019.48.13.566 Color_18ACI
N050.04.21.071 E019.48.13.566 N050.04.20.949 E019.48.12.826 Color_18ACI
N050.04.20.949 E019.48.12.826 N050.04.21.203 E019.48.12.788 Color_18ACI
N050.04.21.203 E019.48.12.788 N050.04.20.980 E019.48.11.225 Color_18ACI
N050.04.20.980 E019.48.11.225 N050.04.22.184 E019.48.10.807 Color_18ACI
N050.04.22.184 E019.48.10.807 N050.04.22.407 E019.48.12.370 Color_18ACI
N050.04.22.407 E019.48.12.370 N050.04.22.645 E019.48.12.275 Color_18ACI
N050.04.22.645 E019.48.12.275 N050.04.22.740 E019.48.12.999 Color_18ACI
N050.04.21.406 E019.48.10.862 N050.04.20.101 E019.48.11.315 Color_18ACI
N050.04.20.101 E019.48.11.315 N050.04.20.034 E019.48.10.846 Color_18ACI
N050.04.20.034 E019.48.10.846 N050.04.21.064 E019.48.10.514 Color_18ACI
N050.04.21.064 E019.48.10.514 N050.04.21.026 E019.48.10.300 Color_18ACI
N050.04.21.026 E019.48.10.300 N050.04.21.290 E019.48.10.221 Color_18ACI
N050.04.21.290 E019.48.10.221 N050.04.21.406 E019.48.10.862 Color_18ACI
N050.04.20.914 E019.48.09.518 N050.04.19.910 E019.48.09.867 Color_18ACI
N050.04.19.910 E019.48.09.867 N050.04.19.849 E019.48.09.497 Color_18ACI
N050.04.19.849 E019.48.09.497 N050.04.20.842 E019.48.09.190 Color_18ACI
N050.04.20.842 E019.48.09.190 N050.04.20.914 E019.48.09.518 Color_18ACI
N050.04.21.463 E019.48.09.277 N050.04.22.509 E019.48.09.003 Color_18ACI
N050.04.22.509 E019.48.09.003 N050.04.22.553 E019.48.09.315 Color_18ACI
N050.04.22.553 E019.48.09.315 N050.04.21.507 E019.48.09.590 Color_18ACI
N050.04.21.507 E019.48.09.590 N050.04.21.463 E019.48.09.277 Color_18ACI
N050.04.22.468 E019.48.08.550 N050.04.21.506 E019.48.08.732 Color_18ACI
N050.04.21.506 E019.48.08.732 N050.04.21.439 E019.48.08.263 Color_18ACI
N050.04.21.439 E019.48.08.263 N050.04.21.793 E019.48.08.191 Color_18ACI
N050.04.21.793 E019.48.08.191 N050.04.21.726 E019.48.07.722 Color_18ACI
N050.04.21.726 E019.48.07.722 N050.04.22.381 E019.48.07.545 Color_18ACI
N050.04.22.381 E019.48.07.545 N050.04.22.468 E019.48.08.550 Color_18ACI
N050.04.20.783 E019.48.07.582 N050.04.19.716 E019.48.07.940 Color_18ACI
N050.04.19.716 E019.48.07.940 N050.04.19.773 E019.48.08.451 Color_18ACI
N050.04.19.773 E019.48.08.451 N050.04.20.201 E019.48.08.327 Color_18ACI
N050.04.20.201 E019.48.08.327 N050.04.20.284 E019.48.08.854 Color_18ACI
N050.04.20.284 E019.48.08.854 N050.04.20.395 E019.48.08.777 Color_18ACI
N050.04.20.395 E019.48.08.777 N050.04.20.328 E019.48.08.308 Color_18ACI
N050.04.20.328 E019.48.08.308 N050.04.20.555 E019.48.08.255 Color_18ACI
N050.04.20.555 E019.48.08.255 N050.04.20.587 E019.48.08.370 Color_18ACI
N050.04.20.587 E019.48.08.370 N050.04.20.878 E019.48.08.306 Color_18ACI
N050.04.20.878 E019.48.08.306 N050.04.20.783 E019.48.07.582 Color_18ACI
N050.04.18.643 E019.47.59.818 N050.04.19.438 E019.48.05.487 Color_18ACI
N050.04.19.438 E019.48.05.487 N050.04.19.886 E019.48.05.281 Color_18ACI
N050.04.19.886 E019.48.05.281 N050.04.19.915 E019.48.05.536 Color_18ACI
N050.04.19.915 E019.48.05.536 N050.04.20.380 E019.48.05.387 Color_18ACI
N050.04.20.380 E019.48.05.387 N050.04.20.325 E019.48.05.116 Color_18ACI
N050.04.20.325 E019.48.05.116 N050.04.20.789 E019.48.04.967 Color_18ACI
N050.04.20.789 E019.48.04.967 N050.04.20.924 E019.48.05.905 Color_18ACI
N050.04.20.924 E019.48.05.905 N050.04.21.124 E019.48.05.836 Color_18ACI
N050.04.21.124 E019.48.05.836 N050.04.20.602 E019.48.01.902 Color_18ACI
N050.04.20.602 E019.48.01.902 N050.04.20.338 E019.48.01.981 Color_18ACI
N050.04.20.338 E019.48.01.981 N050.04.20.180 E019.48.00.648 Color_18ACI
N050.04.20.180 E019.48.00.648 N050.04.21.421 E019.48.00.204 Color_18ACI
N050.04.21.421 E019.48.00.204 N050.04.21.268 E019.47.58.970 Color_18ACI
N050.04.21.268 E019.47.58.970 N050.04.20.001 E019.47.59.397 Color_18ACI
N050.04.20.001 E019.47.59.397 N050.04.19.985 E019.47.59.340 Color_18ACI
N050.04.19.985 E019.47.59.340 N050.04.19.082 E019.47.59.653 Color_18ACI
N050.04.19.082 E019.47.59.653 N050.04.19.037 E019.47.59.341 Color_18ACI
N050.04.19.037 E019.47.59.341 N050.04.18.736 E019.47.59.445 Color_18ACI
N050.04.18.736 E019.47.59.445 N050.04.18.781 E019.47.59.758 Color_18ACI
N050.04.18.781 E019.47.59.758 N050.04.18.643 E019.47.59.818 Color_18ACI
N050.04.29.196 E019.48.09.028 N050.04.28.937 E019.48.09.825 Color_18ACI
N050.04.28.937 E019.48.09.825 N050.04.28.681 E019.48.09.623 Color_18ACI
N050.04.28.681 E019.48.09.623 N050.04.28.913 E019.48.08.811 Color_18ACI
N050.04.28.913 E019.48.08.811 N050.04.29.196 E019.48.09.028 Color_18ACI
N050.04.29.491 E019.48.06.730 N050.04.29.859 E019.48.07.094 Color_18ACI
N050.04.29.859 E019.48.07.094 N050.04.29.920 E019.48.06.846 Color_18ACI
N050.04.29.920 E019.48.06.846 N050.04.29.579 E019.48.06.497 Color_18ACI
N050.04.29.579 E019.48.06.497 N050.04.29.491 E019.48.06.730 Color_18ACI
N050.04.22.067 E019.47.54.641 N050.04.21.491 E019.47.54.866 Color_18ACI
N050.04.21.491 E019.47.54.866 N050.04.21.412 E019.47.54.199 Color_18ACI
N050.04.21.412 E019.47.54.199 N050.04.22.004 E019.47.54.032 Color_18ACI
N050.04.22.004 E019.47.54.032 N050.04.22.067 E019.47.54.641 Color_18ACI
N050.04.21.638 E019.47.58.097 N050.04.21.526 E019.47.57.315 Color_18ACI
N050.04.21.526 E019.47.57.315 N050.04.21.352 E019.47.57.401 Color_18ACI
N050.04.21.352 E019.47.57.401 N050.04.21.447 E019.47.58.125 Color_18ACI
N050.04.21.447 E019.47.58.125 N050.04.21.638 E019.47.58.097 Color_18ACI
N050.04.21.065 E019.47.57.942 N050.04.20.674 E019.47.58.040 Color_18ACI
N050.04.20.674 E019.47.58.040 N050.04.20.692 E019.47.58.337 Color_18ACI
N050.04.20.692 E019.47.58.337 N050.04.21.120 E019.47.58.214 Color_18ACI
N050.04.21.120 E019.47.58.214 N050.04.21.065 E019.47.57.942 Color_18ACI
N050.04.21.532 E019.47.56.795 N050.04.21.264 E019.47.57.015 Color_18ACI
N050.04.21.264 E019.47.57.015 N050.04.21.074 E019.47.56.424 Color_18ACI
N050.04.21.074 E019.47.56.424 N050.04.21.369 E019.47.56.221 Color_18ACI
N050.04.21.369 E019.47.56.221 N050.04.21.532 E019.47.56.795 Color_18ACI
N050.04.26.023 E019.47.26.118 N050.04.26.441 E019.47.28.131 Color_18ACI
N050.04.26.441 E019.47.28.131 N050.04.25.982 E019.47.28.379 Color_18ACI
N050.04.25.982 E019.47.28.379 N050.04.25.911 E019.47.28.050 Color_18ACI
N050.04.25.911 E019.47.28.050 N050.04.26.085 E019.47.27.964 Color_18ACI
N050.04.26.085 E019.47.27.964 N050.04.25.712 E019.47.26.264 Color_18ACI
N050.04.25.712 E019.47.26.264 N050.04.26.023 E019.47.26.118 Color_18ACI
N050.04.39.693 E019.48.27.206 N050.04.39.829 E019.48.28.383 Color_18ACI
N050.04.39.829 E019.48.28.383 N050.04.40.294 E019.48.28.235 Color_18ACI
N050.04.40.294 E019.48.28.235 N050.04.40.158 E019.48.27.058 Color_18ACI
N050.04.40.158 E019.48.27.058 N050.04.39.693 E019.48.27.206 Color_18ACI
N050.04.38.969 E019.48.28.770 N050.04.38.800 E019.48.27.478 Color_18ACI
N050.04.38.800 E019.48.27.478 N050.04.37.982 E019.48.27.700 Color_18ACI
N050.04.37.982 E019.48.27.700 N050.04.38.038 E019.48.28.210 Color_18ACI
N050.04.38.038 E019.48.28.210 N050.04.38.530 E019.48.28.077 Color_18ACI
N050.04.38.530 E019.48.28.077 N050.04.38.641 E019.48.28.859 Color_18ACI
N050.04.38.641 E019.48.28.859 N050.04.38.969 E019.48.28.770 Color_18ACI
N050.04.30.307 E019.47.54.317 N050.04.30.619 E019.47.54.171 Color_18ACI
N050.04.30.619 E019.47.54.171 N050.04.30.594 E019.47.53.775 Color_18ACI
N050.04.30.594 E019.47.53.775 N050.04.30.230 E019.47.53.889 Color_18ACI
N050.04.30.230 E019.47.53.889 N050.04.30.307 E019.47.54.317 Color_18ACI
N050.04.54.720 E019.48.52.255 N050.04.54.647 E019.48.51.687 Color_18ACI
N050.04.54.647 E019.48.51.687 N050.04.54.383 E019.48.51.766 Color_18ACI
N050.04.54.383 E019.48.51.766 N050.04.54.466 E019.48.52.293 Color_18ACI
N050.04.54.466 E019.48.52.293 N050.04.54.720 E019.48.52.255 Color_18ACI
N050.04.16.185 E019.48.12.195 N050.04.15.847 E019.48.12.325 Color_18ACI
N050.04.15.847 E019.48.12.325 N050.04.15.892 E019.48.12.638 Color_18ACI
N050.04.15.892 E019.48.12.638 N050.04.16.219 E019.48.12.549 Color_18ACI
N050.04.16.219 E019.48.12.549 N050.04.16.185 E019.48.12.195 Color_18ACI
N050.04.23.991 E019.47.13.608 N050.04.23.690 E019.47.13.713 Color_18ACI
N050.04.23.690 E019.47.13.713 N050.04.23.724 E019.47.14.067 Color_18ACI
N050.04.23.724 E019.47.14.067 N050.04.24.025 E019.47.13.962 Color_18ACI
N050.04.24.025 E019.47.13.962 N050.04.23.991 E019.47.13.608 Color_18ACI
N050.04.24.578 E019.48.21.487 N050.04.24.644 E019.48.21.098 Color_18ACI
N050.04.24.644 E019.48.21.098 N050.04.24.867 E019.48.21.184 Color_18ACI
N050.04.24.867 E019.48.21.184 N050.04.24.902 E019.48.20.920 Color_18ACI
N050.04.24.902 E019.48.20.920 N050.04.24.994 E019.48.20.547 Color_18ACI
N050.04.24.994 E019.48.20.547 N050.04.25.060 E019.48.20.158 Color_18ACI
N050.04.25.060 E019.48.20.158 N050.04.25.492 E019.48.17.799 Color_18ACI
N050.04.25.492 E019.48.17.799 N050.04.26.311 E019.48.18.196 Color_18ACI
N050.04.26.311 E019.48.18.196 N050.04.25.658 E019.48.21.566 Color_18ACI
N050.04.25.658 E019.48.21.566 N050.04.26.450 E019.48.21.947 Color_18ACI
N050.04.26.450 E019.48.21.947 N050.04.27.109 E019.48.22.249 Color_18ACI
N050.04.27.109 E019.48.22.249 N050.04.27.761 E019.48.18.879 Color_18ACI
N050.04.27.761 E019.48.18.879 N050.04.28.579 E019.48.19.277 Color_18ACI
N050.04.28.579 E019.48.19.277 N050.04.27.927 E019.48.22.646 Color_18ACI
N050.04.27.927 E019.48.22.646 N050.04.28.017 E019.48.22.653 Color_18ACI
N050.04.28.017 E019.48.22.653 N050.04.27.951 E019.48.23.041 Color_18ACI
N050.04.27.951 E019.48.23.041 N050.04.24.578 E019.48.21.487 Color_18ACI
N050.04.25.435 E019.47.53.383 N050.04.25.677 E019.47.55.243 Color_18ACI
N050.04.25.677 E019.47.55.243 N050.04.25.978 E019.47.55.138 Color_18ACI
N050.04.25.978 E019.47.55.138 N050.04.25.709 E019.47.53.263 Color_18ACI
N050.04.25.709 E019.47.53.263 N050.04.25.435 E019.47.53.383 Color_18ACI
N050.04.24.994 E019.47.29.403 N050.04.25.616 E019.47.32.444 Color_18ACI
N050.04.25.616 E019.47.32.444 N050.04.27.156 E019.47.31.657 Color_18ACI
N050.04.27.156 E019.47.31.657 N050.04.26.561 E019.47.28.632 Color_18ACI
N050.04.26.561 E019.47.28.632 N050.04.24.994 E019.47.29.403 Color_18ACI
N050.04.27.207 E019.47.23.687 N050.04.26.621 E019.47.23.954 Color_18ACI
N050.04.26.621 E019.47.23.954 N050.04.26.666 E019.47.24.266 Color_18ACI
N050.04.26.666 E019.47.24.266 N050.04.27.278 E019.47.24.016 Color_18ACI
N050.04.27.278 E019.47.24.016 N050.04.27.207 E019.47.23.687 Color_18ACI
N050.04.25.851 E019.47.24.347 N050.04.25.667 E019.47.24.474 Color_18ACI
N050.04.25.667 E019.47.24.474 N050.04.25.722 E019.47.24.746 Color_18ACI
N050.04.25.722 E019.47.24.746 N050.04.25.896 E019.47.24.660 Color_18ACI
N050.04.25.896 E019.47.24.660 N050.04.25.851 E019.47.24.347 Color_18ACI
N050.04.24.359 E019.47.26.544 N050.04.24.390 E019.47.26.420 Color_18ACI
N050.04.24.390 E019.47.26.420 N050.04.24.443 E019.47.26.452 Color_18ACI
N050.04.24.443 E019.47.26.452 N050.04.24.603 E019.47.25.929 Color_18ACI
N050.04.24.603 E019.47.25.929 N050.04.24.736 E019.47.26.009 Color_18ACI
N050.04.24.736 E019.47.26.009 N050.04.24.592 E019.47.26.589 Color_18ACI
N050.04.24.592 E019.47.26.589 N050.04.24.619 E019.47.26.605 Color_18ACI
N050.04.24.619 E019.47.26.605 N050.04.24.598 E019.47.26.688 Color_18ACI
N050.04.24.598 E019.47.26.688 N050.04.24.359 E019.47.26.544 Color_18ACI
N050.04.23.686 E019.47.22.234 N050.04.23.946 E019.47.23.772 Color_18ACI
N050.04.23.946 E019.47.23.772 N050.04.23.809 E019.47.23.832 Color_18ACI
N050.04.23.809 E019.47.23.832 N050.04.23.548 E019.47.22.294 Color_18ACI
N050.04.23.548 E019.47.22.294 N050.04.23.686 E019.47.22.234 Color_18ACI
N050.04.26.035 E019.47.32.601 N050.04.26.497 E019.47.34.927 Color_18ACI
N050.04.26.497 E019.47.34.927 N050.04.26.983 E019.47.34.695 Color_18ACI
N050.04.26.983 E019.47.34.695 N050.04.26.917 E019.47.34.466 Color_18ACI
N050.04.26.917 E019.47.34.466 N050.04.27.714 E019.47.34.088 Color_18ACI
N050.04.27.714 E019.47.34.088 N050.04.27.516 E019.47.33.160 Color_18ACI
N050.04.27.516 E019.47.33.160 N050.04.27.379 E019.47.33.220 Color_18ACI
N050.04.27.379 E019.47.33.220 N050.04.27.253 E019.47.32.620 Color_18ACI
N050.04.27.253 E019.47.32.620 N050.04.27.179 E019.47.32.671 Color_18ACI
N050.04.27.179 E019.47.32.671 N050.04.27.026 E019.47.32.055 Color_18ACI
N050.04.27.026 E019.47.32.055 N050.04.26.557 E019.47.32.344 Color_18ACI
N050.04.26.557 E019.47.32.344 N050.04.26.486 E019.47.32.015 Color_18ACI
N050.04.26.486 E019.47.32.015 N050.04.26.285 E019.47.32.085 Color_18ACI
N050.04.26.285 E019.47.32.085 N050.04.26.346 E019.47.32.455 Color_18ACI
N050.04.26.346 E019.47.32.455 N050.04.26.035 E019.47.32.601 Color_18ACI
N050.04.28.156 E019.47.32.306 N050.04.28.567 E019.47.32.126 Color_18ACI
N050.04.28.567 E019.47.32.126 N050.04.28.689 E019.47.32.866 Color_18ACI
N050.04.28.689 E019.47.32.866 N050.04.28.278 E019.47.33.047 Color_18ACI
N050.04.28.278 E019.47.33.047 N050.04.28.156 E019.47.32.306 Color_18ACI
N050.04.22.484 E019.47.57.273 N050.04.22.311 E019.47.56.121 Color_18ACI
N050.04.22.311 E019.47.56.121 N050.04.21.920 E019.47.56.219 Color_18ACI
N050.04.21.920 E019.47.56.219 N050.04.21.999 E019.47.56.886 Color_18ACI
N050.04.21.999 E019.47.56.886 N050.04.22.200 E019.47.56.816 Color_18ACI
N050.04.22.200 E019.47.56.816 N050.04.22.283 E019.47.57.343 Color_18ACI
N050.04.22.283 E019.47.57.343 N050.04.22.484 E019.47.57.273 Color_18ACI
N050.04.21.999 E019.47.56.886 N050.04.21.954 E019.47.56.573 Color_18ACI
N050.04.21.954 E019.47.56.573 N050.04.21.764 E019.47.56.601 Color_18ACI
N050.04.21.764 E019.47.56.601 N050.04.21.835 E019.47.56.930 Color_18ACI
N050.04.21.835 E019.47.56.930 N050.04.21.999 E019.47.56.886 Color_18ACI
N050.04.14.017 E019.48.10.462 N050.04.14.473 E019.48.10.593 Color_18ACI
N050.04.14.473 E019.48.10.593 N050.04.14.362 E019.48.11.288 Color_18ACI
N050.04.14.362 E019.48.11.288 N050.04.13.916 E019.48.11.115 Color_18ACI
N050.04.13.916 E019.48.11.115 N050.04.14.017 E019.48.10.462 Color_18ACI
N050.04.14.198 E019.48.11.951 N050.04.14.590 E019.48.12.093 Color_18ACI
N050.04.14.590 E019.48.12.093 N050.04.14.535 E019.48.12.440 Color_18ACI
N050.04.14.535 E019.48.12.440 N050.04.14.169 E019.48.12.315 Color_18ACI
N050.04.14.169 E019.48.12.315 N050.04.14.198 E019.48.11.951 Color_18ACI
N050.04.13.383 E019.48.02.175 N050.04.13.890 E019.48.02.099 Color_18ACI
N050.04.13.890 E019.48.02.099 N050.04.13.920 E019.48.02.594 Color_18ACI
N050.04.13.920 E019.48.02.594 N050.04.13.566 E019.48.02.666 Color_18ACI
N050.04.13.566 E019.48.02.666 N050.04.13.568 E019.48.02.905 Color_18ACI
N050.04.13.568 E019.48.02.905 N050.04.13.431 E019.48.02.966 Color_18ACI
N050.04.13.431 E019.48.02.966 N050.04.13.383 E019.48.02.175 Color_18ACI
N050.04.12.655 E019.48.02.642 N050.04.12.650 E019.48.01.924 Color_18ACI
N050.04.12.650 E019.48.01.924 N050.04.12.840 E019.48.01.896 Color_18ACI
N050.04.12.840 E019.48.01.896 N050.04.12.836 E019.48.02.036 Color_18ACI
N050.04.12.836 E019.48.02.036 N050.04.12.990 E019.48.02.033 Color_18ACI
N050.04.12.990 E019.48.02.033 N050.04.12.999 E019.48.02.611 Color_18ACI
N050.04.12.999 E019.48.02.611 N050.04.12.655 E019.48.02.642 Color_18ACI
N050.04.11.042 E019.48.01.384 N050.04.11.133 E019.48.02.249 Color_18ACI
N050.04.11.133 E019.48.02.249 N050.04.11.360 E019.48.02.195 Color_18ACI
N050.04.11.360 E019.48.02.195 N050.04.11.348 E019.48.01.998 Color_18ACI
N050.04.11.348 E019.48.01.998 N050.04.11.258 E019.48.01.991 Color_18ACI
N050.04.11.258 E019.48.01.991 N050.04.11.179 E019.48.01.324 Color_18ACI
N050.04.11.179 E019.48.01.324 N050.04.11.042 E019.48.01.384 Color_18ACI
N050.04.11.181 E019.48.03.040 N050.04.11.779 E019.48.02.971 Color_18ACI
N050.04.11.779 E019.48.02.971 N050.04.11.769 E019.48.02.394 Color_18ACI
N050.04.11.769 E019.48.02.394 N050.04.11.172 E019.48.02.463 Color_18ACI
N050.04.11.172 E019.48.02.463 N050.04.11.181 E019.48.03.040 Color_18ACI
N050.04.10.619 E019.48.02.844 N050.04.10.706 E019.48.03.849 Color_18ACI
N050.04.10.706 E019.48.03.849 N050.04.11.033 E019.48.03.760 Color_18ACI
N050.04.11.033 E019.48.03.760 N050.04.10.946 E019.48.02.756 Color_18ACI
N050.04.10.946 E019.48.02.756 N050.04.10.619 E019.48.02.844 Color_18ACI
N050.04.13.390 E019.48.12.989 N050.04.14.130 E019.48.14.196 Color_18ACI
N050.04.14.130 E019.48.14.196 N050.04.13.800 E019.48.14.664 Color_18ACI
N050.04.13.800 E019.48.14.664 N050.04.13.050 E019.48.13.498 Color_18ACI
N050.04.13.050 E019.48.13.498 N050.04.13.390 E019.48.12.989 Color_18ACI
N050.04.15.339 E019.48.16.591 N050.04.13.773 E019.48.18.839 Color_18ACI
N050.04.13.773 E019.48.18.839 N050.04.13.935 E019.48.19.174 Color_18ACI
N050.04.13.935 E019.48.19.174 N050.04.15.537 E019.48.16.901 Color_18ACI
N050.04.15.537 E019.48.16.901 N050.04.15.339 E019.48.16.591 Color_18ACI
N050.04.16.335 E019.48.18.000 N050.04.17.074 E019.48.19.207 Color_18ACI
N050.04.17.074 E019.48.19.207 N050.04.16.828 E019.48.19.583 Color_18ACI
N050.04.16.828 E019.48.19.583 N050.04.16.099 E019.48.18.334 Color_18ACI
N050.04.16.099 E019.48.18.334 N050.04.16.335 E019.48.18.000 Color_18ACI
N050.04.14.717 E019.48.18.978 N050.04.15.185 E019.48.19.308 Color_18ACI
N050.04.15.185 E019.48.19.308 N050.04.15.278 E019.48.18.935 Color_18ACI
N050.04.15.278 E019.48.18.935 N050.04.15.613 E019.48.19.184 Color_18ACI
N050.04.15.613 E019.48.19.184 N050.04.15.442 E019.48.19.749 Color_18ACI
N050.04.15.442 E019.48.19.749 N050.04.15.134 E019.48.19.515 Color_18ACI
N050.04.15.134 E019.48.19.515 N050.04.15.082 E019.48.19.722 Color_18ACI
N050.04.15.082 E019.48.19.722 N050.04.14.614 E019.48.19.393 Color_18ACI
N050.04.14.614 E019.48.19.393 N050.04.14.717 E019.48.18.978 Color_18ACI
N050.04.09.242 E019.48.07.777 N050.04.09.608 E019.48.08.521 Color_18ACI
N050.04.09.608 E019.48.08.521 N050.04.09.749 E019.48.08.321 Color_18ACI
N050.04.09.749 E019.48.08.321 N050.04.09.420 E019.48.07.551 Color_18ACI
N050.04.09.420 E019.48.07.551 N050.04.09.242 E019.48.07.777 Color_18ACI
N050.04.12.338 E019.48.14.642 N050.04.12.865 E019.48.16.339 Color_18ACI
N050.04.12.865 E019.48.16.339 N050.04.12.570 E019.48.16.543 Color_18ACI
N050.04.12.570 E019.48.16.543 N050.04.12.070 E019.48.14.861 Color_18ACI
N050.04.12.070 E019.48.14.861 N050.04.12.338 E019.48.14.642 Color_18ACI
N050.04.08.703 E019.48.02.310 N050.04.08.825 E019.48.03.050 Color_18ACI
N050.04.08.825 E019.48.03.050 N050.04.08.514 E019.48.03.196 Color_18ACI
N050.04.08.514 E019.48.03.196 N050.04.08.355 E019.48.02.481 Color_18ACI
N050.04.08.355 E019.48.02.481 N050.04.08.703 E019.48.02.310 Color_18ACI
N050.04.08.970 E019.48.03.328 N050.04.08.542 E019.48.03.451 Color_18ACI
N050.04.08.542 E019.48.03.451 N050.04.08.593 E019.48.03.863 Color_18ACI
N050.04.08.593 E019.48.03.863 N050.04.09.011 E019.48.03.781 Color_18ACI
N050.04.09.011 E019.48.03.781 N050.04.08.970 E019.48.03.328 Color_18ACI
N050.04.09.583 E019.48.03.078 N050.04.09.239 E019.48.03.109 Color_18ACI
N050.04.09.239 E019.48.03.109 N050.04.09.236 E019.48.03.488 Color_18ACI
N050.04.09.236 E019.48.03.488 N050.04.09.617 E019.48.03.432 Color_18ACI
N050.04.09.617 E019.48.03.432 N050.04.09.583 E019.48.03.078 Color_18ACI
N050.04.09.971 E019.48.01.883 N050.04.10.084 E019.48.02.903 Color_18ACI
N050.04.10.084 E019.48.02.903 N050.04.09.820 E019.48.02.982 Color_18ACI
N050.04.09.820 E019.48.02.982 N050.04.09.717 E019.48.01.920 Color_18ACI
N050.04.09.717 E019.48.01.920 N050.04.09.971 E019.48.01.883 Color_18ACI
N050.04.10.104 E019.48.04.058 N050.04.09.712 E019.48.04.156 Color_18ACI
N050.04.09.712 E019.48.04.156 N050.04.09.769 E019.48.04.666 Color_18ACI
N050.04.09.769 E019.48.04.666 N050.04.10.160 E019.48.04.568 Color_18ACI
N050.04.10.160 E019.48.04.568 N050.04.10.104 E019.48.04.058 Color_18ACI
N050.04.11.563 E019.48.10.127 N050.04.12.115 E019.48.10.983 Color_18ACI
N050.04.12.115 E019.48.10.983 N050.04.11.842 E019.48.11.343 Color_18ACI
N050.04.11.842 E019.48.11.343 N050.04.11.307 E019.48.10.544 Color_18ACI
N050.04.11.307 E019.48.10.544 N050.04.11.563 E019.48.10.127 Color_18ACI
N050.04.12.334 E019.48.11.210 N050.04.11.852 E019.48.11.920 Color_18ACI
N050.04.11.852 E019.48.11.920 N050.04.12.024 E019.48.12.214 Color_18ACI
N050.04.12.024 E019.48.12.214 N050.04.12.522 E019.48.11.561 Color_18ACI
N050.04.12.522 E019.48.11.561 N050.04.12.334 E019.48.11.210 Color_18ACI
N050.04.10.762 E019.48.10.645 N050.04.12.152 E019.48.14.529 Color_18ACI
N050.04.12.152 E019.48.14.529 N050.04.11.931 E019.48.14.682 Color_18ACI
N050.04.11.931 E019.48.14.682 N050.04.10.531 E019.48.10.839 Color_18ACI
N050.04.10.531 E019.48.10.839 N050.04.10.762 E019.48.10.645 Color_18ACI
N050.04.21.046 E019.48.18.598 N050.04.21.277 E019.48.18.404 Color_18ACI
N050.04.21.277 E019.48.18.404 N050.04.21.326 E019.48.18.577 Color_18ACI
N050.04.21.326 E019.48.18.577 N050.04.21.484 E019.48.18.433 Color_18ACI
N050.04.21.484 E019.48.18.433 N050.04.21.539 E019.48.18.705 Color_18ACI
N050.04.21.539 E019.48.18.705 N050.04.21.641 E019.48.18.909 Color_18ACI
N050.04.21.641 E019.48.18.909 N050.04.21.743 E019.48.19.113 Color_18ACI
N050.04.21.743 E019.48.19.113 N050.04.21.882 E019.48.19.292 Color_18ACI
N050.04.21.882 E019.48.19.292 N050.04.21.995 E019.48.19.455 Color_18ACI
N050.04.21.995 E019.48.19.455 N050.04.22.101 E019.48.19.519 Color_18ACI
N050.04.22.101 E019.48.19.519 N050.04.22.171 E019.48.19.609 Color_18ACI
N050.04.22.171 E019.48.19.609 N050.04.22.224 E019.48.19.641 Color_18ACI
N050.04.22.224 E019.48.19.641 N050.04.22.320 E019.48.19.746 Color_18ACI
N050.04.22.320 E019.48.19.746 N050.04.22.373 E019.48.19.778 Color_18ACI
N050.04.22.373 E019.48.19.778 N050.04.22.463 E019.48.19.785 Color_18ACI
N050.04.22.463 E019.48.19.785 N050.04.22.418 E019.48.20.091 Color_18ACI
N050.04.22.418 E019.48.20.091 N050.04.22.614 E019.48.20.161 Color_18ACI
N050.04.22.614 E019.48.20.161 N050.04.22.670 E019.48.19.814 Color_18ACI
N050.04.22.670 E019.48.19.814 N050.04.23.266 E019.48.16.792 Color_18ACI
N050.04.23.266 E019.48.16.792 N050.04.24.068 E019.48.17.132 Color_18ACI
N050.04.24.068 E019.48.17.132 N050.04.23.433 E019.48.20.559 Color_18ACI
N050.04.23.433 E019.48.20.559 N050.04.23.629 E019.48.20.630 Color_18ACI
N050.04.23.629 E019.48.20.630 N050.04.23.563 E019.48.21.018 Color_18ACI
N050.04.23.563 E019.48.21.018 N050.04.23.101 E019.48.20.788 Color_18ACI
N050.04.23.101 E019.48.20.788 N050.04.22.336 E019.48.20.422 Color_18ACI
N050.04.22.336 E019.48.20.422 N050.04.22.246 E019.48.20.416 Color_18ACI
N050.04.22.246 E019.48.20.416 N050.04.22.113 E019.48.20.336 Color_18ACI
N050.04.22.113 E019.48.20.336 N050.04.21.990 E019.48.20.214 Color_18ACI
N050.04.21.990 E019.48.20.214 N050.04.21.894 E019.48.20.109 Color_18ACI
N050.04.21.894 E019.48.20.109 N050.04.21.787 E019.48.20.045 Color_18ACI
N050.04.21.787 E019.48.20.045 N050.04.21.675 E019.48.19.882 Color_18ACI
N050.04.21.675 E019.48.19.882 N050.04.21.552 E019.48.19.760 Color_18ACI
N050.04.21.552 E019.48.19.760 N050.04.21.467 E019.48.19.613 Color_18ACI
N050.04.21.467 E019.48.19.613 N050.04.21.338 E019.48.19.393 Color_18ACI
N050.04.21.338 E019.48.19.393 N050.04.21.262 E019.48.19.205 Color_18ACI
N050.04.21.262 E019.48.19.205 N050.04.21.160 E019.48.19.000 Color_18ACI
N050.04.21.160 E019.48.19.000 N050.04.21.095 E019.48.18.770 Color_18ACI
N050.04.21.095 E019.48.18.770 N050.04.21.046 E019.48.18.598 Color_18ACI
N050.04.24.644 E019.48.21.098 N050.04.23.629 E019.48.20.630 Color_18ACI
N050.04.23.629 E019.48.20.630 N050.04.23.563 E019.48.21.018 Color_18ACI
N050.04.23.563 E019.48.21.018 N050.04.24.578 E019.48.21.487 Color_18ACI
N050.04.24.578 E019.48.21.487 N050.04.24.644 E019.48.21.098 Color_18ACI
N050.04.21.734 E019.48.02.393 N050.04.21.421 E019.48.00.204 Color_18ACI
N050.04.21.421 E019.48.00.204 N050.04.20.180 E019.48.00.648 Color_18ACI
N050.04.20.180 E019.48.00.648 N050.04.20.338 E019.48.01.981 Color_18ACI
N050.04.20.338 E019.48.01.981 N050.04.20.714 E019.48.02.684 Color_18ACI
N050.04.20.714 E019.48.02.684 N050.04.21.734 E019.48.02.393 Color_18ACI
N050.04.20.157 E019.46.53.823 N050.04.19.686 E019.46.53.873 Color_18ACI
N050.04.19.686 E019.46.53.873 N050.04.19.688 E019.46.53.494 Color_18ACI
N050.04.19.688 E019.46.53.494 N050.04.20.159 E019.46.53.444 Color_18ACI
N050.04.20.159 E019.46.53.444 N050.04.20.157 E019.46.53.823 Color_18ACI
N050.04.22.110 E019.46.59.380 N050.04.22.279 E019.47.00.053 Color_18ACI
N050.04.22.279 E019.47.00.053 N050.04.22.748 E019.46.59.764 Color_18ACI
N050.04.22.748 E019.46.59.764 N050.04.22.552 E019.46.59.075 Color_18ACI
N050.04.22.552 E019.46.59.075 N050.04.22.110 E019.46.59.380 Color_18ACI
N050.04.22.913 E019.47.19.435 N050.04.23.165 E019.47.21.254 Color_18ACI
N050.04.23.165 E019.47.21.254 N050.04.23.566 E019.47.21.114 Color_18ACI
N050.04.23.566 E019.47.21.114 N050.04.23.304 E019.47.19.337 Color_18ACI
N050.04.23.304 E019.47.19.337 N050.04.22.913 E019.47.19.435 Color_18ACI
N050.04.24.277 E019.48.29.353 N050.04.24.488 E019.48.29.861 Color_18ACI
N050.04.24.488 E019.48.29.861 N050.04.24.283 E019.48.30.071 Color_18ACI
N050.04.24.283 E019.48.30.071 N050.04.24.099 E019.48.29.579 Color_18ACI
N050.04.24.099 E019.48.29.579 N050.04.24.277 E019.48.29.353 Color_18ACI
N050.04.24.423 E019.48.29.012 N050.04.24.607 E019.48.29.504 Color_18ACI
N050.04.24.607 E019.48.29.504 N050.04.24.402 E019.48.29.714 Color_18ACI
N050.04.24.402 E019.48.29.714 N050.04.24.218 E019.48.29.222 Color_18ACI
N050.04.24.218 E019.48.29.222 N050.04.24.423 E019.48.29.012 Color_18ACI
N050.04.24.148 E019.48.29.752 N050.04.24.358 E019.48.30.259 Color_18ACI
N050.04.24.358 E019.48.30.259 N050.04.24.164 E019.48.30.428 Color_18ACI
N050.04.24.164 E019.48.30.428 N050.04.23.953 E019.48.29.920 Color_18ACI
N050.04.23.953 E019.48.29.920 N050.04.24.148 E019.48.29.752 Color_18ACI
N050.04.24.029 E019.48.30.109 N050.04.24.213 E019.48.30.600 Color_18ACI
N050.04.24.213 E019.48.30.600 N050.04.24.008 E019.48.30.810 Color_18ACI
N050.04.24.008 E019.48.30.810 N050.04.23.834 E019.48.30.277 Color_18ACI
N050.04.23.834 E019.48.30.277 N050.04.24.029 E019.48.30.109 Color_18ACI
N050.04.23.899 E019.48.30.507 N050.04.24.110 E019.48.31.014 Color_18ACI
N050.04.24.110 E019.48.31.014 N050.04.23.895 E019.48.31.266 Color_18ACI
N050.04.23.895 E019.48.31.266 N050.04.23.695 E019.48.30.717 Color_18ACI
N050.04.23.695 E019.48.30.717 N050.04.23.899 E019.48.30.507 Color_18ACI
N050.04.22.340 E019.48.32.235 N050.04.22.905 E019.48.32.670 Color_18ACI
N050.04.22.905 E019.48.32.670 N050.04.23.096 E019.48.32.023 Color_18ACI
N050.04.23.096 E019.48.32.023 N050.04.22.531 E019.48.31.588 Color_18ACI
N050.04.22.531 E019.48.31.588 N050.04.22.340 E019.48.32.235 Color_18ACI
N050.04.21.985 E019.48.29.354 N050.04.22.134 E019.48.29.492 Color_18ACI
N050.04.22.134 E019.48.29.492 N050.04.22.216 E019.48.29.160 Color_18ACI
N050.04.22.216 E019.48.29.160 N050.04.22.057 E019.48.29.064 Color_18ACI
N050.04.22.057 E019.48.29.064 N050.04.21.985 E019.48.29.354 Color_18ACI
N050.04.30.237 E019.48.19.989 N050.04.29.992 E019.48.21.222 Color_18ACI
N050.04.29.992 E019.48.21.222 N050.04.29.806 E019.48.21.110 Color_18ACI
N050.04.29.806 E019.48.21.110 N050.04.30.067 E019.48.19.934 Color_18ACI
N050.04.30.067 E019.48.19.934 N050.04.30.237 E019.48.19.989 Color_18ACI
N050.04.16.897 E019.47.59.957 N050.04.17.726 E019.48.05.980 Color_18ACI
N050.04.17.726 E019.48.05.980 N050.04.15.967 E019.48.06.541 Color_18ACI
N050.04.15.967 E019.48.06.541 N050.04.15.128 E019.48.00.559 Color_18ACI
N050.04.15.128 E019.48.00.559 N050.04.16.897 E019.47.59.957 Color_18ACI
N050.04.23.048 E019.48.20.756 N050.04.23.563 E019.48.21.018 Color_18ACI
N050.04.23.563 E019.48.21.018 N050.04.24.827 E019.48.21.589 Color_18ACI
N050.04.24.827 E019.48.21.589 N050.04.24.797 E019.48.21.713 Color_18ACI
N050.04.24.797 E019.48.21.713 N050.04.23.017 E019.48.20.880 Color_18ACI
N050.04.23.017 E019.48.20.880 N050.04.23.048 E019.48.20.756 Color_18ACI
N050.04.12.988 E019.48.01.176 N050.04.13.013 E019.48.01.571 Color_18ACI
N050.04.13.013 E019.48.01.571 N050.04.13.267 E019.48.01.533 Color_18ACI
N050.04.13.267 E019.48.01.533 N050.04.13.216 E019.48.01.122 Color_18ACI
N050.04.13.216 E019.48.01.122 N050.04.12.988 E019.48.01.176 Color_18ACI
N050.04.13.175 E019.48.02.764 N050.04.13.210 E019.48.03.118 Color_18ACI
N050.04.13.210 E019.48.03.118 N050.04.13.337 E019.48.03.099 Color_18ACI
N050.04.13.337 E019.48.03.099 N050.04.13.302 E019.48.02.745 Color_18ACI
N050.04.13.302 E019.48.02.745 N050.04.13.175 E019.48.02.764 Color_18ACI
N050.04.12.999 E019.48.17.277 N050.04.13.427 E019.48.18.631 Color_18ACI
N050.04.13.427 E019.48.18.631 N050.04.13.280 E019.48.18.732 Color_18ACI
N050.04.13.280 E019.48.18.732 N050.04.12.888 E019.48.17.354 Color_18ACI
N050.04.12.888 E019.48.17.354 N050.04.12.999 E019.48.17.277 Color_18ACI
N050.04.09.436 E019.48.06.751 N050.04.09.323 E019.48.06.588 Color_18ACI
N050.04.09.323 E019.48.06.588 N050.04.09.227 E019.48.06.483 Color_18ACI
N050.04.09.227 E019.48.06.483 N050.04.09.174 E019.48.06.451 Color_18ACI
N050.04.09.174 E019.48.06.451 N050.04.09.094 E019.48.06.403 Color_18ACI
N050.04.09.094 E019.48.06.403 N050.04.09.031 E019.48.06.412 Color_18ACI
N050.04.09.031 E019.48.06.412 N050.04.08.983 E019.48.06.479 Color_18ACI
N050.04.08.983 E019.48.06.479 N050.04.08.910 E019.48.06.530 Color_18ACI
N050.04.08.910 E019.48.06.530 N050.04.08.879 E019.48.06.654 Color_18ACI
N050.04.08.879 E019.48.06.654 N050.04.08.848 E019.48.06.778 Color_18ACI
N050.04.08.848 E019.48.06.778 N050.04.08.864 E019.48.06.836 Color_18ACI
N050.04.08.864 E019.48.06.836 N050.04.08.913 E019.48.07.008 Color_18ACI
N050.04.08.913 E019.48.07.008 N050.04.09.015 E019.48.07.212 Color_18ACI
N050.04.09.015 E019.48.07.212 N050.04.09.075 E019.48.07.343 Color_18ACI
N050.04.09.075 E019.48.07.343 N050.04.09.144 E019.48.07.433 Color_18ACI
N050.04.09.144 E019.48.07.433 N050.04.09.224 E019.48.07.481 Color_18ACI
N050.04.09.224 E019.48.07.481 N050.04.09.261 E019.48.07.455 Color_18ACI
N050.04.09.261 E019.48.07.455 N050.04.09.314 E019.48.07.487 Color_18ACI
N050.04.09.314 E019.48.07.487 N050.04.09.361 E019.48.07.421 Color_18ACI
N050.04.09.361 E019.48.07.421 N050.04.09.414 E019.48.07.453 Color_18ACI
N050.04.09.414 E019.48.07.453 N050.04.09.546 E019.48.07.293 Color_18ACI
N050.04.09.546 E019.48.07.293 N050.04.09.503 E019.48.07.220 Color_18ACI
N050.04.09.503 E019.48.07.220 N050.04.09.523 E019.48.07.137 Color_18ACI
N050.04.09.523 E019.48.07.137 N050.04.09.544 E019.48.07.054 Color_18ACI
N050.04.09.544 E019.48.07.054 N050.04.09.548 E019.48.06.914 Color_18ACI
N050.04.09.548 E019.48.06.914 N050.04.09.505 E019.48.06.840 Color_18ACI
N050.04.09.505 E019.48.06.840 N050.04.09.436 E019.48.06.751 Color_18ACI
N050.04.22.756 E019.47.05.770 N050.04.22.882 E019.47.05.512 Color_18ACI
N050.04.22.882 E019.47.05.512 N050.04.23.019 E019.47.05.451 Color_18ACI
N050.04.23.019 E019.47.05.451 N050.04.23.064 E019.47.05.764 Color_18ACI
N050.04.23.064 E019.47.05.764 N050.04.22.763 E019.47.05.868 Color_18ACI
N050.04.22.763 E019.47.05.868 N050.04.22.756 E019.47.05.770 Color_18ACI
N050.04.22.411 E019.47.07.657 N050.04.22.648 E019.47.07.562 Color_18ACI
N050.04.22.648 E019.47.07.562 N050.04.22.599 E019.47.07.389 Color_18ACI
N050.04.22.599 E019.47.07.389 N050.04.23.091 E019.47.07.256 Color_18ACI
N050.04.23.091 E019.47.07.256 N050.04.23.113 E019.47.07.413 Color_18ACI
N050.04.23.113 E019.47.07.413 N050.04.23.314 E019.47.07.343 Color_18ACI
N050.04.23.314 E019.47.07.343 N050.04.23.732 E019.47.10.214 Color_18ACI
N050.04.23.732 E019.47.10.214 N050.04.22.829 E019.47.10.528 Color_18ACI
N050.04.22.829 E019.47.10.528 N050.04.22.411 E019.47.07.657 Color_18ACI
N050.05.00.892 E019.47.26.732 N050.05.00.691 E019.47.25.325 Color_18ACI
N050.05.00.691 E019.47.25.325 N050.05.00.343 E019.47.25.497 Color_18ACI
N050.05.00.343 E019.47.25.497 N050.05.00.554 E019.47.26.862 Color_18ACI
N050.05.00.554 E019.47.26.862 N050.05.00.892 E019.47.26.732 Color_18ACI
N050.04.59.223 E019.47.19.537 N050.04.59.471 E019.47.20.877 Color_18ACI
N050.04.59.471 E019.47.20.877 N050.04.59.809 E019.47.20.747 Color_18ACI
N050.04.59.809 E019.47.20.747 N050.04.59.555 E019.47.19.308 Color_18ACI
N050.04.59.555 E019.47.19.308 N050.04.59.217 E019.47.19.438 Color_18ACI
N050.04.59.217 E019.47.19.438 N050.04.59.223 E019.47.19.537 Color_18ACI
N050.04.23.672 E019.47.13.416 N050.04.23.700 E019.47.13.671 Color_18ACI
N050.04.23.700 E019.47.13.671 N050.04.23.764 E019.47.13.662 Color_18ACI
N050.04.23.764 E019.47.13.662 N050.04.23.746 E019.47.13.365 Color_18ACI
N050.04.23.746 E019.47.13.365 N050.04.23.672 E019.47.13.416 Color_18ACI
N050.04.23.639 E019.47.13.920 N050.04.23.508 E019.47.14.079 Color_18ACI
N050.04.23.508 E019.47.14.079 N050.04.23.694 E019.47.14.191 Color_18ACI
N050.04.23.694 E019.47.14.191 N050.04.23.639 E019.47.13.920 Color_18ACI
N050.04.26.437 E019.47.24.081 N050.04.26.508 E019.47.24.409 Color_18ACI
N050.04.26.508 E019.47.24.409 N050.04.26.655 E019.47.24.308 Color_18ACI
N050.04.26.655 E019.47.24.308 N050.04.26.600 E019.47.24.037 Color_18ACI
N050.04.26.600 E019.47.24.037 N050.04.26.437 E019.47.24.081 Color_18ACI
N050.04.23.077 E019.47.25.058 N050.04.22.887 E019.47.25.086 Color_18ACI
N050.04.22.887 E019.47.25.086 N050.04.22.931 E019.47.25.399 Color_18ACI
N050.04.22.931 E019.47.25.399 N050.04.23.095 E019.47.25.355 Color_18ACI
N050.04.23.095 E019.47.25.355 N050.04.23.077 E019.47.25.058 Color_18ACI
N050.04.25.503 E019.47.26.614 N050.04.25.596 E019.47.27.099 Color_18ACI
N050.04.25.596 E019.47.27.099 N050.04.25.396 E019.47.27.168 Color_18ACI
N050.04.25.396 E019.47.27.168 N050.04.25.292 E019.47.26.725 Color_18ACI
N050.04.25.292 E019.47.26.725 N050.04.25.503 E019.47.26.614 Color_18ACI
N050.04.27.514 E019.47.25.158 N050.04.26.992 E019.47.25.415 Color_18ACI
N050.04.26.992 E019.47.25.415 N050.04.27.047 E019.47.25.686 Color_18ACI
N050.04.27.047 E019.47.25.686 N050.04.27.158 E019.47.25.610 Color_18ACI
N050.04.27.158 E019.47.25.610 N050.04.27.152 E019.47.25.511 Color_18ACI
N050.04.27.152 E019.47.25.511 N050.04.27.563 E019.47.25.330 Color_18ACI
N050.04.27.563 E019.47.25.330 N050.04.27.514 E019.47.25.158 Color_18ACI
N050.04.26.965 E019.47.25.399 N050.04.27.010 E019.47.25.712 Color_18ACI
N050.04.27.010 E019.47.25.712 N050.04.26.900 E019.47.25.788 Color_18ACI
N050.04.26.900 E019.47.25.788 N050.04.26.828 E019.47.25.459 Color_18ACI
N050.04.26.828 E019.47.25.459 N050.04.26.965 E019.47.25.399 Color_18ACI
N050.04.27.671 E019.47.32.538 N050.04.28.082 E019.47.32.357 Color_18ACI
N050.04.28.082 E019.47.32.357 N050.04.28.241 E019.47.33.072 Color_18ACI
N050.04.28.241 E019.47.33.072 N050.04.27.829 E019.47.33.253 Color_18ACI
N050.04.27.829 E019.47.33.253 N050.04.27.671 E019.47.32.538 Color_18ACI
;twy_lines N000.00.00.000 E000.00.00.000 N000.00.00.000 E000.00.00.000
N050.04.34.746 E019.47.28.669 N050.04.34.598 E019.47.28.757 Color_44ACI
N050.04.34.598 E019.47.28.757 N050.04.34.468 E019.47.28.836 Color_44ACI
N050.04.34.468 E019.47.28.836 N050.04.34.330 E019.47.28.976 Color_44ACI
N050.04.34.330 E019.47.28.976 N050.04.34.225 E019.47.29.151 Color_44ACI
N050.04.34.225 E019.47.29.151 N050.04.34.127 E019.47.29.425 Color_44ACI
N050.04.34.127 E019.47.29.425 N050.04.34.028 E019.47.29.699 Color_44ACI
N050.04.34.028 E019.47.29.699 N050.04.34.020 E019.47.29.980 Color_44ACI
N050.04.34.020 E019.47.29.980 N050.04.34.038 E019.47.30.277 Color_44ACI
N050.04.28.677 E019.47.59.906 N050.04.28.791 E019.47.59.690 Color_44ACI
N050.04.28.791 E019.47.59.690 N050.04.28.880 E019.47.59.457 Color_44ACI
N050.04.28.880 E019.47.59.457 N050.04.28.915 E019.47.59.192 Color_44ACI
N050.04.28.915 E019.47.59.192 N050.04.28.950 E019.47.58.928 Color_44ACI
N050.04.28.950 E019.47.58.928 N050.04.28.932 E019.47.58.631 Color_44ACI
N050.04.28.932 E019.47.58.631 N050.04.28.903 E019.47.58.376 Color_44ACI
N050.04.28.903 E019.47.58.376 N050.04.28.822 E019.47.58.089 Color_44ACI
N050.04.28.822 E019.47.58.089 N050.04.28.693 E019.47.57.868 Color_44ACI
N050.04.28.703 E019.47.59.922 N050.04.28.517 E019.47.59.810 Color_44ACI
N050.04.28.517 E019.47.59.810 N050.04.28.378 E019.47.59.631 Color_44ACI
N050.04.28.378 E019.47.59.631 N050.04.28.249 E019.47.59.411 Color_44ACI
N050.04.28.249 E019.47.59.411 N050.04.28.158 E019.47.59.165 Color_44ACI
N050.04.28.158 E019.47.59.165 N050.04.28.092 E019.47.58.935 Color_44ACI
N050.04.28.092 E019.47.58.935 N050.04.28.048 E019.47.58.623 Color_44ACI
N050.04.28.048 E019.47.58.623 N050.04.28.083 E019.47.58.358 Color_44ACI
N050.04.28.083 E019.47.58.358 N050.04.28.091 E019.47.58.077 Color_44ACI
N050.04.28.677 E019.47.59.906 N050.04.29.146 E019.48.03.189 Color_44ACI
N050.04.26.177 E019.48.01.733 N050.04.26.043 E019.48.01.654 Color_44ACI
N050.04.26.043 E019.48.01.654 N050.04.25.926 E019.48.01.631 Color_44ACI
N050.04.25.926 E019.48.01.631 N050.04.25.809 E019.48.01.609 Color_44ACI
N050.04.25.809 E019.48.01.609 N050.04.25.656 E019.48.01.611 Color_44ACI
N050.04.25.656 E019.48.01.611 N050.04.25.545 E019.48.01.688 Color_44ACI
N050.04.25.545 E019.48.01.688 N050.04.25.435 E019.48.01.764 Color_44ACI
N050.04.25.435 E019.48.01.764 N050.04.25.340 E019.48.01.898 Color_44ACI
N050.04.25.340 E019.48.01.898 N050.04.25.263 E019.48.02.089 Color_44ACI
N050.04.26.177 E019.48.01.733 N050.04.26.071 E019.48.01.909 Color_44ACI
N050.04.26.071 E019.48.01.909 N050.04.25.987 E019.48.02.001 Color_44ACI
N050.04.25.987 E019.48.02.001 N050.04.25.866 E019.48.02.119 Color_44ACI
N050.04.25.866 E019.48.02.119 N050.04.25.756 E019.48.02.195 Color_44ACI
N050.04.25.756 E019.48.02.195 N050.04.25.602 E019.48.02.198 Color_44ACI
N050.04.25.602 E019.48.02.198 N050.04.25.486 E019.48.02.176 Color_44ACI
N050.04.25.486 E019.48.02.176 N050.04.25.369 E019.48.02.153 Color_44ACI
N050.04.25.369 E019.48.02.153 N050.04.25.246 E019.48.02.031 Color_44ACI
N050.04.25.525 E019.48.03.866 N050.04.25.592 E019.48.03.716 Color_44ACI
N050.04.25.592 E019.48.03.716 N050.04.25.713 E019.48.03.598 Color_44ACI
N050.04.25.713 E019.48.03.598 N050.04.25.808 E019.48.03.465 Color_44ACI
N050.04.25.808 E019.48.03.465 N050.04.25.945 E019.48.03.404 Color_44ACI
N050.04.25.945 E019.48.03.404 N050.04.26.061 E019.48.03.427 Color_44ACI
N050.04.26.061 E019.48.03.427 N050.04.26.188 E019.48.03.408 Color_44ACI
N050.04.26.188 E019.48.03.408 N050.04.26.295 E019.48.03.472 Color_44ACI
N050.04.26.295 E019.48.03.472 N050.04.26.428 E019.48.03.552 Color_44ACI
N050.04.25.777 E019.48.05.684 N050.04.25.844 E019.48.05.535 Color_44ACI
N050.04.25.844 E019.48.05.535 N050.04.25.965 E019.48.05.417 Color_44ACI
N050.04.25.965 E019.48.05.417 N050.04.26.049 E019.48.05.325 Color_44ACI
N050.04.26.049 E019.48.05.325 N050.04.26.187 E019.48.05.264 Color_44ACI
N050.04.26.187 E019.48.05.264 N050.04.26.313 E019.48.05.245 Color_44ACI
N050.04.26.313 E019.48.05.245 N050.04.26.430 E019.48.05.268 Color_44ACI
N050.04.26.430 E019.48.05.268 N050.04.26.547 E019.48.05.291 Color_44ACI
N050.04.26.547 E019.48.05.291 N050.04.26.680 E019.48.05.371 Color_44ACI
N050.04.25.525 E019.48.03.866 N050.04.25.631 E019.48.03.930 Color_44ACI
N050.04.25.631 E019.48.03.930 N050.04.25.764 E019.48.04.010 Color_44ACI
N050.04.25.764 E019.48.04.010 N050.04.25.881 E019.48.04.033 Color_44ACI
N050.04.25.881 E019.48.04.033 N050.04.26.008 E019.48.04.014 Color_44ACI
N050.04.26.008 E019.48.04.014 N050.04.26.145 E019.48.03.953 Color_44ACI
N050.04.26.145 E019.48.03.953 N050.04.26.239 E019.48.03.820 Color_44ACI
N050.04.26.239 E019.48.03.820 N050.04.26.323 E019.48.03.727 Color_44ACI
N050.04.26.323 E019.48.03.727 N050.04.26.428 E019.48.03.552 Color_44ACI
N050.04.25.777 E019.48.05.684 N050.04.25.899 E019.48.05.806 Color_44ACI
N050.04.25.899 E019.48.05.806 N050.04.26.016 E019.48.05.828 Color_44ACI
N050.04.26.016 E019.48.05.828 N050.04.26.133 E019.48.05.851 Color_44ACI
N050.04.26.133 E019.48.05.851 N050.04.26.260 E019.48.05.832 Color_44ACI
N050.04.26.260 E019.48.05.832 N050.04.26.397 E019.48.05.772 Color_44ACI
N050.04.26.397 E019.48.05.772 N050.04.26.481 E019.48.05.680 Color_44ACI
N050.04.26.481 E019.48.05.680 N050.04.26.602 E019.48.05.562 Color_44ACI
N050.04.26.602 E019.48.05.562 N050.04.26.680 E019.48.05.371 Color_44ACI
N050.04.26.176 E019.48.01.734 N050.04.27.443 E019.48.01.306 Color_44ACI
N050.04.26.428 E019.48.03.552 N050.04.27.668 E019.48.03.109 Color_44ACI
N050.04.26.680 E019.48.05.371 N050.04.27.947 E019.48.04.943 Color_44ACI
N050.04.24.917 E019.47.59.785 N050.04.23.850 E019.48.00.143 Color_44ACI
N050.04.24.236 E019.48.02.900 N050.04.24.298 E019.48.02.651 Color_44ACI
N050.04.24.298 E019.48.02.651 N050.04.24.402 E019.48.02.476 Color_44ACI
N050.04.24.402 E019.48.02.476 N050.04.24.534 E019.48.02.317 Color_44ACI
N050.04.24.534 E019.48.02.317 N050.04.24.655 E019.48.02.199 Color_44ACI
N050.04.24.655 E019.48.02.199 N050.04.24.802 E019.48.02.097 Color_44ACI
N050.04.24.802 E019.48.02.097 N050.04.24.966 E019.48.02.053 Color_44ACI
N050.04.24.966 E019.48.02.053 N050.04.25.119 E019.48.02.050 Color_44ACI
N050.04.25.119 E019.48.02.050 N050.04.25.279 E019.48.02.146 Color_44ACI
N050.04.25.374 E019.48.02.870 N050.04.25.270 E019.48.03.046 Color_44ACI
N050.04.25.270 E019.48.03.046 N050.04.25.122 E019.48.03.147 Color_44ACI
N050.04.25.122 E019.48.03.147 N050.04.24.948 E019.48.03.233 Color_44ACI
N050.04.24.948 E019.48.03.233 N050.04.24.795 E019.48.03.236 Color_44ACI
N050.04.24.795 E019.48.03.236 N050.04.24.651 E019.48.03.197 Color_44ACI
N050.04.24.651 E019.48.03.197 N050.04.24.508 E019.48.03.159 Color_44ACI
N050.04.24.508 E019.48.03.159 N050.04.24.359 E019.48.03.021 Color_44ACI
N050.04.24.359 E019.48.03.021 N050.04.24.236 E019.48.02.900 Color_44ACI
N050.04.25.675 E019.48.04.861 N050.04.25.505 E019.48.04.807 Color_44ACI
N050.04.25.505 E019.48.04.807 N050.04.25.362 E019.48.04.768 Color_44ACI
N050.04.25.362 E019.48.04.768 N050.04.25.198 E019.48.04.812 Color_44ACI
N050.04.25.198 E019.48.04.812 N050.04.25.024 E019.48.04.898 Color_44ACI
N050.04.25.024 E019.48.04.898 N050.04.24.903 E019.48.05.016 Color_44ACI
N050.04.24.903 E019.48.05.016 N050.04.24.762 E019.48.05.216 Color_44ACI
N050.04.24.762 E019.48.05.216 N050.04.24.684 E019.48.05.407 Color_44ACI
N050.04.24.684 E019.48.05.407 N050.04.24.633 E019.48.05.614 Color_44ACI
N050.04.25.760 E019.48.05.627 N050.04.25.629 E019.48.05.786 Color_44ACI
N050.04.25.629 E019.48.05.786 N050.04.25.508 E019.48.05.904 Color_44ACI
N050.04.25.508 E019.48.05.904 N050.04.25.345 E019.48.05.948 Color_44ACI
N050.04.25.345 E019.48.05.948 N050.04.25.181 E019.48.05.992 Color_44ACI
N050.04.25.181 E019.48.05.992 N050.04.25.038 E019.48.05.954 Color_44ACI
N050.04.25.038 E019.48.05.954 N050.04.24.868 E019.48.05.899 Color_44ACI
N050.04.24.868 E019.48.05.899 N050.04.24.745 E019.48.05.777 Color_44ACI
N050.04.24.745 E019.48.05.777 N050.04.24.633 E019.48.05.614 Color_44ACI
N050.04.23.850 E019.48.00.143 N050.04.23.949 E019.47.59.869 Color_44ACI
N050.04.23.949 E019.47.59.869 N050.04.24.100 E019.47.59.627 Color_44ACI
N050.04.24.100 E019.47.59.627 N050.04.24.295 E019.47.59.459 Color_44ACI
N050.04.24.295 E019.47.59.459 N050.04.24.506 E019.47.59.348 Color_44ACI
N050.04.24.506 E019.47.59.348 N050.04.24.723 E019.47.59.335 Color_44ACI
N050.04.24.723 E019.47.59.335 N050.04.24.919 E019.47.59.406 Color_44ACI
N050.04.24.919 E019.47.59.406 N050.04.25.122 E019.47.59.576 Color_44ACI
N050.04.25.122 E019.47.59.576 N050.04.25.250 E019.47.59.796 Color_44ACI
N050.04.23.850 E019.48.00.143 N050.04.22.218 E019.48.00.685 Color_44ACI
N050.04.22.974 E019.48.06.140 N050.04.24.633 E019.48.05.614 Color_44ACI
N050.04.22.615 E019.48.03.400 N050.04.24.236 E019.48.02.900 Color_44ACI
N050.04.25.108 E019.48.08.996 N050.04.23.476 E019.48.09.537 Color_44ACI
N050.04.25.494 E019.48.11.752 N050.04.23.846 E019.48.12.236 Color_44ACI
N050.04.25.098 E019.48.09.038 N050.04.25.160 E019.48.08.789 Color_44ACI
N050.04.25.160 E019.48.08.789 N050.04.25.274 E019.48.08.572 Color_44ACI
N050.04.25.274 E019.48.08.572 N050.04.25.395 E019.48.08.455 Color_44ACI
N050.04.25.395 E019.48.08.455 N050.04.25.526 E019.48.08.296 Color_44ACI
N050.04.25.526 E019.48.08.296 N050.04.25.664 E019.48.08.235 Color_44ACI
N050.04.25.664 E019.48.08.235 N050.04.25.827 E019.48.08.191 Color_44ACI
N050.04.25.827 E019.48.08.191 N050.04.26.008 E019.48.08.204 Color_44ACI
N050.04.26.008 E019.48.08.204 N050.04.26.151 E019.48.08.243 Color_44ACI
N050.04.26.263 E019.48.09.024 N050.04.26.131 E019.48.09.184 Color_44ACI
N050.04.26.131 E019.48.09.184 N050.04.25.984 E019.48.09.285 Color_44ACI
N050.04.25.984 E019.48.09.285 N050.04.25.810 E019.48.09.371 Color_44ACI
N050.04.25.810 E019.48.09.371 N050.04.25.656 E019.48.09.374 Color_44ACI
N050.04.25.656 E019.48.09.374 N050.04.25.503 E019.48.09.377 Color_44ACI
N050.04.25.503 E019.48.09.377 N050.04.25.370 E019.48.09.297 Color_44ACI
N050.04.25.370 E019.48.09.297 N050.04.25.210 E019.48.09.200 Color_44ACI
N050.04.25.210 E019.48.09.200 N050.04.25.098 E019.48.09.038 Color_44ACI
N050.04.26.537 E019.48.10.999 N050.04.26.377 E019.48.10.903 Color_44ACI
N050.04.26.377 E019.48.10.903 N050.04.26.197 E019.48.10.890 Color_44ACI
N050.04.26.197 E019.48.10.890 N050.04.26.070 E019.48.10.909 Color_44ACI
N050.04.26.070 E019.48.10.909 N050.04.25.896 E019.48.10.994 Color_44ACI
N050.04.25.896 E019.48.10.994 N050.04.25.765 E019.48.11.154 Color_44ACI
N050.04.25.765 E019.48.11.154 N050.04.25.634 E019.48.11.313 Color_44ACI
N050.04.25.634 E019.48.11.313 N050.04.25.556 E019.48.11.504 Color_44ACI
N050.04.25.556 E019.48.11.504 N050.04.25.468 E019.48.11.736 Color_44ACI
N050.04.25.494 E019.48.11.752 N050.04.25.607 E019.48.11.915 Color_44ACI
N050.04.25.607 E019.48.11.915 N050.04.25.740 E019.48.11.995 Color_44ACI
N050.04.25.740 E019.48.11.995 N050.04.25.899 E019.48.12.091 Color_44ACI
N050.04.25.899 E019.48.12.091 N050.04.26.079 E019.48.12.105 Color_44ACI
N050.04.26.079 E019.48.12.105 N050.04.26.233 E019.48.12.102 Color_44ACI
N050.04.26.233 E019.48.12.102 N050.04.26.380 E019.48.12.000 Color_44ACI
N050.04.26.380 E019.48.12.000 N050.04.26.501 E019.48.11.882 Color_44ACI
N050.04.26.501 E019.48.11.882 N050.04.26.632 E019.48.11.723 Color_44ACI
N050.04.26.528 E019.48.07.525 N050.04.26.442 E019.48.07.561 Color_44ACI
N050.04.26.442 E019.48.07.561 N050.04.26.344 E019.48.07.612 Color_44ACI
N050.04.26.344 E019.48.07.612 N050.04.26.262 E019.48.07.709 Color_44ACI
N050.04.26.262 E019.48.07.709 N050.04.26.170 E019.48.07.921 Color_44ACI
N050.04.26.170 E019.48.07.921 N050.04.26.144 E019.48.08.082 Color_44ACI
N050.04.26.144 E019.48.08.082 N050.04.26.157 E019.48.08.342 Color_44ACI
N050.04.26.542 E019.48.07.526 N050.04.26.452 E019.48.07.520 Color_44ACI
N050.04.26.452 E019.48.07.520 N050.04.26.362 E019.48.07.513 Color_44ACI
N050.04.26.362 E019.48.07.513 N050.04.26.272 E019.48.07.506 Color_44ACI
N050.04.26.272 E019.48.07.506 N050.04.26.192 E019.48.07.458 Color_44ACI
N050.04.26.192 E019.48.07.458 N050.04.26.123 E019.48.07.369 Color_44ACI
N050.04.26.123 E019.48.07.369 N050.04.26.053 E019.48.07.279 Color_44ACI
N050.04.26.053 E019.48.07.279 N050.04.26.005 E019.48.07.107 Color_44ACI
N050.04.26.005 E019.48.07.107 N050.04.25.972 E019.48.06.992 Color_44ACI
N050.04.26.460 E019.48.10.572 N050.04.26.508 E019.48.10.744 Color_44ACI
N050.04.26.508 E019.48.10.744 N050.04.26.541 E019.48.10.859 Color_44ACI
N050.04.26.541 E019.48.10.859 N050.04.26.611 E019.48.10.948 Color_44ACI
N050.04.26.611 E019.48.10.948 N050.04.26.670 E019.48.11.079 Color_44ACI
N050.04.26.670 E019.48.11.079 N050.04.26.856 E019.48.11.191 Color_44ACI
N050.04.26.856 E019.48.11.191 N050.04.26.956 E019.48.11.156 Color_44ACI
N050.04.26.956 E019.48.11.156 N050.04.27.046 E019.48.11.163 Color_44ACI
N050.04.27.046 E019.48.11.163 N050.04.26.973 E019.48.11.214 Color_44ACI
N050.04.26.973 E019.48.11.214 N050.04.26.899 E019.48.11.265 Color_44ACI
N050.04.26.899 E019.48.11.265 N050.04.26.815 E019.48.11.357 Color_44ACI
N050.04.26.815 E019.48.11.357 N050.04.26.747 E019.48.11.507 Color_44ACI
N050.04.26.747 E019.48.11.507 N050.04.26.675 E019.48.11.797 Color_44ACI
N050.04.26.675 E019.48.11.797 N050.04.26.671 E019.48.11.937 Color_44ACI
N050.04.26.671 E019.48.11.937 N050.04.26.693 E019.48.12.093 Color_44ACI
N050.04.27.046 E019.48.11.163 N050.04.28.140 E019.48.10.821 Color_44ACI
N050.04.26.542 E019.48.07.526 N050.04.27.630 E019.48.07.086 Color_44ACI
N050.04.24.917 E019.47.59.785 N050.04.25.081 E019.47.59.741 Color_44ACI
N050.04.25.081 E019.47.59.741 N050.04.25.202 E019.47.59.624 Color_44ACI
N050.04.25.202 E019.47.59.624 N050.04.25.286 E019.47.59.531 Color_44ACI
N050.04.25.286 E019.47.59.531 N050.04.25.485 E019.47.59.349 Color_44ACI
N050.04.33.288 E019.47.59.921 N050.04.33.216 E019.48.00.211 Color_44ACI
N050.04.33.216 E019.48.00.211 N050.04.33.128 E019.48.00.443 Color_44ACI
N050.04.33.128 E019.48.00.443 N050.04.32.986 E019.48.00.644 Color_44ACI
N050.04.32.986 E019.48.00.644 N050.04.32.743 E019.48.00.640 Color_44ACI
N050.04.32.743 E019.48.00.640 N050.04.32.524 E019.48.00.413 Color_44ACI
N050.04.32.524 E019.48.00.413 N050.04.32.516 E019.48.00.075 Color_44ACI
N050.04.32.516 E019.48.00.075 N050.04.32.697 E019.47.59.470 Color_44ACI
N050.04.32.697 E019.47.59.470 N050.04.33.312 E019.47.57.167 Color_44ACI
N050.04.26.450 E019.46.36.088 N050.04.24.849 E019.46.24.552 Color_44ACI
N050.04.24.849 E019.46.24.552 N050.04.23.266 E019.46.13.313 Color_44ACI
N050.04.33.903 E019.47.52.386 N050.04.35.026 E019.47.49.586 Color_44ACI
N050.04.35.026 E019.47.49.586 N050.04.35.707 E019.47.47.948 Color_44ACI
N050.04.35.707 E019.47.47.948 N050.04.35.857 E019.47.47.467 Color_44ACI
N050.04.35.857 E019.47.47.467 N050.04.36.060 E019.47.47.018 Color_44ACI
N050.04.36.060 E019.47.47.018 N050.04.36.111 E019.47.46.811 Color_44ACI
N050.04.36.111 E019.47.46.811 N050.04.36.173 E019.47.46.562 Color_44ACI
N050.04.36.173 E019.47.46.562 N050.04.36.208 E019.47.46.298 Color_44ACI
N050.04.36.208 E019.47.46.298 N050.04.36.216 E019.47.46.017 Color_44ACI
N050.04.36.216 E019.47.46.017 N050.04.36.182 E019.47.45.663 Color_44ACI
N050.04.42.719 E019.48.11.187 N050.04.42.876 E019.48.12.323 Color_44ACI
N050.04.42.571 E019.48.11.235 N050.04.42.729 E019.48.12.372 Color_44ACI
N050.04.42.850 E019.48.11.144 N050.04.42.895 E019.48.11.464 Color_44ACI
N050.04.42.956 E019.48.11.905 N050.04.43.007 E019.48.12.278 Color_44ACI
N050.04.39.185 E019.47.26.899 N050.04.39.258 E019.47.27.467 Color_44ACI
N050.04.39.422 E019.47.26.804 N050.04.39.461 E019.47.27.018 Color_44ACI
N050.04.39.473 E019.47.27.216 N050.04.39.522 E019.47.27.388 Color_44ACI
N050.04.29.105 E019.47.57.688 N050.04.29.807 E019.47.57.444 Color_44ACI
N050.04.29.807 E019.47.57.444 N050.04.31.011 E019.47.57.026 Color_44ACI
N050.04.34.343 E019.46.51.488 N050.04.34.333 E019.46.52.096 Color_44ACI
N050.04.27.945 E019.46.06.039 N050.04.28.111 E019.46.07.216 Color_44ACI
N050.04.28.081 E019.46.05.991 N050.04.28.138 E019.46.06.380 Color_44ACI
N050.04.28.182 E019.46.06.797 N050.04.28.235 E019.46.07.173 Color_44ACI
N050.04.39.295 E019.47.26.823 N050.04.39.385 E019.47.27.448 Color_44ACI
N050.04.36.077 E019.47.28.218 N050.04.37.006 E019.47.27.921 Color_44ACI
N050.04.37.006 E019.47.27.921 N050.04.38.210 E019.47.27.503 Color_44ACI
N050.04.38.210 E019.47.27.503 N050.04.39.176 E019.47.27.180 Color_44ACI
N050.04.39.559 E019.47.26.744 N050.04.39.571 E019.47.26.942 Color_44ACI
N050.04.39.610 E019.47.27.155 N050.04.39.622 E019.47.27.353 Color_44ACI
N050.04.34.198 E019.46.51.477 N050.04.34.180 E019.46.52.087 Color_44ACI
N050.04.31.263 E019.46.51.557 N050.04.33.011 E019.46.51.657 Color_44ACI
N050.04.33.011 E019.46.51.657 N050.04.34.144 E019.46.51.768 Color_44ACI
N050.04.34.470 E019.46.51.497 N050.04.34.468 E019.46.51.684 Color_44ACI
N050.04.34.461 E019.46.51.901 N050.04.34.456 E019.46.52.103 Color_44ACI
N050.04.34.587 E019.46.51.506 N050.04.34.581 E019.46.51.701 Color_44ACI
N050.04.34.584 E019.46.51.935 N050.04.34.583 E019.46.52.111 Color_44ACI
N050.04.34.631 E019.46.51.776 N050.04.35.315 E019.46.51.854 Color_44ACI
N050.04.35.315 E019.46.51.854 N050.04.35.982 E019.46.51.875 Color_44ACI
N050.04.27.806 E019.46.06.095 N050.04.27.978 E019.46.07.267 Color_44ACI
N050.04.28.208 E019.46.05.955 N050.04.28.263 E019.46.06.328 Color_44ACI
N050.04.28.321 E019.46.06.736 N050.04.28.375 E019.46.07.115 Color_44ACI
N050.04.25.388 E019.46.07.591 N050.04.26.702 E019.46.07.096 Color_44ACI
N050.04.26.702 E019.46.07.096 N050.04.27.304 E019.46.06.887 Color_44ACI
N050.04.27.304 E019.46.06.887 N050.04.27.843 E019.46.06.688 Color_44ACI
N050.04.42.963 E019.48.11.107 N050.04.43.008 E019.48.11.428 Color_44ACI
N050.04.43.068 E019.48.11.860 N050.04.43.121 E019.48.12.240 Color_44ACI
N050.04.36.133 E019.47.53.253 N050.04.37.220 E019.47.52.839 Color_44ACI
N050.04.36.133 E019.47.53.253 N050.04.35.785 E019.47.53.424 Color_44ACI
N050.04.35.785 E019.47.53.424 N050.04.35.646 E019.47.53.618 Color_44ACI
N050.04.35.646 E019.47.53.618 N050.04.35.569 E019.47.53.916 Color_44ACI
N050.04.35.569 E019.47.53.916 N050.04.35.662 E019.47.54.624 Color_44ACI
N050.04.45.129 E019.48.10.955 N050.04.43.122 E019.48.11.652 Color_44ACI
N050.04.42.594 E019.48.11.810 N050.04.42.066 E019.48.11.968 Color_44ACI
N050.04.42.066 E019.48.11.968 N050.04.41.662 E019.48.12.108 Color_44ACI
N050.04.39.732 E019.48.10.966 N050.04.39.848 E019.48.11.299 Color_44ACI
N050.04.39.848 E019.48.11.299 N050.04.39.967 E019.48.11.561 Color_44ACI
N050.04.39.967 E019.48.11.561 N050.04.40.149 E019.48.11.814 Color_44ACI
N050.04.40.149 E019.48.11.814 N050.04.40.314 E019.48.12.009 Color_44ACI
N050.04.40.314 E019.48.12.009 N050.04.40.517 E019.48.12.178 Color_44ACI
N050.04.40.517 E019.48.12.178 N050.04.40.740 E019.48.12.265 Color_44ACI
N050.04.40.740 E019.48.12.265 N050.04.41.057 E019.48.12.311 Color_44ACI
N050.04.39.732 E019.48.10.966 N050.04.39.758 E019.48.11.293 Color_44ACI
N050.04.39.758 E019.48.11.293 N050.04.39.729 E019.48.11.656 Color_44ACI
N050.04.39.729 E019.48.11.656 N050.04.39.684 E019.48.11.962 Color_44ACI
N050.04.39.684 E019.48.11.962 N050.04.39.575 E019.48.12.278 Color_44ACI
N050.04.39.575 E019.48.12.278 N050.04.39.450 E019.48.12.536 Color_44ACI
N050.04.39.450 E019.48.12.536 N050.04.39.272 E019.48.12.762 Color_44ACI
N050.04.39.272 E019.48.12.762 N050.04.39.077 E019.48.12.930 Color_44ACI
N050.04.39.077 E019.48.12.930 N050.04.38.866 E019.48.13.042 Color_44ACI
N050.04.24.667 E019.48.15.826 N050.04.26.209 E019.48.13.802 Color_44ACI
N050.04.27.006 E019.48.12.805 N050.04.26.954 E019.48.13.012 Color_44ACI
N050.04.26.954 E019.48.13.012 N050.04.26.903 E019.48.13.220 Color_44ACI
N050.04.26.903 E019.48.13.220 N050.04.26.835 E019.48.13.369 Color_44ACI
N050.04.26.835 E019.48.13.369 N050.04.26.731 E019.48.13.545 Color_44ACI
N050.04.26.731 E019.48.13.545 N050.04.26.610 E019.48.13.662 Color_44ACI
N050.04.26.610 E019.48.13.662 N050.04.26.499 E019.48.13.738 Color_44ACI
N050.04.26.499 E019.48.13.738 N050.04.26.362 E019.48.13.799 Color_44ACI
N050.04.26.362 E019.48.13.799 N050.04.26.209 E019.48.13.802 Color_44ACI
N050.04.26.996 E019.48.12.847 N050.04.26.879 E019.48.12.824 Color_44ACI
N050.04.26.879 E019.48.12.824 N050.04.26.742 E019.48.12.884 Color_44ACI
N050.04.26.742 E019.48.12.884 N050.04.26.621 E019.48.13.002 Color_44ACI
N050.04.26.621 E019.48.13.002 N050.04.26.500 E019.48.13.120 Color_44ACI
N050.04.26.500 E019.48.13.120 N050.04.26.406 E019.48.13.254 Color_44ACI
N050.04.26.406 E019.48.13.254 N050.04.26.328 E019.48.13.445 Color_44ACI
N050.04.26.328 E019.48.13.445 N050.04.26.260 E019.48.13.594 Color_44ACI
N050.04.26.260 E019.48.13.594 N050.04.26.209 E019.48.13.802 Color_44ACI
N050.04.26.693 E019.48.12.093 N050.04.26.769 E019.48.12.282 Color_44ACI
N050.04.26.769 E019.48.12.282 N050.04.26.818 E019.48.12.454 Color_44ACI
N050.04.26.818 E019.48.12.454 N050.04.26.893 E019.48.12.642 Color_44ACI
N050.04.26.893 E019.48.12.642 N050.04.26.990 E019.48.12.748 Color_44ACI
N050.04.26.990 E019.48.12.748 N050.04.27.075 E019.48.12.895 Color_44ACI
N050.04.27.075 E019.48.12.895 N050.04.27.198 E019.48.13.016 Color_44ACI
N050.04.27.198 E019.48.13.016 N050.04.27.294 E019.48.13.122 Color_44ACI
N050.04.27.294 E019.48.13.122 N050.04.27.427 E019.48.13.202 Color_44ACI
N050.04.32.419 E019.48.15.255 N050.04.32.255 E019.48.15.299 Color_44ACI
N050.04.32.255 E019.48.15.299 N050.04.32.065 E019.48.15.327 Color_44ACI
N050.04.32.065 E019.48.15.327 N050.04.31.975 E019.48.15.321 Color_44ACI
N050.04.31.975 E019.48.15.321 N050.04.31.699 E019.48.15.202 Color_44ACI
N050.04.28.774 E019.48.13.441 N050.04.25.727 E019.48.14.512 Color_44ACI
N050.04.25.727 E019.48.14.512 N050.04.24.232 E019.48.14.993 Color_44ACI
N050.04.29.053 E019.48.18.229 N050.04.29.533 E019.48.15.803 Color_44ACI
N050.04.27.799 E019.48.17.616 N050.04.28.268 E019.48.15.232 Color_44ACI
N050.04.27.427 E019.48.13.202 N050.04.27.449 E019.48.13.358 Color_44ACI
N050.04.27.449 E019.48.13.358 N050.04.27.461 E019.48.13.556 Color_44ACI
N050.04.27.461 E019.48.13.556 N050.04.27.444 E019.48.13.745 Color_44ACI
N050.04.27.444 E019.48.13.745 N050.04.27.433 E019.48.13.872 Color_44ACI
N050.04.27.433 E019.48.13.872 N050.04.27.391 E019.48.14.085 Color_44ACI
N050.04.27.391 E019.48.14.085 N050.04.27.324 E019.48.14.235 Color_44ACI
N050.04.27.324 E019.48.14.235 N050.04.27.266 E019.48.14.343 Color_44ACI
N050.04.27.266 E019.48.14.343 N050.04.27.172 E019.48.14.477 Color_44ACI
N050.04.27.427 E019.48.13.202 N050.04.27.306 E019.48.13.320 Color_44ACI
N050.04.27.306 E019.48.13.320 N050.04.27.212 E019.48.13.453 Color_44ACI
N050.04.27.212 E019.48.13.453 N050.04.27.134 E019.48.13.644 Color_44ACI
N050.04.27.134 E019.48.13.644 N050.04.27.083 E019.48.13.852 Color_44ACI
N050.04.27.083 E019.48.13.852 N050.04.27.031 E019.48.14.059 Color_44ACI
N050.04.27.031 E019.48.14.059 N050.04.27.033 E019.48.14.298 Color_44ACI
N050.04.27.033 E019.48.14.298 N050.04.27.055 E019.48.14.454 Color_44ACI
N050.04.27.055 E019.48.14.454 N050.04.27.121 E019.48.14.684 Color_44ACI
N050.04.28.548 E019.48.13.734 N050.04.28.624 E019.48.13.922 Color_44ACI
N050.04.28.624 E019.48.13.922 N050.04.28.636 E019.48.14.120 Color_44ACI
N050.04.28.636 E019.48.14.120 N050.04.28.638 E019.48.14.359 Color_44ACI
N050.04.28.638 E019.48.14.359 N050.04.28.586 E019.48.14.566 Color_44ACI
N050.04.28.586 E019.48.14.566 N050.04.28.535 E019.48.14.774 Color_44ACI
N050.04.28.535 E019.48.14.774 N050.04.28.494 E019.48.14.939 Color_44ACI
N050.04.28.494 E019.48.14.939 N050.04.28.363 E019.48.15.098 Color_44ACI
N050.04.28.363 E019.48.15.098 N050.04.28.268 E019.48.15.232 Color_44ACI
N050.04.28.575 E019.48.13.750 N050.04.28.454 E019.48.13.868 Color_44ACI
N050.04.28.454 E019.48.13.868 N050.04.28.360 E019.48.14.001 Color_44ACI
N050.04.28.360 E019.48.14.001 N050.04.28.282 E019.48.14.193 Color_44ACI
N050.04.28.282 E019.48.14.193 N050.04.28.230 E019.48.14.400 Color_44ACI
N050.04.28.230 E019.48.14.400 N050.04.28.179 E019.48.14.607 Color_44ACI
N050.04.28.179 E019.48.14.607 N050.04.28.181 E019.48.14.846 Color_44ACI
N050.04.28.181 E019.48.14.846 N050.04.28.219 E019.48.15.060 Color_44ACI
N050.04.28.219 E019.48.15.060 N050.04.28.268 E019.48.15.232 Color_44ACI
N050.04.29.839 E019.48.14.321 N050.04.29.878 E019.48.14.534 Color_44ACI
N050.04.29.878 E019.48.14.534 N050.04.29.916 E019.48.14.748 Color_44ACI
N050.04.29.916 E019.48.14.748 N050.04.29.928 E019.48.14.946 Color_44ACI
N050.04.29.928 E019.48.14.946 N050.04.29.877 E019.48.15.153 Color_44ACI
N050.04.29.877 E019.48.15.153 N050.04.29.826 E019.48.15.360 Color_44ACI
N050.04.29.826 E019.48.15.360 N050.04.29.748 E019.48.15.551 Color_44ACI
N050.04.29.748 E019.48.15.551 N050.04.29.653 E019.48.15.685 Color_44ACI
N050.04.29.653 E019.48.15.685 N050.04.29.533 E019.48.15.803 Color_44ACI
N050.04.29.839 E019.48.14.321 N050.04.29.708 E019.48.14.480 Color_44ACI
N050.04.29.708 E019.48.14.480 N050.04.29.614 E019.48.14.614 Color_44ACI
N050.04.29.614 E019.48.14.614 N050.04.29.536 E019.48.14.805 Color_44ACI
N050.04.29.536 E019.48.14.805 N050.04.29.495 E019.48.14.970 Color_44ACI
N050.04.29.495 E019.48.14.970 N050.04.29.443 E019.48.15.178 Color_44ACI
N050.04.29.443 E019.48.15.178 N050.04.29.455 E019.48.15.375 Color_44ACI
N050.04.29.455 E019.48.15.375 N050.04.29.484 E019.48.15.631 Color_44ACI
N050.04.29.484 E019.48.15.631 N050.04.29.533 E019.48.15.803 Color_44ACI
N050.04.36.889 E019.48.09.184 N050.04.37.291 E019.48.11.998 Color_44ACI
N050.04.35.622 E019.48.09.612 N050.04.36.024 E019.48.12.425 Color_44ACI
N050.04.34.354 E019.48.10.039 N050.04.34.757 E019.48.12.853 Color_44ACI
N050.04.37.291 E019.48.11.998 N050.04.37.240 E019.48.12.205 Color_44ACI
N050.04.37.240 E019.48.12.205 N050.04.37.215 E019.48.12.428 Color_44ACI
N050.04.37.215 E019.48.12.428 N050.04.37.201 E019.48.12.610 Color_44ACI
N050.04.37.201 E019.48.12.610 N050.04.37.239 E019.48.12.824 Color_44ACI
N050.04.37.239 E019.48.12.824 N050.04.37.278 E019.48.13.038 Color_44ACI
N050.04.37.278 E019.48.13.038 N050.04.37.327 E019.48.13.210 Color_44ACI
N050.04.37.327 E019.48.13.210 N050.04.37.402 E019.48.13.398 Color_44ACI
N050.04.37.402 E019.48.13.398 N050.04.37.525 E019.48.13.520 Color_44ACI
N050.04.37.291 E019.48.11.998 N050.04.37.414 E019.48.12.120 Color_44ACI
N050.04.37.414 E019.48.12.120 N050.04.37.489 E019.48.12.308 Color_44ACI
N050.04.37.489 E019.48.12.308 N050.04.37.565 E019.48.12.496 Color_44ACI
N050.04.37.565 E019.48.12.496 N050.04.37.641 E019.48.12.685 Color_44ACI
N050.04.37.641 E019.48.12.685 N050.04.37.653 E019.48.12.882 Color_44ACI
N050.04.37.653 E019.48.12.882 N050.04.37.628 E019.48.13.105 Color_44ACI
N050.04.37.628 E019.48.13.105 N050.04.37.613 E019.48.13.287 Color_44ACI
N050.04.37.613 E019.48.13.287 N050.04.37.562 E019.48.13.494 Color_44ACI
N050.04.36.024 E019.48.12.425 N050.04.36.147 E019.48.12.547 Color_44ACI
N050.04.36.147 E019.48.12.547 N050.04.36.249 E019.48.12.751 Color_44ACI
N050.04.36.249 E019.48.12.751 N050.04.36.298 E019.48.12.924 Color_44ACI
N050.04.36.298 E019.48.12.924 N050.04.36.363 E019.48.13.153 Color_44ACI
N050.04.36.363 E019.48.13.153 N050.04.36.375 E019.48.13.351 Color_44ACI
N050.04.36.375 E019.48.13.351 N050.04.36.350 E019.48.13.574 Color_44ACI
N050.04.36.350 E019.48.13.574 N050.04.36.299 E019.48.13.782 Color_44ACI
N050.04.36.299 E019.48.13.782 N050.04.36.248 E019.48.13.989 Color_44ACI
N050.04.36.024 E019.48.12.425 N050.04.35.921 E019.48.12.840 Color_44ACI
N050.04.35.921 E019.48.12.840 N050.04.35.923 E019.48.13.079 Color_44ACI
N050.04.35.923 E019.48.13.079 N050.04.35.935 E019.48.13.277 Color_44ACI
N050.04.35.935 E019.48.13.277 N050.04.35.974 E019.48.13.491 Color_44ACI
N050.04.35.974 E019.48.13.491 N050.04.36.049 E019.48.13.679 Color_44ACI
N050.04.36.049 E019.48.13.679 N050.04.36.135 E019.48.13.826 Color_44ACI
N050.04.36.135 E019.48.13.826 N050.04.36.221 E019.48.13.973 Color_44ACI
N050.04.34.757 E019.48.12.853 N050.04.34.842 E019.48.13.000 Color_44ACI
N050.04.34.842 E019.48.13.000 N050.04.34.955 E019.48.13.163 Color_44ACI
N050.04.34.955 E019.48.13.163 N050.04.35.030 E019.48.13.351 Color_44ACI
N050.04.35.030 E019.48.13.351 N050.04.35.069 E019.48.13.565 Color_44ACI
N050.04.35.069 E019.48.13.565 N050.04.35.081 E019.48.13.763 Color_44ACI
N050.04.35.081 E019.48.13.763 N050.04.35.083 E019.48.14.002 Color_44ACI
N050.04.35.083 E019.48.14.002 N050.04.35.032 E019.48.14.209 Color_44ACI
N050.04.35.032 E019.48.14.209 N050.04.34.954 E019.48.14.400 Color_44ACI
N050.04.34.757 E019.48.12.853 N050.04.34.679 E019.48.13.044 Color_44ACI
N050.04.34.679 E019.48.13.044 N050.04.34.644 E019.48.13.309 Color_44ACI
N050.04.34.644 E019.48.13.309 N050.04.34.629 E019.48.13.490 Color_44ACI
N050.04.34.629 E019.48.13.490 N050.04.34.631 E019.48.13.730 Color_44ACI
N050.04.34.631 E019.48.13.730 N050.04.34.680 E019.48.13.902 Color_44ACI
N050.04.34.680 E019.48.13.902 N050.04.34.755 E019.48.14.090 Color_44ACI
N050.04.34.755 E019.48.14.090 N050.04.34.858 E019.48.14.295 Color_44ACI
N050.04.34.858 E019.48.14.295 N050.04.34.954 E019.48.14.400 Color_44ACI
N050.04.31.967 E019.47.56.744 N050.04.32.067 E019.47.56.709 Color_44ACI
N050.04.32.067 E019.47.56.709 N050.04.32.194 E019.47.56.691 Color_44ACI
N050.04.32.194 E019.47.56.691 N050.04.32.321 E019.47.56.672 Color_44ACI
N050.04.32.321 E019.47.56.672 N050.04.32.438 E019.47.56.694 Color_44ACI
N050.04.32.438 E019.47.56.694 N050.04.32.554 E019.47.56.717 Color_44ACI
N050.04.32.554 E019.47.56.717 N050.04.32.697 E019.47.56.756 Color_44ACI
N050.04.32.697 E019.47.56.756 N050.04.32.804 E019.47.56.820 Color_44ACI
N050.04.32.804 E019.47.56.820 N050.04.32.910 E019.47.56.884 Color_44ACI
N050.04.35.943 E019.47.58.948 N050.04.36.023 E019.47.58.996 Color_44ACI
N050.04.36.023 E019.47.58.996 N050.04.36.076 E019.47.59.028 Color_44ACI
N050.04.36.076 E019.47.59.028 N050.04.36.156 E019.47.59.076 Color_44ACI
N050.04.36.156 E019.47.59.076 N050.04.36.336 E019.47.59.089 Color_44ACI
N050.04.36.336 E019.47.59.089 N050.04.36.400 E019.47.59.080 Color_44ACI
N050.04.36.400 E019.47.59.080 N050.04.36.653 E019.47.59.042 Color_44ACI
N050.04.36.653 E019.47.59.042 N050.04.36.928 E019.47.58.922 Color_44ACI
N050.04.36.928 E019.47.58.922 N050.04.37.170 E019.47.58.686 Color_44ACI
N050.04.37.170 E019.47.58.686 N050.04.37.385 E019.47.58.435 Color_44ACI
N050.04.37.385 E019.47.58.435 N050.04.37.557 E019.47.58.110 Color_44ACI
N050.04.37.557 E019.47.58.110 N050.04.37.686 E019.47.57.712 Color_44ACI
N050.04.37.686 E019.47.57.712 N050.04.37.752 E019.47.57.323 Color_44ACI
N050.04.37.752 E019.47.57.323 N050.04.37.781 E019.47.56.867 Color_44ACI
N050.04.36.400 E019.47.59.080 N050.04.36.993 E019.47.59.152 Color_44ACI
N050.04.36.993 E019.47.59.152 N050.04.37.200 E019.47.59.181 Color_44ACI
N050.04.37.200 E019.47.59.181 N050.04.37.396 E019.47.59.251 Color_44ACI
N050.04.37.396 E019.47.59.251 N050.04.37.582 E019.47.59.364 Color_44ACI
N050.04.37.582 E019.47.59.364 N050.04.37.732 E019.47.59.501 Color_44ACI
N050.04.37.732 E019.47.59.501 N050.04.37.924 E019.47.59.712 Color_44ACI
N050.04.37.924 E019.47.59.712 N050.04.38.052 E019.47.59.932 Color_44ACI
N050.04.38.052 E019.47.59.932 N050.04.38.171 E019.48.00.194 Color_44ACI
N050.04.38.171 E019.48.00.194 N050.04.38.288 E019.48.00.514 Color_44ACI
N050.04.29.613 E019.46.51.414 N050.04.29.425 E019.46.51.451 Color_44ACI
N050.04.29.425 E019.46.51.451 N050.04.29.277 E019.46.51.552 Color_44ACI
N050.04.29.277 E019.46.51.552 N050.04.29.146 E019.46.51.712 Color_44ACI
N050.04.29.146 E019.46.51.712 N050.04.29.025 E019.46.51.829 Color_44ACI
N050.04.29.025 E019.46.51.829 N050.04.28.937 E019.46.52.062 Color_44ACI
N050.04.28.937 E019.46.52.062 N050.04.28.886 E019.46.52.269 Color_44ACI
N050.04.28.886 E019.46.52.269 N050.04.28.824 E019.46.52.518 Color_44ACI
N050.04.28.824 E019.46.52.518 N050.04.28.816 E019.46.52.798 Color_44ACI
N050.04.37.393 E019.46.49.391 N050.04.37.370 E019.46.49.853 Color_44ACI
N050.04.37.370 E019.46.49.853 N050.04.37.267 E019.46.50.268 Color_44ACI
N050.04.37.267 E019.46.50.268 N050.04.37.138 E019.46.50.666 Color_44ACI
N050.04.37.138 E019.46.50.666 N050.04.36.982 E019.46.51.048 Color_44ACI
N050.04.36.982 E019.46.51.048 N050.04.36.756 E019.46.51.341 Color_44ACI
N050.04.36.756 E019.46.51.341 N050.04.36.514 E019.46.51.576 Color_44ACI
N050.04.36.514 E019.46.51.576 N050.04.36.256 E019.46.51.754 Color_44ACI
N050.04.36.256 E019.46.51.754 N050.04.35.982 E019.46.51.875 Color_44ACI
N050.04.35.982 E019.46.51.875 N050.04.36.729 E019.46.51.944 Color_44ACI
N050.04.36.729 E019.46.51.944 N050.04.36.925 E019.46.52.014 Color_44ACI
N050.04.36.925 E019.46.52.014 N050.04.37.112 E019.46.52.126 Color_44ACI
N050.04.37.112 E019.46.52.126 N050.04.37.287 E019.46.52.280 Color_44ACI
N050.04.37.287 E019.46.52.280 N050.04.37.453 E019.46.52.475 Color_44ACI
N050.04.37.453 E019.46.52.475 N050.04.37.592 E019.46.52.654 Color_44ACI
N050.04.37.592 E019.46.52.654 N050.04.37.721 E019.46.52.874 Color_44ACI
N050.04.37.721 E019.46.52.874 N050.04.37.849 E019.46.53.095 Color_44ACI
N050.04.37.849 E019.46.53.095 N050.04.37.941 E019.46.53.340 Color_44ACI
N050.04.29.411 E019.46.06.156 N050.04.29.702 E019.46.06.093 Color_44ACI
N050.04.29.702 E019.46.06.093 N050.04.29.972 E019.46.06.113 Color_44ACI
N050.04.29.972 E019.46.06.113 N050.04.30.089 E019.46.06.135 Color_44ACI
N050.04.30.089 E019.46.06.135 N050.04.30.232 E019.46.06.174 Color_44ACI
N050.04.30.232 E019.46.06.174 N050.04.30.348 E019.46.06.196 Color_44ACI
N050.04.30.348 E019.46.06.196 N050.04.30.481 E019.46.06.276 Color_44ACI
N050.04.29.411 E019.46.06.156 N050.04.28.307 E019.46.06.539 Color_44ACI
N050.04.23.266 E019.46.13.313 N050.04.23.087 E019.46.12.063 Color_44ACI
N050.04.23.087 E019.46.12.063 N050.04.22.934 E019.46.10.828 Color_44ACI
N050.04.22.934 E019.46.10.828 N050.04.22.873 E019.46.10.458 Color_44ACI
N050.04.22.873 E019.46.10.458 N050.04.22.855 E019.46.10.161 Color_44ACI
N050.04.23.783 E019.46.08.148 N050.04.24.321 E019.46.07.948 Color_44ACI
N050.04.24.321 E019.46.07.948 N050.04.25.388 E019.46.07.591 Color_44ACI
N050.04.22.855 E019.46.10.161 N050.04.22.847 E019.46.09.823 Color_44ACI
N050.04.22.847 E019.46.09.823 N050.04.22.893 E019.46.09.517 Color_44ACI
N050.04.22.893 E019.46.09.517 N050.04.22.975 E019.46.09.186 Color_44ACI
N050.04.22.975 E019.46.09.186 N050.04.23.074 E019.46.08.912 Color_44ACI
N050.04.23.074 E019.46.08.912 N050.04.23.236 E019.46.08.628 Color_44ACI
N050.04.23.236 E019.46.08.628 N050.04.23.377 E019.46.08.428 Color_44ACI
N050.04.23.377 E019.46.08.428 N050.04.23.572 E019.46.08.259 Color_44ACI
N050.04.23.572 E019.46.08.259 N050.04.23.783 E019.46.08.148 Color_44ACI
N050.04.39.631 E019.47.27.072 N050.04.41.099 E019.47.26.575 Color_44ACI
N050.04.42.273 E019.47.24.426 N050.04.42.218 E019.47.24.773 Color_44ACI
N050.04.42.218 E019.47.24.773 N050.04.42.125 E019.47.25.146 Color_44ACI
N050.04.42.125 E019.47.25.146 N050.04.42.017 E019.47.25.461 Color_44ACI
N050.04.42.017 E019.47.25.461 N050.04.41.881 E019.47.25.761 Color_44ACI
N050.04.41.881 E019.47.25.761 N050.04.41.693 E019.47.26.028 Color_44ACI
N050.04.41.693 E019.47.26.028 N050.04.41.514 E019.47.26.254 Color_44ACI
N050.04.41.514 E019.47.26.254 N050.04.41.320 E019.47.26.423 Color_44ACI
N050.04.41.320 E019.47.26.423 N050.04.41.099 E019.47.26.575 Color_44ACI
N050.04.41.099 E019.47.26.575 N050.04.41.326 E019.47.26.522 Color_44ACI
N050.04.41.326 E019.47.26.522 N050.04.41.549 E019.47.26.608 Color_44ACI
N050.04.41.549 E019.47.26.608 N050.04.41.782 E019.47.26.654 Color_44ACI
N050.04.41.782 E019.47.26.654 N050.04.41.995 E019.47.26.782 Color_44ACI
N050.04.41.995 E019.47.26.782 N050.04.42.197 E019.47.26.951 Color_44ACI
N050.04.42.197 E019.47.26.951 N050.04.42.389 E019.47.27.162 Color_44ACI
N050.04.42.389 E019.47.27.162 N050.04.42.534 E019.47.27.440 Color_44ACI
N050.04.42.534 E019.47.27.440 N050.04.42.679 E019.47.27.718 Color_44ACI
N050.04.48.274 E019.48.07.515 N050.04.48.281 E019.48.07.853 Color_44ACI
N050.04.48.281 E019.48.07.853 N050.04.48.226 E019.48.08.201 Color_44ACI
N050.04.48.226 E019.48.08.201 N050.04.48.154 E019.48.08.491 Color_44ACI
N050.04.48.154 E019.48.08.491 N050.04.48.082 E019.48.08.781 Color_44ACI
N050.04.48.082 E019.48.08.781 N050.04.47.973 E019.48.09.096 Color_44ACI
N050.04.47.973 E019.48.09.096 N050.04.47.875 E019.48.09.371 Color_44ACI
N050.04.47.875 E019.48.09.371 N050.04.47.723 E019.48.09.613 Color_44ACI
N050.04.47.723 E019.48.09.613 N050.04.47.571 E019.48.09.855 Color_44ACI
N050.04.47.571 E019.48.09.855 N050.04.47.487 E019.48.09.947 Color_44ACI
N050.04.47.487 E019.48.09.947 N050.04.47.403 E019.48.10.039 Color_44ACI
N050.04.47.403 E019.48.10.039 N050.04.47.319 E019.48.10.131 Color_44ACI
N050.04.47.319 E019.48.10.131 N050.04.47.246 E019.48.10.182 Color_44ACI
N050.04.47.246 E019.48.10.182 N050.04.47.135 E019.48.10.258 Color_44ACI
N050.04.47.135 E019.48.10.258 N050.04.47.061 E019.48.10.309 Color_44ACI
N050.04.47.061 E019.48.10.309 N050.04.46.961 E019.48.10.344 Color_44ACI
N050.04.46.961 E019.48.10.344 N050.04.46.861 E019.48.10.379 Color_44ACI
N050.04.46.861 E019.48.10.379 N050.04.45.129 E019.48.10.955 Color_44ACI
N050.04.34.415 E019.48.14.600 N050.04.32.419 E019.48.15.255 Color_44ACI
N050.04.30.290 E019.46.51.191 N050.04.30.287 E019.46.51.303 Color_44ACI
N050.04.30.284 E019.46.51.406 N050.04.30.280 E019.46.51.537 Color_44ACI
N050.04.30.277 E019.46.51.625 N050.04.30.272 E019.46.51.784 Color_44ACI
N050.04.30.270 E019.46.51.864 N050.04.30.266 E019.46.52.005 Color_44ACI
N050.04.28.625 E019.46.51.350 N050.04.30.219 E019.46.51.453 Color_44ACI
N050.04.30.336 E019.46.51.475 N050.04.31.263 E019.46.51.557 Color_44ACI
N050.04.28.643 E019.46.53.972 N050.04.28.722 E019.46.53.945 Color_44ACI
N050.04.28.782 E019.46.53.924 N050.04.28.882 E019.46.53.890 Color_44ACI
N050.04.28.945 E019.46.53.868 N050.04.29.022 E019.46.53.841 Color_44ACI
N050.04.29.083 E019.46.53.820 N050.04.29.146 E019.46.53.799 Color_44ACI
N050.04.29.207 E019.46.53.777 N050.04.29.284 E019.46.53.751 Color_44ACI
N050.04.27.863 E019.46.48.524 N050.04.27.941 E019.46.48.497 Color_44ACI
N050.04.28.002 E019.46.48.475 N050.04.28.103 E019.46.48.440 Color_44ACI
N050.04.28.164 E019.46.48.418 N050.04.28.242 E019.46.48.390 Color_44ACI
N050.04.28.302 E019.46.48.370 N050.04.28.389 E019.46.48.339 Color_44ACI
N050.04.28.427 E019.46.48.326 N050.04.28.527 E019.46.48.290 Color_44ACI
N050.04.28.816 E019.46.52.798 N050.04.28.216 E019.46.48.437 Color_44ACI
N050.04.28.210 E019.46.48.338 N050.04.26.450 E019.46.36.088 Color_44ACI
N050.04.31.231 E019.47.12.639 N050.04.31.309 E019.47.12.612 Color_44ACI
N050.04.31.369 E019.47.12.592 N050.04.31.469 E019.47.12.557 Color_44ACI
N050.04.31.533 E019.47.12.535 N050.04.31.610 E019.47.12.509 Color_44ACI
N050.04.31.672 E019.47.12.488 N050.04.31.757 E019.47.12.458 Color_44ACI
N050.04.31.797 E019.47.12.445 N050.04.31.895 E019.47.12.411 Color_44ACI
N050.04.33.384 E019.47.25.644 N050.04.32.488 E019.47.19.152 Color_44ACI
N050.04.32.488 E019.47.19.152 N050.04.31.575 E019.47.12.603 Color_44ACI
N050.04.33.891 E019.47.31.750 N050.04.33.988 E019.47.31.715 Color_44ACI
N050.04.34.040 E019.47.31.696 N050.04.34.135 E019.47.31.661 Color_44ACI
N050.04.34.184 E019.47.31.643 N050.04.34.285 E019.47.31.606 Color_44ACI
N050.04.34.346 E019.47.31.584 N050.04.34.420 E019.47.31.557 Color_44ACI
N050.04.34.476 E019.47.31.537 N050.04.34.554 E019.47.31.509 Color_44ACI
N050.04.35.657 E019.47.44.204 N050.04.35.731 E019.47.44.153 Color_44ACI
N050.04.35.794 E019.47.44.144 N050.04.35.885 E019.47.44.151 Color_44ACI
N050.04.35.948 E019.47.44.141 N050.04.36.022 E019.47.44.090 Color_44ACI
N050.04.36.085 E019.47.44.081 N050.04.36.149 E019.47.44.071 Color_44ACI
N050.04.36.222 E019.47.44.021 N050.04.36.312 E019.47.44.027 Color_44ACI
N050.04.37.235 E019.47.55.616 N050.04.37.335 E019.47.55.582 Color_44ACI
N050.04.37.385 E019.47.55.564 N050.04.37.481 E019.47.55.531 Color_44ACI
N050.04.37.524 E019.47.55.516 N050.04.37.628 E019.47.55.480 Color_44ACI
N050.04.37.676 E019.47.55.464 N050.04.37.757 E019.47.55.436 Color_44ACI
N050.04.37.808 E019.47.55.418 N050.04.37.892 E019.47.55.389 Color_44ACI
N050.04.39.378 E019.48.10.840 N050.04.39.449 E019.48.10.813 Color_44ACI
N050.04.39.515 E019.48.10.789 N050.04.39.600 E019.48.10.758 Color_44ACI
N050.04.39.658 E019.48.10.736 N050.04.39.733 E019.48.10.708 Color_44ACI
N050.04.39.794 E019.48.10.686 N050.04.39.896 E019.48.10.649 Color_44ACI
N050.04.40.085 E019.48.10.579 N050.04.40.162 E019.48.10.550 Color_44ACI
N050.04.39.238 E019.48.10.892 N050.04.39.310 E019.48.10.865 Color_44ACI
N050.04.38.415 E019.48.12.528 N050.04.38.432 E019.48.12.657 Color_44ACI
N050.04.38.450 E019.48.12.780 N050.04.38.463 E019.48.12.879 Color_44ACI
N050.04.38.480 E019.48.12.999 N050.04.38.493 E019.48.13.096 Color_44ACI
N050.04.38.510 E019.48.13.216 N050.04.38.528 E019.48.13.344 Color_44ACI
N050.04.38.538 E019.48.13.416 N050.04.38.559 E019.48.13.566 Color_44ACI
N050.04.38.572 E019.48.13.659 N050.04.38.590 E019.48.13.788 Color_44ACI
N050.04.38.385 E019.48.12.313 N050.04.38.398 E019.48.12.407 Color_44ACI
N050.04.31.504 E019.47.56.331 N050.04.31.523 E019.47.56.469 Color_44ACI
N050.04.31.539 E019.47.56.588 N050.04.31.557 E019.47.56.721 Color_44ACI
N050.04.31.569 E019.47.56.815 N050.04.31.587 E019.47.56.947 Color_44ACI
N050.04.31.600 E019.47.57.041 N050.04.31.620 E019.47.57.193 Color_44ACI
N050.04.31.628 E019.47.57.253 N050.04.31.649 E019.47.57.410 Color_44ACI
N050.04.35.335 E019.47.28.196 N050.04.35.353 E019.47.28.324 Color_44ACI
N050.04.35.364 E019.47.28.403 N050.04.35.387 E019.47.28.559 Color_44ACI
N050.04.35.395 E019.47.28.619 N050.04.35.416 E019.47.28.769 Color_44ACI
N050.04.28.966 E019.46.53.794 N050.04.28.883 E019.46.53.267 Color_44ACI
N050.04.28.883 E019.46.53.267 N050.04.28.816 E019.46.52.798 Color_44ACI
N050.04.31.553 E019.47.12.447 N050.04.30.092 E019.47.01.948 Color_44ACI
N050.04.30.092 E019.47.01.948 N050.04.28.988 E019.46.53.950 Color_44ACI
N050.04.33.703 E019.47.27.932 N050.04.33.805 E019.47.28.136 Color_44ACI
N050.04.33.805 E019.47.28.136 N050.04.33.880 E019.47.28.324 Color_44ACI
N050.04.33.880 E019.47.28.324 N050.04.34.019 E019.47.28.503 Color_44ACI
N050.04.34.019 E019.47.28.503 N050.04.34.169 E019.47.28.641 Color_44ACI
N050.04.34.169 E019.47.28.641 N050.04.34.445 E019.47.28.760 Color_44ACI
N050.04.34.445 E019.47.28.760 N050.04.34.709 E019.47.28.681 Color_44ACI
N050.04.34.709 E019.47.28.681 N050.04.34.973 E019.47.28.601 Color_44ACI
N050.04.34.973 E019.47.28.601 N050.04.35.147 E019.47.28.516 Color_44ACI
N050.04.35.147 E019.47.28.516 N050.04.35.337 E019.47.28.488 Color_44ACI
N050.04.35.401 E019.47.28.478 N050.04.35.739 E019.47.28.348 Color_44ACI
N050.04.35.739 E019.47.28.348 N050.04.36.077 E019.47.28.218 Color_44ACI
N050.04.34.207 E019.47.31.569 N050.04.33.808 E019.47.28.615 Color_44ACI
N050.04.33.808 E019.47.28.615 N050.04.33.384 E019.47.25.644 Color_44ACI
N050.04.35.263 E019.47.39.015 N050.04.34.906 E019.47.36.513 Color_44ACI
N050.04.34.906 E019.47.36.513 N050.04.34.581 E019.47.34.127 Color_44ACI
N050.04.34.581 E019.47.34.127 N050.04.34.239 E019.47.31.683 Color_44ACI
N050.04.35.979 E019.47.44.017 N050.04.35.621 E019.47.41.516 Color_44ACI
N050.04.35.621 E019.47.41.516 N050.04.35.263 E019.47.39.015 Color_44ACI
N050.04.37.182 E019.47.52.598 N050.04.36.517 E019.47.48.008 Color_44ACI
N050.04.36.517 E019.47.48.008 N050.04.36.147 E019.47.45.309 Color_44ACI
N050.04.36.147 E019.47.45.309 N050.04.36.074 E019.47.44.741 Color_44ACI
N050.04.36.074 E019.47.44.741 N050.04.36.001 E019.47.44.173 Color_44ACI
N050.04.37.584 E019.47.55.412 N050.04.37.383 E019.47.54.005 Color_44ACI
N050.04.37.383 E019.47.54.005 N050.04.37.182 E019.47.52.598 Color_44ACI
N050.04.39.102 E019.48.06.422 N050.04.38.620 E019.48.02.941 Color_44ACI
N050.04.38.620 E019.48.02.941 N050.04.38.295 E019.48.00.555 Color_44ACI
N050.04.38.295 E019.48.00.555 N050.04.37.993 E019.47.58.325 Color_44ACI
N050.04.37.993 E019.47.58.325 N050.04.37.663 E019.47.56.079 Color_44ACI
N050.04.37.663 E019.47.56.079 N050.04.37.635 E019.47.55.824 Color_44ACI
N050.04.37.635 E019.47.55.824 N050.04.37.607 E019.47.55.569 Color_44ACI
N050.04.39.679 E019.48.10.626 N050.04.39.500 E019.48.09.376 Color_44ACI
N050.04.39.500 E019.48.09.376 N050.04.39.321 E019.48.08.125 Color_44ACI
N050.04.39.321 E019.48.08.125 N050.04.39.203 E019.48.07.245 Color_44ACI
N050.04.39.203 E019.48.07.245 N050.04.39.102 E019.48.06.422 Color_44ACI
N050.04.39.732 E019.48.10.966 N050.04.39.701 E019.48.10.782 Color_44ACI
N050.04.28.774 E019.48.13.441 N050.04.28.853 E019.48.13.489 Color_44ACI
N050.04.28.853 E019.48.13.489 N050.04.28.976 E019.48.13.611 Color_44ACI
N050.04.28.976 E019.48.13.611 N050.04.29.046 E019.48.13.700 Color_44ACI
N050.04.29.046 E019.48.13.700 N050.04.29.115 E019.48.13.790 Color_44ACI
N050.04.29.115 E019.48.13.790 N050.04.29.158 E019.48.13.863 Color_44ACI
N050.04.29.158 E019.48.13.863 N050.04.29.201 E019.48.13.936 Color_44ACI
N050.04.29.201 E019.48.13.936 N050.04.29.233 E019.48.14.051 Color_44ACI
N050.04.27.427 E019.48.13.202 N050.04.28.575 E019.48.13.750 Color_44ACI
N050.04.28.575 E019.48.13.750 N050.04.29.260 E019.48.14.067 Color_44ACI
N050.04.29.260 E019.48.14.067 N050.04.29.839 E019.48.14.321 Color_44ACI
N050.04.29.839 E019.48.14.321 N050.04.31.699 E019.48.15.202 Color_44ACI
N050.04.26.616 E019.48.17.333 N050.04.27.121 E019.48.14.684 Color_44ACI
N050.04.27.121 E019.48.14.684 N050.04.27.172 E019.48.14.477 Color_44ACI
N050.04.29.105 E019.47.57.688 N050.04.27.626 E019.47.58.226 Color_44ACI
N050.04.27.626 E019.47.58.226 N050.04.26.121 E019.47.58.749 Color_44ACI
N050.04.26.121 E019.47.58.749 N050.04.25.874 E019.47.58.885 Color_44ACI
N050.04.25.874 E019.47.58.885 N050.04.25.632 E019.47.59.121 Color_44ACI
N050.04.25.632 E019.47.59.121 N050.04.25.433 E019.47.59.430 Color_44ACI
N050.04.25.433 E019.47.59.430 N050.04.25.250 E019.47.59.796 Color_44ACI
N050.04.25.250 E019.47.59.796 N050.04.25.179 E019.48.00.086 Color_44ACI
N050.04.25.179 E019.48.00.086 N050.04.25.123 E019.48.00.433 Color_44ACI
N050.04.25.123 E019.48.00.433 N050.04.25.121 E019.48.00.813 Color_44ACI
N050.04.25.121 E019.48.00.813 N050.04.25.128 E019.48.01.151 Color_44ACI
N050.04.25.128 E019.48.01.151 N050.04.25.340 E019.48.02.516 Color_44ACI
N050.04.25.340 E019.48.02.516 N050.04.25.525 E019.48.03.866 Color_44ACI
N050.04.25.525 E019.48.03.866 N050.04.25.827 E019.48.06.096 Color_44ACI
N050.04.25.827 E019.48.06.096 N050.04.26.157 E019.48.08.342 Color_44ACI
N050.04.26.157 E019.48.08.342 N050.04.26.269 E019.48.09.123 Color_44ACI
N050.04.26.269 E019.48.09.123 N050.04.26.354 E019.48.09.889 Color_44ACI
N050.04.26.354 E019.48.09.889 N050.04.26.415 E019.48.10.259 Color_44ACI
N050.04.26.415 E019.48.10.259 N050.04.26.553 E019.48.11.057 Color_44ACI
N050.04.26.553 E019.48.11.057 N050.04.26.665 E019.48.11.838 Color_44ACI
N050.04.26.665 E019.48.11.838 N050.04.26.693 E019.48.12.093 Color_44ACI
N050.04.31.011 E019.47.57.026 N050.04.31.502 E019.47.56.893 Color_44ACI
N050.04.31.629 E019.47.56.874 N050.04.31.893 E019.47.56.795 Color_44ACI
N050.04.31.893 E019.47.56.795 N050.04.32.077 E019.47.56.668 Color_44ACI
N050.04.32.077 E019.47.56.668 N050.04.32.229 E019.47.56.426 Color_44ACI
N050.04.32.229 E019.47.56.426 N050.04.32.391 E019.47.56.143 Color_44ACI
N050.04.32.391 E019.47.56.143 N050.04.32.557 E019.47.55.719 Color_44ACI
N050.04.32.557 E019.47.55.719 N050.04.32.713 E019.47.55.337 Color_44ACI
N050.04.32.713 E019.47.55.337 N050.04.33.327 E019.47.53.849 Color_44ACI
N050.04.33.327 E019.47.53.849 N050.04.33.903 E019.47.52.386 Color_44ACI
N050.04.41.665 E019.48.12.108 N050.04.38.866 E019.48.13.042 Color_44ACI
N050.04.38.866 E019.48.13.042 N050.04.38.528 E019.48.13.171 Color_44ACI
N050.04.38.428 E019.48.13.206 N050.04.37.525 E019.48.13.520 Color_44ACI
N050.04.37.525 E019.48.13.520 N050.04.36.221 E019.48.13.973 Color_44ACI
N050.04.36.221 E019.48.13.973 N050.04.34.954 E019.48.14.400 Color_44ACI
N050.04.34.954 E019.48.14.400 N050.04.34.415 E019.48.14.600 Color_44ACI
N050.04.32.910 E019.47.56.884 N050.04.34.900 E019.47.58.225 Color_44ACI
N050.04.34.900 E019.47.58.225 N050.04.35.970 E019.47.58.964 Color_44ACI
N050.04.39.935 E019.48.10.637 N050.04.40.036 E019.48.10.600 Color_44ACI
;twy_edge_lights N000.00.00.000 E000.00.00.000 N000.00.00.000 E000.00.00.000
N050.04.35.652 E019.47.28.787 N050.04.35.599 E019.47.28.751 Color_186ACI
N050.04.35.599 E019.47.28.751 N050.04.35.535 E019.47.28.772 Color_186ACI
N050.04.35.535 E019.47.28.772 N050.04.35.495 E019.47.28.835 Color_186ACI
N050.04.35.495 E019.47.28.835 N050.04.35.484 E019.47.28.939 Color_186ACI
N050.04.35.484 E019.47.28.939 N050.04.35.511 E019.47.29.025 Color_186ACI
N050.04.35.511 E019.47.29.025 N050.04.35.569 E019.47.29.073 Color_186ACI
N050.04.35.569 E019.47.29.073 N050.04.35.629 E019.47.29.061 Color_186ACI
N050.04.35.629 E019.47.29.061 N050.04.35.677 E019.47.28.992 Color_186ACI
N050.04.35.677 E019.47.28.992 N050.04.35.691 E019.47.28.912 Color_186ACI
N050.04.35.691 E019.47.28.912 N050.04.35.677 E019.47.28.832 Color_186ACI
N050.04.35.677 E019.47.28.832 N050.04.35.652 E019.47.28.787 Color_186ACI
N050.04.35.356 E019.47.29.059 N050.04.35.302 E019.47.29.024 Color_186ACI
N050.04.35.302 E019.47.29.024 N050.04.35.238 E019.47.29.044 Color_186ACI
N050.04.35.238 E019.47.29.044 N050.04.35.198 E019.47.29.108 Color_186ACI
N050.04.35.198 E019.47.29.108 N050.04.35.187 E019.47.29.212 Color_186ACI
N050.04.35.187 E019.47.29.212 N050.04.35.215 E019.47.29.298 Color_186ACI
N050.04.35.215 E019.47.29.298 N050.04.35.272 E019.47.29.345 Color_186ACI
N050.04.35.272 E019.47.29.345 N050.04.35.332 E019.47.29.333 Color_186ACI
N050.04.35.332 E019.47.29.333 N050.04.35.381 E019.47.29.264 Color_186ACI
N050.04.35.381 E019.47.29.264 N050.04.35.394 E019.47.29.185 Color_186ACI
N050.04.35.394 E019.47.29.185 N050.04.35.380 E019.47.29.104 Color_186ACI
N050.04.35.380 E019.47.29.104 N050.04.35.356 E019.47.29.059 Color_186ACI
N050.04.35.081 E019.47.29.279 N050.04.35.027 E019.47.29.243 Color_186ACI
N050.04.35.027 E019.47.29.243 N050.04.34.963 E019.47.29.263 Color_186ACI
N050.04.34.963 E019.47.29.263 N050.04.34.923 E019.47.29.327 Color_186ACI
N050.04.34.923 E019.47.29.327 N050.04.34.912 E019.47.29.431 Color_186ACI
N050.04.34.912 E019.47.29.431 N050.04.34.940 E019.47.29.517 Color_186ACI
N050.04.34.940 E019.47.29.517 N050.04.34.998 E019.47.29.564 Color_186ACI
N050.04.34.998 E019.47.29.564 N050.04.35.058 E019.47.29.552 Color_186ACI
N050.04.35.058 E019.47.29.552 N050.04.35.106 E019.47.29.483 Color_186ACI
N050.04.35.106 E019.47.29.483 N050.04.35.119 E019.47.29.404 Color_186ACI
N050.04.35.119 E019.47.29.404 N050.04.35.105 E019.47.29.323 Color_186ACI
N050.04.35.105 E019.47.29.323 N050.04.35.081 E019.47.29.279 Color_186ACI
N050.04.34.931 E019.47.29.577 N050.04.34.877 E019.47.29.541 Color_186ACI
N050.04.34.877 E019.47.29.541 N050.04.34.813 E019.47.29.561 Color_186ACI
N050.04.34.813 E019.47.29.561 N050.04.34.773 E019.47.29.625 Color_186ACI
N050.04.34.773 E019.47.29.625 N050.04.34.762 E019.47.29.729 Color_186ACI
N050.04.34.762 E019.47.29.729 N050.04.34.790 E019.47.29.815 Color_186ACI
N050.04.34.790 E019.47.29.815 N050.04.34.847 E019.47.29.862 Color_186ACI
N050.04.34.847 E019.47.29.862 N050.04.34.907 E019.47.29.850 Color_186ACI
N050.04.34.907 E019.47.29.850 N050.04.34.956 E019.47.29.781 Color_186ACI
N050.04.34.956 E019.47.29.781 N050.04.34.969 E019.47.29.702 Color_186ACI
N050.04.34.969 E019.47.29.702 N050.04.34.955 E019.47.29.621 Color_186ACI
N050.04.34.955 E019.47.29.621 N050.04.34.931 E019.47.29.577 Color_186ACI
N050.04.34.803 E019.47.29.881 N050.04.34.749 E019.47.29.845 Color_186ACI
N050.04.34.749 E019.47.29.845 N050.04.34.685 E019.47.29.866 Color_186ACI
N050.04.34.685 E019.47.29.866 N050.04.34.645 E019.47.29.929 Color_186ACI
N050.04.34.645 E019.47.29.929 N050.04.34.634 E019.47.30.033 Color_186ACI
N050.04.34.634 E019.47.30.033 N050.04.34.662 E019.47.30.119 Color_186ACI
N050.04.34.662 E019.47.30.119 N050.04.34.719 E019.47.30.167 Color_186ACI
N050.04.34.719 E019.47.30.167 N050.04.34.780 E019.47.30.155 Color_186ACI
N050.04.34.780 E019.47.30.155 N050.04.34.828 E019.47.30.086 Color_186ACI
N050.04.34.828 E019.47.30.086 N050.04.34.841 E019.47.30.006 Color_186ACI
N050.04.34.841 E019.47.30.006 N050.04.34.827 E019.47.29.925 Color_186ACI
N050.04.34.827 E019.47.29.925 N050.04.34.803 E019.47.29.881 Color_186ACI
N050.04.34.671 E019.47.30.500 N050.04.34.617 E019.47.30.464 Color_186ACI
N050.04.34.617 E019.47.30.464 N050.04.34.553 E019.47.30.485 Color_186ACI
N050.04.34.553 E019.47.30.485 N050.04.34.513 E019.47.30.548 Color_186ACI
N050.04.34.513 E019.47.30.548 N050.04.34.502 E019.47.30.652 Color_186ACI
N050.04.34.502 E019.47.30.652 N050.04.34.530 E019.47.30.738 Color_186ACI
N050.04.34.530 E019.47.30.738 N050.04.34.587 E019.47.30.786 Color_186ACI
N050.04.34.587 E019.47.30.786 N050.04.34.647 E019.47.30.774 Color_186ACI
N050.04.34.647 E019.47.30.774 N050.04.34.696 E019.47.30.705 Color_186ACI
N050.04.34.696 E019.47.30.705 N050.04.34.709 E019.47.30.625 Color_186ACI
N050.04.34.709 E019.47.30.625 N050.04.34.695 E019.47.30.544 Color_186ACI
N050.04.34.695 E019.47.30.544 N050.04.34.671 E019.47.30.500 Color_186ACI
N050.04.35.492 E019.47.27.834 N050.04.35.438 E019.47.27.798 Color_186ACI
N050.04.35.438 E019.47.27.798 N050.04.35.374 E019.47.27.819 Color_186ACI
N050.04.35.374 E019.47.27.819 N050.04.35.334 E019.47.27.882 Color_186ACI
N050.04.35.334 E019.47.27.882 N050.04.35.323 E019.47.27.986 Color_186ACI
N050.04.35.323 E019.47.27.986 N050.04.35.351 E019.47.28.072 Color_186ACI
N050.04.35.351 E019.47.28.072 N050.04.35.408 E019.47.28.120 Color_186ACI
N050.04.35.408 E019.47.28.120 N050.04.35.469 E019.47.28.108 Color_186ACI
N050.04.35.469 E019.47.28.108 N050.04.35.517 E019.47.28.038 Color_186ACI
N050.04.35.517 E019.47.28.038 N050.04.35.530 E019.47.27.959 Color_186ACI
N050.04.35.530 E019.47.27.959 N050.04.35.516 E019.47.27.878 Color_186ACI
N050.04.35.516 E019.47.27.878 N050.04.35.492 E019.47.27.834 Color_186ACI
N050.04.35.186 E019.47.27.821 N050.04.35.132 E019.47.27.785 Color_186ACI
N050.04.35.132 E019.47.27.785 N050.04.35.068 E019.47.27.806 Color_186ACI
N050.04.35.068 E019.47.27.806 N050.04.35.028 E019.47.27.869 Color_186ACI
N050.04.35.028 E019.47.27.869 N050.04.35.017 E019.47.27.973 Color_186ACI
N050.04.35.017 E019.47.27.973 N050.04.35.045 E019.47.28.059 Color_186ACI
N050.04.35.045 E019.47.28.059 N050.04.35.102 E019.47.28.107 Color_186ACI
N050.04.35.102 E019.47.28.107 N050.04.35.162 E019.47.28.095 Color_186ACI
N050.04.35.162 E019.47.28.095 N050.04.35.211 E019.47.28.026 Color_186ACI
N050.04.35.211 E019.47.28.026 N050.04.35.224 E019.47.27.946 Color_186ACI
N050.04.35.224 E019.47.27.946 N050.04.35.210 E019.47.27.866 Color_186ACI
N050.04.35.210 E019.47.27.866 N050.04.35.186 E019.47.27.821 Color_186ACI
N050.04.34.895 E019.47.27.793 N050.04.34.841 E019.47.27.758 Color_186ACI
N050.04.34.841 E019.47.27.758 N050.04.34.777 E019.47.27.778 Color_186ACI
N050.04.34.777 E019.47.27.778 N050.04.34.737 E019.47.27.842 Color_186ACI
N050.04.34.737 E019.47.27.842 N050.04.34.726 E019.47.27.946 Color_186ACI
N050.04.34.726 E019.47.27.946 N050.04.34.754 E019.47.28.032 Color_186ACI
N050.04.34.754 E019.47.28.032 N050.04.34.812 E019.47.28.079 Color_186ACI
N050.04.34.812 E019.47.28.079 N050.04.34.872 E019.47.28.067 Color_186ACI
N050.04.34.872 E019.47.28.067 N050.04.34.920 E019.47.27.998 Color_186ACI
N050.04.34.920 E019.47.27.998 N050.04.34.933 E019.47.27.919 Color_186ACI
N050.04.34.933 E019.47.27.919 N050.04.34.919 E019.47.27.838 Color_186ACI
N050.04.34.919 E019.47.27.838 N050.04.34.895 E019.47.27.793 Color_186ACI
N050.04.34.691 E019.47.27.618 N050.04.34.638 E019.47.27.583 Color_186ACI
N050.04.34.638 E019.47.27.583 N050.04.34.574 E019.47.27.603 Color_186ACI
N050.04.34.574 E019.47.27.603 N050.04.34.534 E019.47.27.667 Color_186ACI
N050.04.34.534 E019.47.27.667 N050.04.34.523 E019.47.27.771 Color_186ACI
N050.04.34.523 E019.47.27.771 N050.04.34.550 E019.47.27.857 Color_186ACI
N050.04.34.550 E019.47.27.857 N050.04.34.608 E019.47.27.904 Color_186ACI
N050.04.34.608 E019.47.27.904 N050.04.34.668 E019.47.27.892 Color_186ACI
N050.04.34.668 E019.47.27.892 N050.04.34.716 E019.47.27.823 Color_186ACI
N050.04.34.716 E019.47.27.823 N050.04.34.730 E019.47.27.744 Color_186ACI
N050.04.34.730 E019.47.27.744 N050.04.34.716 E019.47.27.663 Color_186ACI
N050.04.34.716 E019.47.27.663 N050.04.34.691 E019.47.27.618 Color_186ACI
N050.04.34.475 E019.47.27.424 N050.04.34.422 E019.47.27.388 Color_186ACI
N050.04.34.422 E019.47.27.388 N050.04.34.358 E019.47.27.408 Color_186ACI
N050.04.34.358 E019.47.27.408 N050.04.34.318 E019.47.27.472 Color_186ACI
N050.04.34.318 E019.47.27.472 N050.04.34.307 E019.47.27.576 Color_186ACI
N050.04.34.307 E019.47.27.576 N050.04.34.334 E019.47.27.662 Color_186ACI
N050.04.34.334 E019.47.27.662 N050.04.34.392 E019.47.27.709 Color_186ACI
N050.04.34.392 E019.47.27.709 N050.04.34.452 E019.47.27.698 Color_186ACI
N050.04.34.452 E019.47.27.698 N050.04.34.500 E019.47.27.628 Color_186ACI
N050.04.34.500 E019.47.27.628 N050.04.34.514 E019.47.27.549 Color_186ACI
N050.04.34.514 E019.47.27.549 N050.04.34.500 E019.47.27.468 Color_186ACI
N050.04.34.500 E019.47.27.468 N050.04.34.475 E019.47.27.424 Color_186ACI
N050.04.34.106 E019.47.26.407 N050.04.34.052 E019.47.26.371 Color_186ACI
N050.04.34.052 E019.47.26.371 N050.04.33.988 E019.47.26.392 Color_186ACI
N050.04.33.988 E019.47.26.392 N050.04.33.949 E019.47.26.455 Color_186ACI
N050.04.33.949 E019.47.26.455 N050.04.33.937 E019.47.26.559 Color_186ACI
N050.04.33.937 E019.47.26.559 N050.04.33.965 E019.47.26.645 Color_186ACI
N050.04.33.965 E019.47.26.645 N050.04.34.023 E019.47.26.693 Color_186ACI
N050.04.34.023 E019.47.26.693 N050.04.34.083 E019.47.26.681 Color_186ACI
N050.04.34.083 E019.47.26.681 N050.04.34.131 E019.47.26.612 Color_186ACI
N050.04.34.131 E019.47.26.612 N050.04.34.144 E019.47.26.532 Color_186ACI
N050.04.34.144 E019.47.26.532 N050.04.34.130 E019.47.26.451 Color_186ACI
N050.04.34.130 E019.47.26.451 N050.04.34.106 E019.47.26.407 Color_186ACI
N050.04.37.238 E019.47.28.255 N050.04.37.185 E019.47.28.219 Color_186ACI
N050.04.37.185 E019.47.28.219 N050.04.37.121 E019.47.28.240 Color_186ACI
N050.04.37.121 E019.47.28.240 N050.04.37.081 E019.47.28.303 Color_186ACI
N050.04.37.081 E019.47.28.303 N050.04.37.070 E019.47.28.407 Color_186ACI
N050.04.37.070 E019.47.28.407 N050.04.37.097 E019.47.28.493 Color_186ACI
N050.04.37.097 E019.47.28.493 N050.04.37.155 E019.47.28.541 Color_186ACI
N050.04.37.155 E019.47.28.541 N050.04.37.215 E019.47.28.529 Color_186ACI
N050.04.37.215 E019.47.28.529 N050.04.37.263 E019.47.28.460 Color_186ACI
N050.04.37.263 E019.47.28.460 N050.04.37.277 E019.47.28.380 Color_186ACI
N050.04.37.277 E019.47.28.380 N050.04.37.263 E019.47.28.300 Color_186ACI
N050.04.37.263 E019.47.28.300 N050.04.37.238 E019.47.28.255 Color_186ACI
N050.04.37.110 E019.47.27.293 N050.04.37.056 E019.47.27.257 Color_186ACI
N050.04.37.056 E019.47.27.257 N050.04.36.992 E019.47.27.277 Color_186ACI
N050.04.36.992 E019.47.27.277 N050.04.36.952 E019.47.27.341 Color_186ACI
N050.04.36.952 E019.47.27.341 N050.04.36.941 E019.47.27.445 Color_186ACI
N050.04.36.941 E019.47.27.445 N050.04.36.969 E019.47.27.531 Color_186ACI
N050.04.36.969 E019.47.27.531 N050.04.37.027 E019.47.27.578 Color_186ACI
N050.04.37.027 E019.47.27.578 N050.04.37.087 E019.47.27.566 Color_186ACI
N050.04.37.087 E019.47.27.566 N050.04.37.135 E019.47.27.497 Color_186ACI
N050.04.37.135 E019.47.27.497 N050.04.37.148 E019.47.27.418 Color_186ACI
N050.04.37.148 E019.47.27.418 N050.04.37.134 E019.47.27.337 Color_186ACI
N050.04.37.134 E019.47.27.337 N050.04.37.110 E019.47.27.293 Color_186ACI
N050.04.38.860 E019.47.27.715 N050.04.38.806 E019.47.27.680 Color_186ACI
N050.04.38.806 E019.47.27.680 N050.04.38.742 E019.47.27.700 Color_186ACI
N050.04.38.742 E019.47.27.700 N050.04.38.702 E019.47.27.764 Color_186ACI
N050.04.38.702 E019.47.27.764 N050.04.38.691 E019.47.27.868 Color_186ACI
N050.04.38.691 E019.47.27.868 N050.04.38.719 E019.47.27.954 Color_186ACI
N050.04.38.719 E019.47.27.954 N050.04.38.776 E019.47.28.001 Color_186ACI
N050.04.38.776 E019.47.28.001 N050.04.38.836 E019.47.27.989 Color_186ACI
N050.04.38.836 E019.47.27.989 N050.04.38.885 E019.47.27.920 Color_186ACI
N050.04.38.885 E019.47.27.920 N050.04.38.898 E019.47.27.841 Color_186ACI
N050.04.38.898 E019.47.27.841 N050.04.38.884 E019.47.27.760 Color_186ACI
N050.04.38.884 E019.47.27.760 N050.04.38.860 E019.47.27.715 Color_186ACI
N050.04.38.720 E019.47.26.749 N050.04.38.667 E019.47.26.713 Color_186ACI
N050.04.38.667 E019.47.26.713 N050.04.38.603 E019.47.26.733 Color_186ACI
N050.04.38.603 E019.47.26.733 N050.04.38.563 E019.47.26.797 Color_186ACI
N050.04.38.563 E019.47.26.797 N050.04.38.552 E019.47.26.901 Color_186ACI
N050.04.38.552 E019.47.26.901 N050.04.38.579 E019.47.26.987 Color_186ACI
N050.04.38.579 E019.47.26.987 N050.04.38.637 E019.47.27.034 Color_186ACI
N050.04.38.637 E019.47.27.034 N050.04.38.697 E019.47.27.022 Color_186ACI
N050.04.38.697 E019.47.27.022 N050.04.38.745 E019.47.26.953 Color_186ACI
N050.04.38.745 E019.47.26.953 N050.04.38.759 E019.47.26.874 Color_186ACI
N050.04.38.759 E019.47.26.874 N050.04.38.745 E019.47.26.793 Color_186ACI
N050.04.38.745 E019.47.26.793 N050.04.38.720 E019.47.26.749 Color_186ACI
N050.04.40.119 E019.47.27.283 N050.04.40.065 E019.47.27.248 Color_186ACI
N050.04.40.065 E019.47.27.248 N050.04.40.001 E019.47.27.268 Color_186ACI
N050.04.40.001 E019.47.27.268 N050.04.39.961 E019.47.27.332 Color_186ACI
N050.04.39.961 E019.47.27.332 N050.04.39.950 E019.47.27.436 Color_186ACI
N050.04.39.950 E019.47.27.436 N050.04.39.978 E019.47.27.522 Color_186ACI
N050.04.39.978 E019.47.27.522 N050.04.40.035 E019.47.27.569 Color_186ACI
N050.04.40.035 E019.47.27.569 N050.04.40.095 E019.47.27.557 Color_186ACI
N050.04.40.095 E019.47.27.557 N050.04.40.144 E019.47.27.488 Color_186ACI
N050.04.40.144 E019.47.27.488 N050.04.40.157 E019.47.27.409 Color_186ACI
N050.04.40.157 E019.47.27.409 N050.04.40.143 E019.47.27.328 Color_186ACI
N050.04.40.143 E019.47.27.328 N050.04.40.119 E019.47.27.283 Color_186ACI
N050.04.40.017 E019.47.26.297 N050.04.39.964 E019.47.26.262 Color_186ACI
N050.04.39.964 E019.47.26.262 N050.04.39.900 E019.47.26.282 Color_186ACI
N050.04.39.900 E019.47.26.282 N050.04.39.860 E019.47.26.345 Color_186ACI
N050.04.39.860 E019.47.26.345 N050.04.39.849 E019.47.26.449 Color_186ACI
N050.04.39.849 E019.47.26.449 N050.04.39.876 E019.47.26.536 Color_186ACI
N050.04.39.876 E019.47.26.536 N050.04.39.934 E019.47.26.583 Color_186ACI
N050.04.39.934 E019.47.26.583 N050.04.39.994 E019.47.26.571 Color_186ACI
N050.04.39.994 E019.47.26.571 N050.04.40.042 E019.47.26.502 Color_186ACI
N050.04.40.042 E019.47.26.502 N050.04.40.055 E019.47.26.422 Color_186ACI
N050.04.40.055 E019.47.26.422 N050.04.40.042 E019.47.26.342 Color_186ACI
N050.04.40.042 E019.47.26.342 N050.04.40.017 E019.47.26.297 Color_186ACI
N050.04.40.365 E019.47.26.016 N050.04.40.311 E019.47.25.981 Color_186ACI
N050.04.40.311 E019.47.25.981 N050.04.40.247 E019.47.26.001 Color_186ACI
N050.04.40.247 E019.47.26.001 N050.04.40.207 E019.47.26.065 Color_186ACI
N050.04.40.207 E019.47.26.065 N050.04.40.196 E019.47.26.169 Color_186ACI
N050.04.40.196 E019.47.26.169 N050.04.40.224 E019.47.26.255 Color_186ACI
N050.04.40.224 E019.47.26.255 N050.04.40.282 E019.47.26.302 Color_186ACI
N050.04.40.282 E019.47.26.302 N050.04.40.342 E019.47.26.290 Color_186ACI
N050.04.40.342 E019.47.26.290 N050.04.40.390 E019.47.26.221 Color_186ACI
N050.04.40.390 E019.47.26.221 N050.04.40.403 E019.47.26.142 Color_186ACI
N050.04.40.403 E019.47.26.142 N050.04.40.389 E019.47.26.061 Color_186ACI
N050.04.40.389 E019.47.26.061 N050.04.40.365 E019.47.26.016 Color_186ACI
N050.04.40.504 E019.47.27.305 N050.04.40.451 E019.47.27.269 Color_186ACI
N050.04.40.451 E019.47.27.269 N050.04.40.386 E019.47.27.290 Color_186ACI
N050.04.40.386 E019.47.27.290 N050.04.40.347 E019.47.27.353 Color_186ACI
N050.04.40.347 E019.47.27.353 N050.04.40.335 E019.47.27.457 Color_186ACI
N050.04.40.335 E019.47.27.457 N050.04.40.363 E019.47.27.543 Color_186ACI
N050.04.40.363 E019.47.27.543 N050.04.40.421 E019.47.27.591 Color_186ACI
N050.04.40.421 E019.47.27.591 N050.04.40.481 E019.47.27.579 Color_186ACI
N050.04.40.481 E019.47.27.579 N050.04.40.529 E019.47.27.510 Color_186ACI
N050.04.40.529 E019.47.27.510 N050.04.40.542 E019.47.27.430 Color_186ACI
N050.04.40.542 E019.47.27.430 N050.04.40.529 E019.47.27.349 Color_186ACI
N050.04.40.529 E019.47.27.349 N050.04.40.504 E019.47.27.305 Color_186ACI
N050.04.40.892 E019.47.27.349 N050.04.40.839 E019.47.27.313 Color_186ACI
N050.04.40.839 E019.47.27.313 N050.04.40.775 E019.47.27.334 Color_186ACI
N050.04.40.775 E019.47.27.334 N050.04.40.735 E019.47.27.397 Color_186ACI
N050.04.40.735 E019.47.27.397 N050.04.40.724 E019.47.27.501 Color_186ACI
N050.04.40.724 E019.47.27.501 N050.04.40.752 E019.47.27.587 Color_186ACI
N050.04.40.752 E019.47.27.587 N050.04.40.809 E019.47.27.635 Color_186ACI
N050.04.40.809 E019.47.27.635 N050.04.40.869 E019.47.27.623 Color_186ACI
N050.04.40.869 E019.47.27.623 N050.04.40.918 E019.47.27.554 Color_186ACI
N050.04.40.918 E019.47.27.554 N050.04.40.931 E019.47.27.474 Color_186ACI
N050.04.40.931 E019.47.27.474 N050.04.40.917 E019.47.27.394 Color_186ACI
N050.04.40.917 E019.47.27.394 N050.04.40.892 E019.47.27.349 Color_186ACI
N050.04.40.727 E019.47.25.731 N050.04.40.673 E019.47.25.696 Color_186ACI
N050.04.40.673 E019.47.25.696 N050.04.40.609 E019.47.25.716 Color_186ACI
N050.04.40.609 E019.47.25.716 N050.04.40.570 E019.47.25.780 Color_186ACI
N050.04.40.570 E019.47.25.780 N050.04.40.558 E019.47.25.884 Color_186ACI
N050.04.40.558 E019.47.25.884 N050.04.40.586 E019.47.25.970 Color_186ACI
N050.04.40.586 E019.47.25.970 N050.04.40.644 E019.47.26.017 Color_186ACI
N050.04.40.644 E019.47.26.017 N050.04.40.704 E019.47.26.005 Color_186ACI
N050.04.40.704 E019.47.26.005 N050.04.40.752 E019.47.25.936 Color_186ACI
N050.04.40.752 E019.47.25.936 N050.04.40.765 E019.47.25.857 Color_186ACI
N050.04.40.765 E019.47.25.857 N050.04.40.751 E019.47.25.776 Color_186ACI
N050.04.40.751 E019.47.25.776 N050.04.40.727 E019.47.25.731 Color_186ACI
N050.04.40.944 E019.47.25.210 N050.04.40.890 E019.47.25.174 Color_186ACI
N050.04.40.890 E019.47.25.174 N050.04.40.826 E019.47.25.195 Color_186ACI
N050.04.40.826 E019.47.25.195 N050.04.40.787 E019.47.25.258 Color_186ACI
N050.04.40.787 E019.47.25.258 N050.04.40.775 E019.47.25.362 Color_186ACI
N050.04.40.775 E019.47.25.362 N050.04.40.803 E019.47.25.448 Color_186ACI
N050.04.40.803 E019.47.25.448 N050.04.40.861 E019.47.25.496 Color_186ACI
N050.04.40.861 E019.47.25.496 N050.04.40.921 E019.47.25.484 Color_186ACI
N050.04.40.921 E019.47.25.484 N050.04.40.969 E019.47.25.415 Color_186ACI
N050.04.40.969 E019.47.25.415 N050.04.40.982 E019.47.25.335 Color_186ACI
N050.04.40.982 E019.47.25.335 N050.04.40.968 E019.47.25.254 Color_186ACI
N050.04.40.968 E019.47.25.254 N050.04.40.944 E019.47.25.210 Color_186ACI
N050.04.41.104 E019.47.24.706 N050.04.41.050 E019.47.24.671 Color_186ACI
N050.04.41.050 E019.47.24.671 N050.04.40.986 E019.47.24.691 Color_186ACI
N050.04.40.986 E019.47.24.691 N050.04.40.947 E019.47.24.755 Color_186ACI
N050.04.40.947 E019.47.24.755 N050.04.40.935 E019.47.24.859 Color_186ACI
N050.04.40.935 E019.47.24.859 N050.04.40.963 E019.47.24.945 Color_186ACI
N050.04.40.963 E019.47.24.945 N050.04.41.021 E019.47.24.992 Color_186ACI
N050.04.41.021 E019.47.24.992 N050.04.41.081 E019.47.24.980 Color_186ACI
N050.04.41.081 E019.47.24.980 N050.04.41.129 E019.47.24.911 Color_186ACI
N050.04.41.129 E019.47.24.911 N050.04.41.142 E019.47.24.832 Color_186ACI
N050.04.41.142 E019.47.24.832 N050.04.41.128 E019.47.24.751 Color_186ACI
N050.04.41.128 E019.47.24.751 N050.04.41.104 E019.47.24.706 Color_186ACI
N050.04.41.271 E019.47.27.707 N050.04.41.217 E019.47.27.671 Color_186ACI
N050.04.41.217 E019.47.27.671 N050.04.41.153 E019.47.27.692 Color_186ACI
N050.04.41.153 E019.47.27.692 N050.04.41.113 E019.47.27.755 Color_186ACI
N050.04.41.113 E019.47.27.755 N050.04.41.102 E019.47.27.859 Color_186ACI
N050.04.41.102 E019.47.27.859 N050.04.41.130 E019.47.27.945 Color_186ACI
N050.04.41.130 E019.47.27.945 N050.04.41.187 E019.47.27.993 Color_186ACI
N050.04.41.187 E019.47.27.993 N050.04.41.247 E019.47.27.981 Color_186ACI
N050.04.41.247 E019.47.27.981 N050.04.41.296 E019.47.27.912 Color_186ACI
N050.04.41.296 E019.47.27.912 N050.04.41.309 E019.47.27.832 Color_186ACI
N050.04.41.309 E019.47.27.832 N050.04.41.295 E019.47.27.751 Color_186ACI
N050.04.41.295 E019.47.27.751 N050.04.41.271 E019.47.27.707 Color_186ACI
N050.04.41.633 E019.47.28.126 N050.04.41.579 E019.47.28.090 Color_186ACI
N050.04.41.579 E019.47.28.090 N050.04.41.515 E019.47.28.111 Color_186ACI
N050.04.41.515 E019.47.28.111 N050.04.41.475 E019.47.28.174 Color_186ACI
N050.04.41.475 E019.47.28.174 N050.04.41.464 E019.47.28.278 Color_186ACI
N050.04.41.464 E019.47.28.278 N050.04.41.492 E019.47.28.364 Color_186ACI
N050.04.41.492 E019.47.28.364 N050.04.41.549 E019.47.28.412 Color_186ACI
N050.04.41.549 E019.47.28.412 N050.04.41.609 E019.47.28.400 Color_186ACI
N050.04.41.609 E019.47.28.400 N050.04.41.658 E019.47.28.331 Color_186ACI
N050.04.41.658 E019.47.28.331 N050.04.41.671 E019.47.28.251 Color_186ACI
N050.04.41.671 E019.47.28.251 N050.04.41.657 E019.47.28.171 Color_186ACI
N050.04.41.657 E019.47.28.171 N050.04.41.633 E019.47.28.126 Color_186ACI
N050.04.41.809 E019.47.28.578 N050.04.41.756 E019.47.28.543 Color_186ACI
N050.04.41.756 E019.47.28.543 N050.04.41.692 E019.47.28.563 Color_186ACI
N050.04.41.692 E019.47.28.563 N050.04.41.652 E019.47.28.627 Color_186ACI
N050.04.41.652 E019.47.28.627 N050.04.41.641 E019.47.28.731 Color_186ACI
N050.04.41.641 E019.47.28.731 N050.04.41.668 E019.47.28.817 Color_186ACI
N050.04.41.668 E019.47.28.817 N050.04.41.726 E019.47.28.864 Color_186ACI
N050.04.41.726 E019.47.28.864 N050.04.41.786 E019.47.28.852 Color_186ACI
N050.04.41.786 E019.47.28.852 N050.04.41.834 E019.47.28.783 Color_186ACI
N050.04.41.834 E019.47.28.783 N050.04.41.848 E019.47.28.704 Color_186ACI
N050.04.41.848 E019.47.28.704 N050.04.41.834 E019.47.28.623 Color_186ACI
N050.04.41.834 E019.47.28.623 N050.04.41.809 E019.47.28.578 Color_186ACI
N050.04.35.043 E019.47.33.273 N050.04.34.990 E019.47.33.237 Color_186ACI
N050.04.34.990 E019.47.33.237 N050.04.34.926 E019.47.33.258 Color_186ACI
N050.04.34.926 E019.47.33.258 N050.04.34.886 E019.47.33.321 Color_186ACI
N050.04.34.886 E019.47.33.321 N050.04.34.875 E019.47.33.425 Color_186ACI
N050.04.34.875 E019.47.33.425 N050.04.34.902 E019.47.33.511 Color_186ACI
N050.04.34.902 E019.47.33.511 N050.04.34.960 E019.47.33.559 Color_186ACI
N050.04.34.960 E019.47.33.559 N050.04.35.020 E019.47.33.547 Color_186ACI
N050.04.35.020 E019.47.33.547 N050.04.35.068 E019.47.33.478 Color_186ACI
N050.04.35.068 E019.47.33.478 N050.04.35.082 E019.47.33.398 Color_186ACI
N050.04.35.082 E019.47.33.398 N050.04.35.068 E019.47.33.318 Color_186ACI
N050.04.35.068 E019.47.33.318 N050.04.35.043 E019.47.33.273 Color_186ACI
N050.04.33.690 E019.47.30.765 N050.04.33.637 E019.47.30.730 Color_186ACI
N050.04.33.637 E019.47.30.730 N050.04.33.573 E019.47.30.750 Color_186ACI
N050.04.33.573 E019.47.30.750 N050.04.33.533 E019.47.30.813 Color_186ACI
N050.04.33.533 E019.47.30.813 N050.04.33.522 E019.47.30.918 Color_186ACI
N050.04.33.522 E019.47.30.918 N050.04.33.549 E019.47.31.004 Color_186ACI
N050.04.33.549 E019.47.31.004 N050.04.33.607 E019.47.31.051 Color_186ACI
N050.04.33.607 E019.47.31.051 N050.04.33.667 E019.47.31.039 Color_186ACI
N050.04.33.667 E019.47.31.039 N050.04.33.715 E019.47.30.970 Color_186ACI
N050.04.33.715 E019.47.30.970 N050.04.33.729 E019.47.30.891 Color_186ACI
N050.04.33.729 E019.47.30.891 N050.04.33.715 E019.47.30.810 Color_186ACI
N050.04.33.715 E019.47.30.810 N050.04.33.690 E019.47.30.765 Color_186ACI
N050.04.34.092 E019.47.33.622 N050.04.34.038 E019.47.33.587 Color_186ACI
N050.04.34.038 E019.47.33.587 N050.04.33.974 E019.47.33.607 Color_186ACI
N050.04.33.974 E019.47.33.607 N050.04.33.934 E019.47.33.671 Color_186ACI
N050.04.33.934 E019.47.33.671 N050.04.33.923 E019.47.33.775 Color_186ACI
N050.04.33.923 E019.47.33.775 N050.04.33.951 E019.47.33.861 Color_186ACI
N050.04.33.951 E019.47.33.861 N050.04.34.008 E019.47.33.908 Color_186ACI
N050.04.34.008 E019.47.33.908 N050.04.34.068 E019.47.33.896 Color_186ACI
N050.04.34.068 E019.47.33.896 N050.04.34.117 E019.47.33.827 Color_186ACI
N050.04.34.117 E019.47.33.827 N050.04.34.130 E019.47.33.748 Color_186ACI
N050.04.34.130 E019.47.33.748 N050.04.34.116 E019.47.33.667 Color_186ACI
N050.04.34.116 E019.47.33.667 N050.04.34.092 E019.47.33.622 Color_186ACI
N050.04.35.460 E019.47.36.238 N050.04.35.407 E019.47.36.202 Color_186ACI
N050.04.35.407 E019.47.36.202 N050.04.35.343 E019.47.36.222 Color_186ACI
N050.04.35.343 E019.47.36.222 N050.04.35.303 E019.47.36.286 Color_186ACI
N050.04.35.303 E019.47.36.286 N050.04.35.292 E019.47.36.390 Color_186ACI
N050.04.35.292 E019.47.36.390 N050.04.35.320 E019.47.36.476 Color_186ACI
N050.04.35.320 E019.47.36.476 N050.04.35.377 E019.47.36.523 Color_186ACI
N050.04.35.377 E019.47.36.523 N050.04.35.437 E019.47.36.511 Color_186ACI
N050.04.35.437 E019.47.36.511 N050.04.35.486 E019.47.36.442 Color_186ACI
N050.04.35.486 E019.47.36.442 N050.04.35.499 E019.47.36.363 Color_186ACI
N050.04.35.499 E019.47.36.363 N050.04.35.485 E019.47.36.282 Color_186ACI
N050.04.35.485 E019.47.36.282 N050.04.35.460 E019.47.36.238 Color_186ACI
N050.04.34.502 E019.47.36.561 N050.04.34.448 E019.47.36.526 Color_186ACI
N050.04.34.448 E019.47.36.526 N050.04.34.384 E019.47.36.546 Color_186ACI
N050.04.34.384 E019.47.36.546 N050.04.34.344 E019.47.36.609 Color_186ACI
N050.04.34.344 E019.47.36.609 N050.04.34.333 E019.47.36.713 Color_186ACI
N050.04.34.333 E019.47.36.713 N050.04.34.361 E019.47.36.800 Color_186ACI
N050.04.34.361 E019.47.36.800 N050.04.34.418 E019.47.36.847 Color_186ACI
N050.04.34.418 E019.47.36.847 N050.04.34.478 E019.47.36.835 Color_186ACI
N050.04.34.478 E019.47.36.835 N050.04.34.527 E019.47.36.766 Color_186ACI
N050.04.34.527 E019.47.36.766 N050.04.34.540 E019.47.36.686 Color_186ACI
N050.04.34.540 E019.47.36.686 N050.04.34.526 E019.47.36.606 Color_186ACI
N050.04.34.526 E019.47.36.606 N050.04.34.502 E019.47.36.561 Color_186ACI
N050.04.35.870 E019.47.39.179 N050.04.35.816 E019.47.39.143 Color_186ACI
N050.04.35.816 E019.47.39.143 N050.04.35.752 E019.47.39.163 Color_186ACI
N050.04.35.752 E019.47.39.163 N050.04.35.712 E019.47.39.227 Color_186ACI
N050.04.35.712 E019.47.39.227 N050.04.35.701 E019.47.39.331 Color_186ACI
N050.04.35.701 E019.47.39.331 N050.04.35.729 E019.47.39.417 Color_186ACI
N050.04.35.729 E019.47.39.417 N050.04.35.787 E019.47.39.464 Color_186ACI
N050.04.35.787 E019.47.39.464 N050.04.35.847 E019.47.39.452 Color_186ACI
N050.04.35.847 E019.47.39.452 N050.04.35.895 E019.47.39.383 Color_186ACI
N050.04.35.895 E019.47.39.383 N050.04.35.908 E019.47.39.304 Color_186ACI
N050.04.35.908 E019.47.39.304 N050.04.35.894 E019.47.39.223 Color_186ACI
N050.04.35.894 E019.47.39.223 N050.04.35.870 E019.47.39.179 Color_186ACI
N050.04.34.909 E019.47.39.511 N050.04.34.855 E019.47.39.475 Color_186ACI
N050.04.34.855 E019.47.39.475 N050.04.34.791 E019.47.39.496 Color_186ACI
N050.04.34.791 E019.47.39.496 N050.04.34.752 E019.47.39.559 Color_186ACI
N050.04.34.752 E019.47.39.559 N050.04.34.740 E019.47.39.663 Color_186ACI
N050.04.34.740 E019.47.39.663 N050.04.34.768 E019.47.39.749 Color_186ACI
N050.04.34.768 E019.47.39.749 N050.04.34.826 E019.47.39.797 Color_186ACI
N050.04.34.826 E019.47.39.797 N050.04.34.886 E019.47.39.785 Color_186ACI
N050.04.34.886 E019.47.39.785 N050.04.34.934 E019.47.39.715 Color_186ACI
N050.04.34.934 E019.47.39.715 N050.04.34.947 E019.47.39.636 Color_186ACI
N050.04.34.947 E019.47.39.636 N050.04.34.933 E019.47.39.555 Color_186ACI
N050.04.34.933 E019.47.39.555 N050.04.34.909 E019.47.39.511 Color_186ACI
N050.04.36.286 E019.47.42.154 N050.04.36.232 E019.47.42.119 Color_186ACI
N050.04.36.232 E019.47.42.119 N050.04.36.168 E019.47.42.139 Color_186ACI
N050.04.36.168 E019.47.42.139 N050.04.36.128 E019.47.42.203 Color_186ACI
N050.04.36.128 E019.47.42.203 N050.04.36.117 E019.47.42.307 Color_186ACI
N050.04.36.117 E019.47.42.307 N050.04.36.145 E019.47.42.393 Color_186ACI
N050.04.36.145 E019.47.42.393 N050.04.36.202 E019.47.42.440 Color_186ACI
N050.04.36.202 E019.47.42.440 N050.04.36.263 E019.47.42.428 Color_186ACI
N050.04.36.263 E019.47.42.428 N050.04.36.311 E019.47.42.359 Color_186ACI
N050.04.36.311 E019.47.42.359 N050.04.36.324 E019.47.42.280 Color_186ACI
N050.04.36.324 E019.47.42.280 N050.04.36.310 E019.47.42.199 Color_186ACI
N050.04.36.310 E019.47.42.199 N050.04.36.286 E019.47.42.154 Color_186ACI
N050.04.35.328 E019.47.42.482 N050.04.35.274 E019.47.42.446 Color_186ACI
N050.04.35.274 E019.47.42.446 N050.04.35.210 E019.47.42.466 Color_186ACI
N050.04.35.210 E019.47.42.466 N050.04.35.170 E019.47.42.530 Color_186ACI
N050.04.35.170 E019.47.42.530 N050.04.35.159 E019.47.42.634 Color_186ACI
N050.04.35.159 E019.47.42.634 N050.04.35.187 E019.47.42.720 Color_186ACI
N050.04.35.187 E019.47.42.720 N050.04.35.244 E019.47.42.767 Color_186ACI
N050.04.35.244 E019.47.42.767 N050.04.35.304 E019.47.42.755 Color_186ACI
N050.04.35.304 E019.47.42.755 N050.04.35.353 E019.47.42.686 Color_186ACI
N050.04.35.353 E019.47.42.686 N050.04.35.366 E019.47.42.607 Color_186ACI
N050.04.35.366 E019.47.42.607 N050.04.35.352 E019.47.42.526 Color_186ACI
N050.04.35.352 E019.47.42.526 N050.04.35.328 E019.47.42.482 Color_186ACI
N050.04.36.686 E019.47.45.042 N050.04.36.632 E019.47.45.006 Color_186ACI
N050.04.36.632 E019.47.45.006 N050.04.36.568 E019.47.45.026 Color_186ACI
N050.04.36.568 E019.47.45.026 N050.04.36.528 E019.47.45.090 Color_186ACI
N050.04.36.528 E019.47.45.090 N050.04.36.517 E019.47.45.194 Color_186ACI
N050.04.36.517 E019.47.45.194 N050.04.36.545 E019.47.45.280 Color_186ACI
N050.04.36.545 E019.47.45.280 N050.04.36.602 E019.47.45.327 Color_186ACI
N050.04.36.602 E019.47.45.327 N050.04.36.663 E019.47.45.315 Color_186ACI
N050.04.36.663 E019.47.45.315 N050.04.36.711 E019.47.45.246 Color_186ACI
N050.04.36.711 E019.47.45.246 N050.04.36.724 E019.47.45.167 Color_186ACI
N050.04.36.724 E019.47.45.167 N050.04.36.710 E019.47.45.086 Color_186ACI
N050.04.36.710 E019.47.45.086 N050.04.36.686 E019.47.45.042 Color_186ACI
N050.04.35.624 E019.47.45.062 N050.04.35.570 E019.47.45.026 Color_186ACI
N050.04.35.570 E019.47.45.026 N050.04.35.506 E019.47.45.047 Color_186ACI
N050.04.35.506 E019.47.45.047 N050.04.35.466 E019.47.45.110 Color_186ACI
N050.04.35.466 E019.47.45.110 N050.04.35.455 E019.47.45.214 Color_186ACI
N050.04.35.455 E019.47.45.214 N050.04.35.483 E019.47.45.300 Color_186ACI
N050.04.35.483 E019.47.45.300 N050.04.35.540 E019.47.45.347 Color_186ACI
N050.04.35.540 E019.47.45.347 N050.04.35.600 E019.47.45.336 Color_186ACI
N050.04.35.600 E019.47.45.336 N050.04.35.649 E019.47.45.266 Color_186ACI
N050.04.35.649 E019.47.45.266 N050.04.35.662 E019.47.45.187 Color_186ACI
N050.04.35.662 E019.47.45.187 N050.04.35.648 E019.47.45.106 Color_186ACI
N050.04.35.648 E019.47.45.106 N050.04.35.624 E019.47.45.062 Color_186ACI
N050.04.35.661 E019.47.45.733 N050.04.35.607 E019.47.45.697 Color_186ACI
N050.04.35.607 E019.47.45.697 N050.04.35.543 E019.47.45.717 Color_186ACI
N050.04.35.543 E019.47.45.717 N050.04.35.503 E019.47.45.781 Color_186ACI
N050.04.35.503 E019.47.45.781 N050.04.35.492 E019.47.45.885 Color_186ACI
N050.04.35.492 E019.47.45.885 N050.04.35.520 E019.47.45.971 Color_186ACI
N050.04.35.520 E019.47.45.971 N050.04.35.577 E019.47.46.018 Color_186ACI
N050.04.35.577 E019.47.46.018 N050.04.35.638 E019.47.46.006 Color_186ACI
N050.04.35.638 E019.47.46.006 N050.04.35.686 E019.47.45.937 Color_186ACI
N050.04.35.686 E019.47.45.937 N050.04.35.699 E019.47.45.858 Color_186ACI
N050.04.35.699 E019.47.45.858 N050.04.35.685 E019.47.45.777 Color_186ACI
N050.04.35.685 E019.47.45.777 N050.04.35.661 E019.47.45.733 Color_186ACI
N050.04.35.576 E019.47.46.506 N050.04.35.522 E019.47.46.470 Color_186ACI
N050.04.35.522 E019.47.46.470 N050.04.35.458 E019.47.46.491 Color_186ACI
N050.04.35.458 E019.47.46.491 N050.04.35.418 E019.47.46.554 Color_186ACI
N050.04.35.418 E019.47.46.554 N050.04.35.407 E019.47.46.658 Color_186ACI
N050.04.35.407 E019.47.46.658 N050.04.35.435 E019.47.46.744 Color_186ACI
N050.04.35.435 E019.47.46.744 N050.04.35.492 E019.47.46.792 Color_186ACI
N050.04.35.492 E019.47.46.792 N050.04.35.552 E019.47.46.780 Color_186ACI
N050.04.35.552 E019.47.46.780 N050.04.35.601 E019.47.46.711 Color_186ACI
N050.04.35.601 E019.47.46.711 N050.04.35.614 E019.47.46.631 Color_186ACI
N050.04.35.614 E019.47.46.631 N050.04.35.600 E019.47.46.550 Color_186ACI
N050.04.35.600 E019.47.46.550 N050.04.35.576 E019.47.46.506 Color_186ACI
N050.04.35.212 E019.47.47.714 N050.04.35.158 E019.47.47.679 Color_186ACI
N050.04.35.158 E019.47.47.679 N050.04.35.094 E019.47.47.699 Color_186ACI
N050.04.35.094 E019.47.47.699 N050.04.35.054 E019.47.47.763 Color_186ACI
N050.04.35.054 E019.47.47.763 N050.04.35.043 E019.47.47.867 Color_186ACI
N050.04.35.043 E019.47.47.867 N050.04.35.071 E019.47.47.953 Color_186ACI
N050.04.35.071 E019.47.47.953 N050.04.35.128 E019.47.48.000 Color_186ACI
N050.04.35.128 E019.47.48.000 N050.04.35.188 E019.47.47.988 Color_186ACI
N050.04.35.188 E019.47.47.988 N050.04.35.237 E019.47.47.919 Color_186ACI
N050.04.35.237 E019.47.47.919 N050.04.35.250 E019.47.47.840 Color_186ACI
N050.04.35.250 E019.47.47.840 N050.04.35.236 E019.47.47.759 Color_186ACI
N050.04.35.236 E019.47.47.759 N050.04.35.212 E019.47.47.714 Color_186ACI
N050.04.34.249 E019.47.50.120 N050.04.34.196 E019.47.50.084 Color_186ACI
N050.04.34.196 E019.47.50.084 N050.04.34.132 E019.47.50.105 Color_186ACI
N050.04.34.132 E019.47.50.105 N050.04.34.092 E019.47.50.168 Color_186ACI
N050.04.34.092 E019.47.50.168 N050.04.34.081 E019.47.50.272 Color_186ACI
N050.04.34.081 E019.47.50.272 N050.04.34.108 E019.47.50.358 Color_186ACI
N050.04.34.108 E019.47.50.358 N050.04.34.166 E019.47.50.406 Color_186ACI
N050.04.34.166 E019.47.50.406 N050.04.34.226 E019.47.50.394 Color_186ACI
N050.04.34.226 E019.47.50.394 N050.04.34.274 E019.47.50.325 Color_186ACI
N050.04.34.274 E019.47.50.325 N050.04.34.288 E019.47.50.245 Color_186ACI
N050.04.34.288 E019.47.50.245 N050.04.34.274 E019.47.50.164 Color_186ACI
N050.04.34.274 E019.47.50.164 N050.04.34.249 E019.47.50.120 Color_186ACI
N050.04.33.342 E019.47.52.374 N050.04.33.288 E019.47.52.339 Color_186ACI
N050.04.33.288 E019.47.52.339 N050.04.33.224 E019.47.52.359 Color_186ACI
N050.04.33.224 E019.47.52.359 N050.04.33.184 E019.47.52.423 Color_186ACI
N050.04.33.184 E019.47.52.423 N050.04.33.173 E019.47.52.527 Color_186ACI
N050.04.33.173 E019.47.52.527 N050.04.33.201 E019.47.52.613 Color_186ACI
N050.04.33.201 E019.47.52.613 N050.04.33.258 E019.47.52.660 Color_186ACI
N050.04.33.258 E019.47.52.660 N050.04.33.318 E019.47.52.648 Color_186ACI
N050.04.33.318 E019.47.52.648 N050.04.33.367 E019.47.52.579 Color_186ACI
N050.04.33.367 E019.47.52.579 N050.04.33.380 E019.47.52.500 Color_186ACI
N050.04.33.380 E019.47.52.500 N050.04.33.366 E019.47.52.419 Color_186ACI
N050.04.33.366 E019.47.52.419 N050.04.33.342 E019.47.52.374 Color_186ACI
N050.04.32.564 E019.47.54.303 N050.04.32.511 E019.47.54.267 Color_186ACI
N050.04.32.511 E019.47.54.267 N050.04.32.447 E019.47.54.288 Color_186ACI
N050.04.32.447 E019.47.54.288 N050.04.32.407 E019.47.54.351 Color_186ACI
N050.04.32.407 E019.47.54.351 N050.04.32.396 E019.47.54.455 Color_186ACI
N050.04.32.396 E019.47.54.455 N050.04.32.423 E019.47.54.541 Color_186ACI
N050.04.32.423 E019.47.54.541 N050.04.32.481 E019.47.54.589 Color_186ACI
N050.04.32.481 E019.47.54.589 N050.04.32.541 E019.47.54.577 Color_186ACI
N050.04.32.541 E019.47.54.577 N050.04.32.589 E019.47.54.507 Color_186ACI
N050.04.32.589 E019.47.54.507 N050.04.32.603 E019.47.54.428 Color_186ACI
N050.04.32.603 E019.47.54.428 N050.04.32.589 E019.47.54.347 Color_186ACI
N050.04.32.589 E019.47.54.347 N050.04.32.564 E019.47.54.303 Color_186ACI
N050.04.32.200 E019.47.55.141 N050.04.32.146 E019.47.55.105 Color_186ACI
N050.04.32.146 E019.47.55.105 N050.04.32.082 E019.47.55.125 Color_186ACI
N050.04.32.082 E019.47.55.125 N050.04.32.042 E019.47.55.189 Color_186ACI
N050.04.32.042 E019.47.55.189 N050.04.32.031 E019.47.55.293 Color_186ACI
N050.04.32.031 E019.47.55.293 N050.04.32.059 E019.47.55.379 Color_186ACI
N050.04.32.059 E019.47.55.379 N050.04.32.116 E019.47.55.426 Color_186ACI
N050.04.32.116 E019.47.55.426 N050.04.32.176 E019.47.55.414 Color_186ACI
N050.04.32.176 E019.47.55.414 N050.04.32.225 E019.47.55.345 Color_186ACI
N050.04.32.225 E019.47.55.345 N050.04.32.238 E019.47.55.266 Color_186ACI
N050.04.32.238 E019.47.55.266 N050.04.32.224 E019.47.55.185 Color_186ACI
N050.04.32.224 E019.47.55.185 N050.04.32.200 E019.47.55.141 Color_186ACI
N050.04.31.872 E019.47.55.547 N050.04.31.819 E019.47.55.511 Color_186ACI
N050.04.31.819 E019.47.55.511 N050.04.31.755 E019.47.55.532 Color_186ACI
N050.04.31.755 E019.47.55.532 N050.04.31.715 E019.47.55.595 Color_186ACI
N050.04.31.715 E019.47.55.595 N050.04.31.704 E019.47.55.699 Color_186ACI
N050.04.31.704 E019.47.55.699 N050.04.31.731 E019.47.55.785 Color_186ACI
N050.04.31.731 E019.47.55.785 N050.04.31.789 E019.47.55.833 Color_186ACI
N050.04.31.789 E019.47.55.833 N050.04.31.849 E019.47.55.821 Color_186ACI
N050.04.31.849 E019.47.55.821 N050.04.31.897 E019.47.55.751 Color_186ACI
N050.04.31.897 E019.47.55.751 N050.04.31.911 E019.47.55.672 Color_186ACI
N050.04.31.911 E019.47.55.672 N050.04.31.897 E019.47.55.591 Color_186ACI
N050.04.31.897 E019.47.55.591 N050.04.31.872 E019.47.55.547 Color_186ACI
N050.04.30.728 E019.47.56.290 N050.04.30.675 E019.47.56.255 Color_186ACI
N050.04.30.675 E019.47.56.255 N050.04.30.611 E019.47.56.275 Color_186ACI
N050.04.30.611 E019.47.56.275 N050.04.30.571 E019.47.56.339 Color_186ACI
N050.04.30.571 E019.47.56.339 N050.04.30.560 E019.47.56.443 Color_186ACI
N050.04.30.560 E019.47.56.443 N050.04.30.587 E019.47.56.529 Color_186ACI
N050.04.30.587 E019.47.56.529 N050.04.30.645 E019.47.56.576 Color_186ACI
N050.04.30.645 E019.47.56.576 N050.04.30.705 E019.47.56.564 Color_186ACI
N050.04.30.705 E019.47.56.564 N050.04.30.753 E019.47.56.495 Color_186ACI
N050.04.30.753 E019.47.56.495 N050.04.30.767 E019.47.56.416 Color_186ACI
N050.04.30.767 E019.47.56.416 N050.04.30.753 E019.47.56.335 Color_186ACI
N050.04.30.753 E019.47.56.335 N050.04.30.728 E019.47.56.290 Color_186ACI
N050.04.29.569 E019.47.56.675 N050.04.29.515 E019.47.56.639 Color_186ACI
N050.04.29.515 E019.47.56.639 N050.04.29.451 E019.47.56.660 Color_186ACI
N050.04.29.451 E019.47.56.660 N050.04.29.412 E019.47.56.723 Color_186ACI
N050.04.29.412 E019.47.56.723 N050.04.29.400 E019.47.56.827 Color_186ACI
N050.04.29.400 E019.47.56.827 N050.04.29.428 E019.47.56.913 Color_186ACI
N050.04.29.428 E019.47.56.913 N050.04.29.486 E019.47.56.961 Color_186ACI
N050.04.29.486 E019.47.56.961 N050.04.29.546 E019.47.56.949 Color_186ACI
N050.04.29.546 E019.47.56.949 N050.04.29.594 E019.47.56.880 Color_186ACI
N050.04.29.594 E019.47.56.880 N050.04.29.607 E019.47.56.800 Color_186ACI
N050.04.29.607 E019.47.56.800 N050.04.29.593 E019.47.56.719 Color_186ACI
N050.04.29.593 E019.47.56.719 N050.04.29.569 E019.47.56.675 Color_186ACI
N050.04.30.942 E019.47.57.794 N050.04.30.889 E019.47.57.758 Color_186ACI
N050.04.30.889 E019.47.57.758 N050.04.30.825 E019.47.57.779 Color_186ACI
N050.04.30.825 E019.47.57.779 N050.04.30.785 E019.47.57.842 Color_186ACI
N050.04.30.785 E019.47.57.842 N050.04.30.774 E019.47.57.946 Color_186ACI
N050.04.30.774 E019.47.57.946 N050.04.30.802 E019.47.58.032 Color_186ACI
N050.04.30.802 E019.47.58.032 N050.04.30.859 E019.47.58.080 Color_186ACI
N050.04.30.859 E019.47.58.080 N050.04.30.919 E019.47.58.068 Color_186ACI
N050.04.30.919 E019.47.58.068 N050.04.30.968 E019.47.57.999 Color_186ACI
N050.04.30.968 E019.47.57.999 N050.04.30.981 E019.47.57.919 Color_186ACI
N050.04.30.981 E019.47.57.919 N050.04.30.967 E019.47.57.838 Color_186ACI
N050.04.30.967 E019.47.57.838 N050.04.30.942 E019.47.57.794 Color_186ACI
N050.04.32.058 E019.47.57.423 N050.04.32.005 E019.47.57.388 Color_186ACI
N050.04.32.005 E019.47.57.388 N050.04.31.941 E019.47.57.408 Color_186ACI
N050.04.31.941 E019.47.57.408 N050.04.31.901 E019.47.57.472 Color_186ACI
N050.04.31.901 E019.47.57.472 N050.04.31.890 E019.47.57.576 Color_186ACI
N050.04.31.890 E019.47.57.576 N050.04.31.917 E019.47.57.662 Color_186ACI
N050.04.31.917 E019.47.57.662 N050.04.31.975 E019.47.57.709 Color_186ACI
N050.04.31.975 E019.47.57.709 N050.04.32.035 E019.47.57.697 Color_186ACI
N050.04.32.035 E019.47.57.697 N050.04.32.083 E019.47.57.628 Color_186ACI
N050.04.32.083 E019.47.57.628 N050.04.32.097 E019.47.57.549 Color_186ACI
N050.04.32.097 E019.47.57.549 N050.04.32.083 E019.47.57.468 Color_186ACI
N050.04.32.083 E019.47.57.468 N050.04.32.058 E019.47.57.423 Color_186ACI
N050.04.32.498 E019.47.57.433 N050.04.32.444 E019.47.57.398 Color_186ACI
N050.04.32.444 E019.47.57.398 N050.04.32.380 E019.47.57.418 Color_186ACI
N050.04.32.380 E019.47.57.418 N050.04.32.340 E019.47.57.482 Color_186ACI
N050.04.32.340 E019.47.57.482 N050.04.32.329 E019.47.57.586 Color_186ACI
N050.04.32.329 E019.47.57.586 N050.04.32.357 E019.47.57.672 Color_186ACI
N050.04.32.357 E019.47.57.672 N050.04.32.414 E019.47.57.719 Color_186ACI
N050.04.32.414 E019.47.57.719 N050.04.32.475 E019.47.57.707 Color_186ACI
N050.04.32.475 E019.47.57.707 N050.04.32.523 E019.47.57.638 Color_186ACI
N050.04.32.523 E019.47.57.638 N050.04.32.536 E019.47.57.559 Color_186ACI
N050.04.32.536 E019.47.57.559 N050.04.32.522 E019.47.57.478 Color_186ACI
N050.04.32.522 E019.47.57.478 N050.04.32.498 E019.47.57.433 Color_186ACI
N050.04.33.319 E019.47.56.102 N050.04.33.266 E019.47.56.066 Color_186ACI
N050.04.33.266 E019.47.56.066 N050.04.33.202 E019.47.56.086 Color_186ACI
N050.04.33.202 E019.47.56.086 N050.04.33.162 E019.47.56.150 Color_186ACI
N050.04.33.162 E019.47.56.150 N050.04.33.151 E019.47.56.254 Color_186ACI
N050.04.33.151 E019.47.56.254 N050.04.33.178 E019.47.56.340 Color_186ACI
N050.04.33.178 E019.47.56.340 N050.04.33.236 E019.47.56.387 Color_186ACI
N050.04.33.236 E019.47.56.387 N050.04.33.296 E019.47.56.375 Color_186ACI
N050.04.33.296 E019.47.56.375 N050.04.33.344 E019.47.56.306 Color_186ACI
N050.04.33.344 E019.47.56.306 N050.04.33.358 E019.47.56.227 Color_186ACI
N050.04.33.358 E019.47.56.227 N050.04.33.344 E019.47.56.146 Color_186ACI
N050.04.33.344 E019.47.56.146 N050.04.33.319 E019.47.56.102 Color_186ACI
N050.04.33.196 E019.47.55.600 N050.04.33.142 E019.47.55.564 Color_186ACI
N050.04.33.142 E019.47.55.564 N050.04.33.078 E019.47.55.585 Color_186ACI
N050.04.33.078 E019.47.55.585 N050.04.33.038 E019.47.55.648 Color_186ACI
N050.04.33.038 E019.47.55.648 N050.04.33.027 E019.47.55.752 Color_186ACI
N050.04.33.027 E019.47.55.752 N050.04.33.055 E019.47.55.838 Color_186ACI
N050.04.33.055 E019.47.55.838 N050.04.33.112 E019.47.55.886 Color_186ACI
N050.04.33.112 E019.47.55.886 N050.04.33.172 E019.47.55.874 Color_186ACI
N050.04.33.172 E019.47.55.874 N050.04.33.221 E019.47.55.805 Color_186ACI
N050.04.33.221 E019.47.55.805 N050.04.33.234 E019.47.55.725 Color_186ACI
N050.04.33.234 E019.47.55.725 N050.04.33.220 E019.47.55.644 Color_186ACI
N050.04.33.220 E019.47.55.644 N050.04.33.196 E019.47.55.600 Color_186ACI
N050.04.34.172 E019.47.53.185 N050.04.34.119 E019.47.53.149 Color_186ACI
N050.04.34.119 E019.47.53.149 N050.04.34.055 E019.47.53.170 Color_186ACI
N050.04.34.055 E019.47.53.170 N050.04.34.015 E019.47.53.233 Color_186ACI
N050.04.34.015 E019.47.53.233 N050.04.34.004 E019.47.53.337 Color_186ACI
N050.04.34.004 E019.47.53.337 N050.04.34.032 E019.47.53.423 Color_186ACI
N050.04.34.032 E019.47.53.423 N050.04.34.089 E019.47.53.470 Color_186ACI
N050.04.34.089 E019.47.53.470 N050.04.34.149 E019.47.53.459 Color_186ACI
N050.04.34.149 E019.47.53.459 N050.04.34.198 E019.47.53.389 Color_186ACI
N050.04.34.198 E019.47.53.389 N050.04.34.211 E019.47.53.310 Color_186ACI
N050.04.34.211 E019.47.53.310 N050.04.34.197 E019.47.53.229 Color_186ACI
N050.04.34.197 E019.47.53.229 N050.04.34.172 E019.47.53.185 Color_186ACI
N050.04.35.113 E019.47.50.845 N050.04.35.059 E019.47.50.809 Color_186ACI
N050.04.35.059 E019.47.50.809 N050.04.34.995 E019.47.50.830 Color_186ACI
N050.04.34.995 E019.47.50.830 N050.04.34.956 E019.47.50.893 Color_186ACI
N050.04.34.956 E019.47.50.893 N050.04.34.944 E019.47.50.997 Color_186ACI
N050.04.34.944 E019.47.50.997 N050.04.34.972 E019.47.51.083 Color_186ACI
N050.04.34.972 E019.47.51.083 N050.04.35.030 E019.47.51.131 Color_186ACI
N050.04.35.030 E019.47.51.131 N050.04.35.090 E019.47.51.119 Color_186ACI
N050.04.35.090 E019.47.51.119 N050.04.35.138 E019.47.51.050 Color_186ACI
N050.04.35.138 E019.47.51.050 N050.04.35.151 E019.47.50.970 Color_186ACI
N050.04.35.151 E019.47.50.970 N050.04.35.137 E019.47.50.890 Color_186ACI
N050.04.35.137 E019.47.50.890 N050.04.35.113 E019.47.50.845 Color_186ACI
N050.04.35.921 E019.47.48.888 N050.04.35.867 E019.47.48.853 Color_186ACI
N050.04.35.867 E019.47.48.853 N050.04.35.803 E019.47.48.873 Color_186ACI
N050.04.35.803 E019.47.48.873 N050.04.35.763 E019.47.48.937 Color_186ACI
N050.04.35.763 E019.47.48.937 N050.04.35.752 E019.47.49.041 Color_186ACI
N050.04.35.752 E019.47.49.041 N050.04.35.780 E019.47.49.127 Color_186ACI
N050.04.35.780 E019.47.49.127 N050.04.35.837 E019.47.49.174 Color_186ACI
N050.04.35.837 E019.47.49.174 N050.04.35.898 E019.47.49.162 Color_186ACI
N050.04.35.898 E019.47.49.162 N050.04.35.946 E019.47.49.093 Color_186ACI
N050.04.35.946 E019.47.49.093 N050.04.35.959 E019.47.49.014 Color_186ACI
N050.04.35.959 E019.47.49.014 N050.04.35.945 E019.47.48.933 Color_186ACI
N050.04.35.945 E019.47.48.933 N050.04.35.921 E019.47.48.888 Color_186ACI
N050.04.36.205 E019.47.48.974 N050.04.36.151 E019.47.48.938 Color_186ACI
N050.04.36.151 E019.47.48.938 N050.04.36.087 E019.47.48.958 Color_186ACI
N050.04.36.087 E019.47.48.958 N050.04.36.047 E019.47.49.022 Color_186ACI
N050.04.36.047 E019.47.49.022 N050.04.36.036 E019.47.49.126 Color_186ACI
N050.04.36.036 E019.47.49.126 N050.04.36.064 E019.47.49.212 Color_186ACI
N050.04.36.064 E019.47.49.212 N050.04.36.122 E019.47.49.259 Color_186ACI
N050.04.36.122 E019.47.49.259 N050.04.36.182 E019.47.49.247 Color_186ACI
N050.04.36.182 E019.47.49.247 N050.04.36.230 E019.47.49.178 Color_186ACI
N050.04.36.230 E019.47.49.178 N050.04.36.243 E019.47.49.099 Color_186ACI
N050.04.36.243 E019.47.49.099 N050.04.36.229 E019.47.49.018 Color_186ACI
N050.04.36.229 E019.47.49.018 N050.04.36.205 E019.47.48.974 Color_186ACI
N050.04.37.095 E019.47.47.989 N050.04.37.042 E019.47.47.954 Color_186ACI
N050.04.37.042 E019.47.47.954 N050.04.36.978 E019.47.47.974 Color_186ACI
N050.04.36.978 E019.47.47.974 N050.04.36.938 E019.47.48.038 Color_186ACI
N050.04.36.938 E019.47.48.038 N050.04.36.927 E019.47.48.142 Color_186ACI
N050.04.36.927 E019.47.48.142 N050.04.36.954 E019.47.48.228 Color_186ACI
N050.04.36.954 E019.47.48.228 N050.04.37.012 E019.47.48.275 Color_186ACI
N050.04.37.012 E019.47.48.275 N050.04.37.072 E019.47.48.263 Color_186ACI
N050.04.37.072 E019.47.48.263 N050.04.37.120 E019.47.48.194 Color_186ACI
N050.04.37.120 E019.47.48.194 N050.04.37.134 E019.47.48.115 Color_186ACI
N050.04.37.134 E019.47.48.115 N050.04.37.120 E019.47.48.034 Color_186ACI
N050.04.37.120 E019.47.48.034 N050.04.37.095 E019.47.47.989 Color_186ACI
N050.04.37.499 E019.47.50.722 N050.04.37.445 E019.47.50.687 Color_186ACI
N050.04.37.445 E019.47.50.687 N050.04.37.381 E019.47.50.707 Color_186ACI
N050.04.37.381 E019.47.50.707 N050.04.37.341 E019.47.50.771 Color_186ACI
N050.04.37.341 E019.47.50.771 N050.04.37.330 E019.47.50.875 Color_186ACI
N050.04.37.330 E019.47.50.875 N050.04.37.358 E019.47.50.961 Color_186ACI
N050.04.37.358 E019.47.50.961 N050.04.37.415 E019.47.51.008 Color_186ACI
N050.04.37.415 E019.47.51.008 N050.04.37.476 E019.47.50.996 Color_186ACI
N050.04.37.476 E019.47.50.996 N050.04.37.524 E019.47.50.927 Color_186ACI
N050.04.37.524 E019.47.50.927 N050.04.37.537 E019.47.50.848 Color_186ACI
N050.04.37.537 E019.47.50.848 N050.04.37.523 E019.47.50.767 Color_186ACI
N050.04.37.523 E019.47.50.767 N050.04.37.499 E019.47.50.722 Color_186ACI
N050.04.36.542 E019.47.51.065 N050.04.36.488 E019.47.51.029 Color_186ACI
N050.04.36.488 E019.47.51.029 N050.04.36.424 E019.47.51.050 Color_186ACI
N050.04.36.424 E019.47.51.050 N050.04.36.384 E019.47.51.113 Color_186ACI
N050.04.36.384 E019.47.51.113 N050.04.36.373 E019.47.51.217 Color_186ACI
N050.04.36.373 E019.47.51.217 N050.04.36.401 E019.47.51.303 Color_186ACI
N050.04.36.401 E019.47.51.303 N050.04.36.458 E019.47.51.351 Color_186ACI
N050.04.36.458 E019.47.51.351 N050.04.36.518 E019.47.51.339 Color_186ACI
N050.04.36.518 E019.47.51.339 N050.04.36.567 E019.47.51.270 Color_186ACI
N050.04.36.567 E019.47.51.270 N050.04.36.580 E019.47.51.190 Color_186ACI
N050.04.36.580 E019.47.51.190 N050.04.36.566 E019.47.51.110 Color_186ACI
N050.04.36.566 E019.47.51.110 N050.04.36.542 E019.47.51.065 Color_186ACI
N050.04.36.865 E019.47.53.403 N050.04.36.811 E019.47.53.368 Color_186ACI
N050.04.36.811 E019.47.53.368 N050.04.36.747 E019.47.53.388 Color_186ACI
N050.04.36.747 E019.47.53.388 N050.04.36.707 E019.47.53.452 Color_186ACI
N050.04.36.707 E019.47.53.452 N050.04.36.696 E019.47.53.556 Color_186ACI
N050.04.36.696 E019.47.53.556 N050.04.36.724 E019.47.53.642 Color_186ACI
N050.04.36.724 E019.47.53.642 N050.04.36.781 E019.47.53.689 Color_186ACI
N050.04.36.781 E019.47.53.689 N050.04.36.841 E019.47.53.677 Color_186ACI
N050.04.36.841 E019.47.53.677 N050.04.36.890 E019.47.53.608 Color_186ACI
N050.04.36.890 E019.47.53.608 N050.04.36.903 E019.47.53.529 Color_186ACI
N050.04.36.903 E019.47.53.529 N050.04.36.889 E019.47.53.448 Color_186ACI
N050.04.36.889 E019.47.53.448 N050.04.36.865 E019.47.53.403 Color_186ACI
N050.04.37.809 E019.47.53.081 N050.04.37.756 E019.47.53.045 Color_186ACI
N050.04.37.756 E019.47.53.045 N050.04.37.692 E019.47.53.066 Color_186ACI
N050.04.37.692 E019.47.53.066 N050.04.37.652 E019.47.53.129 Color_186ACI
N050.04.37.652 E019.47.53.129 N050.04.37.641 E019.47.53.233 Color_186ACI
N050.04.37.641 E019.47.53.233 N050.04.37.668 E019.47.53.319 Color_186ACI
N050.04.37.668 E019.47.53.319 N050.04.37.726 E019.47.53.366 Color_186ACI
N050.04.37.726 E019.47.53.366 N050.04.37.786 E019.47.53.355 Color_186ACI
N050.04.37.786 E019.47.53.355 N050.04.37.834 E019.47.53.285 Color_186ACI
N050.04.37.834 E019.47.53.285 N050.04.37.848 E019.47.53.206 Color_186ACI
N050.04.37.848 E019.47.53.206 N050.04.37.834 E019.47.53.125 Color_186ACI
N050.04.37.834 E019.47.53.125 N050.04.37.809 E019.47.53.081 Color_186ACI
N050.04.38.125 E019.47.55.318 N050.04.38.071 E019.47.55.283 Color_186ACI
N050.04.38.071 E019.47.55.283 N050.04.38.007 E019.47.55.303 Color_186ACI
N050.04.38.007 E019.47.55.303 N050.04.37.967 E019.47.55.366 Color_186ACI
N050.04.37.967 E019.47.55.366 N050.04.37.956 E019.47.55.470 Color_186ACI
N050.04.37.956 E019.47.55.470 N050.04.37.984 E019.47.55.557 Color_186ACI
N050.04.37.984 E019.47.55.557 N050.04.38.041 E019.47.55.604 Color_186ACI
N050.04.38.041 E019.47.55.604 N050.04.38.102 E019.47.55.592 Color_186ACI
N050.04.38.102 E019.47.55.592 N050.04.38.150 E019.47.55.523 Color_186ACI
N050.04.38.150 E019.47.55.523 N050.04.38.163 E019.47.55.443 Color_186ACI
N050.04.38.163 E019.47.55.443 N050.04.38.149 E019.47.55.363 Color_186ACI
N050.04.38.149 E019.47.55.363 N050.04.38.125 E019.47.55.318 Color_186ACI
N050.04.37.164 E019.47.55.571 N050.04.37.110 E019.47.55.535 Color_186ACI
N050.04.37.110 E019.47.55.535 N050.04.37.046 E019.47.55.555 Color_186ACI
N050.04.37.046 E019.47.55.555 N050.04.37.006 E019.47.55.619 Color_186ACI
N050.04.37.006 E019.47.55.619 N050.04.36.995 E019.47.55.723 Color_186ACI
N050.04.36.995 E019.47.55.723 N050.04.37.023 E019.47.55.809 Color_186ACI
N050.04.37.023 E019.47.55.809 N050.04.37.080 E019.47.55.856 Color_186ACI
N050.04.37.080 E019.47.55.856 N050.04.37.141 E019.47.55.844 Color_186ACI
N050.04.37.141 E019.47.55.844 N050.04.37.189 E019.47.55.775 Color_186ACI
N050.04.37.189 E019.47.55.775 N050.04.37.202 E019.47.55.696 Color_186ACI
N050.04.37.202 E019.47.55.696 N050.04.37.188 E019.47.55.615 Color_186ACI
N050.04.37.188 E019.47.55.615 N050.04.37.164 E019.47.55.571 Color_186ACI
N050.04.37.087 E019.47.56.224 N050.04.37.033 E019.47.56.188 Color_186ACI
N050.04.37.033 E019.47.56.188 N050.04.36.969 E019.47.56.208 Color_186ACI
N050.04.36.969 E019.47.56.208 N050.04.36.929 E019.47.56.272 Color_186ACI
N050.04.36.929 E019.47.56.272 N050.04.36.918 E019.47.56.376 Color_186ACI
N050.04.36.918 E019.47.56.376 N050.04.36.946 E019.47.56.462 Color_186ACI
N050.04.36.946 E019.47.56.462 N050.04.37.004 E019.47.56.509 Color_186ACI
N050.04.37.004 E019.47.56.509 N050.04.37.064 E019.47.56.498 Color_186ACI
N050.04.37.064 E019.47.56.498 N050.04.37.112 E019.47.56.428 Color_186ACI
N050.04.37.112 E019.47.56.428 N050.04.37.125 E019.47.56.349 Color_186ACI
N050.04.37.125 E019.47.56.349 N050.04.37.111 E019.47.56.268 Color_186ACI
N050.04.37.111 E019.47.56.268 N050.04.37.087 E019.47.56.224 Color_186ACI
N050.04.37.025 E019.47.56.861 N050.04.36.972 E019.47.56.825 Color_186ACI
N050.04.36.972 E019.47.56.825 N050.04.36.907 E019.47.56.846 Color_186ACI
N050.04.36.907 E019.47.56.846 N050.04.36.868 E019.47.56.909 Color_186ACI
N050.04.36.868 E019.47.56.909 N050.04.36.857 E019.47.57.013 Color_186ACI
N050.04.36.857 E019.47.57.013 N050.04.36.884 E019.47.57.099 Color_186ACI
N050.04.36.884 E019.47.57.099 N050.04.36.942 E019.47.57.147 Color_186ACI
N050.04.36.942 E019.47.57.147 N050.04.37.002 E019.47.57.135 Color_186ACI
N050.04.37.002 E019.47.57.135 N050.04.37.050 E019.47.57.066 Color_186ACI
N050.04.37.050 E019.47.57.066 N050.04.37.063 E019.47.56.986 Color_186ACI
N050.04.37.063 E019.47.56.986 N050.04.37.050 E019.47.56.906 Color_186ACI
N050.04.37.050 E019.47.56.906 N050.04.37.025 E019.47.56.861 Color_186ACI
N050.04.36.704 E019.47.57.278 N050.04.36.650 E019.47.57.242 Color_186ACI
N050.04.36.650 E019.47.57.242 N050.04.36.586 E019.47.57.263 Color_186ACI
N050.04.36.586 E019.47.57.263 N050.04.36.546 E019.47.57.326 Color_186ACI
N050.04.36.546 E019.47.57.326 N050.04.36.535 E019.47.57.430 Color_186ACI
N050.04.36.535 E019.47.57.430 N050.04.36.563 E019.47.57.516 Color_186ACI
N050.04.36.563 E019.47.57.516 N050.04.36.620 E019.47.57.564 Color_186ACI
N050.04.36.620 E019.47.57.564 N050.04.36.680 E019.47.57.552 Color_186ACI
N050.04.36.680 E019.47.57.552 N050.04.36.729 E019.47.57.483 Color_186ACI
N050.04.36.729 E019.47.57.483 N050.04.36.742 E019.47.57.403 Color_186ACI
N050.04.36.742 E019.47.57.403 N050.04.36.728 E019.47.57.322 Color_186ACI
N050.04.36.728 E019.47.57.322 N050.04.36.704 E019.47.57.278 Color_186ACI
N050.04.36.373 E019.47.57.685 N050.04.36.320 E019.47.57.650 Color_186ACI
N050.04.36.320 E019.47.57.650 N050.04.36.256 E019.47.57.670 Color_186ACI
N050.04.36.256 E019.47.57.670 N050.04.36.216 E019.47.57.733 Color_186ACI
N050.04.36.216 E019.47.57.733 N050.04.36.205 E019.47.57.837 Color_186ACI
N050.04.36.205 E019.47.57.837 N050.04.36.233 E019.47.57.924 Color_186ACI
N050.04.36.233 E019.47.57.924 N050.04.36.290 E019.47.57.971 Color_186ACI
N050.04.36.290 E019.47.57.971 N050.04.36.350 E019.47.57.959 Color_186ACI
N050.04.36.350 E019.47.57.959 N050.04.36.399 E019.47.57.890 Color_186ACI
N050.04.36.399 E019.47.57.890 N050.04.36.412 E019.47.57.810 Color_186ACI
N050.04.36.412 E019.47.57.810 N050.04.36.398 E019.47.57.730 Color_186ACI
N050.04.36.398 E019.47.57.730 N050.04.36.373 E019.47.57.685 Color_186ACI
N050.04.35.937 E019.47.57.678 N050.04.35.884 E019.47.57.642 Color_186ACI
N050.04.35.884 E019.47.57.642 N050.04.35.820 E019.47.57.663 Color_186ACI
N050.04.35.820 E019.47.57.663 N050.04.35.780 E019.47.57.726 Color_186ACI
N050.04.35.780 E019.47.57.726 N050.04.35.769 E019.47.57.830 Color_186ACI
N050.04.35.769 E019.47.57.830 N050.04.35.797 E019.47.57.916 Color_186ACI
N050.04.35.797 E019.47.57.916 N050.04.35.854 E019.47.57.964 Color_186ACI
N050.04.35.854 E019.47.57.964 N050.04.35.914 E019.47.57.952 Color_186ACI
N050.04.35.914 E019.47.57.952 N050.04.35.963 E019.47.57.883 Color_186ACI
N050.04.35.963 E019.47.57.883 N050.04.35.976 E019.47.57.803 Color_186ACI
N050.04.35.976 E019.47.57.803 N050.04.35.962 E019.47.57.723 Color_186ACI
N050.04.35.962 E019.47.57.723 N050.04.35.937 E019.47.57.678 Color_186ACI
N050.04.35.555 E019.47.57.607 N050.04.35.502 E019.47.57.571 Color_186ACI
N050.04.35.502 E019.47.57.571 N050.04.35.438 E019.47.57.592 Color_186ACI
N050.04.35.438 E019.47.57.592 N050.04.35.398 E019.47.57.655 Color_186ACI
N050.04.35.398 E019.47.57.655 N050.04.35.387 E019.47.57.759 Color_186ACI
N050.04.35.387 E019.47.57.759 N050.04.35.414 E019.47.57.845 Color_186ACI
N050.04.35.414 E019.47.57.845 N050.04.35.472 E019.47.57.892 Color_186ACI
N050.04.35.472 E019.47.57.892 N050.04.35.532 E019.47.57.881 Color_186ACI
N050.04.35.532 E019.47.57.881 N050.04.35.580 E019.47.57.811 Color_186ACI
N050.04.35.580 E019.47.57.811 N050.04.35.594 E019.47.57.732 Color_186ACI
N050.04.35.594 E019.47.57.732 N050.04.35.580 E019.47.57.651 Color_186ACI
N050.04.35.580 E019.47.57.651 N050.04.35.555 E019.47.57.607 Color_186ACI
N050.04.34.413 E019.47.56.845 N050.04.34.359 E019.47.56.809 Color_186ACI
N050.04.34.359 E019.47.56.809 N050.04.34.295 E019.47.56.830 Color_186ACI
N050.04.34.295 E019.47.56.830 N050.04.34.256 E019.47.56.893 Color_186ACI
N050.04.34.256 E019.47.56.893 N050.04.34.244 E019.47.56.997 Color_186ACI
N050.04.34.244 E019.47.56.997 N050.04.34.272 E019.47.57.083 Color_186ACI
N050.04.34.272 E019.47.57.083 N050.04.34.330 E019.47.57.130 Color_186ACI
N050.04.34.330 E019.47.57.130 N050.04.34.390 E019.47.57.119 Color_186ACI
N050.04.34.390 E019.47.57.119 N050.04.34.438 E019.47.57.049 Color_186ACI
N050.04.34.438 E019.47.57.049 N050.04.34.451 E019.47.56.970 Color_186ACI
N050.04.34.451 E019.47.56.970 N050.04.34.437 E019.47.56.889 Color_186ACI
N050.04.34.437 E019.47.56.889 N050.04.34.413 E019.47.56.845 Color_186ACI
N050.04.38.533 E019.47.58.173 N050.04.38.479 E019.47.58.138 Color_186ACI
N050.04.38.479 E019.47.58.138 N050.04.38.415 E019.47.58.158 Color_186ACI
N050.04.38.415 E019.47.58.158 N050.04.38.375 E019.47.58.221 Color_186ACI
N050.04.38.375 E019.47.58.221 N050.04.38.364 E019.47.58.325 Color_186ACI
N050.04.38.364 E019.47.58.325 N050.04.38.392 E019.47.58.412 Color_186ACI
N050.04.38.392 E019.47.58.412 N050.04.38.449 E019.47.58.459 Color_186ACI
N050.04.38.449 E019.47.58.459 N050.04.38.509 E019.47.58.447 Color_186ACI
N050.04.38.509 E019.47.58.447 N050.04.38.558 E019.47.58.378 Color_186ACI
N050.04.38.558 E019.47.58.378 N050.04.38.571 E019.47.58.298 Color_186ACI
N050.04.38.571 E019.47.58.298 N050.04.38.557 E019.47.58.218 Color_186ACI
N050.04.38.557 E019.47.58.218 N050.04.38.533 E019.47.58.173 Color_186ACI
N050.04.38.926 E019.48.01.024 N050.04.38.873 E019.48.00.989 Color_186ACI
N050.04.38.873 E019.48.00.989 N050.04.38.809 E019.48.01.009 Color_186ACI
N050.04.38.809 E019.48.01.009 N050.04.38.769 E019.48.01.072 Color_186ACI
N050.04.38.769 E019.48.01.072 N050.04.38.758 E019.48.01.176 Color_186ACI
N050.04.38.758 E019.48.01.176 N050.04.38.785 E019.48.01.263 Color_186ACI
N050.04.38.785 E019.48.01.263 N050.04.38.843 E019.48.01.310 Color_186ACI
N050.04.38.843 E019.48.01.310 N050.04.38.903 E019.48.01.298 Color_186ACI
N050.04.38.903 E019.48.01.298 N050.04.38.951 E019.48.01.229 Color_186ACI
N050.04.38.951 E019.48.01.229 N050.04.38.965 E019.48.01.149 Color_186ACI
N050.04.38.965 E019.48.01.149 N050.04.38.951 E019.48.01.069 Color_186ACI
N050.04.38.951 E019.48.01.069 N050.04.38.926 E019.48.01.024 Color_186ACI
N050.04.39.339 E019.48.03.937 N050.04.39.286 E019.48.03.902 Color_186ACI
N050.04.39.286 E019.48.03.902 N050.04.39.222 E019.48.03.922 Color_186ACI
N050.04.39.222 E019.48.03.922 N050.04.39.182 E019.48.03.985 Color_186ACI
N050.04.39.182 E019.48.03.985 N050.04.39.171 E019.48.04.089 Color_186ACI
N050.04.39.171 E019.48.04.089 N050.04.39.198 E019.48.04.176 Color_186ACI
N050.04.39.198 E019.48.04.176 N050.04.39.256 E019.48.04.223 Color_186ACI
N050.04.39.256 E019.48.04.223 N050.04.39.316 E019.48.04.211 Color_186ACI
N050.04.39.316 E019.48.04.211 N050.04.39.364 E019.48.04.142 Color_186ACI
N050.04.39.364 E019.48.04.142 N050.04.39.377 E019.48.04.062 Color_186ACI
N050.04.39.377 E019.48.04.062 N050.04.39.364 E019.48.03.982 Color_186ACI
N050.04.39.364 E019.48.03.982 N050.04.39.339 E019.48.03.937 Color_186ACI
N050.04.39.764 E019.48.06.890 N050.04.39.710 E019.48.06.854 Color_186ACI
N050.04.39.710 E019.48.06.854 N050.04.39.646 E019.48.06.874 Color_186ACI
N050.04.39.646 E019.48.06.874 N050.04.39.606 E019.48.06.938 Color_186ACI
N050.04.39.606 E019.48.06.938 N050.04.39.595 E019.48.07.042 Color_186ACI
N050.04.39.595 E019.48.07.042 N050.04.39.623 E019.48.07.128 Color_186ACI
N050.04.39.623 E019.48.07.128 N050.04.39.681 E019.48.07.175 Color_186ACI
N050.04.39.681 E019.48.07.175 N050.04.39.741 E019.48.07.164 Color_186ACI
N050.04.39.741 E019.48.07.164 N050.04.39.789 E019.48.07.094 Color_186ACI
N050.04.39.789 E019.48.07.094 N050.04.39.802 E019.48.07.015 Color_186ACI
N050.04.39.802 E019.48.07.015 N050.04.39.788 E019.48.06.934 Color_186ACI
N050.04.39.788 E019.48.06.934 N050.04.39.764 E019.48.06.890 Color_186ACI
N050.04.40.156 E019.48.09.820 N050.04.40.102 E019.48.09.784 Color_186ACI
N050.04.40.102 E019.48.09.784 N050.04.40.038 E019.48.09.805 Color_186ACI
N050.04.40.038 E019.48.09.805 N050.04.39.998 E019.48.09.868 Color_186ACI
N050.04.39.998 E019.48.09.868 N050.04.39.987 E019.48.09.972 Color_186ACI
N050.04.39.987 E019.48.09.972 N050.04.40.015 E019.48.10.058 Color_186ACI
N050.04.40.015 E019.48.10.058 N050.04.40.072 E019.48.10.105 Color_186ACI
N050.04.40.072 E019.48.10.105 N050.04.40.132 E019.48.10.094 Color_186ACI
N050.04.40.132 E019.48.10.094 N050.04.40.181 E019.48.10.024 Color_186ACI
N050.04.40.181 E019.48.10.024 N050.04.40.194 E019.48.09.945 Color_186ACI
N050.04.40.194 E019.48.09.945 N050.04.40.180 E019.48.09.864 Color_186ACI
N050.04.40.180 E019.48.09.864 N050.04.40.156 E019.48.09.820 Color_186ACI
N050.04.39.196 E019.48.10.212 N050.04.39.142 E019.48.10.177 Color_186ACI
N050.04.39.142 E019.48.10.177 N050.04.39.078 E019.48.10.197 Color_186ACI
N050.04.39.078 E019.48.10.197 N050.04.39.038 E019.48.10.261 Color_186ACI
N050.04.39.038 E019.48.10.261 N050.04.39.027 E019.48.10.365 Color_186ACI
N050.04.39.027 E019.48.10.365 N050.04.39.055 E019.48.10.451 Color_186ACI
N050.04.39.055 E019.48.10.451 N050.04.39.112 E019.48.10.498 Color_186ACI
N050.04.39.112 E019.48.10.498 N050.04.39.172 E019.48.10.486 Color_186ACI
N050.04.39.172 E019.48.10.486 N050.04.39.221 E019.48.10.417 Color_186ACI
N050.04.39.221 E019.48.10.417 N050.04.39.234 E019.48.10.338 Color_186ACI
N050.04.39.234 E019.48.10.338 N050.04.39.220 E019.48.10.257 Color_186ACI
N050.04.39.220 E019.48.10.257 N050.04.39.196 E019.48.10.212 Color_186ACI
N050.04.38.802 E019.48.07.236 N050.04.38.749 E019.48.07.200 Color_186ACI
N050.04.38.749 E019.48.07.200 N050.04.38.685 E019.48.07.221 Color_186ACI
N050.04.38.685 E019.48.07.221 N050.04.38.645 E019.48.07.284 Color_186ACI
N050.04.38.645 E019.48.07.284 N050.04.38.634 E019.48.07.388 Color_186ACI
N050.04.38.634 E019.48.07.388 N050.04.38.662 E019.48.07.474 Color_186ACI
N050.04.38.662 E019.48.07.474 N050.04.38.719 E019.48.07.522 Color_186ACI
N050.04.38.719 E019.48.07.522 N050.04.38.779 E019.48.07.510 Color_186ACI
N050.04.38.779 E019.48.07.510 N050.04.38.828 E019.48.07.441 Color_186ACI
N050.04.38.828 E019.48.07.441 N050.04.38.841 E019.48.07.361 Color_186ACI
N050.04.38.841 E019.48.07.361 N050.04.38.827 E019.48.07.281 Color_186ACI
N050.04.38.827 E019.48.07.281 N050.04.38.802 E019.48.07.236 Color_186ACI
N050.04.38.371 E019.48.04.282 N050.04.38.317 E019.48.04.246 Color_186ACI
N050.04.38.317 E019.48.04.246 N050.04.38.253 E019.48.04.267 Color_186ACI
N050.04.38.253 E019.48.04.267 N050.04.38.213 E019.48.04.330 Color_186ACI
N050.04.38.213 E019.48.04.330 N050.04.38.202 E019.48.04.434 Color_186ACI
N050.04.38.202 E019.48.04.434 N050.04.38.230 E019.48.04.520 Color_186ACI
N050.04.38.230 E019.48.04.520 N050.04.38.287 E019.48.04.568 Color_186ACI
N050.04.38.287 E019.48.04.568 N050.04.38.347 E019.48.04.556 Color_186ACI
N050.04.38.347 E019.48.04.556 N050.04.38.396 E019.48.04.487 Color_186ACI
N050.04.38.396 E019.48.04.487 N050.04.38.409 E019.48.04.407 Color_186ACI
N050.04.38.409 E019.48.04.407 N050.04.38.395 E019.48.04.326 Color_186ACI
N050.04.38.395 E019.48.04.326 N050.04.38.371 E019.48.04.282 Color_186ACI
N050.04.38.027 E019.48.01.849 N050.04.37.973 E019.48.01.814 Color_186ACI
N050.04.37.973 E019.48.01.814 N050.04.37.909 E019.48.01.834 Color_186ACI
N050.04.37.909 E019.48.01.834 N050.04.37.869 E019.48.01.897 Color_186ACI
N050.04.37.869 E019.48.01.897 N050.04.37.858 E019.48.02.001 Color_186ACI
N050.04.37.858 E019.48.02.001 N050.04.37.886 E019.48.02.087 Color_186ACI
N050.04.37.886 E019.48.02.087 N050.04.37.944 E019.48.02.135 Color_186ACI
N050.04.37.944 E019.48.02.135 N050.04.38.004 E019.48.02.123 Color_186ACI
N050.04.38.004 E019.48.02.123 N050.04.38.052 E019.48.02.054 Color_186ACI
N050.04.38.052 E019.48.02.054 N050.04.38.065 E019.48.01.974 Color_186ACI
N050.04.38.065 E019.48.01.974 N050.04.38.051 E019.48.01.894 Color_186ACI
N050.04.38.051 E019.48.01.894 N050.04.38.027 E019.48.01.849 Color_186ACI
N050.04.37.784 E019.48.01.122 N050.04.37.730 E019.48.01.087 Color_186ACI
N050.04.37.730 E019.48.01.087 N050.04.37.666 E019.48.01.107 Color_186ACI
N050.04.37.666 E019.48.01.107 N050.04.37.626 E019.48.01.171 Color_186ACI
N050.04.37.626 E019.48.01.171 N050.04.37.615 E019.48.01.275 Color_186ACI
N050.04.37.615 E019.48.01.275 N050.04.37.643 E019.48.01.361 Color_186ACI
N050.04.37.643 E019.48.01.361 N050.04.37.700 E019.48.01.408 Color_186ACI
N050.04.37.700 E019.48.01.408 N050.04.37.760 E019.48.01.396 Color_186ACI
N050.04.37.760 E019.48.01.396 N050.04.37.809 E019.48.01.327 Color_186ACI
N050.04.37.809 E019.48.01.327 N050.04.37.822 E019.48.01.248 Color_186ACI
N050.04.37.822 E019.48.01.248 N050.04.37.808 E019.48.01.167 Color_186ACI
N050.04.37.808 E019.48.01.167 N050.04.37.784 E019.48.01.122 Color_186ACI
N050.04.37.347 E019.48.00.609 N050.04.37.293 E019.48.00.574 Color_186ACI
N050.04.37.293 E019.48.00.574 N050.04.37.229 E019.48.00.594 Color_186ACI
N050.04.37.229 E019.48.00.594 N050.04.37.189 E019.48.00.658 Color_186ACI
N050.04.37.189 E019.48.00.658 N050.04.37.178 E019.48.00.762 Color_186ACI
N050.04.37.178 E019.48.00.762 N050.04.37.206 E019.48.00.848 Color_186ACI
N050.04.37.206 E019.48.00.848 N050.04.37.264 E019.48.00.895 Color_186ACI
N050.04.37.264 E019.48.00.895 N050.04.37.324 E019.48.00.883 Color_186ACI
N050.04.37.324 E019.48.00.883 N050.04.37.372 E019.48.00.814 Color_186ACI
N050.04.37.372 E019.48.00.814 N050.04.37.385 E019.48.00.735 Color_186ACI
N050.04.37.385 E019.48.00.735 N050.04.37.371 E019.48.00.654 Color_186ACI
N050.04.37.371 E019.48.00.654 N050.04.37.347 E019.48.00.609 Color_186ACI
N050.04.36.344 E019.47.59.910 N050.04.36.291 E019.47.59.875 Color_186ACI
N050.04.36.291 E019.47.59.875 N050.04.36.227 E019.47.59.895 Color_186ACI
N050.04.36.227 E019.47.59.895 N050.04.36.187 E019.47.59.959 Color_186ACI
N050.04.36.187 E019.47.59.959 N050.04.36.176 E019.48.00.063 Color_186ACI
N050.04.36.176 E019.48.00.063 N050.04.36.204 E019.48.00.149 Color_186ACI
N050.04.36.204 E019.48.00.149 N050.04.36.261 E019.48.00.196 Color_186ACI
N050.04.36.261 E019.48.00.196 N050.04.36.321 E019.48.00.184 Color_186ACI
N050.04.36.321 E019.48.00.184 N050.04.36.370 E019.48.00.115 Color_186ACI
N050.04.36.370 E019.48.00.115 N050.04.36.383 E019.48.00.036 Color_186ACI
N050.04.36.383 E019.48.00.036 N050.04.36.369 E019.47.59.955 Color_186ACI
N050.04.36.369 E019.47.59.955 N050.04.36.344 E019.47.59.910 Color_186ACI
N050.04.35.130 E019.47.59.048 N050.04.35.076 E019.47.59.013 Color_186ACI
N050.04.35.076 E019.47.59.013 N050.04.35.012 E019.47.59.033 Color_186ACI
N050.04.35.012 E019.47.59.033 N050.04.34.972 E019.47.59.097 Color_186ACI
N050.04.34.972 E019.47.59.097 N050.04.34.961 E019.47.59.201 Color_186ACI
N050.04.34.961 E019.47.59.201 N050.04.34.989 E019.47.59.287 Color_186ACI
N050.04.34.989 E019.47.59.287 N050.04.35.046 E019.47.59.334 Color_186ACI
N050.04.35.046 E019.47.59.334 N050.04.35.106 E019.47.59.322 Color_186ACI
N050.04.35.106 E019.47.59.322 N050.04.35.155 E019.47.59.253 Color_186ACI
N050.04.35.155 E019.47.59.253 N050.04.35.168 E019.47.59.174 Color_186ACI
N050.04.35.168 E019.47.59.174 N050.04.35.154 E019.47.59.093 Color_186ACI
N050.04.35.154 E019.47.59.093 N050.04.35.130 E019.47.59.048 Color_186ACI
N050.04.34.026 E019.47.58.279 N050.04.33.972 E019.47.58.243 Color_186ACI
N050.04.33.972 E019.47.58.243 N050.04.33.908 E019.47.58.264 Color_186ACI
N050.04.33.908 E019.47.58.264 N050.04.33.869 E019.47.58.327 Color_186ACI
N050.04.33.869 E019.47.58.327 N050.04.33.857 E019.47.58.431 Color_186ACI
N050.04.33.857 E019.47.58.431 N050.04.33.885 E019.47.58.517 Color_186ACI
N050.04.33.885 E019.47.58.517 N050.04.33.943 E019.47.58.565 Color_186ACI
N050.04.33.943 E019.47.58.565 N050.04.34.003 E019.47.58.553 Color_186ACI
N050.04.34.003 E019.47.58.553 N050.04.34.051 E019.47.58.484 Color_186ACI
N050.04.34.051 E019.47.58.484 N050.04.34.064 E019.47.58.404 Color_186ACI
N050.04.34.064 E019.47.58.404 N050.04.34.050 E019.47.58.324 Color_186ACI
N050.04.34.050 E019.47.58.324 N050.04.34.026 E019.47.58.279 Color_186ACI
N050.04.40.422 E019.48.10.431 N050.04.40.368 E019.48.10.395 Color_186ACI
N050.04.40.368 E019.48.10.395 N050.04.40.304 E019.48.10.416 Color_186ACI
N050.04.40.304 E019.48.10.416 N050.04.40.264 E019.48.10.479 Color_186ACI
N050.04.40.264 E019.48.10.479 N050.04.40.253 E019.48.10.583 Color_186ACI
N050.04.40.253 E019.48.10.583 N050.04.40.281 E019.48.10.669 Color_186ACI
N050.04.40.281 E019.48.10.669 N050.04.40.338 E019.48.10.716 Color_186ACI
N050.04.40.338 E019.48.10.716 N050.04.40.399 E019.48.10.705 Color_186ACI
N050.04.40.399 E019.48.10.705 N050.04.40.447 E019.48.10.635 Color_186ACI
N050.04.40.447 E019.48.10.635 N050.04.40.460 E019.48.10.556 Color_186ACI
N050.04.40.460 E019.48.10.556 N050.04.40.446 E019.48.10.475 Color_186ACI
N050.04.40.446 E019.48.10.475 N050.04.40.422 E019.48.10.431 Color_186ACI
N050.04.40.684 E019.48.11.011 N050.04.40.630 E019.48.10.976 Color_186ACI
N050.04.40.630 E019.48.10.976 N050.04.40.566 E019.48.10.996 Color_186ACI
N050.04.40.566 E019.48.10.996 N050.04.40.527 E019.48.11.059 Color_186ACI
N050.04.40.527 E019.48.11.059 N050.04.40.515 E019.48.11.163 Color_186ACI
N050.04.40.515 E019.48.11.163 N050.04.40.543 E019.48.11.250 Color_186ACI
N050.04.40.543 E019.48.11.250 N050.04.40.601 E019.48.11.297 Color_186ACI
N050.04.40.601 E019.48.11.297 N050.04.40.661 E019.48.11.285 Color_186ACI
N050.04.40.661 E019.48.11.285 N050.04.40.709 E019.48.11.216 Color_186ACI
N050.04.40.709 E019.48.11.216 N050.04.40.722 E019.48.11.136 Color_186ACI
N050.04.40.722 E019.48.11.136 N050.04.40.708 E019.48.11.056 Color_186ACI
N050.04.40.708 E019.48.11.056 N050.04.40.684 E019.48.11.011 Color_186ACI
N050.04.41.137 E019.48.11.138 N050.04.41.083 E019.48.11.102 Color_186ACI
N050.04.41.083 E019.48.11.102 N050.04.41.019 E019.48.11.123 Color_186ACI
N050.04.41.019 E019.48.11.123 N050.04.40.979 E019.48.11.186 Color_186ACI
N050.04.40.979 E019.48.11.186 N050.04.40.968 E019.48.11.290 Color_186ACI
N050.04.40.968 E019.48.11.290 N050.04.40.996 E019.48.11.376 Color_186ACI
N050.04.40.996 E019.48.11.376 N050.04.41.053 E019.48.11.424 Color_186ACI
N050.04.41.053 E019.48.11.424 N050.04.41.113 E019.48.11.412 Color_186ACI
N050.04.41.113 E019.48.11.412 N050.04.41.162 E019.48.11.342 Color_186ACI
N050.04.41.162 E019.48.11.342 N050.04.41.175 E019.48.11.263 Color_186ACI
N050.04.41.175 E019.48.11.263 N050.04.41.161 E019.48.11.182 Color_186ACI
N050.04.41.161 E019.48.11.182 N050.04.41.137 E019.48.11.138 Color_186ACI
N050.04.41.598 E019.48.11.246 N050.04.41.545 E019.48.11.211 Color_186ACI
N050.04.41.545 E019.48.11.211 N050.04.41.481 E019.48.11.231 Color_186ACI
N050.04.41.481 E019.48.11.231 N050.04.41.441 E019.48.11.295 Color_186ACI
N050.04.41.441 E019.48.11.295 N050.04.41.430 E019.48.11.399 Color_186ACI
N050.04.41.430 E019.48.11.399 N050.04.41.457 E019.48.11.485 Color_186ACI
N050.04.41.457 E019.48.11.485 N050.04.41.515 E019.48.11.532 Color_186ACI
N050.04.41.515 E019.48.11.532 N050.04.41.575 E019.48.11.520 Color_186ACI
N050.04.41.575 E019.48.11.520 N050.04.41.623 E019.48.11.451 Color_186ACI
N050.04.41.623 E019.48.11.451 N050.04.41.637 E019.48.11.372 Color_186ACI
N050.04.41.637 E019.48.11.372 N050.04.41.623 E019.48.11.291 Color_186ACI
N050.04.41.623 E019.48.11.291 N050.04.41.598 E019.48.11.246 Color_186ACI
N050.04.42.918 E019.48.10.814 N050.04.42.864 E019.48.10.778 Color_186ACI
N050.04.42.864 E019.48.10.778 N050.04.42.800 E019.48.10.799 Color_186ACI
N050.04.42.800 E019.48.10.799 N050.04.42.760 E019.48.10.862 Color_186ACI
N050.04.42.760 E019.48.10.862 N050.04.42.749 E019.48.10.966 Color_186ACI
N050.04.42.749 E019.48.10.966 N050.04.42.777 E019.48.11.052 Color_186ACI
N050.04.42.777 E019.48.11.052 N050.04.42.835 E019.48.11.100 Color_186ACI
N050.04.42.835 E019.48.11.100 N050.04.42.895 E019.48.11.088 Color_186ACI
N050.04.42.895 E019.48.11.088 N050.04.42.943 E019.48.11.019 Color_186ACI
N050.04.42.943 E019.48.11.019 N050.04.42.956 E019.48.10.939 Color_186ACI
N050.04.42.956 E019.48.10.939 N050.04.42.942 E019.48.10.858 Color_186ACI
N050.04.42.942 E019.48.10.858 N050.04.42.918 E019.48.10.814 Color_186ACI
N050.04.44.525 E019.48.10.273 N050.04.44.471 E019.48.10.237 Color_186ACI
N050.04.44.471 E019.48.10.237 N050.04.44.407 E019.48.10.258 Color_186ACI
N050.04.44.407 E019.48.10.258 N050.04.44.368 E019.48.10.321 Color_186ACI
N050.04.44.368 E019.48.10.321 N050.04.44.356 E019.48.10.425 Color_186ACI
N050.04.44.356 E019.48.10.425 N050.04.44.384 E019.48.10.511 Color_186ACI
N050.04.44.384 E019.48.10.511 N050.04.44.442 E019.48.10.559 Color_186ACI
N050.04.44.442 E019.48.10.559 N050.04.44.502 E019.48.10.547 Color_186ACI
N050.04.44.502 E019.48.10.547 N050.04.44.550 E019.48.10.478 Color_186ACI
N050.04.44.550 E019.48.10.478 N050.04.44.563 E019.48.10.398 Color_186ACI
N050.04.44.563 E019.48.10.398 N050.04.44.549 E019.48.10.318 Color_186ACI
N050.04.44.549 E019.48.10.318 N050.04.44.525 E019.48.10.273 Color_186ACI
N050.04.46.082 E019.48.09.758 N050.04.46.028 E019.48.09.722 Color_186ACI
N050.04.46.028 E019.48.09.722 N050.04.45.964 E019.48.09.743 Color_186ACI
N050.04.45.964 E019.48.09.743 N050.04.45.924 E019.48.09.806 Color_186ACI
N050.04.45.924 E019.48.09.806 N050.04.45.913 E019.48.09.910 Color_186ACI
N050.04.45.913 E019.48.09.910 N050.04.45.941 E019.48.09.996 Color_186ACI
N050.04.45.941 E019.48.09.996 N050.04.45.999 E019.48.10.044 Color_186ACI
N050.04.45.999 E019.48.10.044 N050.04.46.059 E019.48.10.032 Color_186ACI
N050.04.46.059 E019.48.10.032 N050.04.46.107 E019.48.09.963 Color_186ACI
N050.04.46.107 E019.48.09.963 N050.04.46.120 E019.48.09.883 Color_186ACI
N050.04.46.120 E019.48.09.883 N050.04.46.106 E019.48.09.803 Color_186ACI
N050.04.46.106 E019.48.09.803 N050.04.46.082 E019.48.09.758 Color_186ACI
N050.04.46.302 E019.48.09.517 N050.04.46.249 E019.48.09.481 Color_186ACI
N050.04.46.249 E019.48.09.481 N050.04.46.185 E019.48.09.502 Color_186ACI
N050.04.46.185 E019.48.09.502 N050.04.46.145 E019.48.09.565 Color_186ACI
N050.04.46.145 E019.48.09.565 N050.04.46.134 E019.48.09.669 Color_186ACI
N050.04.46.134 E019.48.09.669 N050.04.46.161 E019.48.09.755 Color_186ACI
N050.04.46.161 E019.48.09.755 N050.04.46.219 E019.48.09.803 Color_186ACI
N050.04.46.219 E019.48.09.803 N050.04.46.279 E019.48.09.791 Color_186ACI
N050.04.46.279 E019.48.09.791 N050.04.46.327 E019.48.09.722 Color_186ACI
N050.04.46.327 E019.48.09.722 N050.04.46.341 E019.48.09.642 Color_186ACI
N050.04.46.341 E019.48.09.642 N050.04.46.327 E019.48.09.561 Color_186ACI
N050.04.46.327 E019.48.09.561 N050.04.46.302 E019.48.09.517 Color_186ACI
N050.04.46.529 E019.48.09.269 N050.04.46.475 E019.48.09.233 Color_186ACI
N050.04.46.475 E019.48.09.233 N050.04.46.411 E019.48.09.253 Color_186ACI
N050.04.46.411 E019.48.09.253 N050.04.46.371 E019.48.09.317 Color_186ACI
N050.04.46.371 E019.48.09.317 N050.04.46.360 E019.48.09.421 Color_186ACI
N050.04.46.360 E019.48.09.421 N050.04.46.388 E019.48.09.507 Color_186ACI
N050.04.46.388 E019.48.09.507 N050.04.46.445 E019.48.09.554 Color_186ACI
N050.04.46.445 E019.48.09.554 N050.04.46.505 E019.48.09.542 Color_186ACI
N050.04.46.505 E019.48.09.542 N050.04.46.554 E019.48.09.473 Color_186ACI
N050.04.46.554 E019.48.09.473 N050.04.46.567 E019.48.09.394 Color_186ACI
N050.04.46.567 E019.48.09.394 N050.04.46.553 E019.48.09.313 Color_186ACI
N050.04.46.553 E019.48.09.313 N050.04.46.529 E019.48.09.269 Color_186ACI
N050.04.46.762 E019.48.08.970 N050.04.46.709 E019.48.08.935 Color_186ACI
N050.04.46.709 E019.48.08.935 N050.04.46.645 E019.48.08.955 Color_186ACI
N050.04.46.645 E019.48.08.955 N050.04.46.605 E019.48.09.019 Color_186ACI
N050.04.46.605 E019.48.09.019 N050.04.46.594 E019.48.09.123 Color_186ACI
N050.04.46.594 E019.48.09.123 N050.04.46.621 E019.48.09.209 Color_186ACI
N050.04.46.621 E019.48.09.209 N050.04.46.679 E019.48.09.256 Color_186ACI
N050.04.46.679 E019.48.09.256 N050.04.46.739 E019.48.09.244 Color_186ACI
N050.04.46.739 E019.48.09.244 N050.04.46.787 E019.48.09.175 Color_186ACI
N050.04.46.787 E019.48.09.175 N050.04.46.801 E019.48.09.096 Color_186ACI
N050.04.46.801 E019.48.09.096 N050.04.46.787 E019.48.09.015 Color_186ACI
N050.04.46.787 E019.48.09.015 N050.04.46.762 E019.48.08.970 Color_186ACI
N050.04.46.991 E019.48.08.730 N050.04.46.938 E019.48.08.695 Color_186ACI
N050.04.46.938 E019.48.08.695 N050.04.46.874 E019.48.08.715 Color_186ACI
N050.04.46.874 E019.48.08.715 N050.04.46.834 E019.48.08.778 Color_186ACI
N050.04.46.834 E019.48.08.778 N050.04.46.823 E019.48.08.882 Color_186ACI
N050.04.46.823 E019.48.08.882 N050.04.46.850 E019.48.08.969 Color_186ACI
N050.04.46.850 E019.48.08.969 N050.04.46.908 E019.48.09.016 Color_186ACI
N050.04.46.908 E019.48.09.016 N050.04.46.968 E019.48.09.004 Color_186ACI
N050.04.46.968 E019.48.09.004 N050.04.47.016 E019.48.08.935 Color_186ACI
N050.04.47.016 E019.48.08.935 N050.04.47.029 E019.48.08.855 Color_186ACI
N050.04.47.029 E019.48.08.855 N050.04.47.016 E019.48.08.775 Color_186ACI
N050.04.47.016 E019.48.08.775 N050.04.46.991 E019.48.08.730 Color_186ACI
N050.04.47.081 E019.48.08.229 N050.04.47.027 E019.48.08.193 Color_186ACI
N050.04.47.027 E019.48.08.193 N050.04.46.963 E019.48.08.214 Color_186ACI
N050.04.46.963 E019.48.08.214 N050.04.46.923 E019.48.08.277 Color_186ACI
N050.04.46.923 E019.48.08.277 N050.04.46.912 E019.48.08.381 Color_186ACI
N050.04.46.912 E019.48.08.381 N050.04.46.940 E019.48.08.467 Color_186ACI
N050.04.46.940 E019.48.08.467 N050.04.46.997 E019.48.08.514 Color_186ACI
N050.04.46.997 E019.48.08.514 N050.04.47.057 E019.48.08.503 Color_186ACI
N050.04.47.057 E019.48.08.503 N050.04.47.106 E019.48.08.433 Color_186ACI
N050.04.47.106 E019.48.08.433 N050.04.47.119 E019.48.08.354 Color_186ACI
N050.04.47.119 E019.48.08.354 N050.04.47.105 E019.48.08.273 Color_186ACI
N050.04.47.105 E019.48.08.273 N050.04.47.081 E019.48.08.229 Color_186ACI
N050.04.47.193 E019.48.07.306 N050.04.47.140 E019.48.07.271 Color_186ACI
N050.04.47.140 E019.48.07.271 N050.04.47.075 E019.48.07.291 Color_186ACI
N050.04.47.075 E019.48.07.291 N050.04.47.036 E019.48.07.355 Color_186ACI
N050.04.47.036 E019.48.07.355 N050.04.47.025 E019.48.07.459 Color_186ACI
N050.04.47.025 E019.48.07.459 N050.04.47.052 E019.48.07.545 Color_186ACI
N050.04.47.052 E019.48.07.545 N050.04.47.110 E019.48.07.592 Color_186ACI
N050.04.47.110 E019.48.07.592 N050.04.47.170 E019.48.07.580 Color_186ACI
N050.04.47.170 E019.48.07.580 N050.04.47.218 E019.48.07.511 Color_186ACI
N050.04.47.218 E019.48.07.511 N050.04.47.231 E019.48.07.432 Color_186ACI
N050.04.47.231 E019.48.07.432 N050.04.47.218 E019.48.07.351 Color_186ACI
N050.04.47.218 E019.48.07.351 N050.04.47.193 E019.48.07.306 Color_186ACI
N050.04.47.436 E019.48.10.848 N050.04.47.382 E019.48.10.813 Color_186ACI
N050.04.47.382 E019.48.10.813 N050.04.47.318 E019.48.10.833 Color_186ACI
N050.04.47.318 E019.48.10.833 N050.04.47.278 E019.48.10.897 Color_186ACI
N050.04.47.278 E019.48.10.897 N050.04.47.267 E019.48.11.001 Color_186ACI
N050.04.47.267 E019.48.11.001 N050.04.47.295 E019.48.11.087 Color_186ACI
N050.04.47.295 E019.48.11.087 N050.04.47.352 E019.48.11.134 Color_186ACI
N050.04.47.352 E019.48.11.134 N050.04.47.413 E019.48.11.122 Color_186ACI
N050.04.47.413 E019.48.11.122 N050.04.47.461 E019.48.11.053 Color_186ACI
N050.04.47.461 E019.48.11.053 N050.04.47.474 E019.48.10.974 Color_186ACI
N050.04.47.474 E019.48.10.974 N050.04.47.460 E019.48.10.893 Color_186ACI
N050.04.47.460 E019.48.10.893 N050.04.47.436 E019.48.10.848 Color_186ACI
N050.04.46.290 E019.48.11.239 N050.04.46.237 E019.48.11.203 Color_186ACI
N050.04.46.237 E019.48.11.203 N050.04.46.173 E019.48.11.224 Color_186ACI
N050.04.46.173 E019.48.11.224 N050.04.46.133 E019.48.11.287 Color_186ACI
N050.04.46.133 E019.48.11.287 N050.04.46.122 E019.48.11.391 Color_186ACI
N050.04.46.122 E019.48.11.391 N050.04.46.149 E019.48.11.477 Color_186ACI
N050.04.46.149 E019.48.11.477 N050.04.46.207 E019.48.11.524 Color_186ACI
N050.04.46.207 E019.48.11.524 N050.04.46.267 E019.48.11.513 Color_186ACI
N050.04.46.267 E019.48.11.513 N050.04.46.315 E019.48.11.443 Color_186ACI
N050.04.46.315 E019.48.11.443 N050.04.46.329 E019.48.11.364 Color_186ACI
N050.04.46.329 E019.48.11.364 N050.04.46.315 E019.48.11.283 Color_186ACI
N050.04.46.315 E019.48.11.283 N050.04.46.290 E019.48.11.239 Color_186ACI
N050.04.44.745 E019.48.11.767 N050.04.44.692 E019.48.11.732 Color_186ACI
N050.04.44.692 E019.48.11.732 N050.04.44.628 E019.48.11.752 Color_186ACI
N050.04.44.628 E019.48.11.752 N050.04.44.588 E019.48.11.816 Color_186ACI
N050.04.44.588 E019.48.11.816 N050.04.44.577 E019.48.11.920 Color_186ACI
N050.04.44.577 E019.48.11.920 N050.04.44.604 E019.48.12.006 Color_186ACI
N050.04.44.604 E019.48.12.006 N050.04.44.662 E019.48.12.053 Color_186ACI
N050.04.44.662 E019.48.12.053 N050.04.44.722 E019.48.12.041 Color_186ACI
N050.04.44.722 E019.48.12.041 N050.04.44.770 E019.48.11.972 Color_186ACI
N050.04.44.770 E019.48.11.972 N050.04.44.784 E019.48.11.893 Color_186ACI
N050.04.44.784 E019.48.11.893 N050.04.44.770 E019.48.11.812 Color_186ACI
N050.04.44.770 E019.48.11.812 N050.04.44.745 E019.48.11.767 Color_186ACI
N050.04.43.137 E019.48.12.315 N050.04.43.084 E019.48.12.280 Color_186ACI
N050.04.43.084 E019.48.12.280 N050.04.43.019 E019.48.12.300 Color_186ACI
N050.04.43.019 E019.48.12.300 N050.04.42.980 E019.48.12.363 Color_186ACI
N050.04.42.980 E019.48.12.363 N050.04.42.969 E019.48.12.467 Color_186ACI
N050.04.42.969 E019.48.12.467 N050.04.42.996 E019.48.12.554 Color_186ACI
N050.04.42.996 E019.48.12.554 N050.04.43.054 E019.48.12.601 Color_186ACI
N050.04.43.054 E019.48.12.601 N050.04.43.114 E019.48.12.589 Color_186ACI
N050.04.43.114 E019.48.12.589 N050.04.43.162 E019.48.12.520 Color_186ACI
N050.04.43.162 E019.48.12.520 N050.04.43.175 E019.48.12.440 Color_186ACI
N050.04.43.175 E019.48.12.440 N050.04.43.162 E019.48.12.360 Color_186ACI
N050.04.43.162 E019.48.12.360 N050.04.43.137 E019.48.12.315 Color_186ACI
N050.04.41.764 E019.48.12.839 N050.04.41.710 E019.48.12.804 Color_186ACI
N050.04.41.710 E019.48.12.804 N050.04.41.646 E019.48.12.824 Color_186ACI
N050.04.41.646 E019.48.12.824 N050.04.41.606 E019.48.12.887 Color_186ACI
N050.04.41.606 E019.48.12.887 N050.04.41.595 E019.48.12.991 Color_186ACI
N050.04.41.595 E019.48.12.991 N050.04.41.623 E019.48.13.078 Color_186ACI
N050.04.41.623 E019.48.13.078 N050.04.41.680 E019.48.13.125 Color_186ACI
N050.04.41.680 E019.48.13.125 N050.04.41.740 E019.48.13.113 Color_186ACI
N050.04.41.740 E019.48.13.113 N050.04.41.789 E019.48.13.044 Color_186ACI
N050.04.41.789 E019.48.13.044 N050.04.41.802 E019.48.12.964 Color_186ACI
N050.04.41.802 E019.48.12.964 N050.04.41.788 E019.48.12.884 Color_186ACI
N050.04.41.788 E019.48.12.884 N050.04.41.764 E019.48.12.839 Color_186ACI
N050.04.40.928 E019.48.13.072 N050.04.40.874 E019.48.13.037 Color_186ACI
N050.04.40.874 E019.48.13.037 N050.04.40.810 E019.48.13.057 Color_186ACI
N050.04.40.810 E019.48.13.057 N050.04.40.770 E019.48.13.121 Color_186ACI
N050.04.40.770 E019.48.13.121 N050.04.40.759 E019.48.13.225 Color_186ACI
N050.04.40.759 E019.48.13.225 N050.04.40.787 E019.48.13.311 Color_186ACI
N050.04.40.787 E019.48.13.311 N050.04.40.845 E019.48.13.358 Color_186ACI
N050.04.40.845 E019.48.13.358 N050.04.40.905 E019.48.13.346 Color_186ACI
N050.04.40.905 E019.48.13.346 N050.04.40.953 E019.48.13.277 Color_186ACI
N050.04.40.953 E019.48.13.277 N050.04.40.966 E019.48.13.198 Color_186ACI
N050.04.40.966 E019.48.13.198 N050.04.40.952 E019.48.13.117 Color_186ACI
N050.04.40.952 E019.48.13.117 N050.04.40.928 E019.48.13.072 Color_186ACI
N050.04.40.126 E019.48.13.331 N050.04.40.072 E019.48.13.295 Color_186ACI
N050.04.40.072 E019.48.13.295 N050.04.40.008 E019.48.13.315 Color_186ACI
N050.04.40.008 E019.48.13.315 N050.04.39.968 E019.48.13.379 Color_186ACI
N050.04.39.968 E019.48.13.379 N050.04.39.957 E019.48.13.483 Color_186ACI
N050.04.39.957 E019.48.13.483 N050.04.39.985 E019.48.13.569 Color_186ACI
N050.04.39.985 E019.48.13.569 N050.04.40.042 E019.48.13.616 Color_186ACI
N050.04.40.042 E019.48.13.616 N050.04.40.102 E019.48.13.605 Color_186ACI
N050.04.40.102 E019.48.13.605 N050.04.40.151 E019.48.13.535 Color_186ACI
N050.04.40.151 E019.48.13.535 N050.04.40.164 E019.48.13.456 Color_186ACI
N050.04.40.164 E019.48.13.456 N050.04.40.150 E019.48.13.375 Color_186ACI
N050.04.40.150 E019.48.13.375 N050.04.40.126 E019.48.13.331 Color_186ACI
N050.04.39.398 E019.48.13.441 N050.04.39.344 E019.48.13.406 Color_186ACI
N050.04.39.344 E019.48.13.406 N050.04.39.280 E019.48.13.426 Color_186ACI
N050.04.39.280 E019.48.13.426 N050.04.39.240 E019.48.13.489 Color_186ACI
N050.04.39.240 E019.48.13.489 N050.04.39.229 E019.48.13.593 Color_186ACI
N050.04.39.229 E019.48.13.593 N050.04.39.257 E019.48.13.680 Color_186ACI
N050.04.39.257 E019.48.13.680 N050.04.39.315 E019.48.13.727 Color_186ACI
N050.04.39.315 E019.48.13.727 N050.04.39.375 E019.48.13.715 Color_186ACI
N050.04.39.375 E019.48.13.715 N050.04.39.423 E019.48.13.646 Color_186ACI
N050.04.39.423 E019.48.13.646 N050.04.39.436 E019.48.13.566 Color_186ACI
N050.04.39.436 E019.48.13.566 N050.04.39.422 E019.48.13.486 Color_186ACI
N050.04.39.422 E019.48.13.486 N050.04.39.398 E019.48.13.441 Color_186ACI
N050.04.38.486 E019.48.12.074 N050.04.38.432 E019.48.12.039 Color_186ACI
N050.04.38.432 E019.48.12.039 N050.04.38.368 E019.48.12.059 Color_186ACI
N050.04.38.368 E019.48.12.059 N050.04.38.328 E019.48.12.123 Color_186ACI
N050.04.38.328 E019.48.12.123 N050.04.38.317 E019.48.12.227 Color_186ACI
N050.04.38.317 E019.48.12.227 N050.04.38.345 E019.48.12.313 Color_186ACI
N050.04.38.345 E019.48.12.313 N050.04.38.402 E019.48.12.360 Color_186ACI
N050.04.38.402 E019.48.12.360 N050.04.38.462 E019.48.12.348 Color_186ACI
N050.04.38.462 E019.48.12.348 N050.04.38.511 E019.48.12.279 Color_186ACI
N050.04.38.511 E019.48.12.279 N050.04.38.524 E019.48.12.200 Color_186ACI
N050.04.38.524 E019.48.12.200 N050.04.38.510 E019.48.12.119 Color_186ACI
N050.04.38.510 E019.48.12.119 N050.04.38.486 E019.48.12.074 Color_186ACI
N050.04.38.853 E019.48.11.907 N050.04.38.800 E019.48.11.872 Color_186ACI
N050.04.38.800 E019.48.11.872 N050.04.38.736 E019.48.11.892 Color_186ACI
N050.04.38.736 E019.48.11.892 N050.04.38.696 E019.48.11.956 Color_186ACI
N050.04.38.696 E019.48.11.956 N050.04.38.685 E019.48.12.060 Color_186ACI
N050.04.38.685 E019.48.12.060 N050.04.38.712 E019.48.12.146 Color_186ACI
N050.04.38.712 E019.48.12.146 N050.04.38.770 E019.48.12.193 Color_186ACI
N050.04.38.770 E019.48.12.193 N050.04.38.830 E019.48.12.181 Color_186ACI
N050.04.38.830 E019.48.12.181 N050.04.38.878 E019.48.12.112 Color_186ACI
N050.04.38.878 E019.48.12.112 N050.04.38.892 E019.48.12.033 Color_186ACI
N050.04.38.892 E019.48.12.033 N050.04.38.878 E019.48.11.952 Color_186ACI
N050.04.38.878 E019.48.11.952 N050.04.38.853 E019.48.11.907 Color_186ACI
N050.04.39.072 E019.48.11.585 N050.04.39.019 E019.48.11.549 Color_186ACI
N050.04.39.019 E019.48.11.549 N050.04.38.955 E019.48.11.570 Color_186ACI
N050.04.38.955 E019.48.11.570 N050.04.38.915 E019.48.11.633 Color_186ACI
N050.04.38.915 E019.48.11.633 N050.04.38.904 E019.48.11.737 Color_186ACI
N050.04.38.904 E019.48.11.737 N050.04.38.931 E019.48.11.823 Color_186ACI
N050.04.38.931 E019.48.11.823 N050.04.38.989 E019.48.11.871 Color_186ACI
N050.04.38.989 E019.48.11.871 N050.04.39.049 E019.48.11.859 Color_186ACI
N050.04.39.049 E019.48.11.859 N050.04.39.097 E019.48.11.790 Color_186ACI
N050.04.39.097 E019.48.11.790 N050.04.39.111 E019.48.11.710 Color_186ACI
N050.04.39.111 E019.48.11.710 N050.04.39.097 E019.48.11.629 Color_186ACI
N050.04.39.097 E019.48.11.629 N050.04.39.072 E019.48.11.585 Color_186ACI
N050.04.39.169 E019.48.11.113 N050.04.39.115 E019.48.11.078 Color_186ACI
N050.04.39.115 E019.48.11.078 N050.04.39.051 E019.48.11.098 Color_186ACI
N050.04.39.051 E019.48.11.098 N050.04.39.011 E019.48.11.162 Color_186ACI
N050.04.39.011 E019.48.11.162 N050.04.39.000 E019.48.11.266 Color_186ACI
N050.04.39.000 E019.48.11.266 N050.04.39.028 E019.48.11.352 Color_186ACI
N050.04.39.028 E019.48.11.352 N050.04.39.085 E019.48.11.399 Color_186ACI
N050.04.39.085 E019.48.11.399 N050.04.39.145 E019.48.11.387 Color_186ACI
N050.04.39.145 E019.48.11.387 N050.04.39.194 E019.48.11.318 Color_186ACI
N050.04.39.194 E019.48.11.318 N050.04.39.207 E019.48.11.239 Color_186ACI
N050.04.39.207 E019.48.11.239 N050.04.39.193 E019.48.11.158 Color_186ACI
N050.04.39.193 E019.48.11.158 N050.04.39.169 E019.48.11.113 Color_186ACI
N050.04.47.133 E019.48.07.780 N050.04.47.080 E019.48.07.745 Color_186ACI
N050.04.47.080 E019.48.07.745 N050.04.47.016 E019.48.07.765 Color_186ACI
N050.04.47.016 E019.48.07.765 N050.04.46.976 E019.48.07.828 Color_186ACI
N050.04.46.976 E019.48.07.828 N050.04.46.965 E019.48.07.932 Color_186ACI
N050.04.46.965 E019.48.07.932 N050.04.46.992 E019.48.08.019 Color_186ACI
N050.04.46.992 E019.48.08.019 N050.04.47.050 E019.48.08.066 Color_186ACI
N050.04.47.050 E019.48.08.066 N050.04.47.110 E019.48.08.054 Color_186ACI
N050.04.47.110 E019.48.08.054 N050.04.47.158 E019.48.07.985 Color_186ACI
N050.04.47.158 E019.48.07.985 N050.04.47.172 E019.48.07.905 Color_186ACI
N050.04.47.172 E019.48.07.905 N050.04.47.158 E019.48.07.825 Color_186ACI
N050.04.47.158 E019.48.07.825 N050.04.47.133 E019.48.07.780 Color_186ACI
N050.04.38.708 E019.48.13.627 N050.04.38.654 E019.48.13.592 Color_186ACI
N050.04.38.654 E019.48.13.592 N050.04.38.590 E019.48.13.612 Color_186ACI
N050.04.38.590 E019.48.13.612 N050.04.38.550 E019.48.13.675 Color_186ACI
N050.04.38.550 E019.48.13.675 N050.04.38.539 E019.48.13.779 Color_186ACI
N050.04.38.539 E019.48.13.779 N050.04.38.567 E019.48.13.866 Color_186ACI
N050.04.38.567 E019.48.13.866 N050.04.38.624 E019.48.13.913 Color_186ACI
N050.04.38.624 E019.48.13.913 N050.04.38.684 E019.48.13.901 Color_186ACI
N050.04.38.684 E019.48.13.901 N050.04.38.733 E019.48.13.832 Color_186ACI
N050.04.38.733 E019.48.13.832 N050.04.38.746 E019.48.13.752 Color_186ACI
N050.04.38.746 E019.48.13.752 N050.04.38.732 E019.48.13.672 Color_186ACI
N050.04.38.732 E019.48.13.672 N050.04.38.708 E019.48.13.627 Color_186ACI
N050.04.36.800 E019.48.14.291 N050.04.36.747 E019.48.14.256 Color_186ACI
N050.04.36.747 E019.48.14.256 N050.04.36.683 E019.48.14.276 Color_186ACI
N050.04.36.683 E019.48.14.276 N050.04.36.643 E019.48.14.340 Color_186ACI
N050.04.36.643 E019.48.14.340 N050.04.36.632 E019.48.14.444 Color_186ACI
N050.04.36.632 E019.48.14.444 N050.04.36.659 E019.48.14.530 Color_186ACI
N050.04.36.659 E019.48.14.530 N050.04.36.717 E019.48.14.577 Color_186ACI
N050.04.36.717 E019.48.14.577 N050.04.36.777 E019.48.14.565 Color_186ACI
N050.04.36.777 E019.48.14.565 N050.04.36.825 E019.48.14.496 Color_186ACI
N050.04.36.825 E019.48.14.496 N050.04.36.839 E019.48.14.417 Color_186ACI
N050.04.36.839 E019.48.14.417 N050.04.36.825 E019.48.14.336 Color_186ACI
N050.04.36.825 E019.48.14.336 N050.04.36.800 E019.48.14.291 Color_186ACI
N050.04.34.913 E019.48.14.907 N050.04.34.859 E019.48.14.871 Color_186ACI
N050.04.34.859 E019.48.14.871 N050.04.34.795 E019.48.14.892 Color_186ACI
N050.04.34.795 E019.48.14.892 N050.04.34.755 E019.48.14.955 Color_186ACI
N050.04.34.755 E019.48.14.955 N050.04.34.744 E019.48.15.059 Color_186ACI
N050.04.34.744 E019.48.15.059 N050.04.34.772 E019.48.15.145 Color_186ACI
N050.04.34.772 E019.48.15.145 N050.04.34.829 E019.48.15.193 Color_186ACI
N050.04.34.829 E019.48.15.193 N050.04.34.890 E019.48.15.181 Color_186ACI
N050.04.34.890 E019.48.15.181 N050.04.34.938 E019.48.15.112 Color_186ACI
N050.04.34.938 E019.48.15.112 N050.04.34.951 E019.48.15.032 Color_186ACI
N050.04.34.951 E019.48.15.032 N050.04.34.937 E019.48.14.951 Color_186ACI
N050.04.34.937 E019.48.14.951 N050.04.34.913 E019.48.14.907 Color_186ACI
N050.04.33.019 E019.48.15.567 N050.04.32.965 E019.48.15.531 Color_186ACI
N050.04.32.965 E019.48.15.531 N050.04.32.901 E019.48.15.552 Color_186ACI
N050.04.32.901 E019.48.15.552 N050.04.32.862 E019.48.15.615 Color_186ACI
N050.04.32.862 E019.48.15.615 N050.04.32.850 E019.48.15.719 Color_186ACI
N050.04.32.850 E019.48.15.719 N050.04.32.878 E019.48.15.805 Color_186ACI
N050.04.32.878 E019.48.15.805 N050.04.32.936 E019.48.15.853 Color_186ACI
N050.04.32.936 E019.48.15.853 N050.04.32.996 E019.48.15.841 Color_186ACI
N050.04.32.996 E019.48.15.841 N050.04.33.044 E019.48.15.772 Color_186ACI
N050.04.33.044 E019.48.15.772 N050.04.33.057 E019.48.15.692 Color_186ACI
N050.04.33.057 E019.48.15.692 N050.04.33.043 E019.48.15.611 Color_186ACI
N050.04.33.043 E019.48.15.611 N050.04.33.019 E019.48.15.567 Color_186ACI
N050.04.32.561 E019.48.15.721 N050.04.32.508 E019.48.15.686 Color_186ACI
N050.04.32.508 E019.48.15.686 N050.04.32.444 E019.48.15.706 Color_186ACI
N050.04.32.444 E019.48.15.706 N050.04.32.404 E019.48.15.770 Color_186ACI
N050.04.32.404 E019.48.15.770 N050.04.32.393 E019.48.15.874 Color_186ACI
N050.04.32.393 E019.48.15.874 N050.04.32.420 E019.48.15.960 Color_186ACI
N050.04.32.420 E019.48.15.960 N050.04.32.478 E019.48.16.007 Color_186ACI
N050.04.32.478 E019.48.16.007 N050.04.32.538 E019.48.15.995 Color_186ACI
N050.04.32.538 E019.48.15.995 N050.04.32.586 E019.48.15.926 Color_186ACI
N050.04.32.586 E019.48.15.926 N050.04.32.600 E019.48.15.847 Color_186ACI
N050.04.32.600 E019.48.15.847 N050.04.32.586 E019.48.15.766 Color_186ACI
N050.04.32.586 E019.48.15.766 N050.04.32.561 E019.48.15.721 Color_186ACI
N050.04.32.160 E019.48.15.798 N050.04.32.107 E019.48.15.763 Color_186ACI
N050.04.32.107 E019.48.15.763 N050.04.32.043 E019.48.15.783 Color_186ACI
N050.04.32.043 E019.48.15.783 N050.04.32.003 E019.48.15.847 Color_186ACI
N050.04.32.003 E019.48.15.847 N050.04.31.992 E019.48.15.951 Color_186ACI
N050.04.31.992 E019.48.15.951 N050.04.32.019 E019.48.16.037 Color_186ACI
N050.04.32.019 E019.48.16.037 N050.04.32.077 E019.48.16.084 Color_186ACI
N050.04.32.077 E019.48.16.084 N050.04.32.137 E019.48.16.072 Color_186ACI
N050.04.32.137 E019.48.16.072 N050.04.32.185 E019.48.16.003 Color_186ACI
N050.04.32.185 E019.48.16.003 N050.04.32.199 E019.48.15.924 Color_186ACI
N050.04.32.199 E019.48.15.924 N050.04.32.185 E019.48.15.843 Color_186ACI
N050.04.32.185 E019.48.15.843 N050.04.32.160 E019.48.15.798 Color_186ACI
N050.04.31.719 E019.48.15.679 N050.04.31.665 E019.48.15.644 Color_186ACI
N050.04.31.665 E019.48.15.644 N050.04.31.601 E019.48.15.664 Color_186ACI
N050.04.31.601 E019.48.15.664 N050.04.31.561 E019.48.15.727 Color_186ACI
N050.04.31.561 E019.48.15.727 N050.04.31.550 E019.48.15.831 Color_186ACI
N050.04.31.550 E019.48.15.831 N050.04.31.578 E019.48.15.918 Color_186ACI
N050.04.31.578 E019.48.15.918 N050.04.31.635 E019.48.15.965 Color_186ACI
N050.04.31.635 E019.48.15.965 N050.04.31.696 E019.48.15.953 Color_186ACI
N050.04.31.696 E019.48.15.953 N050.04.31.744 E019.48.15.884 Color_186ACI
N050.04.31.744 E019.48.15.884 N050.04.31.757 E019.48.15.804 Color_186ACI
N050.04.31.757 E019.48.15.804 N050.04.31.743 E019.48.15.724 Color_186ACI
N050.04.31.743 E019.48.15.724 N050.04.31.719 E019.48.15.679 Color_186ACI
N050.04.31.192 E019.48.15.437 N050.04.31.138 E019.48.15.401 Color_186ACI
N050.04.31.138 E019.48.15.401 N050.04.31.074 E019.48.15.422 Color_186ACI
N050.04.31.074 E019.48.15.422 N050.04.31.034 E019.48.15.485 Color_186ACI
N050.04.31.034 E019.48.15.485 N050.04.31.023 E019.48.15.589 Color_186ACI
N050.04.31.023 E019.48.15.589 N050.04.31.051 E019.48.15.675 Color_186ACI
N050.04.31.051 E019.48.15.675 N050.04.31.109 E019.48.15.723 Color_186ACI
N050.04.31.109 E019.48.15.723 N050.04.31.169 E019.48.15.711 Color_186ACI
N050.04.31.169 E019.48.15.711 N050.04.31.217 E019.48.15.642 Color_186ACI
N050.04.31.217 E019.48.15.642 N050.04.31.230 E019.48.15.562 Color_186ACI
N050.04.31.230 E019.48.15.562 N050.04.31.216 E019.48.15.482 Color_186ACI
N050.04.31.216 E019.48.15.482 N050.04.31.192 E019.48.15.437 Color_186ACI
N050.04.30.692 E019.48.15.217 N050.04.30.638 E019.48.15.181 Color_186ACI
N050.04.30.638 E019.48.15.181 N050.04.30.574 E019.48.15.201 Color_186ACI
N050.04.30.574 E019.48.15.201 N050.04.30.534 E019.48.15.265 Color_186ACI
N050.04.30.534 E019.48.15.265 N050.04.30.523 E019.48.15.369 Color_186ACI
N050.04.30.523 E019.48.15.369 N050.04.30.551 E019.48.15.455 Color_186ACI
N050.04.30.551 E019.48.15.455 N050.04.30.608 E019.48.15.502 Color_186ACI
N050.04.30.608 E019.48.15.502 N050.04.30.668 E019.48.15.490 Color_186ACI
N050.04.30.668 E019.48.15.490 N050.04.30.717 E019.48.15.421 Color_186ACI
N050.04.30.717 E019.48.15.421 N050.04.30.730 E019.48.15.342 Color_186ACI
N050.04.30.730 E019.48.15.342 N050.04.30.716 E019.48.15.261 Color_186ACI
N050.04.30.716 E019.48.15.261 N050.04.30.692 E019.48.15.217 Color_186ACI
N050.04.30.575 E019.48.15.916 N050.04.30.521 E019.48.15.881 Color_186ACI
N050.04.30.521 E019.48.15.881 N050.04.30.457 E019.48.15.901 Color_186ACI
N050.04.30.457 E019.48.15.901 N050.04.30.417 E019.48.15.964 Color_186ACI
N050.04.30.417 E019.48.15.964 N050.04.30.406 E019.48.16.069 Color_186ACI
N050.04.30.406 E019.48.16.069 N050.04.30.434 E019.48.16.155 Color_186ACI
N050.04.30.434 E019.48.16.155 N050.04.30.491 E019.48.16.202 Color_186ACI
N050.04.30.491 E019.48.16.202 N050.04.30.551 E019.48.16.190 Color_186ACI
N050.04.30.551 E019.48.16.190 N050.04.30.600 E019.48.16.121 Color_186ACI
N050.04.30.600 E019.48.16.121 N050.04.30.613 E019.48.16.042 Color_186ACI
N050.04.30.613 E019.48.16.042 N050.04.30.599 E019.48.15.961 Color_186ACI
N050.04.30.599 E019.48.15.961 N050.04.30.575 E019.48.15.916 Color_186ACI
N050.04.30.451 E019.48.16.565 N050.04.30.397 E019.48.16.530 Color_186ACI
N050.04.30.397 E019.48.16.530 N050.04.30.333 E019.48.16.550 Color_186ACI
N050.04.30.333 E019.48.16.550 N050.04.30.293 E019.48.16.614 Color_186ACI
N050.04.30.293 E019.48.16.614 N050.04.30.282 E019.48.16.718 Color_186ACI
N050.04.30.282 E019.48.16.718 N050.04.30.310 E019.48.16.804 Color_186ACI
N050.04.30.310 E019.48.16.804 N050.04.30.367 E019.48.16.851 Color_186ACI
N050.04.30.367 E019.48.16.851 N050.04.30.427 E019.48.16.839 Color_186ACI
N050.04.30.427 E019.48.16.839 N050.04.30.476 E019.48.16.770 Color_186ACI
N050.04.30.476 E019.48.16.770 N050.04.30.489 E019.48.16.691 Color_186ACI
N050.04.30.489 E019.48.16.691 N050.04.30.475 E019.48.16.610 Color_186ACI
N050.04.30.475 E019.48.16.610 N050.04.30.451 E019.48.16.565 Color_186ACI
N050.04.30.150 E019.48.17.992 N050.04.30.097 E019.48.17.956 Color_186ACI
N050.04.30.097 E019.48.17.956 N050.04.30.033 E019.48.17.976 Color_186ACI
N050.04.30.033 E019.48.17.976 N050.04.29.993 E019.48.18.040 Color_186ACI
N050.04.29.993 E019.48.18.040 N050.04.29.982 E019.48.18.144 Color_186ACI
N050.04.29.982 E019.48.18.144 N050.04.30.009 E019.48.18.230 Color_186ACI
N050.04.30.009 E019.48.18.230 N050.04.30.067 E019.48.18.277 Color_186ACI
N050.04.30.067 E019.48.18.277 N050.04.30.127 E019.48.18.265 Color_186ACI
N050.04.30.127 E019.48.18.265 N050.04.30.175 E019.48.18.196 Color_186ACI
N050.04.30.175 E019.48.18.196 N050.04.30.189 E019.48.18.117 Color_186ACI
N050.04.30.189 E019.48.18.117 N050.04.30.175 E019.48.18.036 Color_186ACI
N050.04.30.175 E019.48.18.036 N050.04.30.150 E019.48.17.992 Color_186ACI
N050.04.33.790 E019.47.24.185 N050.04.33.736 E019.47.24.149 Color_186ACI
N050.04.33.736 E019.47.24.149 N050.04.33.672 E019.47.24.170 Color_186ACI
N050.04.33.672 E019.47.24.170 N050.04.33.632 E019.47.24.233 Color_186ACI
N050.04.33.632 E019.47.24.233 N050.04.33.621 E019.47.24.337 Color_186ACI
N050.04.33.621 E019.47.24.337 N050.04.33.649 E019.47.24.423 Color_186ACI
N050.04.33.649 E019.47.24.423 N050.04.33.706 E019.47.24.471 Color_186ACI
N050.04.33.706 E019.47.24.471 N050.04.33.766 E019.47.24.459 Color_186ACI
N050.04.33.766 E019.47.24.459 N050.04.33.815 E019.47.24.390 Color_186ACI
N050.04.33.815 E019.47.24.390 N050.04.33.828 E019.47.24.310 Color_186ACI
N050.04.33.828 E019.47.24.310 N050.04.33.814 E019.47.24.229 Color_186ACI
N050.04.33.814 E019.47.24.229 N050.04.33.790 E019.47.24.185 Color_186ACI
N050.04.33.401 E019.47.21.334 N050.04.33.347 E019.47.21.298 Color_186ACI
N050.04.33.347 E019.47.21.298 N050.04.33.283 E019.47.21.318 Color_186ACI
N050.04.33.283 E019.47.21.318 N050.04.33.243 E019.47.21.382 Color_186ACI
N050.04.33.243 E019.47.21.382 N050.04.33.232 E019.47.21.486 Color_186ACI
N050.04.33.232 E019.47.21.486 N050.04.33.260 E019.47.21.572 Color_186ACI
N050.04.33.260 E019.47.21.572 N050.04.33.317 E019.47.21.619 Color_186ACI
N050.04.33.317 E019.47.21.619 N050.04.33.377 E019.47.21.608 Color_186ACI
N050.04.33.377 E019.47.21.608 N050.04.33.426 E019.47.21.538 Color_186ACI
N050.04.33.426 E019.47.21.538 N050.04.33.439 E019.47.21.459 Color_186ACI
N050.04.33.439 E019.47.21.459 N050.04.33.425 E019.47.21.378 Color_186ACI
N050.04.33.425 E019.47.21.378 N050.04.33.401 E019.47.21.334 Color_186ACI
N050.04.32.979 E019.47.18.397 N050.04.32.925 E019.47.18.362 Color_186ACI
N050.04.32.925 E019.47.18.362 N050.04.32.861 E019.47.18.382 Color_186ACI
N050.04.32.861 E019.47.18.382 N050.04.32.821 E019.47.18.446 Color_186ACI
N050.04.32.821 E019.47.18.446 N050.04.32.810 E019.47.18.550 Color_186ACI
N050.04.32.810 E019.47.18.550 N050.04.32.838 E019.47.18.636 Color_186ACI
N050.04.32.838 E019.47.18.636 N050.04.32.895 E019.47.18.683 Color_186ACI
N050.04.32.895 E019.47.18.683 N050.04.32.955 E019.47.18.671 Color_186ACI
N050.04.32.955 E019.47.18.671 N050.04.33.004 E019.47.18.602 Color_186ACI
N050.04.33.004 E019.47.18.602 N050.04.33.017 E019.47.18.523 Color_186ACI
N050.04.33.017 E019.47.18.523 N050.04.33.003 E019.47.18.442 Color_186ACI
N050.04.33.003 E019.47.18.442 N050.04.32.979 E019.47.18.397 Color_186ACI
N050.04.32.570 E019.47.15.417 N050.04.32.517 E019.47.15.382 Color_186ACI
N050.04.32.517 E019.47.15.382 N050.04.32.453 E019.47.15.402 Color_186ACI
N050.04.32.453 E019.47.15.402 N050.04.32.413 E019.47.15.465 Color_186ACI
N050.04.32.413 E019.47.15.465 N050.04.32.402 E019.47.15.569 Color_186ACI
N050.04.32.402 E019.47.15.569 N050.04.32.430 E019.47.15.656 Color_186ACI
N050.04.32.430 E019.47.15.656 N050.04.32.487 E019.47.15.703 Color_186ACI
N050.04.32.487 E019.47.15.703 N050.04.32.547 E019.47.15.691 Color_186ACI
N050.04.32.547 E019.47.15.691 N050.04.32.596 E019.47.15.622 Color_186ACI
N050.04.32.596 E019.47.15.622 N050.04.32.609 E019.47.15.542 Color_186ACI
N050.04.32.609 E019.47.15.542 N050.04.32.595 E019.47.15.462 Color_186ACI
N050.04.32.595 E019.47.15.462 N050.04.32.570 E019.47.15.417 Color_186ACI
N050.04.32.192 E019.47.12.724 N050.04.32.138 E019.47.12.689 Color_186ACI
N050.04.32.138 E019.47.12.689 N050.04.32.074 E019.47.12.709 Color_186ACI
N050.04.32.074 E019.47.12.709 N050.04.32.034 E019.47.12.773 Color_186ACI
N050.04.32.034 E019.47.12.773 N050.04.32.023 E019.47.12.877 Color_186ACI
N050.04.32.023 E019.47.12.877 N050.04.32.051 E019.47.12.963 Color_186ACI
N050.04.32.051 E019.47.12.963 N050.04.32.108 E019.47.13.010 Color_186ACI
N050.04.32.108 E019.47.13.010 N050.04.32.168 E019.47.12.998 Color_186ACI
N050.04.32.168 E019.47.12.998 N050.04.32.217 E019.47.12.929 Color_186ACI
N050.04.32.217 E019.47.12.929 N050.04.32.230 E019.47.12.850 Color_186ACI
N050.04.32.230 E019.47.12.850 N050.04.32.216 E019.47.12.769 Color_186ACI
N050.04.32.216 E019.47.12.769 N050.04.32.192 E019.47.12.724 Color_186ACI
N050.04.31.775 E019.47.09.776 N050.04.31.721 E019.47.09.741 Color_186ACI
N050.04.31.721 E019.47.09.741 N050.04.31.657 E019.47.09.761 Color_186ACI
N050.04.31.657 E019.47.09.761 N050.04.31.617 E019.47.09.825 Color_186ACI
N050.04.31.617 E019.47.09.825 N050.04.31.606 E019.47.09.929 Color_186ACI
N050.04.31.606 E019.47.09.929 N050.04.31.634 E019.47.10.015 Color_186ACI
N050.04.31.634 E019.47.10.015 N050.04.31.691 E019.47.10.062 Color_186ACI
N050.04.31.691 E019.47.10.062 N050.04.31.751 E019.47.10.050 Color_186ACI
N050.04.31.751 E019.47.10.050 N050.04.31.800 E019.47.09.981 Color_186ACI
N050.04.31.800 E019.47.09.981 N050.04.31.813 E019.47.09.902 Color_186ACI
N050.04.31.813 E019.47.09.902 N050.04.31.799 E019.47.09.821 Color_186ACI
N050.04.31.799 E019.47.09.821 N050.04.31.775 E019.47.09.776 Color_186ACI
N050.04.31.378 E019.47.06.812 N050.04.31.324 E019.47.06.777 Color_186ACI
N050.04.31.324 E019.47.06.777 N050.04.31.260 E019.47.06.797 Color_186ACI
N050.04.31.260 E019.47.06.797 N050.04.31.221 E019.47.06.861 Color_186ACI
N050.04.31.221 E019.47.06.861 N050.04.31.209 E019.47.06.965 Color_186ACI
N050.04.31.209 E019.47.06.965 N050.04.31.237 E019.47.07.051 Color_186ACI
N050.04.31.237 E019.47.07.051 N050.04.31.295 E019.47.07.098 Color_186ACI
N050.04.31.295 E019.47.07.098 N050.04.31.355 E019.47.07.086 Color_186ACI
N050.04.31.355 E019.47.07.086 N050.04.31.403 E019.47.07.017 Color_186ACI
N050.04.31.403 E019.47.07.017 N050.04.31.416 E019.47.06.938 Color_186ACI
N050.04.31.416 E019.47.06.938 N050.04.31.402 E019.47.06.857 Color_186ACI
N050.04.31.402 E019.47.06.857 N050.04.31.378 E019.47.06.812 Color_186ACI
N050.04.30.955 E019.47.03.871 N050.04.30.902 E019.47.03.836 Color_186ACI
N050.04.30.902 E019.47.03.836 N050.04.30.838 E019.47.03.856 Color_186ACI
N050.04.30.838 E019.47.03.856 N050.04.30.798 E019.47.03.920 Color_186ACI
N050.04.30.798 E019.47.03.920 N050.04.30.787 E019.47.04.024 Color_186ACI
N050.04.30.787 E019.47.04.024 N050.04.30.815 E019.47.04.110 Color_186ACI
N050.04.30.815 E019.47.04.110 N050.04.30.872 E019.47.04.157 Color_186ACI
N050.04.30.872 E019.47.04.157 N050.04.30.932 E019.47.04.145 Color_186ACI
N050.04.30.932 E019.47.04.145 N050.04.30.981 E019.47.04.076 Color_186ACI
N050.04.30.981 E019.47.04.076 N050.04.30.994 E019.47.03.997 Color_186ACI
N050.04.30.994 E019.47.03.997 N050.04.30.980 E019.47.03.916 Color_186ACI
N050.04.30.980 E019.47.03.916 N050.04.30.955 E019.47.03.871 Color_186ACI
N050.04.30.546 E019.47.00.906 N050.04.30.492 E019.47.00.871 Color_186ACI
N050.04.30.492 E019.47.00.871 N050.04.30.428 E019.47.00.891 Color_186ACI
N050.04.30.428 E019.47.00.891 N050.04.30.388 E019.47.00.954 Color_186ACI
N050.04.30.388 E019.47.00.954 N050.04.30.377 E019.47.01.058 Color_186ACI
N050.04.30.377 E019.47.01.058 N050.04.30.405 E019.47.01.145 Color_186ACI
N050.04.30.405 E019.47.01.145 N050.04.30.463 E019.47.01.192 Color_186ACI
N050.04.30.463 E019.47.01.192 N050.04.30.523 E019.47.01.180 Color_186ACI
N050.04.30.523 E019.47.01.180 N050.04.30.571 E019.47.01.111 Color_186ACI
N050.04.30.571 E019.47.01.111 N050.04.30.584 E019.47.01.031 Color_186ACI
N050.04.30.584 E019.47.01.031 N050.04.30.570 E019.47.00.951 Color_186ACI
N050.04.30.570 E019.47.00.951 N050.04.30.546 E019.47.00.906 Color_186ACI
N050.04.30.141 E019.46.58.001 N050.04.30.087 E019.46.57.965 Color_186ACI
N050.04.30.087 E019.46.57.965 N050.04.30.023 E019.46.57.986 Color_186ACI
N050.04.30.023 E019.46.57.986 N050.04.29.983 E019.46.58.049 Color_186ACI
N050.04.29.983 E019.46.58.049 N050.04.29.972 E019.46.58.153 Color_186ACI
N050.04.29.972 E019.46.58.153 N050.04.30.000 E019.46.58.239 Color_186ACI
N050.04.30.000 E019.46.58.239 N050.04.30.057 E019.46.58.287 Color_186ACI
N050.04.30.057 E019.46.58.287 N050.04.30.117 E019.46.58.275 Color_186ACI
N050.04.30.117 E019.46.58.275 N050.04.30.166 E019.46.58.205 Color_186ACI
N050.04.30.166 E019.46.58.205 N050.04.30.179 E019.46.58.126 Color_186ACI
N050.04.30.179 E019.46.58.126 N050.04.30.165 E019.46.58.045 Color_186ACI
N050.04.30.165 E019.46.58.045 N050.04.30.141 E019.46.58.001 Color_186ACI
N050.04.29.860 E019.46.55.937 N050.04.29.806 E019.46.55.902 Color_186ACI
N050.04.29.806 E019.46.55.902 N050.04.29.742 E019.46.55.922 Color_186ACI
N050.04.29.742 E019.46.55.922 N050.04.29.702 E019.46.55.986 Color_186ACI
N050.04.29.702 E019.46.55.986 N050.04.29.691 E019.46.56.090 Color_186ACI
N050.04.29.691 E019.46.56.090 N050.04.29.719 E019.46.56.176 Color_186ACI
N050.04.29.719 E019.46.56.176 N050.04.29.777 E019.46.56.223 Color_186ACI
N050.04.29.777 E019.46.56.223 N050.04.29.837 E019.46.56.211 Color_186ACI
N050.04.29.837 E019.46.56.211 N050.04.29.885 E019.46.56.142 Color_186ACI
N050.04.29.885 E019.46.56.142 N050.04.29.898 E019.46.56.063 Color_186ACI
N050.04.29.898 E019.46.56.063 N050.04.29.884 E019.46.55.982 Color_186ACI
N050.04.29.884 E019.46.55.982 N050.04.29.860 E019.46.55.937 Color_186ACI
N050.04.29.575 E019.46.53.895 N050.04.29.522 E019.46.53.860 Color_186ACI
N050.04.29.522 E019.46.53.860 N050.04.29.458 E019.46.53.880 Color_186ACI
N050.04.29.458 E019.46.53.880 N050.04.29.418 E019.46.53.943 Color_186ACI
N050.04.29.418 E019.46.53.943 N050.04.29.407 E019.46.54.047 Color_186ACI
N050.04.29.407 E019.46.54.047 N050.04.29.434 E019.46.54.134 Color_186ACI
N050.04.29.434 E019.46.54.134 N050.04.29.492 E019.46.54.181 Color_186ACI
N050.04.29.492 E019.46.54.181 N050.04.29.552 E019.46.54.169 Color_186ACI
N050.04.29.552 E019.46.54.169 N050.04.29.601 E019.46.54.100 Color_186ACI
N050.04.29.601 E019.46.54.100 N050.04.29.614 E019.46.54.020 Color_186ACI
N050.04.29.614 E019.46.54.020 N050.04.29.600 E019.46.53.940 Color_186ACI
N050.04.29.600 E019.46.53.940 N050.04.29.575 E019.46.53.895 Color_186ACI
N050.04.29.694 E019.46.52.883 N050.04.29.641 E019.46.52.847 Color_186ACI
N050.04.29.641 E019.46.52.847 N050.04.29.577 E019.46.52.868 Color_186ACI
N050.04.29.577 E019.46.52.868 N050.04.29.537 E019.46.52.931 Color_186ACI
N050.04.29.537 E019.46.52.931 N050.04.29.526 E019.46.53.035 Color_186ACI
N050.04.29.526 E019.46.53.035 N050.04.29.553 E019.46.53.121 Color_186ACI
N050.04.29.553 E019.46.53.121 N050.04.29.611 E019.46.53.169 Color_186ACI
N050.04.29.611 E019.46.53.169 N050.04.29.671 E019.46.53.157 Color_186ACI
N050.04.29.671 E019.46.53.157 N050.04.29.719 E019.46.53.088 Color_186ACI
N050.04.29.719 E019.46.53.088 N050.04.29.733 E019.46.53.008 Color_186ACI
N050.04.29.733 E019.46.53.008 N050.04.29.719 E019.46.52.928 Color_186ACI
N050.04.29.719 E019.46.52.928 N050.04.29.694 E019.46.52.883 Color_186ACI
N050.04.30.058 E019.46.52.209 N050.04.30.005 E019.46.52.174 Color_186ACI
N050.04.30.005 E019.46.52.174 N050.04.29.941 E019.46.52.194 Color_186ACI
N050.04.29.941 E019.46.52.194 N050.04.29.901 E019.46.52.258 Color_186ACI
N050.04.29.901 E019.46.52.258 N050.04.29.890 E019.46.52.362 Color_186ACI
N050.04.29.890 E019.46.52.362 N050.04.29.917 E019.46.52.448 Color_186ACI
N050.04.29.917 E019.46.52.448 N050.04.29.975 E019.46.52.495 Color_186ACI
N050.04.29.975 E019.46.52.495 N050.04.30.035 E019.46.52.483 Color_186ACI
N050.04.30.035 E019.46.52.483 N050.04.30.083 E019.46.52.414 Color_186ACI
N050.04.30.083 E019.46.52.414 N050.04.30.097 E019.46.52.335 Color_186ACI
N050.04.30.097 E019.46.52.335 N050.04.30.083 E019.46.52.254 Color_186ACI
N050.04.30.083 E019.46.52.254 N050.04.30.058 E019.46.52.209 Color_186ACI
N050.04.30.423 E019.46.52.053 N050.04.30.370 E019.46.52.018 Color_186ACI
N050.04.30.370 E019.46.52.018 N050.04.30.306 E019.46.52.038 Color_186ACI
N050.04.30.306 E019.46.52.038 N050.04.30.266 E019.46.52.101 Color_186ACI
N050.04.30.266 E019.46.52.101 N050.04.30.255 E019.46.52.205 Color_186ACI
N050.04.30.255 E019.46.52.205 N050.04.30.282 E019.46.52.292 Color_186ACI
N050.04.30.282 E019.46.52.292 N050.04.30.340 E019.46.52.339 Color_186ACI
N050.04.30.340 E019.46.52.339 N050.04.30.400 E019.46.52.327 Color_186ACI
N050.04.30.400 E019.46.52.327 N050.04.30.448 E019.46.52.258 Color_186ACI
N050.04.30.448 E019.46.52.258 N050.04.30.462 E019.46.52.178 Color_186ACI
N050.04.30.462 E019.46.52.178 N050.04.30.448 E019.46.52.098 Color_186ACI
N050.04.30.448 E019.46.52.098 N050.04.30.423 E019.46.52.053 Color_186ACI
N050.04.30.822 E019.46.51.907 N050.04.30.768 E019.46.51.872 Color_186ACI
N050.04.30.768 E019.46.51.872 N050.04.30.704 E019.46.51.892 Color_186ACI
N050.04.30.704 E019.46.51.892 N050.04.30.664 E019.46.51.955 Color_186ACI
N050.04.30.664 E019.46.51.955 N050.04.30.653 E019.46.52.059 Color_186ACI
N050.04.30.653 E019.46.52.059 N050.04.30.681 E019.46.52.146 Color_186ACI
N050.04.30.681 E019.46.52.146 N050.04.30.738 E019.46.52.193 Color_186ACI
N050.04.30.738 E019.46.52.193 N050.04.30.798 E019.46.52.181 Color_186ACI
N050.04.30.798 E019.46.52.181 N050.04.30.847 E019.46.52.112 Color_186ACI
N050.04.30.847 E019.46.52.112 N050.04.30.860 E019.46.52.032 Color_186ACI
N050.04.30.860 E019.46.52.032 N050.04.30.846 E019.46.51.952 Color_186ACI
N050.04.30.846 E019.46.51.952 N050.04.30.822 E019.46.51.907 Color_186ACI
N050.04.32.777 E019.46.52.048 N050.04.32.723 E019.46.52.012 Color_186ACI
N050.04.32.723 E019.46.52.012 N050.04.32.659 E019.46.52.033 Color_186ACI
N050.04.32.659 E019.46.52.033 N050.04.32.619 E019.46.52.096 Color_186ACI
N050.04.32.619 E019.46.52.096 N050.04.32.608 E019.46.52.200 Color_186ACI
N050.04.32.608 E019.46.52.200 N050.04.32.636 E019.46.52.286 Color_186ACI
N050.04.32.636 E019.46.52.286 N050.04.32.693 E019.46.52.333 Color_186ACI
N050.04.32.693 E019.46.52.333 N050.04.32.753 E019.46.52.322 Color_186ACI
N050.04.32.753 E019.46.52.322 N050.04.32.802 E019.46.52.252 Color_186ACI
N050.04.32.802 E019.46.52.252 N050.04.32.815 E019.46.52.173 Color_186ACI
N050.04.32.815 E019.46.52.173 N050.04.32.801 E019.46.52.092 Color_186ACI
N050.04.32.801 E019.46.52.092 N050.04.32.777 E019.46.52.048 Color_186ACI
N050.04.34.776 E019.46.52.205 N050.04.34.722 E019.46.52.170 Color_186ACI
N050.04.34.722 E019.46.52.170 N050.04.34.658 E019.46.52.190 Color_186ACI
N050.04.34.658 E019.46.52.190 N050.04.34.618 E019.46.52.254 Color_186ACI
N050.04.34.618 E019.46.52.254 N050.04.34.607 E019.46.52.358 Color_186ACI
N050.04.34.607 E019.46.52.358 N050.04.34.635 E019.46.52.444 Color_186ACI
N050.04.34.635 E019.46.52.444 N050.04.34.692 E019.46.52.491 Color_186ACI
N050.04.34.692 E019.46.52.491 N050.04.34.752 E019.46.52.479 Color_186ACI
N050.04.34.752 E019.46.52.479 N050.04.34.801 E019.46.52.410 Color_186ACI
N050.04.34.801 E019.46.52.410 N050.04.34.814 E019.46.52.331 Color_186ACI
N050.04.34.814 E019.46.52.331 N050.04.34.800 E019.46.52.250 Color_186ACI
N050.04.34.800 E019.46.52.250 N050.04.34.776 E019.46.52.205 Color_186ACI
N050.04.35.483 E019.46.52.282 N050.04.35.430 E019.46.52.247 Color_186ACI
N050.04.35.430 E019.46.52.247 N050.04.35.366 E019.46.52.267 Color_186ACI
N050.04.35.366 E019.46.52.267 N050.04.35.326 E019.46.52.331 Color_186ACI
N050.04.35.326 E019.46.52.331 N050.04.35.315 E019.46.52.435 Color_186ACI
N050.04.35.315 E019.46.52.435 N050.04.35.343 E019.46.52.521 Color_186ACI
N050.04.35.343 E019.46.52.521 N050.04.35.400 E019.46.52.568 Color_186ACI
N050.04.35.400 E019.46.52.568 N050.04.35.460 E019.46.52.556 Color_186ACI
N050.04.35.460 E019.46.52.556 N050.04.35.509 E019.46.52.487 Color_186ACI
N050.04.35.509 E019.46.52.487 N050.04.35.522 E019.46.52.408 Color_186ACI
N050.04.35.522 E019.46.52.408 N050.04.35.508 E019.46.52.327 Color_186ACI
N050.04.35.508 E019.46.52.327 N050.04.35.483 E019.46.52.282 Color_186ACI
N050.04.35.933 E019.46.52.392 N050.04.35.879 E019.46.52.357 Color_186ACI
N050.04.35.879 E019.46.52.357 N050.04.35.815 E019.46.52.377 Color_186ACI
N050.04.35.815 E019.46.52.377 N050.04.35.775 E019.46.52.441 Color_186ACI
N050.04.35.775 E019.46.52.441 N050.04.35.764 E019.46.52.545 Color_186ACI
N050.04.35.764 E019.46.52.545 N050.04.35.792 E019.46.52.631 Color_186ACI
N050.04.35.792 E019.46.52.631 N050.04.35.849 E019.46.52.678 Color_186ACI
N050.04.35.849 E019.46.52.678 N050.04.35.909 E019.46.52.666 Color_186ACI
N050.04.35.909 E019.46.52.666 N050.04.35.958 E019.46.52.597 Color_186ACI
N050.04.35.958 E019.46.52.597 N050.04.35.971 E019.46.52.518 Color_186ACI
N050.04.35.971 E019.46.52.518 N050.04.35.957 E019.46.52.437 Color_186ACI
N050.04.35.957 E019.46.52.437 N050.04.35.933 E019.46.52.392 Color_186ACI
N050.04.36.288 E019.46.52.547 N050.04.36.235 E019.46.52.511 Color_186ACI
N050.04.36.235 E019.46.52.511 N050.04.36.171 E019.46.52.531 Color_186ACI
N050.04.36.171 E019.46.52.531 N050.04.36.131 E019.46.52.595 Color_186ACI
N050.04.36.131 E019.46.52.595 N050.04.36.120 E019.46.52.699 Color_186ACI
N050.04.36.120 E019.46.52.699 N050.04.36.147 E019.46.52.785 Color_186ACI
N050.04.36.147 E019.46.52.785 N050.04.36.205 E019.46.52.832 Color_186ACI
N050.04.36.205 E019.46.52.832 N050.04.36.265 E019.46.52.820 Color_186ACI
N050.04.36.265 E019.46.52.820 N050.04.36.313 E019.46.52.751 Color_186ACI
N050.04.36.313 E019.46.52.751 N050.04.36.327 E019.46.52.672 Color_186ACI
N050.04.36.327 E019.46.52.672 N050.04.36.313 E019.46.52.591 Color_186ACI
N050.04.36.313 E019.46.52.591 N050.04.36.288 E019.46.52.547 Color_186ACI
N050.04.36.522 E019.46.52.843 N050.04.36.468 E019.46.52.807 Color_186ACI
N050.04.36.468 E019.46.52.807 N050.04.36.404 E019.46.52.827 Color_186ACI
N050.04.36.404 E019.46.52.827 N050.04.36.365 E019.46.52.891 Color_186ACI
N050.04.36.365 E019.46.52.891 N050.04.36.353 E019.46.52.995 Color_186ACI
N050.04.36.353 E019.46.52.995 N050.04.36.381 E019.46.53.081 Color_186ACI
N050.04.36.381 E019.46.53.081 N050.04.36.439 E019.46.53.128 Color_186ACI
N050.04.36.439 E019.46.53.128 N050.04.36.499 E019.46.53.117 Color_186ACI
N050.04.36.499 E019.46.53.117 N050.04.36.547 E019.46.53.047 Color_186ACI
N050.04.36.547 E019.46.53.047 N050.04.36.560 E019.46.52.968 Color_186ACI
N050.04.36.560 E019.46.52.968 N050.04.36.546 E019.46.52.887 Color_186ACI
N050.04.36.546 E019.46.52.887 N050.04.36.522 E019.46.52.843 Color_186ACI
N050.04.36.739 E019.46.53.134 N050.04.36.685 E019.46.53.098 Color_186ACI
N050.04.36.685 E019.46.53.098 N050.04.36.621 E019.46.53.119 Color_186ACI
N050.04.36.621 E019.46.53.119 N050.04.36.582 E019.46.53.182 Color_186ACI
N050.04.36.582 E019.46.53.182 N050.04.36.570 E019.46.53.286 Color_186ACI
N050.04.36.570 E019.46.53.286 N050.04.36.598 E019.46.53.372 Color_186ACI
N050.04.36.598 E019.46.53.372 N050.04.36.656 E019.46.53.420 Color_186ACI
N050.04.36.656 E019.46.53.420 N050.04.36.716 E019.46.53.408 Color_186ACI
N050.04.36.716 E019.46.53.408 N050.04.36.764 E019.46.53.339 Color_186ACI
N050.04.36.764 E019.46.53.339 N050.04.36.777 E019.46.53.259 Color_186ACI
N050.04.36.777 E019.46.53.259 N050.04.36.763 E019.46.53.178 Color_186ACI
N050.04.36.763 E019.46.53.178 N050.04.36.739 E019.46.53.134 Color_186ACI
N050.04.36.883 E019.46.53.508 N050.04.36.829 E019.46.53.472 Color_186ACI
N050.04.36.829 E019.46.53.472 N050.04.36.765 E019.46.53.492 Color_186ACI
N050.04.36.765 E019.46.53.492 N050.04.36.725 E019.46.53.556 Color_186ACI
N050.04.36.725 E019.46.53.556 N050.04.36.714 E019.46.53.660 Color_186ACI
N050.04.36.714 E019.46.53.660 N050.04.36.742 E019.46.53.746 Color_186ACI
N050.04.36.742 E019.46.53.746 N050.04.36.799 E019.46.53.793 Color_186ACI
N050.04.36.799 E019.46.53.793 N050.04.36.859 E019.46.53.781 Color_186ACI
N050.04.36.859 E019.46.53.781 N050.04.36.908 E019.46.53.712 Color_186ACI
N050.04.36.908 E019.46.53.712 N050.04.36.921 E019.46.53.633 Color_186ACI
N050.04.36.921 E019.46.53.633 N050.04.36.907 E019.46.53.552 Color_186ACI
N050.04.36.907 E019.46.53.552 N050.04.36.883 E019.46.53.508 Color_186ACI
N050.04.36.243 E019.46.49.119 N050.04.36.190 E019.46.49.084 Color_186ACI
N050.04.36.190 E019.46.49.084 N050.04.36.125 E019.46.49.104 Color_186ACI
N050.04.36.125 E019.46.49.104 N050.04.36.086 E019.46.49.167 Color_186ACI
N050.04.36.086 E019.46.49.167 N050.04.36.074 E019.46.49.272 Color_186ACI
N050.04.36.074 E019.46.49.272 N050.04.36.102 E019.46.49.358 Color_186ACI
N050.04.36.102 E019.46.49.358 N050.04.36.160 E019.46.49.405 Color_186ACI
N050.04.36.160 E019.46.49.405 N050.04.36.220 E019.46.49.393 Color_186ACI
N050.04.36.220 E019.46.49.393 N050.04.36.268 E019.46.49.324 Color_186ACI
N050.04.36.268 E019.46.49.324 N050.04.36.281 E019.46.49.245 Color_186ACI
N050.04.36.281 E019.46.49.245 N050.04.36.268 E019.46.49.164 Color_186ACI
N050.04.36.268 E019.46.49.164 N050.04.36.243 E019.46.49.119 Color_186ACI
N050.04.36.186 E019.46.49.745 N050.04.36.132 E019.46.49.709 Color_186ACI
N050.04.36.132 E019.46.49.709 N050.04.36.068 E019.46.49.730 Color_186ACI
N050.04.36.068 E019.46.49.730 N050.04.36.028 E019.46.49.793 Color_186ACI
N050.04.36.028 E019.46.49.793 N050.04.36.017 E019.46.49.897 Color_186ACI
N050.04.36.017 E019.46.49.897 N050.04.36.045 E019.46.49.983 Color_186ACI
N050.04.36.045 E019.46.49.983 N050.04.36.103 E019.46.50.031 Color_186ACI
N050.04.36.103 E019.46.50.031 N050.04.36.163 E019.46.50.019 Color_186ACI
N050.04.36.163 E019.46.50.019 N050.04.36.211 E019.46.49.950 Color_186ACI
N050.04.36.211 E019.46.49.950 N050.04.36.224 E019.46.49.870 Color_186ACI
N050.04.36.224 E019.46.49.870 N050.04.36.210 E019.46.49.790 Color_186ACI
N050.04.36.210 E019.46.49.790 N050.04.36.186 E019.46.49.745 Color_186ACI
N050.04.35.935 E019.46.50.264 N050.04.35.881 E019.46.50.228 Color_186ACI
N050.04.35.881 E019.46.50.228 N050.04.35.817 E019.46.50.249 Color_186ACI
N050.04.35.817 E019.46.50.249 N050.04.35.777 E019.46.50.312 Color_186ACI
N050.04.35.777 E019.46.50.312 N050.04.35.766 E019.46.50.416 Color_186ACI
N050.04.35.766 E019.46.50.416 N050.04.35.794 E019.46.50.502 Color_186ACI
N050.04.35.794 E019.46.50.502 N050.04.35.851 E019.46.50.550 Color_186ACI
N050.04.35.851 E019.46.50.550 N050.04.35.912 E019.46.50.538 Color_186ACI
N050.04.35.912 E019.46.50.538 N050.04.35.960 E019.46.50.469 Color_186ACI
N050.04.35.960 E019.46.50.469 N050.04.35.973 E019.46.50.389 Color_186ACI
N050.04.35.973 E019.46.50.389 N050.04.35.959 E019.46.50.308 Color_186ACI
N050.04.35.959 E019.46.50.308 N050.04.35.935 E019.46.50.264 Color_186ACI
N050.04.35.630 E019.46.50.814 N050.04.35.576 E019.46.50.779 Color_186ACI
N050.04.35.576 E019.46.50.779 N050.04.35.512 E019.46.50.799 Color_186ACI
N050.04.35.512 E019.46.50.799 N050.04.35.472 E019.46.50.862 Color_186ACI
N050.04.35.472 E019.46.50.862 N050.04.35.461 E019.46.50.966 Color_186ACI
N050.04.35.461 E019.46.50.966 N050.04.35.489 E019.46.51.053 Color_186ACI
N050.04.35.489 E019.46.51.053 N050.04.35.546 E019.46.51.100 Color_186ACI
N050.04.35.546 E019.46.51.100 N050.04.35.606 E019.46.51.088 Color_186ACI
N050.04.35.606 E019.46.51.088 N050.04.35.655 E019.46.51.019 Color_186ACI
N050.04.35.655 E019.46.51.019 N050.04.35.668 E019.46.50.939 Color_186ACI
N050.04.35.668 E019.46.50.939 N050.04.35.654 E019.46.50.859 Color_186ACI
N050.04.35.654 E019.46.50.859 N050.04.35.630 E019.46.50.814 Color_186ACI
N050.04.35.175 E019.46.50.982 N050.04.35.121 E019.46.50.947 Color_186ACI
N050.04.35.121 E019.46.50.947 N050.04.35.057 E019.46.50.967 Color_186ACI
N050.04.35.057 E019.46.50.967 N050.04.35.018 E019.46.51.031 Color_186ACI
N050.04.35.018 E019.46.51.031 N050.04.35.006 E019.46.51.135 Color_186ACI
N050.04.35.006 E019.46.51.135 N050.04.35.034 E019.46.51.221 Color_186ACI
N050.04.35.034 E019.46.51.221 N050.04.35.092 E019.46.51.268 Color_186ACI
N050.04.35.092 E019.46.51.268 N050.04.35.152 E019.46.51.256 Color_186ACI
N050.04.35.152 E019.46.51.256 N050.04.35.200 E019.46.51.187 Color_186ACI
N050.04.35.200 E019.46.51.187 N050.04.35.213 E019.46.51.108 Color_186ACI
N050.04.35.213 E019.46.51.108 N050.04.35.199 E019.46.51.027 Color_186ACI
N050.04.35.199 E019.46.51.027 N050.04.35.175 E019.46.50.982 Color_186ACI
N050.04.34.790 E019.46.51.125 N050.04.34.736 E019.46.51.089 Color_186ACI
N050.04.34.736 E019.46.51.089 N050.04.34.672 E019.46.51.109 Color_186ACI
N050.04.34.672 E019.46.51.109 N050.04.34.632 E019.46.51.173 Color_186ACI
N050.04.34.632 E019.46.51.173 N050.04.34.621 E019.46.51.277 Color_186ACI
N050.04.34.621 E019.46.51.277 N050.04.34.649 E019.46.51.363 Color_186ACI
N050.04.34.649 E019.46.51.363 N050.04.34.706 E019.46.51.410 Color_186ACI
N050.04.34.706 E019.46.51.410 N050.04.34.767 E019.46.51.398 Color_186ACI
N050.04.34.767 E019.46.51.398 N050.04.34.815 E019.46.51.329 Color_186ACI
N050.04.34.815 E019.46.51.329 N050.04.34.828 E019.46.51.250 Color_186ACI
N050.04.34.828 E019.46.51.250 N050.04.34.814 E019.46.51.169 Color_186ACI
N050.04.34.814 E019.46.51.169 N050.04.34.790 E019.46.51.125 Color_186ACI
N050.04.32.780 E019.46.51.016 N050.04.32.726 E019.46.50.980 Color_186ACI
N050.04.32.726 E019.46.50.980 N050.04.32.662 E019.46.51.001 Color_186ACI
N050.04.32.662 E019.46.51.001 N050.04.32.622 E019.46.51.064 Color_186ACI
N050.04.32.622 E019.46.51.064 N050.04.32.611 E019.46.51.168 Color_186ACI
N050.04.32.611 E019.46.51.168 N050.04.32.639 E019.46.51.254 Color_186ACI
N050.04.32.639 E019.46.51.254 N050.04.32.696 E019.46.51.301 Color_186ACI
N050.04.32.696 E019.46.51.301 N050.04.32.756 E019.46.51.290 Color_186ACI
N050.04.32.756 E019.46.51.290 N050.04.32.805 E019.46.51.220 Color_186ACI
N050.04.32.805 E019.46.51.220 N050.04.32.818 E019.46.51.141 Color_186ACI
N050.04.32.818 E019.46.51.141 N050.04.32.804 E019.46.51.060 Color_186ACI
N050.04.32.804 E019.46.51.060 N050.04.32.780 E019.46.51.016 Color_186ACI
N050.04.30.845 E019.46.50.883 N050.04.30.791 E019.46.50.848 Color_186ACI
N050.04.30.791 E019.46.50.848 N050.04.30.727 E019.46.50.868 Color_186ACI
N050.04.30.727 E019.46.50.868 N050.04.30.687 E019.46.50.931 Color_186ACI
N050.04.30.687 E019.46.50.931 N050.04.30.676 E019.46.51.035 Color_186ACI
N050.04.30.676 E019.46.51.035 N050.04.30.704 E019.46.51.122 Color_186ACI
N050.04.30.704 E019.46.51.122 N050.04.30.762 E019.46.51.169 Color_186ACI
N050.04.30.762 E019.46.51.169 N050.04.30.822 E019.46.51.157 Color_186ACI
N050.04.30.822 E019.46.51.157 N050.04.30.870 E019.46.51.088 Color_186ACI
N050.04.30.870 E019.46.51.088 N050.04.30.883 E019.46.51.008 Color_186ACI
N050.04.30.883 E019.46.51.008 N050.04.30.869 E019.46.50.928 Color_186ACI
N050.04.30.869 E019.46.50.928 N050.04.30.845 E019.46.50.883 Color_186ACI
N050.04.30.079 E019.46.50.829 N050.04.30.026 E019.46.50.793 Color_186ACI
N050.04.30.026 E019.46.50.793 N050.04.29.962 E019.46.50.814 Color_186ACI
N050.04.29.962 E019.46.50.814 N050.04.29.922 E019.46.50.877 Color_186ACI
N050.04.29.922 E019.46.50.877 N050.04.29.911 E019.46.50.981 Color_186ACI
N050.04.29.911 E019.46.50.981 N050.04.29.938 E019.46.51.067 Color_186ACI
N050.04.29.938 E019.46.51.067 N050.04.29.996 E019.46.51.115 Color_186ACI
N050.04.29.996 E019.46.51.115 N050.04.30.056 E019.46.51.103 Color_186ACI
N050.04.30.056 E019.46.51.103 N050.04.30.104 E019.46.51.034 Color_186ACI
N050.04.30.104 E019.46.51.034 N050.04.30.118 E019.46.50.954 Color_186ACI
N050.04.30.118 E019.46.50.954 N050.04.30.104 E019.46.50.874 Color_186ACI
N050.04.30.104 E019.46.50.874 N050.04.30.079 E019.46.50.829 Color_186ACI
N050.04.29.683 E019.46.50.597 N050.04.29.629 E019.46.50.562 Color_186ACI
N050.04.29.629 E019.46.50.562 N050.04.29.565 E019.46.50.582 Color_186ACI
N050.04.29.565 E019.46.50.582 N050.04.29.525 E019.46.50.646 Color_186ACI
N050.04.29.525 E019.46.50.646 N050.04.29.514 E019.46.50.750 Color_186ACI
N050.04.29.514 E019.46.50.750 N050.04.29.542 E019.46.50.836 Color_186ACI
N050.04.29.542 E019.46.50.836 N050.04.29.599 E019.46.50.883 Color_186ACI
N050.04.29.599 E019.46.50.883 N050.04.29.659 E019.46.50.871 Color_186ACI
N050.04.29.659 E019.46.50.871 N050.04.29.708 E019.46.50.802 Color_186ACI
N050.04.29.708 E019.46.50.802 N050.04.29.721 E019.46.50.723 Color_186ACI
N050.04.29.721 E019.46.50.723 N050.04.29.707 E019.46.50.642 Color_186ACI
N050.04.29.707 E019.46.50.642 N050.04.29.683 E019.46.50.597 Color_186ACI
N050.04.29.338 E019.46.50.370 N050.04.29.285 E019.46.50.335 Color_186ACI
N050.04.29.285 E019.46.50.335 N050.04.29.221 E019.46.50.355 Color_186ACI
N050.04.29.221 E019.46.50.355 N050.04.29.181 E019.46.50.418 Color_186ACI
N050.04.29.181 E019.46.50.418 N050.04.29.170 E019.46.50.522 Color_186ACI
N050.04.29.170 E019.46.50.522 N050.04.29.197 E019.46.50.609 Color_186ACI
N050.04.29.197 E019.46.50.609 N050.04.29.255 E019.46.50.656 Color_186ACI
N050.04.29.255 E019.46.50.656 N050.04.29.315 E019.46.50.644 Color_186ACI
N050.04.29.315 E019.46.50.644 N050.04.29.363 E019.46.50.575 Color_186ACI
N050.04.29.363 E019.46.50.575 N050.04.29.377 E019.46.50.495 Color_186ACI
N050.04.29.377 E019.46.50.495 N050.04.29.363 E019.46.50.415 Color_186ACI
N050.04.29.363 E019.46.50.415 N050.04.29.338 E019.46.50.370 Color_186ACI
N050.04.28.942 E019.46.49.348 N050.04.28.888 E019.46.49.312 Color_186ACI
N050.04.28.888 E019.46.49.312 N050.04.28.824 E019.46.49.333 Color_186ACI
N050.04.28.824 E019.46.49.333 N050.04.28.784 E019.46.49.396 Color_186ACI
N050.04.28.784 E019.46.49.396 N050.04.28.773 E019.46.49.500 Color_186ACI
N050.04.28.773 E019.46.49.500 N050.04.28.801 E019.46.49.586 Color_186ACI
N050.04.28.801 E019.46.49.586 N050.04.28.858 E019.46.49.634 Color_186ACI
N050.04.28.858 E019.46.49.634 N050.04.28.918 E019.46.49.622 Color_186ACI
N050.04.28.918 E019.46.49.622 N050.04.28.967 E019.46.49.553 Color_186ACI
N050.04.28.967 E019.46.49.553 N050.04.28.980 E019.46.49.473 Color_186ACI
N050.04.28.980 E019.46.49.473 N050.04.28.966 E019.46.49.393 Color_186ACI
N050.04.28.966 E019.46.49.393 N050.04.28.942 E019.46.49.348 Color_186ACI
N050.04.28.751 E019.46.48.008 N050.04.28.698 E019.46.47.972 Color_186ACI
N050.04.28.698 E019.46.47.972 N050.04.28.634 E019.46.47.993 Color_186ACI
N050.04.28.634 E019.46.47.993 N050.04.28.594 E019.46.48.056 Color_186ACI
N050.04.28.594 E019.46.48.056 N050.04.28.583 E019.46.48.160 Color_186ACI
N050.04.28.583 E019.46.48.160 N050.04.28.611 E019.46.48.246 Color_186ACI
N050.04.28.611 E019.46.48.246 N050.04.28.668 E019.46.48.294 Color_186ACI
N050.04.28.668 E019.46.48.294 N050.04.28.728 E019.46.48.282 Color_186ACI
N050.04.28.728 E019.46.48.282 N050.04.28.777 E019.46.48.213 Color_186ACI
N050.04.28.777 E019.46.48.213 N050.04.28.790 E019.46.48.133 Color_186ACI
N050.04.28.790 E019.46.48.133 N050.04.28.776 E019.46.48.052 Color_186ACI
N050.04.28.776 E019.46.48.052 N050.04.28.751 E019.46.48.008 Color_186ACI
N050.04.28.359 E019.46.45.334 N050.04.28.305 E019.46.45.298 Color_186ACI
N050.04.28.305 E019.46.45.298 N050.04.28.241 E019.46.45.319 Color_186ACI
N050.04.28.241 E019.46.45.319 N050.04.28.201 E019.46.45.382 Color_186ACI
N050.04.28.201 E019.46.45.382 N050.04.28.190 E019.46.45.486 Color_186ACI
N050.04.28.190 E019.46.45.486 N050.04.28.218 E019.46.45.572 Color_186ACI
N050.04.28.218 E019.46.45.572 N050.04.28.276 E019.46.45.620 Color_186ACI
N050.04.28.276 E019.46.45.620 N050.04.28.336 E019.46.45.608 Color_186ACI
N050.04.28.336 E019.46.45.608 N050.04.28.384 E019.46.45.539 Color_186ACI
N050.04.28.384 E019.46.45.539 N050.04.28.397 E019.46.45.459 Color_186ACI
N050.04.28.397 E019.46.45.459 N050.04.28.383 E019.46.45.378 Color_186ACI
N050.04.28.383 E019.46.45.378 N050.04.28.359 E019.46.45.334 Color_186ACI
N050.04.27.959 E019.46.42.341 N050.04.27.905 E019.46.42.305 Color_186ACI
N050.04.27.905 E019.46.42.305 N050.04.27.841 E019.46.42.326 Color_186ACI
N050.04.27.841 E019.46.42.326 N050.04.27.801 E019.46.42.389 Color_186ACI
N050.04.27.801 E019.46.42.389 N050.04.27.790 E019.46.42.493 Color_186ACI
N050.04.27.790 E019.46.42.493 N050.04.27.818 E019.46.42.579 Color_186ACI
N050.04.27.818 E019.46.42.579 N050.04.27.875 E019.46.42.627 Color_186ACI
N050.04.27.875 E019.46.42.627 N050.04.27.936 E019.46.42.615 Color_186ACI
N050.04.27.936 E019.46.42.615 N050.04.27.984 E019.46.42.546 Color_186ACI
N050.04.27.984 E019.46.42.546 N050.04.27.997 E019.46.42.466 Color_186ACI
N050.04.27.997 E019.46.42.466 N050.04.27.983 E019.46.42.385 Color_186ACI
N050.04.27.983 E019.46.42.385 N050.04.27.959 E019.46.42.341 Color_186ACI
N050.04.27.534 E019.46.39.385 N050.04.27.481 E019.46.39.350 Color_186ACI
N050.04.27.481 E019.46.39.350 N050.04.27.417 E019.46.39.370 Color_186ACI
N050.04.27.417 E019.46.39.370 N050.04.27.377 E019.46.39.433 Color_186ACI
N050.04.27.377 E019.46.39.433 N050.04.27.366 E019.46.39.537 Color_186ACI
N050.04.27.366 E019.46.39.537 N050.04.27.393 E019.46.39.624 Color_186ACI
N050.04.27.393 E019.46.39.624 N050.04.27.451 E019.46.39.671 Color_186ACI
N050.04.27.451 E019.46.39.671 N050.04.27.511 E019.46.39.659 Color_186ACI
N050.04.27.511 E019.46.39.659 N050.04.27.559 E019.46.39.590 Color_186ACI
N050.04.27.559 E019.46.39.590 N050.04.27.573 E019.46.39.510 Color_186ACI
N050.04.27.573 E019.46.39.510 N050.04.27.559 E019.46.39.430 Color_186ACI
N050.04.27.559 E019.46.39.430 N050.04.27.534 E019.46.39.385 Color_186ACI
N050.04.27.124 E019.46.36.440 N050.04.27.070 E019.46.36.405 Color_186ACI
N050.04.27.070 E019.46.36.405 N050.04.27.006 E019.46.36.425 Color_186ACI
N050.04.27.006 E019.46.36.425 N050.04.26.967 E019.46.36.489 Color_186ACI
N050.04.26.967 E019.46.36.489 N050.04.26.955 E019.46.36.593 Color_186ACI
N050.04.26.955 E019.46.36.593 N050.04.26.983 E019.46.36.679 Color_186ACI
N050.04.26.983 E019.46.36.679 N050.04.27.041 E019.46.36.726 Color_186ACI
N050.04.27.041 E019.46.36.726 N050.04.27.101 E019.46.36.714 Color_186ACI
N050.04.27.101 E019.46.36.714 N050.04.27.149 E019.46.36.645 Color_186ACI
N050.04.27.149 E019.46.36.645 N050.04.27.162 E019.46.36.566 Color_186ACI
N050.04.27.162 E019.46.36.566 N050.04.27.148 E019.46.36.485 Color_186ACI
N050.04.27.148 E019.46.36.485 N050.04.27.124 E019.46.36.440 Color_186ACI
N050.04.26.701 E019.46.33.494 N050.04.26.647 E019.46.33.459 Color_186ACI
N050.04.26.647 E019.46.33.459 N050.04.26.583 E019.46.33.479 Color_186ACI
N050.04.26.583 E019.46.33.479 N050.04.26.543 E019.46.33.543 Color_186ACI
N050.04.26.543 E019.46.33.543 N050.04.26.532 E019.46.33.647 Color_186ACI
N050.04.26.532 E019.46.33.647 N050.04.26.560 E019.46.33.733 Color_186ACI
N050.04.26.560 E019.46.33.733 N050.04.26.617 E019.46.33.780 Color_186ACI
N050.04.26.617 E019.46.33.780 N050.04.26.677 E019.46.33.768 Color_186ACI
N050.04.26.677 E019.46.33.768 N050.04.26.726 E019.46.33.699 Color_186ACI
N050.04.26.726 E019.46.33.699 N050.04.26.739 E019.46.33.620 Color_186ACI
N050.04.26.739 E019.46.33.620 N050.04.26.725 E019.46.33.539 Color_186ACI
N050.04.26.725 E019.46.33.539 N050.04.26.701 E019.46.33.494 Color_186ACI
N050.04.26.296 E019.46.30.543 N050.04.26.243 E019.46.30.507 Color_186ACI
N050.04.26.243 E019.46.30.507 N050.04.26.179 E019.46.30.528 Color_186ACI
N050.04.26.179 E019.46.30.528 N050.04.26.139 E019.46.30.591 Color_186ACI
N050.04.26.139 E019.46.30.591 N050.04.26.128 E019.46.30.695 Color_186ACI
N050.04.26.128 E019.46.30.695 N050.04.26.155 E019.46.30.781 Color_186ACI
N050.04.26.155 E019.46.30.781 N050.04.26.213 E019.46.30.829 Color_186ACI
N050.04.26.213 E019.46.30.829 N050.04.26.273 E019.46.30.817 Color_186ACI
N050.04.26.273 E019.46.30.817 N050.04.26.321 E019.46.30.748 Color_186ACI
N050.04.26.321 E019.46.30.748 N050.04.26.335 E019.46.30.668 Color_186ACI
N050.04.26.335 E019.46.30.668 N050.04.26.321 E019.46.30.588 Color_186ACI
N050.04.26.321 E019.46.30.588 N050.04.26.296 E019.46.30.543 Color_186ACI
N050.04.25.882 E019.46.27.594 N050.04.25.829 E019.46.27.559 Color_186ACI
N050.04.25.829 E019.46.27.559 N050.04.25.765 E019.46.27.579 Color_186ACI
N050.04.25.765 E019.46.27.579 N050.04.25.725 E019.46.27.643 Color_186ACI
N050.04.25.725 E019.46.27.643 N050.04.25.714 E019.46.27.747 Color_186ACI
N050.04.25.714 E019.46.27.747 N050.04.25.741 E019.46.27.833 Color_186ACI
N050.04.25.741 E019.46.27.833 N050.04.25.799 E019.46.27.880 Color_186ACI
N050.04.25.799 E019.46.27.880 N050.04.25.859 E019.46.27.868 Color_186ACI
N050.04.25.859 E019.46.27.868 N050.04.25.907 E019.46.27.799 Color_186ACI
N050.04.25.907 E019.46.27.799 N050.04.25.921 E019.46.27.720 Color_186ACI
N050.04.25.921 E019.46.27.720 N050.04.25.907 E019.46.27.639 Color_186ACI
N050.04.25.907 E019.46.27.639 N050.04.25.882 E019.46.27.594 Color_186ACI
N050.04.25.528 E019.46.25.020 N050.04.25.474 E019.46.24.985 Color_186ACI
N050.04.25.474 E019.46.24.985 N050.04.25.410 E019.46.25.005 Color_186ACI
N050.04.25.410 E019.46.25.005 N050.04.25.370 E019.46.25.068 Color_186ACI
N050.04.25.370 E019.46.25.068 N050.04.25.359 E019.46.25.172 Color_186ACI
N050.04.25.359 E019.46.25.172 N050.04.25.387 E019.46.25.259 Color_186ACI
N050.04.25.387 E019.46.25.259 N050.04.25.445 E019.46.25.306 Color_186ACI
N050.04.25.445 E019.46.25.306 N050.04.25.505 E019.46.25.294 Color_186ACI
N050.04.25.505 E019.46.25.294 N050.04.25.553 E019.46.25.225 Color_186ACI
N050.04.25.553 E019.46.25.225 N050.04.25.566 E019.46.25.145 Color_186ACI
N050.04.25.566 E019.46.25.145 N050.04.25.552 E019.46.25.065 Color_186ACI
N050.04.25.552 E019.46.25.065 N050.04.25.528 E019.46.25.020 Color_186ACI
N050.04.25.185 E019.46.22.508 N050.04.25.131 E019.46.22.472 Color_186ACI
N050.04.25.131 E019.46.22.472 N050.04.25.067 E019.46.22.492 Color_186ACI
N050.04.25.067 E019.46.22.492 N050.04.25.027 E019.46.22.556 Color_186ACI
N050.04.25.027 E019.46.22.556 N050.04.25.016 E019.46.22.660 Color_186ACI
N050.04.25.016 E019.46.22.660 N050.04.25.044 E019.46.22.746 Color_186ACI
N050.04.25.044 E019.46.22.746 N050.04.25.101 E019.46.22.793 Color_186ACI
N050.04.25.101 E019.46.22.793 N050.04.25.161 E019.46.22.781 Color_186ACI
N050.04.25.161 E019.46.22.781 N050.04.25.210 E019.46.22.712 Color_186ACI
N050.04.25.210 E019.46.22.712 N050.04.25.223 E019.46.22.633 Color_186ACI
N050.04.25.223 E019.46.22.633 N050.04.25.209 E019.46.22.552 Color_186ACI
N050.04.25.209 E019.46.22.552 N050.04.25.185 E019.46.22.508 Color_186ACI
N050.04.25.016 E019.46.21.387 N050.04.24.962 E019.46.21.352 Color_186ACI
N050.04.24.962 E019.46.21.352 N050.04.24.898 E019.46.21.372 Color_186ACI
N050.04.24.898 E019.46.21.372 N050.04.24.858 E019.46.21.436 Color_186ACI
N050.04.24.858 E019.46.21.436 N050.04.24.847 E019.46.21.540 Color_186ACI
N050.04.24.847 E019.46.21.540 N050.04.24.875 E019.46.21.626 Color_186ACI
N050.04.24.875 E019.46.21.626 N050.04.24.932 E019.46.21.673 Color_186ACI
N050.04.24.932 E019.46.21.673 N050.04.24.992 E019.46.21.661 Color_186ACI
N050.04.24.992 E019.46.21.661 N050.04.25.041 E019.46.21.592 Color_186ACI
N050.04.25.041 E019.46.21.592 N050.04.25.054 E019.46.21.513 Color_186ACI
N050.04.25.054 E019.46.21.513 N050.04.25.040 E019.46.21.432 Color_186ACI
N050.04.25.040 E019.46.21.432 N050.04.25.016 E019.46.21.387 Color_186ACI
N050.04.32.863 E019.47.24.470 N050.04.32.809 E019.47.24.434 Color_186ACI
N050.04.32.809 E019.47.24.434 N050.04.32.745 E019.47.24.454 Color_186ACI
N050.04.32.745 E019.47.24.454 N050.04.32.705 E019.47.24.518 Color_186ACI
N050.04.32.705 E019.47.24.518 N050.04.32.694 E019.47.24.622 Color_186ACI
N050.04.32.694 E019.47.24.622 N050.04.32.722 E019.47.24.708 Color_186ACI
N050.04.32.722 E019.47.24.708 N050.04.32.779 E019.47.24.755 Color_186ACI
N050.04.32.779 E019.47.24.755 N050.04.32.839 E019.47.24.743 Color_186ACI
N050.04.32.839 E019.47.24.743 N050.04.32.888 E019.47.24.674 Color_186ACI
N050.04.32.888 E019.47.24.674 N050.04.32.901 E019.47.24.595 Color_186ACI
N050.04.32.901 E019.47.24.595 N050.04.32.887 E019.47.24.514 Color_186ACI
N050.04.32.887 E019.47.24.514 N050.04.32.863 E019.47.24.470 Color_186ACI
N050.04.32.438 E019.47.21.653 N050.04.32.384 E019.47.21.618 Color_186ACI
N050.04.32.384 E019.47.21.618 N050.04.32.320 E019.47.21.638 Color_186ACI
N050.04.32.320 E019.47.21.638 N050.04.32.280 E019.47.21.702 Color_186ACI
N050.04.32.280 E019.47.21.702 N050.04.32.269 E019.47.21.806 Color_186ACI
N050.04.32.269 E019.47.21.806 N050.04.32.297 E019.47.21.892 Color_186ACI
N050.04.32.297 E019.47.21.892 N050.04.32.354 E019.47.21.939 Color_186ACI
N050.04.32.354 E019.47.21.939 N050.04.32.414 E019.47.21.927 Color_186ACI
N050.04.32.414 E019.47.21.927 N050.04.32.463 E019.47.21.858 Color_186ACI
N050.04.32.463 E019.47.21.858 N050.04.32.476 E019.47.21.779 Color_186ACI
N050.04.32.476 E019.47.21.779 N050.04.32.462 E019.47.21.698 Color_186ACI
N050.04.32.462 E019.47.21.698 N050.04.32.438 E019.47.21.653 Color_186ACI
N050.04.32.017 E019.47.18.681 N050.04.31.963 E019.47.18.646 Color_186ACI
N050.04.31.963 E019.47.18.646 N050.04.31.899 E019.47.18.666 Color_186ACI
N050.04.31.899 E019.47.18.666 N050.04.31.859 E019.47.18.730 Color_186ACI
N050.04.31.859 E019.47.18.730 N050.04.31.848 E019.47.18.834 Color_186ACI
N050.04.31.848 E019.47.18.834 N050.04.31.876 E019.47.18.920 Color_186ACI
N050.04.31.876 E019.47.18.920 N050.04.31.933 E019.47.18.967 Color_186ACI
N050.04.31.933 E019.47.18.967 N050.04.31.993 E019.47.18.955 Color_186ACI
N050.04.31.993 E019.47.18.955 N050.04.32.042 E019.47.18.886 Color_186ACI
N050.04.32.042 E019.47.18.886 N050.04.32.055 E019.47.18.807 Color_186ACI
N050.04.32.055 E019.47.18.807 N050.04.32.041 E019.47.18.726 Color_186ACI
N050.04.32.041 E019.47.18.726 N050.04.32.017 E019.47.18.681 Color_186ACI
N050.04.31.597 E019.47.15.738 N050.04.31.543 E019.47.15.703 Color_186ACI
N050.04.31.543 E019.47.15.703 N050.04.31.479 E019.47.15.723 Color_186ACI
N050.04.31.479 E019.47.15.723 N050.04.31.439 E019.47.15.787 Color_186ACI
N050.04.31.439 E019.47.15.787 N050.04.31.428 E019.47.15.891 Color_186ACI
N050.04.31.428 E019.47.15.891 N050.04.31.456 E019.47.15.977 Color_186ACI
N050.04.31.456 E019.47.15.977 N050.04.31.513 E019.47.16.024 Color_186ACI
N050.04.31.513 E019.47.16.024 N050.04.31.573 E019.47.16.012 Color_186ACI
N050.04.31.573 E019.47.16.012 N050.04.31.622 E019.47.15.943 Color_186ACI
N050.04.31.622 E019.47.15.943 N050.04.31.635 E019.47.15.864 Color_186ACI
N050.04.31.635 E019.47.15.864 N050.04.31.621 E019.47.15.783 Color_186ACI
N050.04.31.621 E019.47.15.783 N050.04.31.597 E019.47.15.738 Color_186ACI
N050.04.31.225 E019.47.13.064 N050.04.31.171 E019.47.13.028 Color_186ACI
N050.04.31.171 E019.47.13.028 N050.04.31.107 E019.47.13.048 Color_186ACI
N050.04.31.107 E019.47.13.048 N050.04.31.067 E019.47.13.112 Color_186ACI
N050.04.31.067 E019.47.13.112 N050.04.31.056 E019.47.13.216 Color_186ACI
N050.04.31.056 E019.47.13.216 N050.04.31.084 E019.47.13.302 Color_186ACI
N050.04.31.084 E019.47.13.302 N050.04.31.141 E019.47.13.349 Color_186ACI
N050.04.31.141 E019.47.13.349 N050.04.31.201 E019.47.13.337 Color_186ACI
N050.04.31.201 E019.47.13.337 N050.04.31.250 E019.47.13.268 Color_186ACI
N050.04.31.250 E019.47.13.268 N050.04.31.263 E019.47.13.189 Color_186ACI
N050.04.31.263 E019.47.13.189 N050.04.31.249 E019.47.13.108 Color_186ACI
N050.04.31.249 E019.47.13.108 N050.04.31.225 E019.47.13.064 Color_186ACI
N050.04.30.817 E019.47.10.128 N050.04.30.764 E019.47.10.092 Color_186ACI
N050.04.30.764 E019.47.10.092 N050.04.30.700 E019.47.10.113 Color_186ACI
N050.04.30.700 E019.47.10.113 N050.04.30.660 E019.47.10.176 Color_186ACI
N050.04.30.660 E019.47.10.176 N050.04.30.649 E019.47.10.280 Color_186ACI
N050.04.30.649 E019.47.10.280 N050.04.30.677 E019.47.10.366 Color_186ACI
N050.04.30.677 E019.47.10.366 N050.04.30.734 E019.47.10.413 Color_186ACI
N050.04.30.734 E019.47.10.413 N050.04.30.794 E019.47.10.402 Color_186ACI
N050.04.30.794 E019.47.10.402 N050.04.30.843 E019.47.10.332 Color_186ACI
N050.04.30.843 E019.47.10.332 N050.04.30.856 E019.47.10.253 Color_186ACI
N050.04.30.856 E019.47.10.253 N050.04.30.842 E019.47.10.172 Color_186ACI
N050.04.30.842 E019.47.10.172 N050.04.30.817 E019.47.10.128 Color_186ACI
N050.04.30.382 E019.47.07.138 N050.04.30.329 E019.47.07.102 Color_186ACI
N050.04.30.329 E019.47.07.102 N050.04.30.265 E019.47.07.123 Color_186ACI
N050.04.30.265 E019.47.07.123 N050.04.30.225 E019.47.07.186 Color_186ACI
N050.04.30.225 E019.47.07.186 N050.04.30.214 E019.47.07.290 Color_186ACI
N050.04.30.214 E019.47.07.290 N050.04.30.241 E019.47.07.376 Color_186ACI
N050.04.30.241 E019.47.07.376 N050.04.30.299 E019.47.07.424 Color_186ACI
N050.04.30.299 E019.47.07.424 N050.04.30.359 E019.47.07.412 Color_186ACI
N050.04.30.359 E019.47.07.412 N050.04.30.407 E019.47.07.343 Color_186ACI
N050.04.30.407 E019.47.07.343 N050.04.30.421 E019.47.07.263 Color_186ACI
N050.04.30.421 E019.47.07.263 N050.04.30.407 E019.47.07.183 Color_186ACI
N050.04.30.407 E019.47.07.183 N050.04.30.382 E019.47.07.138 Color_186ACI
N050.04.29.969 E019.47.04.186 N050.04.29.915 E019.47.04.150 Color_186ACI
N050.04.29.915 E019.47.04.150 N050.04.29.851 E019.47.04.171 Color_186ACI
N050.04.29.851 E019.47.04.171 N050.04.29.811 E019.47.04.234 Color_186ACI
N050.04.29.811 E019.47.04.234 N050.04.29.800 E019.47.04.338 Color_186ACI
N050.04.29.800 E019.47.04.338 N050.04.29.828 E019.47.04.424 Color_186ACI
N050.04.29.828 E019.47.04.424 N050.04.29.885 E019.47.04.472 Color_186ACI
N050.04.29.885 E019.47.04.472 N050.04.29.945 E019.47.04.460 Color_186ACI
N050.04.29.945 E019.47.04.460 N050.04.29.994 E019.47.04.391 Color_186ACI
N050.04.29.994 E019.47.04.391 N050.04.30.007 E019.47.04.311 Color_186ACI
N050.04.30.007 E019.47.04.311 N050.04.29.993 E019.47.04.231 Color_186ACI
N050.04.29.993 E019.47.04.231 N050.04.29.969 E019.47.04.186 Color_186ACI
N050.04.29.566 E019.47.01.227 N050.04.29.512 E019.47.01.191 Color_186ACI
N050.04.29.512 E019.47.01.191 N050.04.29.448 E019.47.01.212 Color_186ACI
N050.04.29.448 E019.47.01.212 N050.04.29.408 E019.47.01.275 Color_186ACI
N050.04.29.408 E019.47.01.275 N050.04.29.397 E019.47.01.379 Color_186ACI
N050.04.29.397 E019.47.01.379 N050.04.29.425 E019.47.01.465 Color_186ACI
N050.04.29.425 E019.47.01.465 N050.04.29.482 E019.47.01.513 Color_186ACI
N050.04.29.482 E019.47.01.513 N050.04.29.542 E019.47.01.501 Color_186ACI
N050.04.29.542 E019.47.01.501 N050.04.29.591 E019.47.01.432 Color_186ACI
N050.04.29.591 E019.47.01.432 N050.04.29.604 E019.47.01.352 Color_186ACI
N050.04.29.604 E019.47.01.352 N050.04.29.590 E019.47.01.271 Color_186ACI
N050.04.29.590 E019.47.01.271 N050.04.29.566 E019.47.01.227 Color_186ACI
N050.04.29.175 E019.46.58.308 N050.04.29.121 E019.46.58.273 Color_186ACI
N050.04.29.121 E019.46.58.273 N050.04.29.057 E019.46.58.293 Color_186ACI
N050.04.29.057 E019.46.58.293 N050.04.29.017 E019.46.58.357 Color_186ACI
N050.04.29.017 E019.46.58.357 N050.04.29.006 E019.46.58.461 Color_186ACI
N050.04.29.006 E019.46.58.461 N050.04.29.034 E019.46.58.547 Color_186ACI
N050.04.29.034 E019.46.58.547 N050.04.29.091 E019.46.58.594 Color_186ACI
N050.04.29.091 E019.46.58.594 N050.04.29.151 E019.46.58.582 Color_186ACI
N050.04.29.151 E019.46.58.582 N050.04.29.200 E019.46.58.513 Color_186ACI
N050.04.29.200 E019.46.58.513 N050.04.29.213 E019.46.58.434 Color_186ACI
N050.04.29.213 E019.46.58.434 N050.04.29.199 E019.46.58.353 Color_186ACI
N050.04.29.199 E019.46.58.353 N050.04.29.175 E019.46.58.308 Color_186ACI
N050.04.28.867 E019.46.56.267 N050.04.28.814 E019.46.56.231 Color_186ACI
N050.04.28.814 E019.46.56.231 N050.04.28.750 E019.46.56.251 Color_186ACI
N050.04.28.750 E019.46.56.251 N050.04.28.710 E019.46.56.315 Color_186ACI
N050.04.28.710 E019.46.56.315 N050.04.28.699 E019.46.56.419 Color_186ACI
N050.04.28.699 E019.46.56.419 N050.04.28.726 E019.46.56.505 Color_186ACI
N050.04.28.726 E019.46.56.505 N050.04.28.784 E019.46.56.552 Color_186ACI
N050.04.28.784 E019.46.56.552 N050.04.28.844 E019.46.56.540 Color_186ACI
N050.04.28.844 E019.46.56.540 N050.04.28.892 E019.46.56.471 Color_186ACI
N050.04.28.892 E019.46.56.471 N050.04.28.906 E019.46.56.392 Color_186ACI
N050.04.28.906 E019.46.56.392 N050.04.28.892 E019.46.56.311 Color_186ACI
N050.04.28.892 E019.46.56.311 N050.04.28.867 E019.46.56.267 Color_186ACI
N050.04.28.574 E019.46.54.184 N050.04.28.520 E019.46.54.148 Color_186ACI
N050.04.28.520 E019.46.54.148 N050.04.28.456 E019.46.54.169 Color_186ACI
N050.04.28.456 E019.46.54.169 N050.04.28.416 E019.46.54.232 Color_186ACI
N050.04.28.416 E019.46.54.232 N050.04.28.405 E019.46.54.336 Color_186ACI
N050.04.28.405 E019.46.54.336 N050.04.28.433 E019.46.54.422 Color_186ACI
N050.04.28.433 E019.46.54.422 N050.04.28.491 E019.46.54.470 Color_186ACI
N050.04.28.491 E019.46.54.470 N050.04.28.551 E019.46.54.458 Color_186ACI
N050.04.28.551 E019.46.54.458 N050.04.28.599 E019.46.54.389 Color_186ACI
N050.04.28.599 E019.46.54.389 N050.04.28.612 E019.46.54.309 Color_186ACI
N050.04.28.612 E019.46.54.309 N050.04.28.598 E019.46.54.228 Color_186ACI
N050.04.28.598 E019.46.54.228 N050.04.28.574 E019.46.54.184 Color_186ACI
N050.04.27.772 E019.46.48.353 N050.04.27.718 E019.46.48.318 Color_186ACI
N050.04.27.718 E019.46.48.318 N050.04.27.654 E019.46.48.338 Color_186ACI
N050.04.27.654 E019.46.48.338 N050.04.27.614 E019.46.48.402 Color_186ACI
N050.04.27.614 E019.46.48.402 N050.04.27.603 E019.46.48.506 Color_186ACI
N050.04.27.603 E019.46.48.506 N050.04.27.631 E019.46.48.592 Color_186ACI
N050.04.27.631 E019.46.48.592 N050.04.27.688 E019.46.48.639 Color_186ACI
N050.04.27.688 E019.46.48.639 N050.04.27.748 E019.46.48.627 Color_186ACI
N050.04.27.748 E019.46.48.627 N050.04.27.797 E019.46.48.558 Color_186ACI
N050.04.27.797 E019.46.48.558 N050.04.27.810 E019.46.48.479 Color_186ACI
N050.04.27.810 E019.46.48.479 N050.04.27.796 E019.46.48.398 Color_186ACI
N050.04.27.796 E019.46.48.398 N050.04.27.772 E019.46.48.353 Color_186ACI
N050.04.27.389 E019.46.45.634 N050.04.27.336 E019.46.45.598 Color_186ACI
N050.04.27.336 E019.46.45.598 N050.04.27.272 E019.46.45.619 Color_186ACI
N050.04.27.272 E019.46.45.619 N050.04.27.232 E019.46.45.682 Color_186ACI
N050.04.27.232 E019.46.45.682 N050.04.27.221 E019.46.45.786 Color_186ACI
N050.04.27.221 E019.46.45.786 N050.04.27.248 E019.46.45.872 Color_186ACI
N050.04.27.248 E019.46.45.872 N050.04.27.306 E019.46.45.920 Color_186ACI
N050.04.27.306 E019.46.45.920 N050.04.27.366 E019.46.45.908 Color_186ACI
N050.04.27.366 E019.46.45.908 N050.04.27.414 E019.46.45.839 Color_186ACI
N050.04.27.414 E019.46.45.839 N050.04.27.428 E019.46.45.759 Color_186ACI
N050.04.27.428 E019.46.45.759 N050.04.27.414 E019.46.45.678 Color_186ACI
N050.04.27.414 E019.46.45.678 N050.04.27.389 E019.46.45.634 Color_186ACI
N050.04.26.980 E019.46.42.684 N050.04.26.927 E019.46.42.649 Color_186ACI
N050.04.26.927 E019.46.42.649 N050.04.26.863 E019.46.42.669 Color_186ACI
N050.04.26.863 E019.46.42.669 N050.04.26.823 E019.46.42.732 Color_186ACI
N050.04.26.823 E019.46.42.732 N050.04.26.812 E019.46.42.836 Color_186ACI
N050.04.26.812 E019.46.42.836 N050.04.26.839 E019.46.42.923 Color_186ACI
N050.04.26.839 E019.46.42.923 N050.04.26.897 E019.46.42.970 Color_186ACI
N050.04.26.897 E019.46.42.970 N050.04.26.957 E019.46.42.958 Color_186ACI
N050.04.26.957 E019.46.42.958 N050.04.27.005 E019.46.42.889 Color_186ACI
N050.04.27.005 E019.46.42.889 N050.04.27.019 E019.46.42.809 Color_186ACI
N050.04.27.019 E019.46.42.809 N050.04.27.005 E019.46.42.729 Color_186ACI
N050.04.27.005 E019.46.42.729 N050.04.26.980 E019.46.42.684 Color_186ACI
N050.04.26.562 E019.46.39.718 N050.04.26.509 E019.46.39.683 Color_186ACI
N050.04.26.509 E019.46.39.683 N050.04.26.445 E019.46.39.703 Color_186ACI
N050.04.26.445 E019.46.39.703 N050.04.26.405 E019.46.39.766 Color_186ACI
N050.04.26.405 E019.46.39.766 N050.04.26.394 E019.46.39.870 Color_186ACI
N050.04.26.394 E019.46.39.870 N050.04.26.421 E019.46.39.957 Color_186ACI
N050.04.26.421 E019.46.39.957 N050.04.26.479 E019.46.40.004 Color_186ACI
N050.04.26.479 E019.46.40.004 N050.04.26.539 E019.46.39.992 Color_186ACI
N050.04.26.539 E019.46.39.992 N050.04.26.587 E019.46.39.923 Color_186ACI
N050.04.26.587 E019.46.39.923 N050.04.26.601 E019.46.39.843 Color_186ACI
N050.04.26.601 E019.46.39.843 N050.04.26.587 E019.46.39.763 Color_186ACI
N050.04.26.587 E019.46.39.763 N050.04.26.562 E019.46.39.718 Color_186ACI
N050.04.26.164 E019.46.36.780 N050.04.26.110 E019.46.36.744 Color_186ACI
N050.04.26.110 E019.46.36.744 N050.04.26.046 E019.46.36.765 Color_186ACI
N050.04.26.046 E019.46.36.765 N050.04.26.007 E019.46.36.828 Color_186ACI
N050.04.26.007 E019.46.36.828 N050.04.25.995 E019.46.36.932 Color_186ACI
N050.04.25.995 E019.46.36.932 N050.04.26.023 E019.46.37.018 Color_186ACI
N050.04.26.023 E019.46.37.018 N050.04.26.081 E019.46.37.066 Color_186ACI
N050.04.26.081 E019.46.37.066 N050.04.26.141 E019.46.37.054 Color_186ACI
N050.04.26.141 E019.46.37.054 N050.04.26.189 E019.46.36.985 Color_186ACI
N050.04.26.189 E019.46.36.985 N050.04.26.202 E019.46.36.905 Color_186ACI
N050.04.26.202 E019.46.36.905 N050.04.26.188 E019.46.36.825 Color_186ACI
N050.04.26.188 E019.46.36.825 N050.04.26.164 E019.46.36.780 Color_186ACI
N050.04.25.734 E019.46.33.811 N050.04.25.680 E019.46.33.775 Color_186ACI
N050.04.25.680 E019.46.33.775 N050.04.25.616 E019.46.33.795 Color_186ACI
N050.04.25.616 E019.46.33.795 N050.04.25.577 E019.46.33.859 Color_186ACI
N050.04.25.577 E019.46.33.859 N050.04.25.565 E019.46.33.963 Color_186ACI
N050.04.25.565 E019.46.33.963 N050.04.25.593 E019.46.34.049 Color_186ACI
N050.04.25.593 E019.46.34.049 N050.04.25.651 E019.46.34.096 Color_186ACI
N050.04.25.651 E019.46.34.096 N050.04.25.711 E019.46.34.084 Color_186ACI
N050.04.25.711 E019.46.34.084 N050.04.25.759 E019.46.34.015 Color_186ACI
N050.04.25.759 E019.46.34.015 N050.04.25.772 E019.46.33.936 Color_186ACI
N050.04.25.772 E019.46.33.936 N050.04.25.758 E019.46.33.855 Color_186ACI
N050.04.25.758 E019.46.33.855 N050.04.25.734 E019.46.33.811 Color_186ACI
N050.04.25.330 E019.46.30.881 N050.04.25.276 E019.46.30.845 Color_186ACI
N050.04.25.276 E019.46.30.845 N050.04.25.212 E019.46.30.866 Color_186ACI
N050.04.25.212 E019.46.30.866 N050.04.25.173 E019.46.30.929 Color_186ACI
N050.04.25.173 E019.46.30.929 N050.04.25.161 E019.46.31.033 Color_186ACI
N050.04.25.161 E019.46.31.033 N050.04.25.189 E019.46.31.119 Color_186ACI
N050.04.25.189 E019.46.31.119 N050.04.25.247 E019.46.31.167 Color_186ACI
N050.04.25.247 E019.46.31.167 N050.04.25.307 E019.46.31.155 Color_186ACI
N050.04.25.307 E019.46.31.155 N050.04.25.355 E019.46.31.086 Color_186ACI
N050.04.25.355 E019.46.31.086 N050.04.25.368 E019.46.31.006 Color_186ACI
N050.04.25.368 E019.46.31.006 N050.04.25.354 E019.46.30.925 Color_186ACI
N050.04.25.354 E019.46.30.925 N050.04.25.330 E019.46.30.881 Color_186ACI
N050.04.24.921 E019.46.27.913 N050.04.24.868 E019.46.27.877 Color_186ACI
N050.04.24.868 E019.46.27.877 N050.04.24.804 E019.46.27.898 Color_186ACI
N050.04.24.804 E019.46.27.898 N050.04.24.764 E019.46.27.961 Color_186ACI
N050.04.24.764 E019.46.27.961 N050.04.24.753 E019.46.28.065 Color_186ACI
N050.04.24.753 E019.46.28.065 N050.04.24.780 E019.46.28.151 Color_186ACI
N050.04.24.780 E019.46.28.151 N050.04.24.838 E019.46.28.199 Color_186ACI
N050.04.24.838 E019.46.28.199 N050.04.24.898 E019.46.28.187 Color_186ACI
N050.04.24.898 E019.46.28.187 N050.04.24.946 E019.46.28.118 Color_186ACI
N050.04.24.946 E019.46.28.118 N050.04.24.960 E019.46.28.038 Color_186ACI
N050.04.24.960 E019.46.28.038 N050.04.24.946 E019.46.27.957 Color_186ACI
N050.04.24.946 E019.46.27.957 N050.04.24.921 E019.46.27.913 Color_186ACI
N050.04.24.556 E019.46.25.353 N050.04.24.503 E019.46.25.317 Color_186ACI
N050.04.24.503 E019.46.25.317 N050.04.24.439 E019.46.25.338 Color_186ACI
N050.04.24.439 E019.46.25.338 N050.04.24.399 E019.46.25.401 Color_186ACI
N050.04.24.399 E019.46.25.401 N050.04.24.388 E019.46.25.505 Color_186ACI
N050.04.24.388 E019.46.25.505 N050.04.24.416 E019.46.25.591 Color_186ACI
N050.04.24.416 E019.46.25.591 N050.04.24.473 E019.46.25.639 Color_186ACI
N050.04.24.473 E019.46.25.639 N050.04.24.533 E019.46.25.627 Color_186ACI
N050.04.24.533 E019.46.25.627 N050.04.24.582 E019.46.25.558 Color_186ACI
N050.04.24.582 E019.46.25.558 N050.04.24.595 E019.46.25.478 Color_186ACI
N050.04.24.595 E019.46.25.478 N050.04.24.581 E019.46.25.397 Color_186ACI
N050.04.24.581 E019.46.25.397 N050.04.24.556 E019.46.25.353 Color_186ACI
N050.04.24.193 E019.46.22.807 N050.04.24.140 E019.46.22.772 Color_186ACI
N050.04.24.140 E019.46.22.772 N050.04.24.076 E019.46.22.792 Color_186ACI
N050.04.24.076 E019.46.22.792 N050.04.24.036 E019.46.22.856 Color_186ACI
N050.04.24.036 E019.46.22.856 N050.04.24.025 E019.46.22.960 Color_186ACI
N050.04.24.025 E019.46.22.960 N050.04.24.053 E019.46.23.046 Color_186ACI
N050.04.24.053 E019.46.23.046 N050.04.24.110 E019.46.23.093 Color_186ACI
N050.04.24.110 E019.46.23.093 N050.04.24.170 E019.46.23.081 Color_186ACI
N050.04.24.170 E019.46.23.081 N050.04.24.219 E019.46.23.012 Color_186ACI
N050.04.24.219 E019.46.23.012 N050.04.24.232 E019.46.22.933 Color_186ACI
N050.04.24.232 E019.46.22.933 N050.04.24.218 E019.46.22.852 Color_186ACI
N050.04.24.218 E019.46.22.852 N050.04.24.193 E019.46.22.807 Color_186ACI
N050.04.23.748 E019.46.19.623 N050.04.23.694 E019.46.19.588 Color_186ACI
N050.04.23.694 E019.46.19.588 N050.04.23.630 E019.46.19.608 Color_186ACI
N050.04.23.630 E019.46.19.608 N050.04.23.591 E019.46.19.671 Color_186ACI
N050.04.23.591 E019.46.19.671 N050.04.23.579 E019.46.19.775 Color_186ACI
N050.04.23.579 E019.46.19.775 N050.04.23.607 E019.46.19.862 Color_186ACI
N050.04.23.607 E019.46.19.862 N050.04.23.665 E019.46.19.909 Color_186ACI
N050.04.23.665 E019.46.19.909 N050.04.23.725 E019.46.19.897 Color_186ACI
N050.04.23.725 E019.46.19.897 N050.04.23.773 E019.46.19.828 Color_186ACI
N050.04.23.773 E019.46.19.828 N050.04.23.786 E019.46.19.748 Color_186ACI
N050.04.23.786 E019.46.19.748 N050.04.23.772 E019.46.19.668 Color_186ACI
N050.04.23.772 E019.46.19.668 N050.04.23.748 E019.46.19.623 Color_186ACI
N050.04.23.474 E019.46.17.659 N050.04.23.420 E019.46.17.623 Color_186ACI
N050.04.23.420 E019.46.17.623 N050.04.23.356 E019.46.17.644 Color_186ACI
N050.04.23.356 E019.46.17.644 N050.04.23.317 E019.46.17.707 Color_186ACI
N050.04.23.317 E019.46.17.707 N050.04.23.305 E019.46.17.811 Color_186ACI
N050.04.23.305 E019.46.17.811 N050.04.23.333 E019.46.17.897 Color_186ACI
N050.04.23.333 E019.46.17.897 N050.04.23.391 E019.46.17.945 Color_186ACI
N050.04.23.391 E019.46.17.945 N050.04.23.451 E019.46.17.933 Color_186ACI
N050.04.23.451 E019.46.17.933 N050.04.23.499 E019.46.17.864 Color_186ACI
N050.04.23.499 E019.46.17.864 N050.04.23.512 E019.46.17.784 Color_186ACI
N050.04.23.512 E019.46.17.784 N050.04.23.498 E019.46.17.703 Color_186ACI
N050.04.23.498 E019.46.17.703 N050.04.23.474 E019.46.17.659 Color_186ACI
N050.04.23.150 E019.46.15.384 N050.04.23.096 E019.46.15.348 Color_186ACI
N050.04.23.096 E019.46.15.348 N050.04.23.032 E019.46.15.369 Color_186ACI
N050.04.23.032 E019.46.15.369 N050.04.22.992 E019.46.15.432 Color_186ACI
N050.04.22.992 E019.46.15.432 N050.04.22.981 E019.46.15.536 Color_186ACI
N050.04.22.981 E019.46.15.536 N050.04.23.009 E019.46.15.622 Color_186ACI
N050.04.23.009 E019.46.15.622 N050.04.23.066 E019.46.15.670 Color_186ACI
N050.04.23.066 E019.46.15.670 N050.04.23.126 E019.46.15.658 Color_186ACI
N050.04.23.126 E019.46.15.658 N050.04.23.175 E019.46.15.589 Color_186ACI
N050.04.23.175 E019.46.15.589 N050.04.23.188 E019.46.15.509 Color_186ACI
N050.04.23.188 E019.46.15.509 N050.04.23.174 E019.46.15.428 Color_186ACI
N050.04.23.174 E019.46.15.428 N050.04.23.150 E019.46.15.384 Color_186ACI
N050.04.22.839 E019.46.13.200 N050.04.22.785 E019.46.13.165 Color_186ACI
N050.04.22.785 E019.46.13.165 N050.04.22.721 E019.46.13.185 Color_186ACI
N050.04.22.721 E019.46.13.185 N050.04.22.681 E019.46.13.249 Color_186ACI
N050.04.22.681 E019.46.13.249 N050.04.22.670 E019.46.13.353 Color_186ACI
N050.04.22.670 E019.46.13.353 N050.04.22.698 E019.46.13.439 Color_186ACI
N050.04.22.698 E019.46.13.439 N050.04.22.755 E019.46.13.486 Color_186ACI
N050.04.22.755 E019.46.13.486 N050.04.22.815 E019.46.13.474 Color_186ACI
N050.04.22.815 E019.46.13.474 N050.04.22.864 E019.46.13.405 Color_186ACI
N050.04.22.864 E019.46.13.405 N050.04.22.877 E019.46.13.326 Color_186ACI
N050.04.22.877 E019.46.13.326 N050.04.22.863 E019.46.13.245 Color_186ACI
N050.04.22.863 E019.46.13.245 N050.04.22.839 E019.46.13.200 Color_186ACI
N050.04.22.550 E019.46.11.153 N050.04.22.496 E019.46.11.118 Color_186ACI
N050.04.22.496 E019.46.11.118 N050.04.22.432 E019.46.11.138 Color_186ACI
N050.04.22.432 E019.46.11.138 N050.04.22.392 E019.46.11.201 Color_186ACI
N050.04.22.392 E019.46.11.201 N050.04.22.381 E019.46.11.306 Color_186ACI
N050.04.22.381 E019.46.11.306 N050.04.22.409 E019.46.11.392 Color_186ACI
N050.04.22.409 E019.46.11.392 N050.04.22.466 E019.46.11.439 Color_186ACI
N050.04.22.466 E019.46.11.439 N050.04.22.526 E019.46.11.427 Color_186ACI
N050.04.22.526 E019.46.11.427 N050.04.22.575 E019.46.11.358 Color_186ACI
N050.04.22.575 E019.46.11.358 N050.04.22.588 E019.46.11.278 Color_186ACI
N050.04.22.588 E019.46.11.278 N050.04.22.574 E019.46.11.198 Color_186ACI
N050.04.22.574 E019.46.11.198 N050.04.22.550 E019.46.11.153 Color_186ACI
N050.04.22.347 E019.46.09.571 N050.04.22.293 E019.46.09.536 Color_186ACI
N050.04.22.293 E019.46.09.536 N050.04.22.229 E019.46.09.556 Color_186ACI
N050.04.22.229 E019.46.09.556 N050.04.22.190 E019.46.09.620 Color_186ACI
N050.04.22.190 E019.46.09.620 N050.04.22.178 E019.46.09.724 Color_186ACI
N050.04.22.178 E019.46.09.724 N050.04.22.206 E019.46.09.810 Color_186ACI
N050.04.22.206 E019.46.09.810 N050.04.22.264 E019.46.09.857 Color_186ACI
N050.04.22.264 E019.46.09.857 N050.04.22.324 E019.46.09.845 Color_186ACI
N050.04.22.324 E019.46.09.845 N050.04.22.372 E019.46.09.776 Color_186ACI
N050.04.22.372 E019.46.09.776 N050.04.22.385 E019.46.09.697 Color_186ACI
N050.04.22.385 E019.46.09.697 N050.04.22.371 E019.46.09.616 Color_186ACI
N050.04.22.371 E019.46.09.616 N050.04.22.347 E019.46.09.571 Color_186ACI
N050.04.22.105 E019.46.07.862 N050.04.22.051 E019.46.07.826 Color_186ACI
N050.04.22.051 E019.46.07.826 N050.04.21.987 E019.46.07.847 Color_186ACI
N050.04.21.987 E019.46.07.847 N050.04.21.947 E019.46.07.910 Color_186ACI
N050.04.21.947 E019.46.07.910 N050.04.21.936 E019.46.08.014 Color_186ACI
N050.04.21.936 E019.46.08.014 N050.04.21.964 E019.46.08.100 Color_186ACI
N050.04.21.964 E019.46.08.100 N050.04.22.022 E019.46.08.148 Color_186ACI
N050.04.22.022 E019.46.08.148 N050.04.22.082 E019.46.08.136 Color_186ACI
N050.04.22.082 E019.46.08.136 N050.04.22.130 E019.46.08.067 Color_186ACI
N050.04.22.130 E019.46.08.067 N050.04.22.143 E019.46.07.987 Color_186ACI
N050.04.22.143 E019.46.07.987 N050.04.22.129 E019.46.07.906 Color_186ACI
N050.04.22.129 E019.46.07.906 N050.04.22.105 E019.46.07.862 Color_186ACI
N050.04.23.142 E019.46.07.459 N050.04.23.088 E019.46.07.424 Color_186ACI
N050.04.23.088 E019.46.07.424 N050.04.23.024 E019.46.07.444 Color_186ACI
N050.04.23.024 E019.46.07.444 N050.04.22.984 E019.46.07.507 Color_186ACI
N050.04.22.984 E019.46.07.507 N050.04.22.973 E019.46.07.611 Color_186ACI
N050.04.22.973 E019.46.07.611 N050.04.23.001 E019.46.07.697 Color_186ACI
N050.04.23.001 E019.46.07.697 N050.04.23.059 E019.46.07.745 Color_186ACI
N050.04.23.059 E019.46.07.745 N050.04.23.119 E019.46.07.733 Color_186ACI
N050.04.23.119 E019.46.07.733 N050.04.23.167 E019.46.07.664 Color_186ACI
N050.04.23.167 E019.46.07.664 N050.04.23.180 E019.46.07.584 Color_186ACI
N050.04.23.180 E019.46.07.584 N050.04.23.166 E019.46.07.504 Color_186ACI
N050.04.23.166 E019.46.07.504 N050.04.23.142 E019.46.07.459 Color_186ACI
N050.04.24.082 E019.46.07.107 N050.04.24.029 E019.46.07.072 Color_186ACI
N050.04.24.029 E019.46.07.072 N050.04.23.965 E019.46.07.092 Color_186ACI
N050.04.23.965 E019.46.07.092 N050.04.23.925 E019.46.07.156 Color_186ACI
N050.04.23.925 E019.46.07.156 N050.04.23.914 E019.46.07.260 Color_186ACI
N050.04.23.914 E019.46.07.260 N050.04.23.942 E019.46.07.346 Color_186ACI
N050.04.23.942 E019.46.07.346 N050.04.23.999 E019.46.07.393 Color_186ACI
N050.04.23.999 E019.46.07.393 N050.04.24.059 E019.46.07.381 Color_186ACI
N050.04.24.059 E019.46.07.381 N050.04.24.108 E019.46.07.312 Color_186ACI
N050.04.24.108 E019.46.07.312 N050.04.24.121 E019.46.07.233 Color_186ACI
N050.04.24.121 E019.46.07.233 N050.04.24.107 E019.46.07.152 Color_186ACI
N050.04.24.107 E019.46.07.152 N050.04.24.082 E019.46.07.107 Color_186ACI
N050.04.25.648 E019.46.06.581 N050.04.25.594 E019.46.06.545 Color_186ACI
N050.04.25.594 E019.46.06.545 N050.04.25.530 E019.46.06.566 Color_186ACI
N050.04.25.530 E019.46.06.566 N050.04.25.490 E019.46.06.629 Color_186ACI
N050.04.25.490 E019.46.06.629 N050.04.25.479 E019.46.06.733 Color_186ACI
N050.04.25.479 E019.46.06.733 N050.04.25.507 E019.46.06.819 Color_186ACI
N050.04.25.507 E019.46.06.819 N050.04.25.564 E019.46.06.867 Color_186ACI
N050.04.25.564 E019.46.06.867 N050.04.25.624 E019.46.06.855 Color_186ACI
N050.04.25.624 E019.46.06.855 N050.04.25.673 E019.46.06.786 Color_186ACI
N050.04.25.673 E019.46.06.786 N050.04.25.686 E019.46.06.706 Color_186ACI
N050.04.25.686 E019.46.06.706 N050.04.25.672 E019.46.06.625 Color_186ACI
N050.04.25.672 E019.46.06.625 N050.04.25.648 E019.46.06.581 Color_186ACI
N050.04.27.195 E019.46.06.012 N050.04.27.141 E019.46.05.977 Color_186ACI
N050.04.27.141 E019.46.05.977 N050.04.27.077 E019.46.05.997 Color_186ACI
N050.04.27.077 E019.46.05.997 N050.04.27.037 E019.46.06.060 Color_186ACI
N050.04.27.037 E019.46.06.060 N050.04.27.026 E019.46.06.164 Color_186ACI
N050.04.27.026 E019.46.06.164 N050.04.27.054 E019.46.06.251 Color_186ACI
N050.04.27.054 E019.46.06.251 N050.04.27.111 E019.46.06.298 Color_186ACI
N050.04.27.111 E019.46.06.298 N050.04.27.171 E019.46.06.286 Color_186ACI
N050.04.27.171 E019.46.06.286 N050.04.27.220 E019.46.06.217 Color_186ACI
N050.04.27.220 E019.46.06.217 N050.04.27.233 E019.46.06.137 Color_186ACI
N050.04.27.233 E019.46.06.137 N050.04.27.219 E019.46.06.057 Color_186ACI
N050.04.27.219 E019.46.06.057 N050.04.27.195 E019.46.06.012 Color_186ACI
N050.04.28.684 E019.46.05.492 N050.04.28.630 E019.46.05.457 Color_186ACI
N050.04.28.630 E019.46.05.457 N050.04.28.566 E019.46.05.477 Color_186ACI
N050.04.28.566 E019.46.05.477 N050.04.28.526 E019.46.05.540 Color_186ACI
N050.04.28.526 E019.46.05.540 N050.04.28.515 E019.46.05.644 Color_186ACI
N050.04.28.515 E019.46.05.644 N050.04.28.543 E019.46.05.731 Color_186ACI
N050.04.28.543 E019.46.05.731 N050.04.28.600 E019.46.05.778 Color_186ACI
N050.04.28.600 E019.46.05.778 N050.04.28.660 E019.46.05.766 Color_186ACI
N050.04.28.660 E019.46.05.766 N050.04.28.709 E019.46.05.697 Color_186ACI
N050.04.28.709 E019.46.05.697 N050.04.28.722 E019.46.05.617 Color_186ACI
N050.04.28.722 E019.46.05.617 N050.04.28.708 E019.46.05.537 Color_186ACI
N050.04.28.708 E019.46.05.537 N050.04.28.684 E019.46.05.492 Color_186ACI
N050.04.29.878 E019.46.05.042 N050.04.29.824 E019.46.05.006 Color_186ACI
N050.04.29.824 E019.46.05.006 N050.04.29.760 E019.46.05.027 Color_186ACI
N050.04.29.760 E019.46.05.027 N050.04.29.720 E019.46.05.090 Color_186ACI
N050.04.29.720 E019.46.05.090 N050.04.29.709 E019.46.05.194 Color_186ACI
N050.04.29.709 E019.46.05.194 N050.04.29.737 E019.46.05.280 Color_186ACI
N050.04.29.737 E019.46.05.280 N050.04.29.794 E019.46.05.327 Color_186ACI
N050.04.29.794 E019.46.05.327 N050.04.29.854 E019.46.05.316 Color_186ACI
N050.04.29.854 E019.46.05.316 N050.04.29.903 E019.46.05.246 Color_186ACI
N050.04.29.903 E019.46.05.246 N050.04.29.916 E019.46.05.167 Color_186ACI
N050.04.29.916 E019.46.05.167 N050.04.29.902 E019.46.05.086 Color_186ACI
N050.04.29.902 E019.46.05.086 N050.04.29.878 E019.46.05.042 Color_186ACI
N050.04.28.927 E019.46.07.015 N050.04.28.873 E019.46.06.979 Color_186ACI
N050.04.28.873 E019.46.06.979 N050.04.28.809 E019.46.06.999 Color_186ACI
N050.04.28.809 E019.46.06.999 N050.04.28.769 E019.46.07.063 Color_186ACI
N050.04.28.769 E019.46.07.063 N050.04.28.758 E019.46.07.167 Color_186ACI
N050.04.28.758 E019.46.07.167 N050.04.28.786 E019.46.07.253 Color_186ACI
N050.04.28.786 E019.46.07.253 N050.04.28.843 E019.46.07.300 Color_186ACI
N050.04.28.843 E019.46.07.300 N050.04.28.904 E019.46.07.288 Color_186ACI
N050.04.28.904 E019.46.07.288 N050.04.28.952 E019.46.07.219 Color_186ACI
N050.04.28.952 E019.46.07.219 N050.04.28.965 E019.46.07.140 Color_186ACI
N050.04.28.965 E019.46.07.140 N050.04.28.951 E019.46.07.059 Color_186ACI
N050.04.28.951 E019.46.07.059 N050.04.28.927 E019.46.07.015 Color_186ACI
N050.04.30.389 E019.46.07.931 N050.04.30.335 E019.46.07.896 Color_186ACI
N050.04.30.335 E019.46.07.896 N050.04.30.271 E019.46.07.916 Color_186ACI
N050.04.30.271 E019.46.07.916 N050.04.30.232 E019.46.07.980 Color_186ACI
N050.04.30.232 E019.46.07.980 N050.04.30.220 E019.46.08.084 Color_186ACI
N050.04.30.220 E019.46.08.084 N050.04.30.248 E019.46.08.170 Color_186ACI
N050.04.30.248 E019.46.08.170 N050.04.30.306 E019.46.08.217 Color_186ACI
N050.04.30.306 E019.46.08.217 N050.04.30.366 E019.46.08.205 Color_186ACI
N050.04.30.366 E019.46.08.205 N050.04.30.414 E019.46.08.136 Color_186ACI
N050.04.30.414 E019.46.08.136 N050.04.30.427 E019.46.08.057 Color_186ACI
N050.04.30.427 E019.46.08.057 N050.04.30.413 E019.46.07.976 Color_186ACI
N050.04.30.413 E019.46.07.976 N050.04.30.389 E019.46.07.931 Color_186ACI
N050.04.30.087 E019.46.07.266 N050.04.30.034 E019.46.07.230 Color_186ACI
N050.04.30.034 E019.46.07.230 N050.04.29.970 E019.46.07.251 Color_186ACI
N050.04.29.970 E019.46.07.251 N050.04.29.930 E019.46.07.314 Color_186ACI
N050.04.29.930 E019.46.07.314 N050.04.29.919 E019.46.07.418 Color_186ACI
N050.04.29.919 E019.46.07.418 N050.04.29.946 E019.46.07.504 Color_186ACI
N050.04.29.946 E019.46.07.504 N050.04.30.004 E019.46.07.552 Color_186ACI
N050.04.30.004 E019.46.07.552 N050.04.30.064 E019.46.07.540 Color_186ACI
N050.04.30.064 E019.46.07.540 N050.04.30.112 E019.46.07.471 Color_186ACI
N050.04.30.112 E019.46.07.471 N050.04.30.126 E019.46.07.391 Color_186ACI
N050.04.30.126 E019.46.07.391 N050.04.30.112 E019.46.07.311 Color_186ACI
N050.04.30.112 E019.46.07.311 N050.04.30.087 E019.46.07.266 Color_186ACI
N050.04.29.481 E019.46.07.110 N050.04.29.427 E019.46.07.074 Color_186ACI
N050.04.29.427 E019.46.07.074 N050.04.29.363 E019.46.07.095 Color_186ACI
N050.04.29.363 E019.46.07.095 N050.04.29.324 E019.46.07.158 Color_186ACI
N050.04.29.324 E019.46.07.158 N050.04.29.312 E019.46.07.262 Color_186ACI
N050.04.29.312 E019.46.07.262 N050.04.29.340 E019.46.07.348 Color_186ACI
N050.04.29.340 E019.46.07.348 N050.04.29.398 E019.46.07.396 Color_186ACI
N050.04.29.398 E019.46.07.396 N050.04.29.458 E019.46.07.384 Color_186ACI
N050.04.29.458 E019.46.07.384 N050.04.29.506 E019.46.07.315 Color_186ACI
N050.04.29.506 E019.46.07.315 N050.04.29.519 E019.46.07.235 Color_186ACI
N050.04.29.519 E019.46.07.235 N050.04.29.505 E019.46.07.154 Color_186ACI
N050.04.29.505 E019.46.07.154 N050.04.29.481 E019.46.07.110 Color_186ACI
N050.04.27.407 E019.46.07.534 N050.04.27.354 E019.46.07.499 Color_186ACI
N050.04.27.354 E019.46.07.499 N050.04.27.290 E019.46.07.519 Color_186ACI
N050.04.27.290 E019.46.07.519 N050.04.27.250 E019.46.07.583 Color_186ACI
N050.04.27.250 E019.46.07.583 N050.04.27.239 E019.46.07.687 Color_186ACI
N050.04.27.239 E019.46.07.687 N050.04.27.266 E019.46.07.773 Color_186ACI
N050.04.27.266 E019.46.07.773 N050.04.27.324 E019.46.07.820 Color_186ACI
N050.04.27.324 E019.46.07.820 N050.04.27.384 E019.46.07.808 Color_186ACI
N050.04.27.384 E019.46.07.808 N050.04.27.432 E019.46.07.739 Color_186ACI
N050.04.27.432 E019.46.07.739 N050.04.27.446 E019.46.07.660 Color_186ACI
N050.04.27.446 E019.46.07.660 N050.04.27.432 E019.46.07.579 Color_186ACI
N050.04.27.432 E019.46.07.579 N050.04.27.407 E019.46.07.534 Color_186ACI
N050.04.25.846 E019.46.08.061 N050.04.25.792 E019.46.08.026 Color_186ACI
N050.04.25.792 E019.46.08.026 N050.04.25.728 E019.46.08.046 Color_186ACI
N050.04.25.728 E019.46.08.046 N050.04.25.689 E019.46.08.110 Color_186ACI
N050.04.25.689 E019.46.08.110 N050.04.25.677 E019.46.08.214 Color_186ACI
N050.04.25.677 E019.46.08.214 N050.04.25.705 E019.46.08.300 Color_186ACI
N050.04.25.705 E019.46.08.300 N050.04.25.763 E019.46.08.347 Color_186ACI
N050.04.25.763 E019.46.08.347 N050.04.25.823 E019.46.08.335 Color_186ACI
N050.04.25.823 E019.46.08.335 N050.04.25.871 E019.46.08.266 Color_186ACI
N050.04.25.871 E019.46.08.266 N050.04.25.884 E019.46.08.187 Color_186ACI
N050.04.25.884 E019.46.08.187 N050.04.25.870 E019.46.08.106 Color_186ACI
N050.04.25.870 E019.46.08.106 N050.04.25.846 E019.46.08.061 Color_186ACI
N050.04.24.273 E019.46.08.650 N050.04.24.220 E019.46.08.615 Color_186ACI
N050.04.24.220 E019.46.08.615 N050.04.24.156 E019.46.08.635 Color_186ACI
N050.04.24.156 E019.46.08.635 N050.04.24.116 E019.46.08.699 Color_186ACI
N050.04.24.116 E019.46.08.699 N050.04.24.105 E019.46.08.803 Color_186ACI
N050.04.24.105 E019.46.08.803 N050.04.24.133 E019.46.08.889 Color_186ACI
N050.04.24.133 E019.46.08.889 N050.04.24.190 E019.46.08.936 Color_186ACI
N050.04.24.190 E019.46.08.936 N050.04.24.250 E019.46.08.924 Color_186ACI
N050.04.24.250 E019.46.08.924 N050.04.24.299 E019.46.08.855 Color_186ACI
N050.04.24.299 E019.46.08.855 N050.04.24.312 E019.46.08.776 Color_186ACI
N050.04.24.312 E019.46.08.776 N050.04.24.298 E019.46.08.695 Color_186ACI
N050.04.24.298 E019.46.08.695 N050.04.24.273 E019.46.08.650 Color_186ACI
N050.04.24.007 E019.46.08.989 N050.04.23.954 E019.46.08.953 Color_186ACI
N050.04.23.954 E019.46.08.953 N050.04.23.890 E019.46.08.974 Color_186ACI
N050.04.23.890 E019.46.08.974 N050.04.23.850 E019.46.09.037 Color_186ACI
N050.04.23.850 E019.46.09.037 N050.04.23.839 E019.46.09.141 Color_186ACI
N050.04.23.839 E019.46.09.141 N050.04.23.867 E019.46.09.227 Color_186ACI
N050.04.23.867 E019.46.09.227 N050.04.23.924 E019.46.09.275 Color_186ACI
N050.04.23.924 E019.46.09.275 N050.04.23.984 E019.46.09.263 Color_186ACI
N050.04.23.984 E019.46.09.263 N050.04.24.033 E019.46.09.194 Color_186ACI
N050.04.24.033 E019.46.09.194 N050.04.24.046 E019.46.09.114 Color_186ACI
N050.04.24.046 E019.46.09.114 N050.04.24.032 E019.46.09.034 Color_186ACI
N050.04.24.032 E019.46.09.034 N050.04.24.007 E019.46.08.989 Color_186ACI
N050.04.23.697 E019.46.09.423 N050.04.23.643 E019.46.09.388 Color_186ACI
N050.04.23.643 E019.46.09.388 N050.04.23.579 E019.46.09.408 Color_186ACI
N050.04.23.579 E019.46.09.408 N050.04.23.539 E019.46.09.472 Color_186ACI
N050.04.23.539 E019.46.09.472 N050.04.23.528 E019.46.09.576 Color_186ACI
N050.04.23.528 E019.46.09.576 N050.04.23.556 E019.46.09.662 Color_186ACI
N050.04.23.556 E019.46.09.662 N050.04.23.614 E019.46.09.709 Color_186ACI
N050.04.23.614 E019.46.09.709 N050.04.23.674 E019.46.09.697 Color_186ACI
N050.04.23.674 E019.46.09.697 N050.04.23.722 E019.46.09.628 Color_186ACI
N050.04.23.722 E019.46.09.628 N050.04.23.735 E019.46.09.549 Color_186ACI
N050.04.23.735 E019.46.09.549 N050.04.23.721 E019.46.09.468 Color_186ACI
N050.04.23.721 E019.46.09.468 N050.04.23.697 E019.46.09.423 Color_186ACI
N050.04.23.598 E019.46.10.016 N050.04.23.544 E019.46.09.981 Color_186ACI
N050.04.23.544 E019.46.09.981 N050.04.23.480 E019.46.10.001 Color_186ACI
N050.04.23.480 E019.46.10.001 N050.04.23.441 E019.46.10.065 Color_186ACI
N050.04.23.441 E019.46.10.065 N050.04.23.429 E019.46.10.169 Color_186ACI
N050.04.23.429 E019.46.10.169 N050.04.23.457 E019.46.10.255 Color_186ACI
N050.04.23.457 E019.46.10.255 N050.04.23.515 E019.46.10.302 Color_186ACI
N050.04.23.515 E019.46.10.302 N050.04.23.575 E019.46.10.290 Color_186ACI
N050.04.23.575 E019.46.10.290 N050.04.23.623 E019.46.10.221 Color_186ACI
N050.04.23.623 E019.46.10.221 N050.04.23.636 E019.46.10.142 Color_186ACI
N050.04.23.636 E019.46.10.142 N050.04.23.622 E019.46.10.061 Color_186ACI
N050.04.23.622 E019.46.10.061 N050.04.23.598 E019.46.10.016 Color_186ACI
N050.04.23.524 E019.46.10.836 N050.04.23.470 E019.46.10.801 Color_186ACI
N050.04.23.470 E019.46.10.801 N050.04.23.406 E019.46.10.821 Color_186ACI
N050.04.23.406 E019.46.10.821 N050.04.23.366 E019.46.10.885 Color_186ACI
N050.04.23.366 E019.46.10.885 N050.04.23.355 E019.46.10.989 Color_186ACI
N050.04.23.355 E019.46.10.989 N050.04.23.383 E019.46.11.075 Color_186ACI
N050.04.23.383 E019.46.11.075 N050.04.23.441 E019.46.11.122 Color_186ACI
N050.04.23.441 E019.46.11.122 N050.04.23.501 E019.46.11.110 Color_186ACI
N050.04.23.501 E019.46.11.110 N050.04.23.549 E019.46.11.041 Color_186ACI
N050.04.23.549 E019.46.11.041 N050.04.23.562 E019.46.10.962 Color_186ACI
N050.04.23.562 E019.46.10.962 N050.04.23.548 E019.46.10.881 Color_186ACI
N050.04.23.548 E019.46.10.881 N050.04.23.524 E019.46.10.836 Color_186ACI
N050.04.23.832 E019.46.12.885 N050.04.23.778 E019.46.12.849 Color_186ACI
N050.04.23.778 E019.46.12.849 N050.04.23.714 E019.46.12.870 Color_186ACI
N050.04.23.714 E019.46.12.870 N050.04.23.674 E019.46.12.933 Color_186ACI
N050.04.23.674 E019.46.12.933 N050.04.23.663 E019.46.13.037 Color_186ACI
N050.04.23.663 E019.46.13.037 N050.04.23.691 E019.46.13.123 Color_186ACI
N050.04.23.691 E019.46.13.123 N050.04.23.748 E019.46.13.171 Color_186ACI
N050.04.23.748 E019.46.13.171 N050.04.23.808 E019.46.13.159 Color_186ACI
N050.04.23.808 E019.46.13.159 N050.04.23.857 E019.46.13.090 Color_186ACI
N050.04.23.857 E019.46.13.090 N050.04.23.870 E019.46.13.010 Color_186ACI
N050.04.23.870 E019.46.13.010 N050.04.23.856 E019.46.12.929 Color_186ACI
N050.04.23.856 E019.46.12.929 N050.04.23.832 E019.46.12.885 Color_186ACI
N050.04.24.121 E019.46.15.021 N050.04.24.068 E019.46.14.985 Color_186ACI
N050.04.24.068 E019.46.14.985 N050.04.24.004 E019.46.15.006 Color_186ACI
N050.04.24.004 E019.46.15.006 N050.04.23.964 E019.46.15.069 Color_186ACI
N050.04.23.964 E019.46.15.069 N050.04.23.953 E019.46.15.173 Color_186ACI
N050.04.23.953 E019.46.15.173 N050.04.23.980 E019.46.15.259 Color_186ACI
N050.04.23.980 E019.46.15.259 N050.04.24.038 E019.46.15.306 Color_186ACI
N050.04.24.038 E019.46.15.306 N050.04.24.098 E019.46.15.295 Color_186ACI
N050.04.24.098 E019.46.15.295 N050.04.24.146 E019.46.15.225 Color_186ACI
N050.04.24.146 E019.46.15.225 N050.04.24.160 E019.46.15.146 Color_186ACI
N050.04.24.160 E019.46.15.146 N050.04.24.146 E019.46.15.065 Color_186ACI
N050.04.24.146 E019.46.15.065 N050.04.24.121 E019.46.15.021 Color_186ACI
N050.04.24.442 E019.46.17.281 N050.04.24.388 E019.46.17.245 Color_186ACI
N050.04.24.388 E019.46.17.245 N050.04.24.324 E019.46.17.265 Color_186ACI
N050.04.24.324 E019.46.17.265 N050.04.24.284 E019.46.17.329 Color_186ACI
N050.04.24.284 E019.46.17.329 N050.04.24.273 E019.46.17.433 Color_186ACI
N050.04.24.273 E019.46.17.433 N050.04.24.301 E019.46.17.519 Color_186ACI
N050.04.24.301 E019.46.17.519 N050.04.24.358 E019.46.17.566 Color_186ACI
N050.04.24.358 E019.46.17.566 N050.04.24.418 E019.46.17.554 Color_186ACI
N050.04.24.418 E019.46.17.554 N050.04.24.467 E019.46.17.485 Color_186ACI
N050.04.24.467 E019.46.17.485 N050.04.24.480 E019.46.17.406 Color_186ACI
N050.04.24.480 E019.46.17.406 N050.04.24.466 E019.46.17.325 Color_186ACI
N050.04.24.466 E019.46.17.325 N050.04.24.442 E019.46.17.281 Color_186ACI
;park_dots N000.00.00.000 E000.00.00.000 N000.00.00.000 E000.00.00.000
N050.04.35.741 E019.47.54.513 N050.04.35.687 E019.47.54.478 Color_44ACI
N050.04.35.687 E019.47.54.478 N050.04.35.623 E019.47.54.498 Color_44ACI
N050.04.35.623 E019.47.54.498 N050.04.35.583 E019.47.54.562 Color_44ACI
N050.04.35.583 E019.47.54.562 N050.04.35.572 E019.47.54.666 Color_44ACI
N050.04.35.572 E019.47.54.666 N050.04.35.600 E019.47.54.752 Color_44ACI
N050.04.35.600 E019.47.54.752 N050.04.35.657 E019.47.54.799 Color_44ACI
N050.04.35.657 E019.47.54.799 N050.04.35.717 E019.47.54.787 Color_44ACI
N050.04.35.717 E019.47.54.787 N050.04.35.766 E019.47.54.718 Color_44ACI
N050.04.35.766 E019.47.54.718 N050.04.35.779 E019.47.54.639 Color_44ACI
N050.04.35.779 E019.47.54.639 N050.04.35.765 E019.47.54.558 Color_44ACI
N050.04.35.765 E019.47.54.558 N050.04.35.741 E019.47.54.513 Color_44ACI
N050.04.33.355 E019.47.59.824 N050.04.33.302 E019.47.59.789 Color_44ACI
N050.04.33.302 E019.47.59.789 N050.04.33.238 E019.47.59.809 Color_44ACI
N050.04.33.238 E019.47.59.809 N050.04.33.198 E019.47.59.873 Color_44ACI
N050.04.33.198 E019.47.59.873 N050.04.33.187 E019.47.59.977 Color_44ACI
N050.04.33.187 E019.47.59.977 N050.04.33.214 E019.48.00.063 Color_44ACI
N050.04.33.214 E019.48.00.063 N050.04.33.272 E019.48.00.110 Color_44ACI
N050.04.33.272 E019.48.00.110 N050.04.33.332 E019.48.00.098 Color_44ACI
N050.04.33.332 E019.48.00.098 N050.04.33.380 E019.48.00.029 Color_44ACI
N050.04.33.380 E019.48.00.029 N050.04.33.394 E019.47.59.950 Color_44ACI
N050.04.33.394 E019.47.59.950 N050.04.33.380 E019.47.59.869 Color_44ACI
N050.04.33.380 E019.47.59.869 N050.04.33.355 E019.47.59.824 Color_44ACI
N050.04.36.959 E019.48.09.061 N050.04.36.905 E019.48.09.025 Color_44ACI
N050.04.36.905 E019.48.09.025 N050.04.36.841 E019.48.09.046 Color_44ACI
N050.04.36.841 E019.48.09.046 N050.04.36.801 E019.48.09.109 Color_44ACI
N050.04.36.801 E019.48.09.109 N050.04.36.790 E019.48.09.213 Color_44ACI
N050.04.36.790 E019.48.09.213 N050.04.36.818 E019.48.09.299 Color_44ACI
N050.04.36.818 E019.48.09.299 N050.04.36.875 E019.48.09.347 Color_44ACI
N050.04.36.875 E019.48.09.347 N050.04.36.935 E019.48.09.335 Color_44ACI
N050.04.36.935 E019.48.09.335 N050.04.36.984 E019.48.09.266 Color_44ACI
N050.04.36.984 E019.48.09.266 N050.04.36.997 E019.48.09.186 Color_44ACI
N050.04.36.997 E019.48.09.186 N050.04.36.983 E019.48.09.105 Color_44ACI
N050.04.36.983 E019.48.09.105 N050.04.36.959 E019.48.09.061 Color_44ACI
N050.04.35.696 E019.48.09.519 N050.04.35.643 E019.48.09.484 Color_44ACI
N050.04.35.643 E019.48.09.484 N050.04.35.579 E019.48.09.504 Color_44ACI
N050.04.35.579 E019.48.09.504 N050.04.35.539 E019.48.09.567 Color_44ACI
N050.04.35.539 E019.48.09.567 N050.04.35.528 E019.48.09.671 Color_44ACI
N050.04.35.528 E019.48.09.671 N050.04.35.555 E019.48.09.758 Color_44ACI
N050.04.35.555 E019.48.09.758 N050.04.35.613 E019.48.09.805 Color_44ACI
N050.04.35.613 E019.48.09.805 N050.04.35.673 E019.48.09.793 Color_44ACI
N050.04.35.673 E019.48.09.793 N050.04.35.721 E019.48.09.724 Color_44ACI
N050.04.35.721 E019.48.09.724 N050.04.35.735 E019.48.09.644 Color_44ACI
N050.04.35.735 E019.48.09.644 N050.04.35.721 E019.48.09.564 Color_44ACI
N050.04.35.721 E019.48.09.564 N050.04.35.696 E019.48.09.519 Color_44ACI
N050.04.34.422 E019.48.09.898 N050.04.34.368 E019.48.09.863 Color_44ACI
N050.04.34.368 E019.48.09.863 N050.04.34.304 E019.48.09.883 Color_44ACI
N050.04.34.304 E019.48.09.883 N050.04.34.264 E019.48.09.946 Color_44ACI
N050.04.34.264 E019.48.09.946 N050.04.34.253 E019.48.10.050 Color_44ACI
N050.04.34.253 E019.48.10.050 N050.04.34.281 E019.48.10.137 Color_44ACI
N050.04.34.281 E019.48.10.137 N050.04.34.338 E019.48.10.184 Color_44ACI
N050.04.34.338 E019.48.10.184 N050.04.34.398 E019.48.10.172 Color_44ACI
N050.04.34.398 E019.48.10.172 N050.04.34.447 E019.48.10.103 Color_44ACI
N050.04.34.447 E019.48.10.103 N050.04.34.460 E019.48.10.023 Color_44ACI
N050.04.34.460 E019.48.10.023 N050.04.34.446 E019.48.09.943 Color_44ACI
N050.04.34.446 E019.48.09.943 N050.04.34.422 E019.48.09.898 Color_44ACI
N050.04.29.214 E019.48.03.076 N050.04.29.160 E019.48.03.041 Color_44ACI
N050.04.29.160 E019.48.03.041 N050.04.29.096 E019.48.03.061 Color_44ACI
N050.04.29.096 E019.48.03.061 N050.04.29.056 E019.48.03.125 Color_44ACI
N050.04.29.056 E019.48.03.125 N050.04.29.045 E019.48.03.229 Color_44ACI
N050.04.29.045 E019.48.03.229 N050.04.29.073 E019.48.03.315 Color_44ACI
N050.04.29.073 E019.48.03.315 N050.04.29.130 E019.48.03.362 Color_44ACI
N050.04.29.130 E019.48.03.362 N050.04.29.190 E019.48.03.350 Color_44ACI
N050.04.29.190 E019.48.03.350 N050.04.29.239 E019.48.03.281 Color_44ACI
N050.04.29.239 E019.48.03.281 N050.04.29.252 E019.48.03.202 Color_44ACI
N050.04.29.252 E019.48.03.202 N050.04.29.238 E019.48.03.121 Color_44ACI
N050.04.29.238 E019.48.03.121 N050.04.29.214 E019.48.03.076 Color_44ACI
N050.04.27.520 E019.48.01.198 N050.04.27.466 E019.48.01.163 Color_44ACI
N050.04.27.466 E019.48.01.163 N050.04.27.402 E019.48.01.183 Color_44ACI
N050.04.27.402 E019.48.01.183 N050.04.27.362 E019.48.01.247 Color_44ACI
N050.04.27.362 E019.48.01.247 N050.04.27.351 E019.48.01.351 Color_44ACI
N050.04.27.351 E019.48.01.351 N050.04.27.379 E019.48.01.437 Color_44ACI
N050.04.27.379 E019.48.01.437 N050.04.27.436 E019.48.01.484 Color_44ACI
N050.04.27.436 E019.48.01.484 N050.04.27.496 E019.48.01.472 Color_44ACI
N050.04.27.496 E019.48.01.472 N050.04.27.545 E019.48.01.403 Color_44ACI
N050.04.27.545 E019.48.01.403 N050.04.27.558 E019.48.01.324 Color_44ACI
N050.04.27.558 E019.48.01.324 N050.04.27.544 E019.48.01.243 Color_44ACI
N050.04.27.544 E019.48.01.243 N050.04.27.520 E019.48.01.198 Color_44ACI
N050.04.27.763 E019.48.02.989 N050.04.27.709 E019.48.02.953 Color_44ACI
N050.04.27.709 E019.48.02.953 N050.04.27.645 E019.48.02.973 Color_44ACI
N050.04.27.645 E019.48.02.973 N050.04.27.605 E019.48.03.037 Color_44ACI
N050.04.27.605 E019.48.03.037 N050.04.27.594 E019.48.03.141 Color_44ACI
N050.04.27.594 E019.48.03.141 N050.04.27.622 E019.48.03.227 Color_44ACI
N050.04.27.622 E019.48.03.227 N050.04.27.679 E019.48.03.274 Color_44ACI
N050.04.27.679 E019.48.03.274 N050.04.27.739 E019.48.03.262 Color_44ACI
N050.04.27.739 E019.48.03.262 N050.04.27.788 E019.48.03.193 Color_44ACI
N050.04.27.788 E019.48.03.193 N050.04.27.801 E019.48.03.114 Color_44ACI
N050.04.27.801 E019.48.03.114 N050.04.27.787 E019.48.03.033 Color_44ACI
N050.04.27.787 E019.48.03.033 N050.04.27.763 E019.48.02.989 Color_44ACI
N050.04.28.018 E019.48.04.818 N050.04.27.964 E019.48.04.783 Color_44ACI
N050.04.27.964 E019.48.04.783 N050.04.27.900 E019.48.04.803 Color_44ACI
N050.04.27.900 E019.48.04.803 N050.04.27.860 E019.48.04.867 Color_44ACI
N050.04.27.860 E019.48.04.867 N050.04.27.849 E019.48.04.971 Color_44ACI
N050.04.27.849 E019.48.04.971 N050.04.27.877 E019.48.05.057 Color_44ACI
N050.04.27.877 E019.48.05.057 N050.04.27.934 E019.48.05.104 Color_44ACI
N050.04.27.934 E019.48.05.104 N050.04.27.995 E019.48.05.092 Color_44ACI
N050.04.27.995 E019.48.05.092 N050.04.28.043 E019.48.05.023 Color_44ACI
N050.04.28.043 E019.48.05.023 N050.04.28.056 E019.48.04.944 Color_44ACI
N050.04.28.056 E019.48.04.944 N050.04.28.042 E019.48.04.863 Color_44ACI
N050.04.28.042 E019.48.04.863 N050.04.28.018 E019.48.04.818 Color_44ACI
N050.04.27.698 E019.48.06.961 N050.04.27.644 E019.48.06.926 Color_44ACI
N050.04.27.644 E019.48.06.926 N050.04.27.580 E019.48.06.946 Color_44ACI
N050.04.27.580 E019.48.06.946 N050.04.27.540 E019.48.07.009 Color_44ACI
N050.04.27.540 E019.48.07.009 N050.04.27.529 E019.48.07.113 Color_44ACI
N050.04.27.529 E019.48.07.113 N050.04.27.557 E019.48.07.200 Color_44ACI
N050.04.27.557 E019.48.07.200 N050.04.27.614 E019.48.07.247 Color_44ACI
N050.04.27.614 E019.48.07.247 N050.04.27.674 E019.48.07.235 Color_44ACI
N050.04.27.674 E019.48.07.235 N050.04.27.723 E019.48.07.166 Color_44ACI
N050.04.27.723 E019.48.07.166 N050.04.27.736 E019.48.07.086 Color_44ACI
N050.04.27.736 E019.48.07.086 N050.04.27.722 E019.48.07.006 Color_44ACI
N050.04.27.722 E019.48.07.006 N050.04.27.698 E019.48.06.961 Color_44ACI
N050.04.28.203 E019.48.10.699 N050.04.28.150 E019.48.10.664 Color_44ACI
N050.04.28.150 E019.48.10.664 N050.04.28.086 E019.48.10.684 Color_44ACI
N050.04.28.086 E019.48.10.684 N050.04.28.046 E019.48.10.748 Color_44ACI
N050.04.28.046 E019.48.10.748 N050.04.28.035 E019.48.10.852 Color_44ACI
N050.04.28.035 E019.48.10.852 N050.04.28.062 E019.48.10.938 Color_44ACI
N050.04.28.062 E019.48.10.938 N050.04.28.120 E019.48.10.985 Color_44ACI
N050.04.28.120 E019.48.10.985 N050.04.28.180 E019.48.10.973 Color_44ACI
N050.04.28.180 E019.48.10.973 N050.04.28.228 E019.48.10.904 Color_44ACI
N050.04.28.228 E019.48.10.904 N050.04.28.242 E019.48.10.825 Color_44ACI
N050.04.28.242 E019.48.10.825 N050.04.28.228 E019.48.10.744 Color_44ACI
N050.04.28.228 E019.48.10.744 N050.04.28.203 E019.48.10.699 Color_44ACI
N050.04.22.283 E019.48.00.568 N050.04.22.229 E019.48.00.532 Color_44ACI
N050.04.22.229 E019.48.00.532 N050.04.22.165 E019.48.00.553 Color_44ACI
N050.04.22.165 E019.48.00.553 N050.04.22.125 E019.48.00.616 Color_44ACI
N050.04.22.125 E019.48.00.616 N050.04.22.114 E019.48.00.720 Color_44ACI
N050.04.22.114 E019.48.00.720 N050.04.22.142 E019.48.00.806 Color_44ACI
N050.04.22.142 E019.48.00.806 N050.04.22.199 E019.48.00.854 Color_44ACI
N050.04.22.199 E019.48.00.854 N050.04.22.259 E019.48.00.842 Color_44ACI
N050.04.22.259 E019.48.00.842 N050.04.22.308 E019.48.00.773 Color_44ACI
N050.04.22.308 E019.48.00.773 N050.04.22.321 E019.48.00.693 Color_44ACI
N050.04.22.321 E019.48.00.693 N050.04.22.307 E019.48.00.612 Color_44ACI
N050.04.22.307 E019.48.00.612 N050.04.22.283 E019.48.00.568 Color_44ACI
N050.04.22.672 E019.48.03.277 N050.04.22.618 E019.48.03.242 Color_44ACI
N050.04.22.618 E019.48.03.242 N050.04.22.554 E019.48.03.262 Color_44ACI
N050.04.22.554 E019.48.03.262 N050.04.22.514 E019.48.03.326 Color_44ACI
N050.04.22.514 E019.48.03.326 N050.04.22.503 E019.48.03.430 Color_44ACI
N050.04.22.503 E019.48.03.430 N050.04.22.531 E019.48.03.516 Color_44ACI
N050.04.22.531 E019.48.03.516 N050.04.22.589 E019.48.03.563 Color_44ACI
N050.04.22.589 E019.48.03.563 N050.04.22.649 E019.48.03.551 Color_44ACI
N050.04.22.649 E019.48.03.551 N050.04.22.697 E019.48.03.482 Color_44ACI
N050.04.22.697 E019.48.03.482 N050.04.22.710 E019.48.03.403 Color_44ACI
N050.04.22.710 E019.48.03.403 N050.04.22.696 E019.48.03.322 Color_44ACI
N050.04.22.696 E019.48.03.322 N050.04.22.672 E019.48.03.277 Color_44ACI
N050.04.23.032 E019.48.06.014 N050.04.22.978 E019.48.05.978 Color_44ACI
N050.04.22.978 E019.48.05.978 N050.04.22.914 E019.48.05.999 Color_44ACI
N050.04.22.914 E019.48.05.999 N050.04.22.875 E019.48.06.062 Color_44ACI
N050.04.22.875 E019.48.06.062 N050.04.22.863 E019.48.06.166 Color_44ACI
N050.04.22.863 E019.48.06.166 N050.04.22.891 E019.48.06.252 Color_44ACI
N050.04.22.891 E019.48.06.252 N050.04.22.949 E019.48.06.299 Color_44ACI
N050.04.22.949 E019.48.06.299 N050.04.23.009 E019.48.06.288 Color_44ACI
N050.04.23.009 E019.48.06.288 N050.04.23.057 E019.48.06.218 Color_44ACI
N050.04.23.057 E019.48.06.218 N050.04.23.070 E019.48.06.139 Color_44ACI
N050.04.23.070 E019.48.06.139 N050.04.23.056 E019.48.06.058 Color_44ACI
N050.04.23.056 E019.48.06.058 N050.04.23.032 E019.48.06.014 Color_44ACI
N050.04.23.537 E019.48.09.408 N050.04.23.484 E019.48.09.372 Color_44ACI
N050.04.23.484 E019.48.09.372 N050.04.23.420 E019.48.09.392 Color_44ACI
N050.04.23.420 E019.48.09.392 N050.04.23.380 E019.48.09.456 Color_44ACI
N050.04.23.380 E019.48.09.456 N050.04.23.369 E019.48.09.560 Color_44ACI
N050.04.23.369 E019.48.09.560 N050.04.23.396 E019.48.09.646 Color_44ACI
N050.04.23.396 E019.48.09.646 N050.04.23.454 E019.48.09.693 Color_44ACI
N050.04.23.454 E019.48.09.693 N050.04.23.514 E019.48.09.681 Color_44ACI
N050.04.23.514 E019.48.09.681 N050.04.23.562 E019.48.09.612 Color_44ACI
N050.04.23.562 E019.48.09.612 N050.04.23.576 E019.48.09.533 Color_44ACI
N050.04.23.576 E019.48.09.533 N050.04.23.562 E019.48.09.452 Color_44ACI
N050.04.23.562 E019.48.09.452 N050.04.23.537 E019.48.09.408 Color_44ACI
N050.04.23.901 E019.48.12.117 N050.04.23.848 E019.48.12.082 Color_44ACI
N050.04.23.848 E019.48.12.082 N050.04.23.784 E019.48.12.102 Color_44ACI
N050.04.23.784 E019.48.12.102 N050.04.23.744 E019.48.12.166 Color_44ACI
N050.04.23.744 E019.48.12.166 N050.04.23.733 E019.48.12.270 Color_44ACI
N050.04.23.733 E019.48.12.270 N050.04.23.761 E019.48.12.356 Color_44ACI
N050.04.23.761 E019.48.12.356 N050.04.23.818 E019.48.12.403 Color_44ACI
N050.04.23.818 E019.48.12.403 N050.04.23.878 E019.48.12.391 Color_44ACI
N050.04.23.878 E019.48.12.391 N050.04.23.927 E019.48.12.322 Color_44ACI
N050.04.23.927 E019.48.12.322 N050.04.23.940 E019.48.12.243 Color_44ACI
N050.04.23.940 E019.48.12.243 N050.04.23.926 E019.48.12.162 Color_44ACI
N050.04.23.926 E019.48.12.162 N050.04.23.901 E019.48.12.117 Color_44ACI
N050.04.24.295 E019.48.14.884 N050.04.24.241 E019.48.14.848 Color_44ACI
N050.04.24.241 E019.48.14.848 N050.04.24.177 E019.48.14.869 Color_44ACI
N050.04.24.177 E019.48.14.869 N050.04.24.138 E019.48.14.932 Color_44ACI
N050.04.24.138 E019.48.14.932 N050.04.24.126 E019.48.15.036 Color_44ACI
N050.04.24.126 E019.48.15.036 N050.04.24.154 E019.48.15.122 Color_44ACI
N050.04.24.154 E019.48.15.122 N050.04.24.212 E019.48.15.170 Color_44ACI
N050.04.24.212 E019.48.15.170 N050.04.24.272 E019.48.15.158 Color_44ACI
N050.04.24.272 E019.48.15.158 N050.04.24.320 E019.48.15.088 Color_44ACI
N050.04.24.320 E019.48.15.088 N050.04.24.333 E019.48.15.009 Color_44ACI
N050.04.24.333 E019.48.15.009 N050.04.24.319 E019.48.14.928 Color_44ACI
N050.04.24.319 E019.48.14.928 N050.04.24.295 E019.48.14.884 Color_44ACI
N050.04.24.714 E019.48.15.729 N050.04.24.660 E019.48.15.693 Color_44ACI
N050.04.24.660 E019.48.15.693 N050.04.24.596 E019.48.15.713 Color_44ACI
N050.04.24.596 E019.48.15.713 N050.04.24.556 E019.48.15.777 Color_44ACI
N050.04.24.556 E019.48.15.777 N050.04.24.545 E019.48.15.881 Color_44ACI
N050.04.24.545 E019.48.15.881 N050.04.24.573 E019.48.15.967 Color_44ACI
N050.04.24.573 E019.48.15.967 N050.04.24.631 E019.48.16.014 Color_44ACI
N050.04.24.631 E019.48.16.014 N050.04.24.691 E019.48.16.003 Color_44ACI
N050.04.24.691 E019.48.16.003 N050.04.24.739 E019.48.15.933 Color_44ACI
N050.04.24.739 E019.48.15.933 N050.04.24.752 E019.48.15.854 Color_44ACI
N050.04.24.752 E019.48.15.854 N050.04.24.738 E019.48.15.773 Color_44ACI
N050.04.24.738 E019.48.15.773 N050.04.24.714 E019.48.15.729 Color_44ACI
N050.04.24.845 E019.48.15.540 N050.04.24.792 E019.48.15.505 Color_44ACI
N050.04.24.792 E019.48.15.505 N050.04.24.728 E019.48.15.525 Color_44ACI
N050.04.24.728 E019.48.15.525 N050.04.24.688 E019.48.15.589 Color_44ACI
N050.04.24.688 E019.48.15.589 N050.04.24.677 E019.48.15.693 Color_44ACI
N050.04.24.677 E019.48.15.693 N050.04.24.704 E019.48.15.779 Color_44ACI
N050.04.24.704 E019.48.15.779 N050.04.24.762 E019.48.15.826 Color_44ACI
N050.04.24.762 E019.48.15.826 N050.04.24.822 E019.48.15.814 Color_44ACI
N050.04.24.822 E019.48.15.814 N050.04.24.871 E019.48.15.745 Color_44ACI
N050.04.24.871 E019.48.15.745 N050.04.24.884 E019.48.15.666 Color_44ACI
N050.04.24.884 E019.48.15.666 N050.04.24.870 E019.48.15.585 Color_44ACI
N050.04.24.870 E019.48.15.585 N050.04.24.845 E019.48.15.540 Color_44ACI
N050.04.25.764 E019.48.14.395 N050.04.25.710 E019.48.14.359 Color_44ACI
N050.04.25.710 E019.48.14.359 N050.04.25.646 E019.48.14.380 Color_44ACI
N050.04.25.646 E019.48.14.380 N050.04.25.606 E019.48.14.443 Color_44ACI
N050.04.25.606 E019.48.14.443 N050.04.25.595 E019.48.14.547 Color_44ACI
N050.04.25.595 E019.48.14.547 N050.04.25.623 E019.48.14.633 Color_44ACI
N050.04.25.623 E019.48.14.633 N050.04.25.680 E019.48.14.681 Color_44ACI
N050.04.25.680 E019.48.14.681 N050.04.25.740 E019.48.14.669 Color_44ACI
N050.04.25.740 E019.48.14.669 N050.04.25.789 E019.48.14.600 Color_44ACI
N050.04.25.789 E019.48.14.600 N050.04.25.802 E019.48.14.520 Color_44ACI
N050.04.25.802 E019.48.14.520 N050.04.25.788 E019.48.14.439 Color_44ACI
N050.04.25.788 E019.48.14.439 N050.04.25.764 E019.48.14.395 Color_44ACI
N050.04.29.165 E019.48.17.836 N050.04.29.112 E019.48.17.801 Color_44ACI
N050.04.29.112 E019.48.17.801 N050.04.29.048 E019.48.17.821 Color_44ACI
N050.04.29.048 E019.48.17.821 N050.04.29.008 E019.48.17.884 Color_44ACI
N050.04.29.008 E019.48.17.884 N050.04.28.997 E019.48.17.988 Color_44ACI
N050.04.28.997 E019.48.17.988 N050.04.29.025 E019.48.18.075 Color_44ACI
N050.04.29.025 E019.48.18.075 N050.04.29.082 E019.48.18.122 Color_44ACI
N050.04.29.082 E019.48.18.122 N050.04.29.142 E019.48.18.110 Color_44ACI
N050.04.29.142 E019.48.18.110 N050.04.29.191 E019.48.18.041 Color_44ACI
N050.04.29.191 E019.48.18.041 N050.04.29.204 E019.48.17.961 Color_44ACI
N050.04.29.204 E019.48.17.961 N050.04.29.190 E019.48.17.881 Color_44ACI
N050.04.29.190 E019.48.17.881 N050.04.29.165 E019.48.17.836 Color_44ACI
N050.04.29.111 E019.48.18.106 N050.04.29.057 E019.48.18.071 Color_44ACI
N050.04.29.057 E019.48.18.071 N050.04.28.993 E019.48.18.091 Color_44ACI
N050.04.28.993 E019.48.18.091 N050.04.28.953 E019.48.18.155 Color_44ACI
N050.04.28.953 E019.48.18.155 N050.04.28.942 E019.48.18.259 Color_44ACI
N050.04.28.942 E019.48.18.259 N050.04.28.970 E019.48.18.345 Color_44ACI
N050.04.28.970 E019.48.18.345 N050.04.29.027 E019.48.18.392 Color_44ACI
N050.04.29.027 E019.48.18.392 N050.04.29.087 E019.48.18.380 Color_44ACI
N050.04.29.087 E019.48.18.380 N050.04.29.136 E019.48.18.311 Color_44ACI
N050.04.29.136 E019.48.18.311 N050.04.29.149 E019.48.18.232 Color_44ACI
N050.04.29.149 E019.48.18.232 N050.04.29.135 E019.48.18.151 Color_44ACI
N050.04.29.135 E019.48.18.151 N050.04.29.111 E019.48.18.106 Color_44ACI
N050.04.27.860 E019.48.17.513 N050.04.27.807 E019.48.17.477 Color_44ACI
N050.04.27.807 E019.48.17.477 N050.04.27.743 E019.48.17.497 Color_44ACI
N050.04.27.743 E019.48.17.497 N050.04.27.703 E019.48.17.561 Color_44ACI
N050.04.27.703 E019.48.17.561 N050.04.27.692 E019.48.17.665 Color_44ACI
N050.04.27.692 E019.48.17.665 N050.04.27.720 E019.48.17.751 Color_44ACI
N050.04.27.720 E019.48.17.751 N050.04.27.777 E019.48.17.798 Color_44ACI
N050.04.27.777 E019.48.17.798 N050.04.27.837 E019.48.17.786 Color_44ACI
N050.04.27.837 E019.48.17.786 N050.04.27.886 E019.48.17.717 Color_44ACI
N050.04.27.886 E019.48.17.717 N050.04.27.899 E019.48.17.638 Color_44ACI
N050.04.27.899 E019.48.17.638 N050.04.27.885 E019.48.17.557 Color_44ACI
N050.04.27.885 E019.48.17.557 N050.04.27.860 E019.48.17.513 Color_44ACI
N050.04.27.911 E019.48.17.247 N050.04.27.857 E019.48.17.211 Color_44ACI
N050.04.27.857 E019.48.17.211 N050.04.27.793 E019.48.17.232 Color_44ACI
N050.04.27.793 E019.48.17.232 N050.04.27.753 E019.48.17.295 Color_44ACI
N050.04.27.753 E019.48.17.295 N050.04.27.742 E019.48.17.399 Color_44ACI
N050.04.27.742 E019.48.17.399 N050.04.27.770 E019.48.17.485 Color_44ACI
N050.04.27.770 E019.48.17.485 N050.04.27.828 E019.48.17.533 Color_44ACI
N050.04.27.828 E019.48.17.533 N050.04.27.888 E019.48.17.521 Color_44ACI
N050.04.27.888 E019.48.17.521 N050.04.27.936 E019.48.17.452 Color_44ACI
N050.04.27.936 E019.48.17.452 N050.04.27.949 E019.48.17.372 Color_44ACI
N050.04.27.949 E019.48.17.372 N050.04.27.935 E019.48.17.291 Color_44ACI
N050.04.27.935 E019.48.17.291 N050.04.27.911 E019.48.17.247 Color_44ACI
N050.04.26.720 E019.48.16.994 N050.04.26.666 E019.48.16.959 Color_44ACI
N050.04.26.666 E019.48.16.959 N050.04.26.602 E019.48.16.979 Color_44ACI
N050.04.26.602 E019.48.16.979 N050.04.26.562 E019.48.17.043 Color_44ACI
N050.04.26.562 E019.48.17.043 N050.04.26.551 E019.48.17.147 Color_44ACI
N050.04.26.551 E019.48.17.147 N050.04.26.579 E019.48.17.233 Color_44ACI
N050.04.26.579 E019.48.17.233 N050.04.26.637 E019.48.17.280 Color_44ACI
N050.04.26.637 E019.48.17.280 N050.04.26.697 E019.48.17.268 Color_44ACI
N050.04.26.697 E019.48.17.268 N050.04.26.745 E019.48.17.199 Color_44ACI
N050.04.26.745 E019.48.17.199 N050.04.26.758 E019.48.17.120 Color_44ACI
N050.04.26.758 E019.48.17.120 N050.04.26.744 E019.48.17.039 Color_44ACI
N050.04.26.744 E019.48.17.039 N050.04.26.720 E019.48.16.994 Color_44ACI
N050.04.26.685 E019.48.17.246 N050.04.26.631 E019.48.17.211 Color_44ACI
N050.04.26.631 E019.48.17.211 N050.04.26.567 E019.48.17.231 Color_44ACI
N050.04.26.567 E019.48.17.231 N050.04.26.527 E019.48.17.295 Color_44ACI
N050.04.26.527 E019.48.17.295 N050.04.26.516 E019.48.17.399 Color_44ACI
N050.04.26.516 E019.48.17.399 N050.04.26.544 E019.48.17.485 Color_44ACI
N050.04.26.544 E019.48.17.485 N050.04.26.601 E019.48.17.532 Color_44ACI
N050.04.26.601 E019.48.17.532 N050.04.26.661 E019.48.17.520 Color_44ACI
N050.04.26.661 E019.48.17.520 N050.04.26.710 E019.48.17.451 Color_44ACI
N050.04.26.710 E019.48.17.451 N050.04.26.723 E019.48.17.372 Color_44ACI
N050.04.26.723 E019.48.17.372 N050.04.26.709 E019.48.17.291 Color_44ACI
N050.04.26.709 E019.48.17.291 N050.04.26.685 E019.48.17.246 Color_44ACI
;rwy_ctr_lights N000.00.00.000 E000.00.00.000 N000.00.00.000 E000.00.00.000
N050.04.33.589 E019.46.21.071 N050.04.33.579 E019.46.20.981 Color_252ACI
N050.04.33.579 E019.46.20.981 N050.04.33.533 E019.46.20.909 Color_252ACI
N050.04.33.533 E019.46.20.909 N050.04.33.477 E019.46.20.892 Color_252ACI
N050.04.33.477 E019.46.20.892 N050.04.33.415 E019.46.20.935 Color_252ACI
N050.04.33.415 E019.46.20.935 N050.04.33.384 E019.46.21.019 Color_252ACI
N050.04.33.384 E019.46.21.019 N050.04.33.390 E019.46.21.120 Color_252ACI
N050.04.33.390 E019.46.21.120 N050.04.33.430 E019.46.21.191 Color_252ACI
N050.04.33.430 E019.46.21.191 N050.04.33.493 E019.46.21.216 Color_252ACI
N050.04.33.493 E019.46.21.216 N050.04.33.543 E019.46.21.190 Color_252ACI
N050.04.33.543 E019.46.21.190 N050.04.33.579 E019.46.21.127 Color_252ACI
N050.04.33.579 E019.46.21.127 N050.04.33.589 E019.46.21.071 Color_252ACI
N050.04.34.001 E019.46.24.016 N050.04.33.990 E019.46.23.927 Color_252ACI
N050.04.33.990 E019.46.23.927 N050.04.33.944 E019.46.23.855 Color_252ACI
N050.04.33.944 E019.46.23.855 N050.04.33.888 E019.46.23.838 Color_252ACI
N050.04.33.888 E019.46.23.838 N050.04.33.826 E019.46.23.881 Color_252ACI
N050.04.33.826 E019.46.23.881 N050.04.33.795 E019.46.23.964 Color_252ACI
N050.04.33.795 E019.46.23.964 N050.04.33.801 E019.46.24.065 Color_252ACI
N050.04.33.801 E019.46.24.065 N050.04.33.841 E019.46.24.137 Color_252ACI
N050.04.33.841 E019.46.24.137 N050.04.33.905 E019.46.24.162 Color_252ACI
N050.04.33.905 E019.46.24.162 N050.04.33.954 E019.46.24.135 Color_252ACI
N050.04.33.954 E019.46.24.135 N050.04.33.990 E019.46.24.072 Color_252ACI
N050.04.33.990 E019.46.24.072 N050.04.34.001 E019.46.24.016 Color_252ACI
N050.04.34.412 E019.46.26.962 N050.04.34.401 E019.46.26.872 Color_252ACI
N050.04.34.401 E019.46.26.872 N050.04.34.355 E019.46.26.800 Color_252ACI
N050.04.34.355 E019.46.26.800 N050.04.34.299 E019.46.26.783 Color_252ACI
N050.04.34.299 E019.46.26.783 N050.04.34.237 E019.46.26.826 Color_252ACI
N050.04.34.237 E019.46.26.826 N050.04.34.206 E019.46.26.910 Color_252ACI
N050.04.34.206 E019.46.26.910 N050.04.34.213 E019.46.27.010 Color_252ACI
N050.04.34.213 E019.46.27.010 N050.04.34.252 E019.46.27.082 Color_252ACI
N050.04.34.252 E019.46.27.082 N050.04.34.316 E019.46.27.107 Color_252ACI
N050.04.34.316 E019.46.27.107 N050.04.34.366 E019.46.27.080 Color_252ACI
N050.04.34.366 E019.46.27.080 N050.04.34.401 E019.46.27.018 Color_252ACI
N050.04.34.401 E019.46.27.018 N050.04.34.412 E019.46.26.962 Color_252ACI
N050.04.34.823 E019.46.29.907 N050.04.34.812 E019.46.29.818 Color_252ACI
N050.04.34.812 E019.46.29.818 N050.04.34.766 E019.46.29.746 Color_252ACI
N050.04.34.766 E019.46.29.746 N050.04.34.710 E019.46.29.729 Color_252ACI
N050.04.34.710 E019.46.29.729 N050.04.34.648 E019.46.29.771 Color_252ACI
N050.04.34.648 E019.46.29.771 N050.04.34.617 E019.46.29.855 Color_252ACI
N050.04.34.617 E019.46.29.855 N050.04.34.624 E019.46.29.956 Color_252ACI
N050.04.34.624 E019.46.29.956 N050.04.34.663 E019.46.30.027 Color_252ACI
N050.04.34.663 E019.46.30.027 N050.04.34.727 E019.46.30.052 Color_252ACI
N050.04.34.727 E019.46.30.052 N050.04.34.777 E019.46.30.026 Color_252ACI
N050.04.34.777 E019.46.30.026 N050.04.34.812 E019.46.29.963 Color_252ACI
N050.04.34.812 E019.46.29.963 N050.04.34.823 E019.46.29.907 Color_252ACI
N050.04.35.234 E019.46.32.852 N050.04.35.223 E019.46.32.763 Color_252ACI
N050.04.35.223 E019.46.32.763 N050.04.35.177 E019.46.32.691 Color_252ACI
N050.04.35.177 E019.46.32.691 N050.04.35.121 E019.46.32.674 Color_252ACI
N050.04.35.121 E019.46.32.674 N050.04.35.059 E019.46.32.717 Color_252ACI
N050.04.35.059 E019.46.32.717 N050.04.35.029 E019.46.32.800 Color_252ACI
N050.04.35.029 E019.46.32.800 N050.04.35.035 E019.46.32.901 Color_252ACI
N050.04.35.035 E019.46.32.901 N050.04.35.074 E019.46.32.973 Color_252ACI
N050.04.35.074 E019.46.32.973 N050.04.35.138 E019.46.32.998 Color_252ACI
N050.04.35.138 E019.46.32.998 N050.04.35.188 E019.46.32.971 Color_252ACI
N050.04.35.188 E019.46.32.971 N050.04.35.223 E019.46.32.909 Color_252ACI
N050.04.35.223 E019.46.32.909 N050.04.35.234 E019.46.32.852 Color_252ACI
N050.04.35.645 E019.46.35.798 N050.04.35.634 E019.46.35.708 Color_252ACI
N050.04.35.634 E019.46.35.708 N050.04.35.588 E019.46.35.636 Color_252ACI
N050.04.35.588 E019.46.35.636 N050.04.35.532 E019.46.35.620 Color_252ACI
N050.04.35.532 E019.46.35.620 N050.04.35.470 E019.46.35.662 Color_252ACI
N050.04.35.470 E019.46.35.662 N050.04.35.440 E019.46.35.746 Color_252ACI
N050.04.35.440 E019.46.35.746 N050.04.35.446 E019.46.35.847 Color_252ACI
N050.04.35.446 E019.46.35.847 N050.04.35.485 E019.46.35.918 Color_252ACI
N050.04.35.485 E019.46.35.918 N050.04.35.549 E019.46.35.943 Color_252ACI
N050.04.35.549 E019.46.35.943 N050.04.35.599 E019.46.35.917 Color_252ACI
N050.04.35.599 E019.46.35.917 N050.04.35.634 E019.46.35.854 Color_252ACI
N050.04.35.634 E019.46.35.854 N050.04.35.645 E019.46.35.798 Color_252ACI
N050.04.36.056 E019.46.38.743 N050.04.36.046 E019.46.38.654 Color_252ACI
N050.04.36.046 E019.46.38.654 N050.04.35.999 E019.46.38.582 Color_252ACI
N050.04.35.999 E019.46.38.582 N050.04.35.943 E019.46.38.565 Color_252ACI
N050.04.35.943 E019.46.38.565 N050.04.35.882 E019.46.38.608 Color_252ACI
N050.04.35.882 E019.46.38.608 N050.04.35.851 E019.46.38.691 Color_252ACI
N050.04.35.851 E019.46.38.691 N050.04.35.857 E019.46.38.792 Color_252ACI
N050.04.35.857 E019.46.38.792 N050.04.35.897 E019.46.38.864 Color_252ACI
N050.04.35.897 E019.46.38.864 N050.04.35.960 E019.46.38.889 Color_252ACI
N050.04.35.960 E019.46.38.889 N050.04.36.010 E019.46.38.862 Color_252ACI
N050.04.36.010 E019.46.38.862 N050.04.36.046 E019.46.38.799 Color_252ACI
N050.04.36.046 E019.46.38.799 N050.04.36.056 E019.46.38.743 Color_252ACI
N050.04.36.467 E019.46.41.689 N050.04.36.457 E019.46.41.599 Color_252ACI
N050.04.36.457 E019.46.41.599 N050.04.36.411 E019.46.41.527 Color_252ACI
N050.04.36.411 E019.46.41.527 N050.04.36.355 E019.46.41.510 Color_252ACI
N050.04.36.355 E019.46.41.510 N050.04.36.293 E019.46.41.553 Color_252ACI
N050.04.36.293 E019.46.41.553 N050.04.36.262 E019.46.41.637 Color_252ACI
N050.04.36.262 E019.46.41.637 N050.04.36.268 E019.46.41.738 Color_252ACI
N050.04.36.268 E019.46.41.738 N050.04.36.308 E019.46.41.809 Color_252ACI
N050.04.36.308 E019.46.41.809 N050.04.36.371 E019.46.41.834 Color_252ACI
N050.04.36.371 E019.46.41.834 N050.04.36.421 E019.46.41.807 Color_252ACI
N050.04.36.421 E019.46.41.807 N050.04.36.457 E019.46.41.745 Color_252ACI
N050.04.36.457 E019.46.41.745 N050.04.36.467 E019.46.41.689 Color_252ACI
N050.04.36.878 E019.46.44.634 N050.04.36.868 E019.46.44.545 Color_252ACI
N050.04.36.868 E019.46.44.545 N050.04.36.822 E019.46.44.473 Color_252ACI
N050.04.36.822 E019.46.44.473 N050.04.36.766 E019.46.44.456 Color_252ACI
N050.04.36.766 E019.46.44.456 N050.04.36.704 E019.46.44.498 Color_252ACI
N050.04.36.704 E019.46.44.498 N050.04.36.673 E019.46.44.582 Color_252ACI
N050.04.36.673 E019.46.44.582 N050.04.36.679 E019.46.44.683 Color_252ACI
N050.04.36.679 E019.46.44.683 N050.04.36.719 E019.46.44.755 Color_252ACI
N050.04.36.719 E019.46.44.755 N050.04.36.782 E019.46.44.779 Color_252ACI
N050.04.36.782 E019.46.44.779 N050.04.36.832 E019.46.44.753 Color_252ACI
N050.04.36.832 E019.46.44.753 N050.04.36.868 E019.46.44.690 Color_252ACI
N050.04.36.868 E019.46.44.690 N050.04.36.878 E019.46.44.634 Color_252ACI
N050.04.37.289 E019.46.47.580 N050.04.37.279 E019.46.47.490 Color_252ACI
N050.04.37.279 E019.46.47.490 N050.04.37.233 E019.46.47.418 Color_252ACI
N050.04.37.233 E019.46.47.418 N050.04.37.177 E019.46.47.401 Color_252ACI
N050.04.37.177 E019.46.47.401 N050.04.37.115 E019.46.47.444 Color_252ACI
N050.04.37.115 E019.46.47.444 N050.04.37.084 E019.46.47.527 Color_252ACI
N050.04.37.084 E019.46.47.527 N050.04.37.090 E019.46.47.628 Color_252ACI
N050.04.37.090 E019.46.47.628 N050.04.37.130 E019.46.47.700 Color_252ACI
N050.04.37.130 E019.46.47.700 N050.04.37.194 E019.46.47.725 Color_252ACI
N050.04.37.194 E019.46.47.725 N050.04.37.243 E019.46.47.698 Color_252ACI
N050.04.37.243 E019.46.47.698 N050.04.37.279 E019.46.47.636 Color_252ACI
N050.04.37.279 E019.46.47.636 N050.04.37.289 E019.46.47.580 Color_252ACI
N050.04.37.495 E019.46.49.052 N050.04.37.484 E019.46.48.963 Color_252ACI
N050.04.37.484 E019.46.48.963 N050.04.37.438 E019.46.48.891 Color_252ACI
N050.04.37.438 E019.46.48.891 N050.04.37.382 E019.46.48.874 Color_252ACI
N050.04.37.382 E019.46.48.874 N050.04.37.320 E019.46.48.917 Color_252ACI
N050.04.37.320 E019.46.48.917 N050.04.37.290 E019.46.49.000 Color_252ACI
N050.04.37.290 E019.46.49.000 N050.04.37.296 E019.46.49.101 Color_252ACI
N050.04.37.296 E019.46.49.101 N050.04.37.335 E019.46.49.173 Color_252ACI
N050.04.37.335 E019.46.49.173 N050.04.37.399 E019.46.49.198 Color_252ACI
N050.04.37.399 E019.46.49.198 N050.04.37.449 E019.46.49.171 Color_252ACI
N050.04.37.449 E019.46.49.171 N050.04.37.484 E019.46.49.108 Color_252ACI
N050.04.37.484 E019.46.49.108 N050.04.37.495 E019.46.49.052 Color_252ACI
N050.04.37.701 E019.46.50.525 N050.04.37.690 E019.46.50.436 Color_252ACI
N050.04.37.690 E019.46.50.436 N050.04.37.644 E019.46.50.363 Color_252ACI
N050.04.37.644 E019.46.50.363 N050.04.37.588 E019.46.50.347 Color_252ACI
N050.04.37.588 E019.46.50.347 N050.04.37.526 E019.46.50.389 Color_252ACI
N050.04.37.526 E019.46.50.389 N050.04.37.495 E019.46.50.473 Color_252ACI
N050.04.37.495 E019.46.50.473 N050.04.37.502 E019.46.50.574 Color_252ACI
N050.04.37.502 E019.46.50.574 N050.04.37.541 E019.46.50.645 Color_252ACI
N050.04.37.541 E019.46.50.645 N050.04.37.605 E019.46.50.670 Color_252ACI
N050.04.37.605 E019.46.50.670 N050.04.37.654 E019.46.50.644 Color_252ACI
N050.04.37.654 E019.46.50.644 N050.04.37.690 E019.46.50.581 Color_252ACI
N050.04.37.690 E019.46.50.581 N050.04.37.701 E019.46.50.525 Color_252ACI
N050.04.37.906 E019.46.51.998 N050.04.37.896 E019.46.51.908 Color_252ACI
N050.04.37.896 E019.46.51.908 N050.04.37.849 E019.46.51.836 Color_252ACI
N050.04.37.849 E019.46.51.836 N050.04.37.793 E019.46.51.819 Color_252ACI
N050.04.37.793 E019.46.51.819 N050.04.37.732 E019.46.51.862 Color_252ACI
N050.04.37.732 E019.46.51.862 N050.04.37.701 E019.46.51.946 Color_252ACI
N050.04.37.701 E019.46.51.946 N050.04.37.707 E019.46.52.047 Color_252ACI
N050.04.37.707 E019.46.52.047 N050.04.37.747 E019.46.52.118 Color_252ACI
N050.04.37.747 E019.46.52.118 N050.04.37.810 E019.46.52.143 Color_252ACI
N050.04.37.810 E019.46.52.143 N050.04.37.860 E019.46.52.116 Color_252ACI
N050.04.37.860 E019.46.52.116 N050.04.37.896 E019.46.52.054 Color_252ACI
N050.04.37.896 E019.46.52.054 N050.04.37.906 E019.46.51.998 Color_252ACI
N050.04.38.112 E019.46.53.470 N050.04.38.101 E019.46.53.381 Color_252ACI
N050.04.38.101 E019.46.53.381 N050.04.38.055 E019.46.53.309 Color_252ACI
N050.04.38.055 E019.46.53.309 N050.04.37.999 E019.46.53.292 Color_252ACI
N050.04.37.999 E019.46.53.292 N050.04.37.937 E019.46.53.335 Color_252ACI
N050.04.37.937 E019.46.53.335 N050.04.37.906 E019.46.53.418 Color_252ACI
N050.04.37.906 E019.46.53.418 N050.04.37.913 E019.46.53.519 Color_252ACI
N050.04.37.913 E019.46.53.519 N050.04.37.952 E019.46.53.591 Color_252ACI
N050.04.37.952 E019.46.53.591 N050.04.38.016 E019.46.53.616 Color_252ACI
N050.04.38.016 E019.46.53.616 N050.04.38.066 E019.46.53.589 Color_252ACI
N050.04.38.066 E019.46.53.589 N050.04.38.101 E019.46.53.527 Color_252ACI
N050.04.38.101 E019.46.53.527 N050.04.38.112 E019.46.53.470 Color_252ACI
N050.04.38.317 E019.46.54.943 N050.04.38.307 E019.46.54.854 Color_252ACI
N050.04.38.307 E019.46.54.854 N050.04.38.261 E019.46.54.782 Color_252ACI
N050.04.38.261 E019.46.54.782 N050.04.38.205 E019.46.54.765 Color_252ACI
N050.04.38.205 E019.46.54.765 N050.04.38.143 E019.46.54.807 Color_252ACI
N050.04.38.143 E019.46.54.807 N050.04.38.112 E019.46.54.891 Color_252ACI
N050.04.38.112 E019.46.54.891 N050.04.38.118 E019.46.54.992 Color_252ACI
N050.04.38.118 E019.46.54.992 N050.04.38.158 E019.46.55.064 Color_252ACI
N050.04.38.158 E019.46.55.064 N050.04.38.221 E019.46.55.088 Color_252ACI
N050.04.38.221 E019.46.55.088 N050.04.38.271 E019.46.55.062 Color_252ACI
N050.04.38.271 E019.46.55.062 N050.04.38.307 E019.46.54.999 Color_252ACI
N050.04.38.307 E019.46.54.999 N050.04.38.317 E019.46.54.943 Color_252ACI
N050.04.38.523 E019.46.56.416 N050.04.38.512 E019.46.56.326 Color_252ACI
N050.04.38.512 E019.46.56.326 N050.04.38.466 E019.46.56.254 Color_252ACI
N050.04.38.466 E019.46.56.254 N050.04.38.410 E019.46.56.237 Color_252ACI
N050.04.38.410 E019.46.56.237 N050.04.38.348 E019.46.56.280 Color_252ACI
N050.04.38.348 E019.46.56.280 N050.04.38.317 E019.46.56.364 Color_252ACI
N050.04.38.317 E019.46.56.364 N050.04.38.324 E019.46.56.465 Color_252ACI
N050.04.38.324 E019.46.56.465 N050.04.38.363 E019.46.56.536 Color_252ACI
N050.04.38.363 E019.46.56.536 N050.04.38.427 E019.46.56.561 Color_252ACI
N050.04.38.427 E019.46.56.561 N050.04.38.477 E019.46.56.535 Color_252ACI
N050.04.38.477 E019.46.56.535 N050.04.38.512 E019.46.56.472 Color_252ACI
N050.04.38.512 E019.46.56.472 N050.04.38.523 E019.46.56.416 Color_252ACI
N050.04.38.728 E019.46.57.889 N050.04.38.718 E019.46.57.799 Color_252ACI
N050.04.38.718 E019.46.57.799 N050.04.38.672 E019.46.57.727 Color_252ACI
N050.04.38.672 E019.46.57.727 N050.04.38.616 E019.46.57.710 Color_252ACI
N050.04.38.616 E019.46.57.710 N050.04.38.554 E019.46.57.753 Color_252ACI
N050.04.38.554 E019.46.57.753 N050.04.38.523 E019.46.57.836 Color_252ACI
N050.04.38.523 E019.46.57.836 N050.04.38.529 E019.46.57.937 Color_252ACI
N050.04.38.529 E019.46.57.937 N050.04.38.569 E019.46.58.009 Color_252ACI
N050.04.38.569 E019.46.58.009 N050.04.38.632 E019.46.58.034 Color_252ACI
N050.04.38.632 E019.46.58.034 N050.04.38.682 E019.46.58.007 Color_252ACI
N050.04.38.682 E019.46.58.007 N050.04.38.718 E019.46.57.945 Color_252ACI
N050.04.38.718 E019.46.57.945 N050.04.38.728 E019.46.57.889 Color_252ACI
N050.04.38.934 E019.46.59.361 N050.04.38.923 E019.46.59.272 Color_252ACI
N050.04.38.923 E019.46.59.272 N050.04.38.877 E019.46.59.200 Color_252ACI
N050.04.38.877 E019.46.59.200 N050.04.38.821 E019.46.59.183 Color_252ACI
N050.04.38.821 E019.46.59.183 N050.04.38.759 E019.46.59.226 Color_252ACI
N050.04.38.759 E019.46.59.226 N050.04.38.729 E019.46.59.309 Color_252ACI
N050.04.38.729 E019.46.59.309 N050.04.38.735 E019.46.59.410 Color_252ACI
N050.04.38.735 E019.46.59.410 N050.04.38.774 E019.46.59.482 Color_252ACI
N050.04.38.774 E019.46.59.482 N050.04.38.838 E019.46.59.507 Color_252ACI
N050.04.38.838 E019.46.59.507 N050.04.38.888 E019.46.59.480 Color_252ACI
N050.04.38.888 E019.46.59.480 N050.04.38.923 E019.46.59.417 Color_252ACI
N050.04.38.923 E019.46.59.417 N050.04.38.934 E019.46.59.361 Color_252ACI
N050.04.39.139 E019.47.00.834 N050.04.39.129 E019.47.00.745 Color_252ACI
N050.04.39.129 E019.47.00.745 N050.04.39.083 E019.47.00.672 Color_252ACI
N050.04.39.083 E019.47.00.672 N050.04.39.027 E019.47.00.656 Color_252ACI
N050.04.39.027 E019.47.00.656 N050.04.38.965 E019.47.00.698 Color_252ACI
N050.04.38.965 E019.47.00.698 N050.04.38.934 E019.47.00.782 Color_252ACI
N050.04.38.934 E019.47.00.782 N050.04.38.940 E019.47.00.883 Color_252ACI
N050.04.38.940 E019.47.00.883 N050.04.38.980 E019.47.00.954 Color_252ACI
N050.04.38.980 E019.47.00.954 N050.04.39.044 E019.47.00.979 Color_252ACI
N050.04.39.044 E019.47.00.979 N050.04.39.093 E019.47.00.953 Color_252ACI
N050.04.39.093 E019.47.00.953 N050.04.39.129 E019.47.00.890 Color_252ACI
N050.04.39.129 E019.47.00.890 N050.04.39.139 E019.47.00.834 Color_252ACI
N050.04.39.345 E019.47.02.307 N050.04.39.334 E019.47.02.217 Color_252ACI
N050.04.39.334 E019.47.02.217 N050.04.39.288 E019.47.02.145 Color_252ACI
N050.04.39.288 E019.47.02.145 N050.04.39.232 E019.47.02.128 Color_252ACI
N050.04.39.232 E019.47.02.128 N050.04.39.170 E019.47.02.171 Color_252ACI
N050.04.39.170 E019.47.02.171 N050.04.39.140 E019.47.02.255 Color_252ACI
N050.04.39.140 E019.47.02.255 N050.04.39.146 E019.47.02.355 Color_252ACI
N050.04.39.146 E019.47.02.355 N050.04.39.185 E019.47.02.427 Color_252ACI
N050.04.39.185 E019.47.02.427 N050.04.39.249 E019.47.02.452 Color_252ACI
N050.04.39.249 E019.47.02.452 N050.04.39.299 E019.47.02.425 Color_252ACI
N050.04.39.299 E019.47.02.425 N050.04.39.334 E019.47.02.363 Color_252ACI
N050.04.39.334 E019.47.02.363 N050.04.39.345 E019.47.02.307 Color_252ACI
N050.04.39.551 E019.47.03.779 N050.04.39.540 E019.47.03.690 Color_252ACI
N050.04.39.540 E019.47.03.690 N050.04.39.494 E019.47.03.618 Color_252ACI
N050.04.39.494 E019.47.03.618 N050.04.39.438 E019.47.03.601 Color_252ACI
N050.04.39.438 E019.47.03.601 N050.04.39.376 E019.47.03.644 Color_252ACI
N050.04.39.376 E019.47.03.644 N050.04.39.345 E019.47.03.727 Color_252ACI
N050.04.39.345 E019.47.03.727 N050.04.39.351 E019.47.03.828 Color_252ACI
N050.04.39.351 E019.47.03.828 N050.04.39.391 E019.47.03.900 Color_252ACI
N050.04.39.391 E019.47.03.900 N050.04.39.455 E019.47.03.925 Color_252ACI
N050.04.39.455 E019.47.03.925 N050.04.39.504 E019.47.03.898 Color_252ACI
N050.04.39.504 E019.47.03.898 N050.04.39.540 E019.47.03.836 Color_252ACI
N050.04.39.540 E019.47.03.836 N050.04.39.551 E019.47.03.779 Color_252ACI
N050.04.39.756 E019.47.05.252 N050.04.39.746 E019.47.05.163 Color_252ACI
N050.04.39.746 E019.47.05.163 N050.04.39.699 E019.47.05.091 Color_252ACI
N050.04.39.699 E019.47.05.091 N050.04.39.643 E019.47.05.074 Color_252ACI
N050.04.39.643 E019.47.05.074 N050.04.39.582 E019.47.05.116 Color_252ACI
N050.04.39.582 E019.47.05.116 N050.04.39.551 E019.47.05.200 Color_252ACI
N050.04.39.551 E019.47.05.200 N050.04.39.557 E019.47.05.301 Color_252ACI
N050.04.39.557 E019.47.05.301 N050.04.39.596 E019.47.05.372 Color_252ACI
N050.04.39.596 E019.47.05.372 N050.04.39.660 E019.47.05.397 Color_252ACI
N050.04.39.660 E019.47.05.397 N050.04.39.710 E019.47.05.371 Color_252ACI
N050.04.39.710 E019.47.05.371 N050.04.39.746 E019.47.05.308 Color_252ACI
N050.04.39.746 E019.47.05.308 N050.04.39.756 E019.47.05.252 Color_252ACI
N050.04.28.446 E019.45.44.231 N050.04.28.436 E019.45.44.142 Color_252ACI
N050.04.28.436 E019.45.44.142 N050.04.28.390 E019.45.44.069 Color_252ACI
N050.04.28.390 E019.45.44.069 N050.04.28.334 E019.45.44.053 Color_252ACI
N050.04.28.334 E019.45.44.053 N050.04.28.272 E019.45.44.095 Color_252ACI
N050.04.28.272 E019.45.44.095 N050.04.28.241 E019.45.44.179 Color_252ACI
N050.04.28.241 E019.45.44.179 N050.04.28.247 E019.45.44.280 Color_252ACI
N050.04.28.247 E019.45.44.280 N050.04.28.287 E019.45.44.351 Color_252ACI
N050.04.28.287 E019.45.44.351 N050.04.28.350 E019.45.44.376 Color_252ACI
N050.04.28.350 E019.45.44.376 N050.04.28.400 E019.45.44.350 Color_252ACI
N050.04.28.400 E019.45.44.350 N050.04.28.436 E019.45.44.287 Color_252ACI
N050.04.28.436 E019.45.44.287 N050.04.28.446 E019.45.44.231 Color_252ACI
N050.04.28.654 E019.45.45.716 N050.04.28.643 E019.45.45.627 Color_252ACI
N050.04.28.643 E019.45.45.627 N050.04.28.597 E019.45.45.555 Color_252ACI
N050.04.28.597 E019.45.45.555 N050.04.28.541 E019.45.45.538 Color_252ACI
N050.04.28.541 E019.45.45.538 N050.04.28.479 E019.45.45.580 Color_252ACI
N050.04.28.479 E019.45.45.580 N050.04.28.448 E019.45.45.664 Color_252ACI
N050.04.28.448 E019.45.45.664 N050.04.28.455 E019.45.45.765 Color_252ACI
N050.04.28.455 E019.45.45.765 N050.04.28.494 E019.45.45.836 Color_252ACI
N050.04.28.494 E019.45.45.836 N050.04.28.558 E019.45.45.861 Color_252ACI
N050.04.28.558 E019.45.45.861 N050.04.28.608 E019.45.45.835 Color_252ACI
N050.04.28.608 E019.45.45.835 N050.04.28.643 E019.45.45.772 Color_252ACI
N050.04.28.643 E019.45.45.772 N050.04.28.654 E019.45.45.716 Color_252ACI
N050.04.28.859 E019.45.47.183 N050.04.28.848 E019.45.47.093 Color_252ACI
N050.04.28.848 E019.45.47.093 N050.04.28.802 E019.45.47.021 Color_252ACI
N050.04.28.802 E019.45.47.021 N050.04.28.746 E019.45.47.004 Color_252ACI
N050.04.28.746 E019.45.47.004 N050.04.28.684 E019.45.47.047 Color_252ACI
N050.04.28.684 E019.45.47.047 N050.04.28.653 E019.45.47.131 Color_252ACI
N050.04.28.653 E019.45.47.131 N050.04.28.660 E019.45.47.232 Color_252ACI
N050.04.28.660 E019.45.47.232 N050.04.28.699 E019.45.47.303 Color_252ACI
N050.04.28.699 E019.45.47.303 N050.04.28.763 E019.45.47.328 Color_252ACI
N050.04.28.763 E019.45.47.328 N050.04.28.812 E019.45.47.302 Color_252ACI
N050.04.28.812 E019.45.47.302 N050.04.28.848 E019.45.47.239 Color_252ACI
N050.04.28.848 E019.45.47.239 N050.04.28.859 E019.45.47.183 Color_252ACI
N050.04.29.064 E019.45.48.656 N050.04.29.054 E019.45.48.567 Color_252ACI
N050.04.29.054 E019.45.48.567 N050.04.29.008 E019.45.48.495 Color_252ACI
N050.04.29.008 E019.45.48.495 N050.04.28.952 E019.45.48.478 Color_252ACI
N050.04.28.952 E019.45.48.478 N050.04.28.890 E019.45.48.521 Color_252ACI
N050.04.28.890 E019.45.48.521 N050.04.28.859 E019.45.48.604 Color_252ACI
N050.04.28.859 E019.45.48.604 N050.04.28.865 E019.45.48.705 Color_252ACI
N050.04.28.865 E019.45.48.705 N050.04.28.905 E019.45.48.777 Color_252ACI
N050.04.28.905 E019.45.48.777 N050.04.28.968 E019.45.48.802 Color_252ACI
N050.04.28.968 E019.45.48.802 N050.04.29.018 E019.45.48.775 Color_252ACI
N050.04.29.018 E019.45.48.775 N050.04.29.054 E019.45.48.713 Color_252ACI
N050.04.29.054 E019.45.48.713 N050.04.29.064 E019.45.48.656 Color_252ACI
N050.04.27.574 E019.45.50.723 N050.04.27.564 E019.45.50.633 Color_252ACI
N050.04.27.564 E019.45.50.633 N050.04.27.518 E019.45.50.561 Color_252ACI
N050.04.27.518 E019.45.50.561 N050.04.27.462 E019.45.50.544 Color_252ACI
N050.04.27.462 E019.45.50.544 N050.04.27.400 E019.45.50.587 Color_252ACI
N050.04.27.400 E019.45.50.587 N050.04.27.369 E019.45.50.670 Color_252ACI
N050.04.27.369 E019.45.50.670 N050.04.27.375 E019.45.50.771 Color_252ACI
N050.04.27.375 E019.45.50.771 N050.04.27.415 E019.45.50.843 Color_252ACI
N050.04.27.415 E019.45.50.843 N050.04.27.478 E019.45.50.868 Color_252ACI
N050.04.27.478 E019.45.50.868 N050.04.27.528 E019.45.50.841 Color_252ACI
N050.04.27.528 E019.45.50.841 N050.04.27.564 E019.45.50.779 Color_252ACI
N050.04.27.564 E019.45.50.779 N050.04.27.574 E019.45.50.723 Color_252ACI
N050.04.27.848 E019.45.50.630 N050.04.27.838 E019.45.50.540 Color_252ACI
N050.04.27.838 E019.45.50.540 N050.04.27.792 E019.45.50.468 Color_252ACI
N050.04.27.792 E019.45.50.468 N050.04.27.736 E019.45.50.451 Color_252ACI
N050.04.27.736 E019.45.50.451 N050.04.27.674 E019.45.50.494 Color_252ACI
N050.04.27.674 E019.45.50.494 N050.04.27.643 E019.45.50.577 Color_252ACI
N050.04.27.643 E019.45.50.577 N050.04.27.649 E019.45.50.678 Color_252ACI
N050.04.27.649 E019.45.50.678 N050.04.27.689 E019.45.50.750 Color_252ACI
N050.04.27.689 E019.45.50.750 N050.04.27.753 E019.45.50.775 Color_252ACI
N050.04.27.753 E019.45.50.775 N050.04.27.802 E019.45.50.748 Color_252ACI
N050.04.27.802 E019.45.50.748 N050.04.27.838 E019.45.50.686 Color_252ACI
N050.04.27.838 E019.45.50.686 N050.04.27.848 E019.45.50.630 Color_252ACI
N050.04.28.139 E019.45.50.531 N050.04.28.128 E019.45.50.442 Color_252ACI
N050.04.28.128 E019.45.50.442 N050.04.28.082 E019.45.50.370 Color_252ACI
N050.04.28.082 E019.45.50.370 N050.04.28.026 E019.45.50.353 Color_252ACI
N050.04.28.026 E019.45.50.353 N050.04.27.964 E019.45.50.396 Color_252ACI
N050.04.27.964 E019.45.50.396 N050.04.27.933 E019.45.50.479 Color_252ACI
N050.04.27.933 E019.45.50.479 N050.04.27.940 E019.45.50.580 Color_252ACI
N050.04.27.940 E019.45.50.580 N050.04.27.979 E019.45.50.652 Color_252ACI
N050.04.27.979 E019.45.50.652 N050.04.28.043 E019.45.50.677 Color_252ACI
N050.04.28.043 E019.45.50.677 N050.04.28.092 E019.45.50.650 Color_252ACI
N050.04.28.092 E019.45.50.650 N050.04.28.128 E019.45.50.587 Color_252ACI
N050.04.28.128 E019.45.50.587 N050.04.28.139 E019.45.50.531 Color_252ACI
N050.04.28.418 E019.45.50.436 N050.04.28.408 E019.45.50.347 Color_252ACI
N050.04.28.408 E019.45.50.347 N050.04.28.362 E019.45.50.275 Color_252ACI
N050.04.28.362 E019.45.50.275 N050.04.28.306 E019.45.50.258 Color_252ACI
N050.04.28.306 E019.45.50.258 N050.04.28.244 E019.45.50.301 Color_252ACI
N050.04.28.244 E019.45.50.301 N050.04.28.213 E019.45.50.384 Color_252ACI
N050.04.28.213 E019.45.50.384 N050.04.28.219 E019.45.50.485 Color_252ACI
N050.04.28.219 E019.45.50.485 N050.04.28.259 E019.45.50.557 Color_252ACI
N050.04.28.259 E019.45.50.557 N050.04.28.322 E019.45.50.582 Color_252ACI
N050.04.28.322 E019.45.50.582 N050.04.28.372 E019.45.50.555 Color_252ACI
N050.04.28.372 E019.45.50.555 N050.04.28.408 E019.45.50.493 Color_252ACI
N050.04.28.408 E019.45.50.493 N050.04.28.418 E019.45.50.436 Color_252ACI
N050.04.28.705 E019.45.50.339 N050.04.28.694 E019.45.50.250 Color_252ACI
N050.04.28.694 E019.45.50.250 N050.04.28.648 E019.45.50.178 Color_252ACI
N050.04.28.648 E019.45.50.178 N050.04.28.592 E019.45.50.161 Color_252ACI
N050.04.28.592 E019.45.50.161 N050.04.28.530 E019.45.50.204 Color_252ACI
N050.04.28.530 E019.45.50.204 N050.04.28.499 E019.45.50.287 Color_252ACI
N050.04.28.499 E019.45.50.287 N050.04.28.506 E019.45.50.388 Color_252ACI
N050.04.28.506 E019.45.50.388 N050.04.28.545 E019.45.50.460 Color_252ACI
N050.04.28.545 E019.45.50.460 N050.04.28.609 E019.45.50.485 Color_252ACI
N050.04.28.609 E019.45.50.485 N050.04.28.659 E019.45.50.458 Color_252ACI
N050.04.28.659 E019.45.50.458 N050.04.28.694 E019.45.50.395 Color_252ACI
N050.04.28.694 E019.45.50.395 N050.04.28.705 E019.45.50.339 Color_252ACI
N050.04.28.984 E019.45.50.245 N050.04.28.974 E019.45.50.155 Color_252ACI
N050.04.28.974 E019.45.50.155 N050.04.28.927 E019.45.50.083 Color_252ACI
N050.04.28.927 E019.45.50.083 N050.04.28.872 E019.45.50.066 Color_252ACI
N050.04.28.872 E019.45.50.066 N050.04.28.810 E019.45.50.109 Color_252ACI
N050.04.28.810 E019.45.50.109 N050.04.28.779 E019.45.50.192 Color_252ACI
N050.04.28.779 E019.45.50.192 N050.04.28.785 E019.45.50.293 Color_252ACI
N050.04.28.785 E019.45.50.293 N050.04.28.825 E019.45.50.365 Color_252ACI
N050.04.28.825 E019.45.50.365 N050.04.28.888 E019.45.50.390 Color_252ACI
N050.04.28.888 E019.45.50.390 N050.04.28.938 E019.45.50.363 Color_252ACI
N050.04.28.938 E019.45.50.363 N050.04.28.974 E019.45.50.301 Color_252ACI
N050.04.28.974 E019.45.50.301 N050.04.28.984 E019.45.50.245 Color_252ACI
N050.04.29.274 E019.45.50.146 N050.04.29.263 E019.45.50.057 Color_252ACI
N050.04.29.263 E019.45.50.057 N050.04.29.217 E019.45.49.985 Color_252ACI
N050.04.29.217 E019.45.49.985 N050.04.29.161 E019.45.49.968 Color_252ACI
N050.04.29.161 E019.45.49.968 N050.04.29.099 E019.45.50.011 Color_252ACI
N050.04.29.099 E019.45.50.011 N050.04.29.069 E019.45.50.094 Color_252ACI
N050.04.29.069 E019.45.50.094 N050.04.29.075 E019.45.50.195 Color_252ACI
N050.04.29.075 E019.45.50.195 N050.04.29.114 E019.45.50.267 Color_252ACI
N050.04.29.114 E019.45.50.267 N050.04.29.178 E019.45.50.292 Color_252ACI
N050.04.29.178 E019.45.50.292 N050.04.29.228 E019.45.50.265 Color_252ACI
N050.04.29.228 E019.45.50.265 N050.04.29.263 E019.45.50.202 Color_252ACI
N050.04.29.263 E019.45.50.202 N050.04.29.274 E019.45.50.146 Color_252ACI
N050.04.29.561 E019.45.50.049 N050.04.29.550 E019.45.49.960 Color_252ACI
N050.04.29.550 E019.45.49.960 N050.04.29.504 E019.45.49.887 Color_252ACI
N050.04.29.504 E019.45.49.887 N050.04.29.448 E019.45.49.871 Color_252ACI
N050.04.29.448 E019.45.49.871 N050.04.29.386 E019.45.49.913 Color_252ACI
N050.04.29.386 E019.45.49.913 N050.04.29.356 E019.45.49.997 Color_252ACI
N050.04.29.356 E019.45.49.997 N050.04.29.362 E019.45.50.098 Color_252ACI
N050.04.29.362 E019.45.50.098 N050.04.29.401 E019.45.50.169 Color_252ACI
N050.04.29.401 E019.45.50.169 N050.04.29.465 E019.45.50.194 Color_252ACI
N050.04.29.465 E019.45.50.194 N050.04.29.515 E019.45.50.168 Color_252ACI
N050.04.29.515 E019.45.50.168 N050.04.29.550 E019.45.50.105 Color_252ACI
N050.04.29.550 E019.45.50.105 N050.04.29.561 E019.45.50.049 Color_252ACI
N050.04.29.844 E019.45.49.953 N050.04.29.834 E019.45.49.863 Color_252ACI
N050.04.29.834 E019.45.49.863 N050.04.29.788 E019.45.49.791 Color_252ACI
N050.04.29.788 E019.45.49.791 N050.04.29.732 E019.45.49.774 Color_252ACI
N050.04.29.732 E019.45.49.774 N050.04.29.670 E019.45.49.817 Color_252ACI
N050.04.29.670 E019.45.49.817 N050.04.29.639 E019.45.49.901 Color_252ACI
N050.04.29.639 E019.45.49.901 N050.04.29.645 E019.45.50.002 Color_252ACI
N050.04.29.645 E019.45.50.002 N050.04.29.685 E019.45.50.073 Color_252ACI
N050.04.29.685 E019.45.50.073 N050.04.29.749 E019.45.50.098 Color_252ACI
N050.04.29.749 E019.45.50.098 N050.04.29.798 E019.45.50.072 Color_252ACI
N050.04.29.798 E019.45.50.072 N050.04.29.834 E019.45.50.009 Color_252ACI
N050.04.29.834 E019.45.50.009 N050.04.29.844 E019.45.49.953 Color_252ACI
N050.04.30.117 E019.45.49.860 N050.04.30.106 E019.45.49.771 Color_252ACI
N050.04.30.106 E019.45.49.771 N050.04.30.060 E019.45.49.699 Color_252ACI
N050.04.30.060 E019.45.49.699 N050.04.30.004 E019.45.49.682 Color_252ACI
N050.04.30.004 E019.45.49.682 N050.04.29.942 E019.45.49.725 Color_252ACI
N050.04.29.942 E019.45.49.725 N050.04.29.912 E019.45.49.808 Color_252ACI
N050.04.29.912 E019.45.49.808 N050.04.29.918 E019.45.49.909 Color_252ACI
N050.04.29.918 E019.45.49.909 N050.04.29.957 E019.45.49.981 Color_252ACI
N050.04.29.957 E019.45.49.981 N050.04.30.021 E019.45.50.006 Color_252ACI
N050.04.30.021 E019.45.50.006 N050.04.30.071 E019.45.49.979 Color_252ACI
N050.04.30.071 E019.45.49.979 N050.04.30.106 E019.45.49.917 Color_252ACI
N050.04.30.106 E019.45.49.917 N050.04.30.117 E019.45.49.860 Color_252ACI
N050.04.30.399 E019.45.49.765 N050.04.30.389 E019.45.49.675 Color_252ACI
N050.04.30.389 E019.45.49.675 N050.04.30.343 E019.45.49.603 Color_252ACI
N050.04.30.343 E019.45.49.603 N050.04.30.287 E019.45.49.586 Color_252ACI
N050.04.30.287 E019.45.49.586 N050.04.30.225 E019.45.49.629 Color_252ACI
N050.04.30.225 E019.45.49.629 N050.04.30.194 E019.45.49.713 Color_252ACI
N050.04.30.194 E019.45.49.713 N050.04.30.200 E019.45.49.814 Color_252ACI
N050.04.30.200 E019.45.49.814 N050.04.30.240 E019.45.49.885 Color_252ACI
N050.04.30.240 E019.45.49.885 N050.04.30.303 E019.45.49.910 Color_252ACI
N050.04.30.303 E019.45.49.910 N050.04.30.353 E019.45.49.883 Color_252ACI
N050.04.30.353 E019.45.49.883 N050.04.30.389 E019.45.49.821 Color_252ACI
N050.04.30.389 E019.45.49.821 N050.04.30.399 E019.45.49.765 Color_252ACI
N050.04.30.696 E019.45.49.664 N050.04.30.686 E019.45.49.575 Color_252ACI
N050.04.30.686 E019.45.49.575 N050.04.30.640 E019.45.49.502 Color_252ACI
N050.04.30.640 E019.45.49.502 N050.04.30.584 E019.45.49.486 Color_252ACI
N050.04.30.584 E019.45.49.486 N050.04.30.522 E019.45.49.528 Color_252ACI
N050.04.30.522 E019.45.49.528 N050.04.30.491 E019.45.49.612 Color_252ACI
N050.04.30.491 E019.45.49.612 N050.04.30.497 E019.45.49.713 Color_252ACI
N050.04.30.497 E019.45.49.713 N050.04.30.537 E019.45.49.784 Color_252ACI
N050.04.30.537 E019.45.49.784 N050.04.30.601 E019.45.49.809 Color_252ACI
N050.04.30.601 E019.45.49.809 N050.04.30.650 E019.45.49.783 Color_252ACI
N050.04.30.650 E019.45.49.783 N050.04.30.686 E019.45.49.720 Color_252ACI
N050.04.30.686 E019.45.49.720 N050.04.30.696 E019.45.49.664 Color_252ACI
N050.04.30.979 E019.45.49.568 N050.04.30.969 E019.45.49.479 Color_252ACI
N050.04.30.969 E019.45.49.479 N050.04.30.923 E019.45.49.407 Color_252ACI
N050.04.30.923 E019.45.49.407 N050.04.30.867 E019.45.49.390 Color_252ACI
N050.04.30.867 E019.45.49.390 N050.04.30.805 E019.45.49.432 Color_252ACI
N050.04.30.805 E019.45.49.432 N050.04.30.774 E019.45.49.516 Color_252ACI
N050.04.30.774 E019.45.49.516 N050.04.30.780 E019.45.49.617 Color_252ACI
N050.04.30.780 E019.45.49.617 N050.04.30.820 E019.45.49.689 Color_252ACI
N050.04.30.820 E019.45.49.689 N050.04.30.883 E019.45.49.713 Color_252ACI
N050.04.30.883 E019.45.49.713 N050.04.30.933 E019.45.49.687 Color_252ACI
N050.04.30.933 E019.45.49.687 N050.04.30.969 E019.45.49.624 Color_252ACI
N050.04.30.969 E019.45.49.624 N050.04.30.979 E019.45.49.568 Color_252ACI
N050.04.29.479 E019.45.51.625 N050.04.29.468 E019.45.51.535 Color_252ACI
N050.04.29.468 E019.45.51.535 N050.04.29.422 E019.45.51.463 Color_252ACI
N050.04.29.422 E019.45.51.463 N050.04.29.366 E019.45.51.447 Color_252ACI
N050.04.29.366 E019.45.51.447 N050.04.29.304 E019.45.51.489 Color_252ACI
N050.04.29.304 E019.45.51.489 N050.04.29.274 E019.45.51.573 Color_252ACI
N050.04.29.274 E019.45.51.573 N050.04.29.280 E019.45.51.674 Color_252ACI
N050.04.29.280 E019.45.51.674 N050.04.29.319 E019.45.51.745 Color_252ACI
N050.04.29.319 E019.45.51.745 N050.04.29.383 E019.45.51.770 Color_252ACI
N050.04.29.383 E019.45.51.770 N050.04.29.433 E019.45.51.744 Color_252ACI
N050.04.29.433 E019.45.51.744 N050.04.29.468 E019.45.51.681 Color_252ACI
N050.04.29.468 E019.45.51.681 N050.04.29.479 E019.45.51.625 Color_252ACI
N050.04.29.683 E019.45.53.088 N050.04.29.673 E019.45.52.999 Color_252ACI
N050.04.29.673 E019.45.52.999 N050.04.29.627 E019.45.52.926 Color_252ACI
N050.04.29.627 E019.45.52.926 N050.04.29.571 E019.45.52.910 Color_252ACI
N050.04.29.571 E019.45.52.910 N050.04.29.509 E019.45.52.952 Color_252ACI
N050.04.29.509 E019.45.52.952 N050.04.29.478 E019.45.53.036 Color_252ACI
N050.04.29.478 E019.45.53.036 N050.04.29.484 E019.45.53.137 Color_252ACI
N050.04.29.484 E019.45.53.137 N050.04.29.524 E019.45.53.208 Color_252ACI
N050.04.29.524 E019.45.53.208 N050.04.29.587 E019.45.53.233 Color_252ACI
N050.04.29.587 E019.45.53.233 N050.04.29.637 E019.45.53.207 Color_252ACI
N050.04.29.637 E019.45.53.207 N050.04.29.673 E019.45.53.144 Color_252ACI
N050.04.29.673 E019.45.53.144 N050.04.29.683 E019.45.53.088 Color_252ACI
N050.04.29.892 E019.45.54.580 N050.04.29.881 E019.45.54.491 Color_252ACI
N050.04.29.881 E019.45.54.491 N050.04.29.835 E019.45.54.419 Color_252ACI
N050.04.29.835 E019.45.54.419 N050.04.29.779 E019.45.54.402 Color_252ACI
N050.04.29.779 E019.45.54.402 N050.04.29.717 E019.45.54.444 Color_252ACI
N050.04.29.717 E019.45.54.444 N050.04.29.686 E019.45.54.528 Color_252ACI
N050.04.29.686 E019.45.54.528 N050.04.29.693 E019.45.54.629 Color_252ACI
N050.04.29.693 E019.45.54.629 N050.04.29.732 E019.45.54.700 Color_252ACI
N050.04.29.732 E019.45.54.700 N050.04.29.796 E019.45.54.725 Color_252ACI
N050.04.29.796 E019.45.54.725 N050.04.29.846 E019.45.54.699 Color_252ACI
N050.04.29.846 E019.45.54.699 N050.04.29.881 E019.45.54.636 Color_252ACI
N050.04.29.881 E019.45.54.636 N050.04.29.892 E019.45.54.580 Color_252ACI
N050.04.30.096 E019.45.56.043 N050.04.30.085 E019.45.55.954 Color_252ACI
N050.04.30.085 E019.45.55.954 N050.04.30.039 E019.45.55.882 Color_252ACI
N050.04.30.039 E019.45.55.882 N050.04.29.983 E019.45.55.865 Color_252ACI
N050.04.29.983 E019.45.55.865 N050.04.29.921 E019.45.55.907 Color_252ACI
N050.04.29.921 E019.45.55.907 N050.04.29.891 E019.45.55.991 Color_252ACI
N050.04.29.891 E019.45.55.991 N050.04.29.897 E019.45.56.092 Color_252ACI
N050.04.29.897 E019.45.56.092 N050.04.29.936 E019.45.56.164 Color_252ACI
N050.04.29.936 E019.45.56.164 N050.04.30.000 E019.45.56.188 Color_252ACI
N050.04.30.000 E019.45.56.188 N050.04.30.050 E019.45.56.162 Color_252ACI
N050.04.30.050 E019.45.56.162 N050.04.30.085 E019.45.56.099 Color_252ACI
N050.04.30.085 E019.45.56.099 N050.04.30.096 E019.45.56.043 Color_252ACI
N050.04.30.302 E019.45.57.521 N050.04.30.292 E019.45.57.431 Color_252ACI
N050.04.30.292 E019.45.57.431 N050.04.30.246 E019.45.57.359 Color_252ACI
N050.04.30.246 E019.45.57.359 N050.04.30.190 E019.45.57.342 Color_252ACI
N050.04.30.190 E019.45.57.342 N050.04.30.128 E019.45.57.385 Color_252ACI
N050.04.30.128 E019.45.57.385 N050.04.30.097 E019.45.57.469 Color_252ACI
N050.04.30.097 E019.45.57.469 N050.04.30.103 E019.45.57.570 Color_252ACI
N050.04.30.103 E019.45.57.570 N050.04.30.143 E019.45.57.641 Color_252ACI
N050.04.30.143 E019.45.57.641 N050.04.30.206 E019.45.57.666 Color_252ACI
N050.04.30.206 E019.45.57.666 N050.04.30.256 E019.45.57.639 Color_252ACI
N050.04.30.256 E019.45.57.639 N050.04.30.292 E019.45.57.577 Color_252ACI
N050.04.30.292 E019.45.57.577 N050.04.30.302 E019.45.57.521 Color_252ACI
N050.04.30.511 E019.45.59.014 N050.04.30.500 E019.45.58.925 Color_252ACI
N050.04.30.500 E019.45.58.925 N050.04.30.454 E019.45.58.853 Color_252ACI
N050.04.30.454 E019.45.58.853 N050.04.30.398 E019.45.58.836 Color_252ACI
N050.04.30.398 E019.45.58.836 N050.04.30.336 E019.45.58.878 Color_252ACI
N050.04.30.336 E019.45.58.878 N050.04.30.306 E019.45.58.962 Color_252ACI
N050.04.30.306 E019.45.58.962 N050.04.30.312 E019.45.59.063 Color_252ACI
N050.04.30.312 E019.45.59.063 N050.04.30.351 E019.45.59.134 Color_252ACI
N050.04.30.351 E019.45.59.134 N050.04.30.415 E019.45.59.159 Color_252ACI
N050.04.30.415 E019.45.59.159 N050.04.30.465 E019.45.59.133 Color_252ACI
N050.04.30.465 E019.45.59.133 N050.04.30.500 E019.45.59.070 Color_252ACI
N050.04.30.500 E019.45.59.070 N050.04.30.511 E019.45.59.014 Color_252ACI
N050.04.30.716 E019.46.00.483 N050.04.30.705 E019.46.00.394 Color_252ACI
N050.04.30.705 E019.46.00.394 N050.04.30.659 E019.46.00.322 Color_252ACI
N050.04.30.659 E019.46.00.322 N050.04.30.603 E019.46.00.305 Color_252ACI
N050.04.30.603 E019.46.00.305 N050.04.30.542 E019.46.00.348 Color_252ACI
N050.04.30.542 E019.46.00.348 N050.04.30.511 E019.46.00.431 Color_252ACI
N050.04.30.511 E019.46.00.431 N050.04.30.517 E019.46.00.532 Color_252ACI
N050.04.30.517 E019.46.00.532 N050.04.30.556 E019.46.00.604 Color_252ACI
N050.04.30.556 E019.46.00.604 N050.04.30.620 E019.46.00.629 Color_252ACI
N050.04.30.620 E019.46.00.629 N050.04.30.670 E019.46.00.602 Color_252ACI
N050.04.30.670 E019.46.00.602 N050.04.30.706 E019.46.00.539 Color_252ACI
N050.04.30.706 E019.46.00.539 N050.04.30.716 E019.46.00.483 Color_252ACI
N050.04.30.920 E019.46.01.947 N050.04.30.910 E019.46.01.857 Color_252ACI
N050.04.30.910 E019.46.01.857 N050.04.30.864 E019.46.01.785 Color_252ACI
N050.04.30.864 E019.46.01.785 N050.04.30.808 E019.46.01.768 Color_252ACI
N050.04.30.808 E019.46.01.768 N050.04.30.746 E019.46.01.811 Color_252ACI
N050.04.30.746 E019.46.01.811 N050.04.30.715 E019.46.01.895 Color_252ACI
N050.04.30.715 E019.46.01.895 N050.04.30.721 E019.46.01.996 Color_252ACI
N050.04.30.721 E019.46.01.996 N050.04.30.761 E019.46.02.067 Color_252ACI
N050.04.30.761 E019.46.02.067 N050.04.30.824 E019.46.02.092 Color_252ACI
N050.04.30.824 E019.46.02.092 N050.04.30.874 E019.46.02.066 Color_252ACI
N050.04.30.874 E019.46.02.066 N050.04.30.910 E019.46.02.003 Color_252ACI
N050.04.30.910 E019.46.02.003 N050.04.30.920 E019.46.01.947 Color_252ACI
N050.04.31.138 E019.46.03.506 N050.04.31.128 E019.46.03.417 Color_252ACI
N050.04.31.128 E019.46.03.417 N050.04.31.082 E019.46.03.345 Color_252ACI
N050.04.31.082 E019.46.03.345 N050.04.31.026 E019.46.03.328 Color_252ACI
N050.04.31.026 E019.46.03.328 N050.04.30.964 E019.46.03.371 Color_252ACI
N050.04.30.964 E019.46.03.371 N050.04.30.933 E019.46.03.454 Color_252ACI
N050.04.30.933 E019.46.03.454 N050.04.30.939 E019.46.03.555 Color_252ACI
N050.04.30.939 E019.46.03.555 N050.04.30.979 E019.46.03.627 Color_252ACI
N050.04.30.979 E019.46.03.627 N050.04.31.042 E019.46.03.652 Color_252ACI
N050.04.31.042 E019.46.03.652 N050.04.31.092 E019.46.03.625 Color_252ACI
N050.04.31.092 E019.46.03.625 N050.04.31.128 E019.46.03.562 Color_252ACI
N050.04.31.128 E019.46.03.562 N050.04.31.138 E019.46.03.506 Color_252ACI
N050.04.28.421 E019.46.05.340 N050.04.28.410 E019.46.05.250 Color_252ACI
N050.04.28.410 E019.46.05.250 N050.04.28.364 E019.46.05.178 Color_252ACI
N050.04.28.364 E019.46.05.178 N050.04.28.308 E019.46.05.161 Color_252ACI
N050.04.28.308 E019.46.05.161 N050.04.28.247 E019.46.05.204 Color_252ACI
N050.04.28.247 E019.46.05.204 N050.04.28.216 E019.46.05.288 Color_252ACI
N050.04.28.216 E019.46.05.288 N050.04.28.222 E019.46.05.389 Color_252ACI
N050.04.28.222 E019.46.05.389 N050.04.28.261 E019.46.05.460 Color_252ACI
N050.04.28.261 E019.46.05.460 N050.04.28.325 E019.46.05.485 Color_252ACI
N050.04.28.325 E019.46.05.485 N050.04.28.375 E019.46.05.459 Color_252ACI
N050.04.28.375 E019.46.05.459 N050.04.28.411 E019.46.05.396 Color_252ACI
N050.04.28.411 E019.46.05.396 N050.04.28.421 E019.46.05.340 Color_252ACI
N050.04.28.707 E019.46.05.243 N050.04.28.696 E019.46.05.154 Color_252ACI
N050.04.28.696 E019.46.05.154 N050.04.28.650 E019.46.05.081 Color_252ACI
N050.04.28.650 E019.46.05.081 N050.04.28.594 E019.46.05.065 Color_252ACI
N050.04.28.594 E019.46.05.065 N050.04.28.532 E019.46.05.107 Color_252ACI
N050.04.28.532 E019.46.05.107 N050.04.28.502 E019.46.05.191 Color_252ACI
N050.04.28.502 E019.46.05.191 N050.04.28.508 E019.46.05.292 Color_252ACI
N050.04.28.508 E019.46.05.292 N050.04.28.547 E019.46.05.363 Color_252ACI
N050.04.28.547 E019.46.05.363 N050.04.28.611 E019.46.05.388 Color_252ACI
N050.04.28.611 E019.46.05.388 N050.04.28.661 E019.46.05.362 Color_252ACI
N050.04.28.661 E019.46.05.362 N050.04.28.696 E019.46.05.299 Color_252ACI
N050.04.28.696 E019.46.05.299 N050.04.28.707 E019.46.05.243 Color_252ACI
N050.04.28.985 E019.46.05.149 N050.04.28.974 E019.46.05.059 Color_252ACI
N050.04.28.974 E019.46.05.059 N050.04.28.928 E019.46.04.987 Color_252ACI
N050.04.28.928 E019.46.04.987 N050.04.28.872 E019.46.04.970 Color_252ACI
N050.04.28.872 E019.46.04.970 N050.04.28.810 E019.46.05.013 Color_252ACI
N050.04.28.810 E019.46.05.013 N050.04.28.779 E019.46.05.097 Color_252ACI
N050.04.28.779 E019.46.05.097 N050.04.28.786 E019.46.05.198 Color_252ACI
N050.04.28.786 E019.46.05.198 N050.04.28.825 E019.46.05.269 Color_252ACI
N050.04.28.825 E019.46.05.269 N050.04.28.889 E019.46.05.294 Color_252ACI
N050.04.28.889 E019.46.05.294 N050.04.28.939 E019.46.05.268 Color_252ACI
N050.04.28.939 E019.46.05.268 N050.04.28.974 E019.46.05.205 Color_252ACI
N050.04.28.974 E019.46.05.205 N050.04.28.985 E019.46.05.149 Color_252ACI
N050.04.29.269 E019.46.05.052 N050.04.29.259 E019.46.04.963 Color_252ACI
N050.04.29.259 E019.46.04.963 N050.04.29.213 E019.46.04.891 Color_252ACI
N050.04.29.213 E019.46.04.891 N050.04.29.157 E019.46.04.874 Color_252ACI
N050.04.29.157 E019.46.04.874 N050.04.29.095 E019.46.04.917 Color_252ACI
N050.04.29.095 E019.46.04.917 N050.04.29.064 E019.46.05.000 Color_252ACI
N050.04.29.064 E019.46.05.000 N050.04.29.070 E019.46.05.101 Color_252ACI
N050.04.29.070 E019.46.05.101 N050.04.29.110 E019.46.05.173 Color_252ACI
N050.04.29.110 E019.46.05.173 N050.04.29.173 E019.46.05.198 Color_252ACI
N050.04.29.173 E019.46.05.198 N050.04.29.223 E019.46.05.171 Color_252ACI
N050.04.29.223 E019.46.05.171 N050.04.29.259 E019.46.05.108 Color_252ACI
N050.04.29.259 E019.46.05.108 N050.04.29.269 E019.46.05.052 Color_252ACI
N050.04.29.551 E019.46.04.957 N050.04.29.541 E019.46.04.867 Color_252ACI
N050.04.29.541 E019.46.04.867 N050.04.29.494 E019.46.04.795 Color_252ACI
N050.04.29.494 E019.46.04.795 N050.04.29.438 E019.46.04.778 Color_252ACI
N050.04.29.438 E019.46.04.778 N050.04.29.377 E019.46.04.821 Color_252ACI
N050.04.29.377 E019.46.04.821 N050.04.29.346 E019.46.04.905 Color_252ACI
N050.04.29.346 E019.46.04.905 N050.04.29.352 E019.46.05.006 Color_252ACI
N050.04.29.352 E019.46.05.006 N050.04.29.391 E019.46.05.077 Color_252ACI
N050.04.29.391 E019.46.05.077 N050.04.29.455 E019.46.05.102 Color_252ACI
N050.04.29.455 E019.46.05.102 N050.04.29.505 E019.46.05.075 Color_252ACI
N050.04.29.505 E019.46.05.075 N050.04.29.541 E019.46.05.013 Color_252ACI
N050.04.29.541 E019.46.05.013 N050.04.29.551 E019.46.04.957 Color_252ACI
N050.04.29.823 E019.46.04.865 N050.04.29.812 E019.46.04.775 Color_252ACI
N050.04.29.812 E019.46.04.775 N050.04.29.766 E019.46.04.703 Color_252ACI
N050.04.29.766 E019.46.04.703 N050.04.29.710 E019.46.04.686 Color_252ACI
N050.04.29.710 E019.46.04.686 N050.04.29.648 E019.46.04.729 Color_252ACI
N050.04.29.648 E019.46.04.729 N050.04.29.617 E019.46.04.813 Color_252ACI
N050.04.29.617 E019.46.04.813 N050.04.29.624 E019.46.04.913 Color_252ACI
N050.04.29.624 E019.46.04.913 N050.04.29.663 E019.46.04.985 Color_252ACI
N050.04.29.663 E019.46.04.985 N050.04.29.727 E019.46.05.010 Color_252ACI
N050.04.29.727 E019.46.05.010 N050.04.29.776 E019.46.04.983 Color_252ACI
N050.04.29.776 E019.46.04.983 N050.04.29.812 E019.46.04.921 Color_252ACI
N050.04.29.812 E019.46.04.921 N050.04.29.823 E019.46.04.865 Color_252ACI
N050.04.30.133 E019.46.04.760 N050.04.30.122 E019.46.04.670 Color_252ACI
N050.04.30.122 E019.46.04.670 N050.04.30.076 E019.46.04.598 Color_252ACI
N050.04.30.076 E019.46.04.598 N050.04.30.020 E019.46.04.581 Color_252ACI
N050.04.30.020 E019.46.04.581 N050.04.29.958 E019.46.04.624 Color_252ACI
N050.04.29.958 E019.46.04.624 N050.04.29.927 E019.46.04.707 Color_252ACI
N050.04.29.927 E019.46.04.707 N050.04.29.934 E019.46.04.808 Color_252ACI
N050.04.29.934 E019.46.04.808 N050.04.29.973 E019.46.04.880 Color_252ACI
N050.04.29.973 E019.46.04.880 N050.04.30.037 E019.46.04.905 Color_252ACI
N050.04.30.037 E019.46.04.905 N050.04.30.087 E019.46.04.878 Color_252ACI
N050.04.30.087 E019.46.04.878 N050.04.30.122 E019.46.04.816 Color_252ACI
N050.04.30.122 E019.46.04.816 N050.04.30.133 E019.46.04.760 Color_252ACI
N050.04.30.411 E019.46.04.665 N050.04.30.401 E019.46.04.576 Color_252ACI
N050.04.30.401 E019.46.04.576 N050.04.30.354 E019.46.04.504 Color_252ACI
N050.04.30.354 E019.46.04.504 N050.04.30.299 E019.46.04.487 Color_252ACI
N050.04.30.299 E019.46.04.487 N050.04.30.237 E019.46.04.529 Color_252ACI
N050.04.30.237 E019.46.04.529 N050.04.30.206 E019.46.04.613 Color_252ACI
N050.04.30.206 E019.46.04.613 N050.04.30.212 E019.46.04.714 Color_252ACI
N050.04.30.212 E019.46.04.714 N050.04.30.252 E019.46.04.786 Color_252ACI
N050.04.30.252 E019.46.04.786 N050.04.30.315 E019.46.04.810 Color_252ACI
N050.04.30.315 E019.46.04.810 N050.04.30.365 E019.46.04.784 Color_252ACI
N050.04.30.365 E019.46.04.784 N050.04.30.401 E019.46.04.721 Color_252ACI
N050.04.30.401 E019.46.04.721 N050.04.30.411 E019.46.04.665 Color_252ACI
N050.04.30.684 E019.46.04.572 N050.04.30.674 E019.46.04.483 Color_252ACI
N050.04.30.674 E019.46.04.483 N050.04.30.628 E019.46.04.411 Color_252ACI
N050.04.30.628 E019.46.04.411 N050.04.30.572 E019.46.04.394 Color_252ACI
N050.04.30.572 E019.46.04.394 N050.04.30.510 E019.46.04.437 Color_252ACI
N050.04.30.510 E019.46.04.437 N050.04.30.479 E019.46.04.520 Color_252ACI
N050.04.30.479 E019.46.04.520 N050.04.30.485 E019.46.04.621 Color_252ACI
N050.04.30.485 E019.46.04.621 N050.04.30.525 E019.46.04.693 Color_252ACI
N050.04.30.525 E019.46.04.693 N050.04.30.589 E019.46.04.718 Color_252ACI
N050.04.30.589 E019.46.04.718 N050.04.30.638 E019.46.04.691 Color_252ACI
N050.04.30.638 E019.46.04.691 N050.04.30.674 E019.46.04.629 Color_252ACI
N050.04.30.674 E019.46.04.629 N050.04.30.684 E019.46.04.572 Color_252ACI
N050.04.30.963 E019.46.04.478 N050.04.30.952 E019.46.04.389 Color_252ACI
N050.04.30.952 E019.46.04.389 N050.04.30.906 E019.46.04.317 Color_252ACI
N050.04.30.906 E019.46.04.317 N050.04.30.850 E019.46.04.300 Color_252ACI
N050.04.30.850 E019.46.04.300 N050.04.30.788 E019.46.04.342 Color_252ACI
N050.04.30.788 E019.46.04.342 N050.04.30.757 E019.46.04.426 Color_252ACI
N050.04.30.757 E019.46.04.426 N050.04.30.763 E019.46.04.527 Color_252ACI
N050.04.30.763 E019.46.04.527 N050.04.30.803 E019.46.04.599 Color_252ACI
N050.04.30.803 E019.46.04.599 N050.04.30.867 E019.46.04.623 Color_252ACI
N050.04.30.867 E019.46.04.623 N050.04.30.916 E019.46.04.597 Color_252ACI
N050.04.30.916 E019.46.04.597 N050.04.30.952 E019.46.04.534 Color_252ACI
N050.04.30.952 E019.46.04.534 N050.04.30.963 E019.46.04.478 Color_252ACI
N050.04.31.262 E019.46.04.377 N050.04.31.251 E019.46.04.287 Color_252ACI
N050.04.31.251 E019.46.04.287 N050.04.31.205 E019.46.04.215 Color_252ACI
N050.04.31.205 E019.46.04.215 N050.04.31.149 E019.46.04.198 Color_252ACI
N050.04.31.149 E019.46.04.198 N050.04.31.087 E019.46.04.241 Color_252ACI
N050.04.31.087 E019.46.04.241 N050.04.31.057 E019.46.04.325 Color_252ACI
N050.04.31.057 E019.46.04.325 N050.04.31.063 E019.46.04.425 Color_252ACI
N050.04.31.063 E019.46.04.425 N050.04.31.102 E019.46.04.497 Color_252ACI
N050.04.31.102 E019.46.04.497 N050.04.31.166 E019.46.04.522 Color_252ACI
N050.04.31.166 E019.46.04.522 N050.04.31.216 E019.46.04.495 Color_252ACI
N050.04.31.216 E019.46.04.495 N050.04.31.251 E019.46.04.433 Color_252ACI
N050.04.31.251 E019.46.04.433 N050.04.31.262 E019.46.04.377 Color_252ACI
N050.04.31.553 E019.46.04.278 N050.04.31.542 E019.46.04.189 Color_252ACI
N050.04.31.542 E019.46.04.189 N050.04.31.496 E019.46.04.116 Color_252ACI
N050.04.31.496 E019.46.04.116 N050.04.31.440 E019.46.04.100 Color_252ACI
N050.04.31.440 E019.46.04.100 N050.04.31.378 E019.46.04.142 Color_252ACI
N050.04.31.378 E019.46.04.142 N050.04.31.348 E019.46.04.226 Color_252ACI
N050.04.31.348 E019.46.04.226 N050.04.31.354 E019.46.04.327 Color_252ACI
N050.04.31.354 E019.46.04.327 N050.04.31.393 E019.46.04.398 Color_252ACI
N050.04.31.393 E019.46.04.398 N050.04.31.457 E019.46.04.423 Color_252ACI
N050.04.31.457 E019.46.04.423 N050.04.31.507 E019.46.04.397 Color_252ACI
N050.04.31.507 E019.46.04.397 N050.04.31.542 E019.46.04.334 Color_252ACI
N050.04.31.542 E019.46.04.334 N050.04.31.553 E019.46.04.278 Color_252ACI
N050.04.31.833 E019.46.04.183 N050.04.31.822 E019.46.04.094 Color_252ACI
N050.04.31.822 E019.46.04.094 N050.04.31.776 E019.46.04.022 Color_252ACI
N050.04.31.776 E019.46.04.022 N050.04.31.720 E019.46.04.005 Color_252ACI
N050.04.31.720 E019.46.04.005 N050.04.31.658 E019.46.04.047 Color_252ACI
N050.04.31.658 E019.46.04.047 N050.04.31.627 E019.46.04.131 Color_252ACI
N050.04.31.627 E019.46.04.131 N050.04.31.634 E019.46.04.232 Color_252ACI
N050.04.31.634 E019.46.04.232 N050.04.31.673 E019.46.04.304 Color_252ACI
N050.04.31.673 E019.46.04.304 N050.04.31.737 E019.46.04.328 Color_252ACI
N050.04.31.737 E019.46.04.328 N050.04.31.787 E019.46.04.302 Color_252ACI
N050.04.31.787 E019.46.04.302 N050.04.31.822 E019.46.04.239 Color_252ACI
N050.04.31.822 E019.46.04.239 N050.04.31.833 E019.46.04.183 Color_252ACI
N050.04.32.109 E019.46.04.089 N050.04.32.098 E019.46.04.000 Color_252ACI
N050.04.32.098 E019.46.04.000 N050.04.32.052 E019.46.03.928 Color_252ACI
N050.04.32.052 E019.46.03.928 N050.04.31.996 E019.46.03.911 Color_252ACI
N050.04.31.996 E019.46.03.911 N050.04.31.934 E019.46.03.954 Color_252ACI
N050.04.31.934 E019.46.03.954 N050.04.31.903 E019.46.04.037 Color_252ACI
N050.04.31.903 E019.46.04.037 N050.04.31.910 E019.46.04.138 Color_252ACI
N050.04.31.910 E019.46.04.138 N050.04.31.949 E019.46.04.210 Color_252ACI
N050.04.31.949 E019.46.04.210 N050.04.32.013 E019.46.04.235 Color_252ACI
N050.04.32.013 E019.46.04.235 N050.04.32.063 E019.46.04.208 Color_252ACI
N050.04.32.063 E019.46.04.208 N050.04.32.098 E019.46.04.146 Color_252ACI
N050.04.32.098 E019.46.04.146 N050.04.32.109 E019.46.04.089 Color_252ACI
N050.04.32.397 E019.46.03.992 N050.04.32.387 E019.46.03.902 Color_252ACI
N050.04.32.387 E019.46.03.902 N050.04.32.340 E019.46.03.830 Color_252ACI
N050.04.32.340 E019.46.03.830 N050.04.32.284 E019.46.03.813 Color_252ACI
N050.04.32.284 E019.46.03.813 N050.04.32.223 E019.46.03.856 Color_252ACI
N050.04.32.223 E019.46.03.856 N050.04.32.192 E019.46.03.940 Color_252ACI
N050.04.32.192 E019.46.03.940 N050.04.32.198 E019.46.04.041 Color_252ACI
N050.04.32.198 E019.46.04.041 N050.04.32.238 E019.46.04.112 Color_252ACI
N050.04.32.238 E019.46.04.112 N050.04.32.301 E019.46.04.137 Color_252ACI
N050.04.32.301 E019.46.04.137 N050.04.32.351 E019.46.04.111 Color_252ACI
N050.04.32.351 E019.46.04.111 N050.04.32.387 E019.46.04.048 Color_252ACI
N050.04.32.387 E019.46.04.048 N050.04.32.397 E019.46.03.992 Color_252ACI
N050.04.32.673 E019.46.03.898 N050.04.32.663 E019.46.03.809 Color_252ACI
N050.04.32.663 E019.46.03.809 N050.04.32.617 E019.46.03.737 Color_252ACI
N050.04.32.617 E019.46.03.737 N050.04.32.561 E019.46.03.720 Color_252ACI
N050.04.32.561 E019.46.03.720 N050.04.32.499 E019.46.03.762 Color_252ACI
N050.04.32.499 E019.46.03.762 N050.04.32.468 E019.46.03.846 Color_252ACI
N050.04.32.468 E019.46.03.846 N050.04.32.474 E019.46.03.947 Color_252ACI
N050.04.32.474 E019.46.03.947 N050.04.32.514 E019.46.04.018 Color_252ACI
N050.04.32.514 E019.46.04.018 N050.04.32.577 E019.46.04.043 Color_252ACI
N050.04.32.577 E019.46.04.043 N050.04.32.627 E019.46.04.017 Color_252ACI
N050.04.32.627 E019.46.04.017 N050.04.32.663 E019.46.03.954 Color_252ACI
N050.04.32.663 E019.46.03.954 N050.04.32.673 E019.46.03.898 Color_252ACI
N050.04.32.959 E019.46.03.801 N050.04.32.949 E019.46.03.712 Color_252ACI
N050.04.32.949 E019.46.03.712 N050.04.32.903 E019.46.03.640 Color_252ACI
N050.04.32.903 E019.46.03.640 N050.04.32.847 E019.46.03.623 Color_252ACI
N050.04.32.847 E019.46.03.623 N050.04.32.785 E019.46.03.665 Color_252ACI
N050.04.32.785 E019.46.03.665 N050.04.32.754 E019.46.03.749 Color_252ACI
N050.04.32.754 E019.46.03.749 N050.04.32.760 E019.46.03.850 Color_252ACI
N050.04.32.760 E019.46.03.850 N050.04.32.800 E019.46.03.922 Color_252ACI
N050.04.32.800 E019.46.03.922 N050.04.32.863 E019.46.03.946 Color_252ACI
N050.04.32.863 E019.46.03.946 N050.04.32.913 E019.46.03.920 Color_252ACI
N050.04.32.913 E019.46.03.920 N050.04.32.949 E019.46.03.857 Color_252ACI
N050.04.32.949 E019.46.03.857 N050.04.32.959 E019.46.03.801 Color_252ACI
N050.04.33.257 E019.46.03.700 N050.04.33.246 E019.46.03.611 Color_252ACI
N050.04.33.246 E019.46.03.611 N050.04.33.200 E019.46.03.539 Color_252ACI
N050.04.33.200 E019.46.03.539 N050.04.33.144 E019.46.03.522 Color_252ACI
N050.04.33.144 E019.46.03.522 N050.04.33.082 E019.46.03.565 Color_252ACI
N050.04.33.082 E019.46.03.565 N050.04.33.051 E019.46.03.648 Color_252ACI
N050.04.33.051 E019.46.03.648 N050.04.33.058 E019.46.03.749 Color_252ACI
N050.04.33.058 E019.46.03.749 N050.04.33.097 E019.46.03.821 Color_252ACI
N050.04.33.097 E019.46.03.821 N050.04.33.161 E019.46.03.846 Color_252ACI
N050.04.33.161 E019.46.03.846 N050.04.33.210 E019.46.03.819 Color_252ACI
N050.04.33.210 E019.46.03.819 N050.04.33.246 E019.46.03.756 Color_252ACI
N050.04.33.246 E019.46.03.756 N050.04.33.257 E019.46.03.700 Color_252ACI
N050.04.33.525 E019.46.03.609 N050.04.33.515 E019.46.03.520 Color_252ACI
N050.04.33.515 E019.46.03.520 N050.04.33.469 E019.46.03.448 Color_252ACI
N050.04.33.469 E019.46.03.448 N050.04.33.413 E019.46.03.431 Color_252ACI
N050.04.33.413 E019.46.03.431 N050.04.33.351 E019.46.03.474 Color_252ACI
N050.04.33.351 E019.46.03.474 N050.04.33.320 E019.46.03.557 Color_252ACI
N050.04.33.320 E019.46.03.557 N050.04.33.326 E019.46.03.658 Color_252ACI
N050.04.33.326 E019.46.03.658 N050.04.33.366 E019.46.03.730 Color_252ACI
N050.04.33.366 E019.46.03.730 N050.04.33.429 E019.46.03.755 Color_252ACI
N050.04.33.429 E019.46.03.755 N050.04.33.479 E019.46.03.728 Color_252ACI
N050.04.33.479 E019.46.03.728 N050.04.33.515 E019.46.03.665 Color_252ACI
N050.04.33.515 E019.46.03.665 N050.04.33.525 E019.46.03.609 Color_252ACI
N050.04.33.818 E019.46.03.510 N050.04.33.808 E019.46.03.421 Color_252ACI
N050.04.33.808 E019.46.03.421 N050.04.33.761 E019.46.03.348 Color_252ACI
N050.04.33.761 E019.46.03.348 N050.04.33.706 E019.46.03.332 Color_252ACI
N050.04.33.706 E019.46.03.332 N050.04.33.644 E019.46.03.374 Color_252ACI
N050.04.33.644 E019.46.03.374 N050.04.33.613 E019.46.03.458 Color_252ACI
N050.04.33.613 E019.46.03.458 N050.04.33.619 E019.46.03.559 Color_252ACI
N050.04.33.619 E019.46.03.559 N050.04.33.659 E019.46.03.630 Color_252ACI
N050.04.33.659 E019.46.03.630 N050.04.33.722 E019.46.03.655 Color_252ACI
N050.04.33.722 E019.46.03.655 N050.04.33.772 E019.46.03.629 Color_252ACI
N050.04.33.772 E019.46.03.629 N050.04.33.808 E019.46.03.566 Color_252ACI
N050.04.33.808 E019.46.03.566 N050.04.33.818 E019.46.03.510 Color_252ACI
N050.04.34.103 E019.46.03.413 N050.04.34.092 E019.46.03.324 Color_252ACI
N050.04.34.092 E019.46.03.324 N050.04.34.046 E019.46.03.252 Color_252ACI
N050.04.34.046 E019.46.03.252 N050.04.33.990 E019.46.03.235 Color_252ACI
N050.04.33.990 E019.46.03.235 N050.04.33.928 E019.46.03.278 Color_252ACI
N050.04.33.928 E019.46.03.278 N050.04.33.898 E019.46.03.361 Color_252ACI
N050.04.33.898 E019.46.03.361 N050.04.33.904 E019.46.03.462 Color_252ACI
N050.04.33.904 E019.46.03.462 N050.04.33.943 E019.46.03.534 Color_252ACI
N050.04.33.943 E019.46.03.534 N050.04.34.007 E019.46.03.559 Color_252ACI
N050.04.34.007 E019.46.03.559 N050.04.34.057 E019.46.03.532 Color_252ACI
N050.04.34.057 E019.46.03.532 N050.04.34.092 E019.46.03.470 Color_252ACI
N050.04.34.092 E019.46.03.470 N050.04.34.103 E019.46.03.413 Color_252ACI
N050.04.52.813 E019.48.43.014 N050.04.52.803 E019.48.42.924 Color_252ACI
N050.04.52.803 E019.48.42.924 N050.04.52.757 E019.48.42.852 Color_252ACI
N050.04.52.757 E019.48.42.852 N050.04.52.701 E019.48.42.836 Color_252ACI
N050.04.52.701 E019.48.42.836 N050.04.52.639 E019.48.42.878 Color_252ACI
N050.04.52.639 E019.48.42.878 N050.04.52.608 E019.48.42.962 Color_252ACI
N050.04.52.608 E019.48.42.962 N050.04.52.614 E019.48.43.063 Color_252ACI
N050.04.52.614 E019.48.43.063 N050.04.52.654 E019.48.43.134 Color_252ACI
N050.04.52.654 E019.48.43.134 N050.04.52.717 E019.48.43.159 Color_252ACI
N050.04.52.717 E019.48.43.159 N050.04.52.767 E019.48.43.133 Color_252ACI
N050.04.52.767 E019.48.43.133 N050.04.52.803 E019.48.43.070 Color_252ACI
N050.04.52.803 E019.48.43.070 N050.04.52.813 E019.48.43.014 Color_252ACI
N050.04.53.097 E019.48.42.918 N050.04.53.087 E019.48.42.829 Color_252ACI
N050.04.53.087 E019.48.42.829 N050.04.53.041 E019.48.42.756 Color_252ACI
N050.04.53.041 E019.48.42.756 N050.04.52.985 E019.48.42.740 Color_252ACI
N050.04.52.985 E019.48.42.740 N050.04.52.923 E019.48.42.782 Color_252ACI
N050.04.52.923 E019.48.42.782 N050.04.52.892 E019.48.42.866 Color_252ACI
N050.04.52.892 E019.48.42.866 N050.04.52.898 E019.48.42.967 Color_252ACI
N050.04.52.898 E019.48.42.967 N050.04.52.938 E019.48.43.038 Color_252ACI
N050.04.52.938 E019.48.43.038 N050.04.53.001 E019.48.43.063 Color_252ACI
N050.04.53.001 E019.48.43.063 N050.04.53.051 E019.48.43.037 Color_252ACI
N050.04.53.051 E019.48.43.037 N050.04.53.087 E019.48.42.974 Color_252ACI
N050.04.53.087 E019.48.42.974 N050.04.53.097 E019.48.42.918 Color_252ACI
N050.04.53.662 E019.48.42.727 N050.04.53.651 E019.48.42.638 Color_252ACI
N050.04.53.651 E019.48.42.638 N050.04.53.605 E019.48.42.566 Color_252ACI
N050.04.53.605 E019.48.42.566 N050.04.53.549 E019.48.42.549 Color_252ACI
N050.04.53.549 E019.48.42.549 N050.04.53.487 E019.48.42.592 Color_252ACI
N050.04.53.487 E019.48.42.592 N050.04.53.456 E019.48.42.675 Color_252ACI
N050.04.53.456 E019.48.42.675 N050.04.53.463 E019.48.42.776 Color_252ACI
N050.04.53.463 E019.48.42.776 N050.04.53.502 E019.48.42.848 Color_252ACI
N050.04.53.502 E019.48.42.848 N050.04.53.566 E019.48.42.873 Color_252ACI
N050.04.53.566 E019.48.42.873 N050.04.53.615 E019.48.42.846 Color_252ACI
N050.04.53.615 E019.48.42.846 N050.04.53.651 E019.48.42.783 Color_252ACI
N050.04.53.651 E019.48.42.783 N050.04.53.662 E019.48.42.727 Color_252ACI
N050.04.53.943 E019.48.42.632 N050.04.53.933 E019.48.42.543 Color_252ACI
N050.04.53.933 E019.48.42.543 N050.04.53.887 E019.48.42.470 Color_252ACI
N050.04.53.887 E019.48.42.470 N050.04.53.831 E019.48.42.454 Color_252ACI
N050.04.53.831 E019.48.42.454 N050.04.53.769 E019.48.42.496 Color_252ACI
N050.04.53.769 E019.48.42.496 N050.04.53.738 E019.48.42.580 Color_252ACI
N050.04.53.738 E019.48.42.580 N050.04.53.744 E019.48.42.681 Color_252ACI
N050.04.53.744 E019.48.42.681 N050.04.53.784 E019.48.42.752 Color_252ACI
N050.04.53.784 E019.48.42.752 N050.04.53.847 E019.48.42.777 Color_252ACI
N050.04.53.847 E019.48.42.777 N050.04.53.897 E019.48.42.751 Color_252ACI
N050.04.53.897 E019.48.42.751 N050.04.53.933 E019.48.42.688 Color_252ACI
N050.04.53.933 E019.48.42.688 N050.04.53.943 E019.48.42.632 Color_252ACI
N050.04.52.605 E019.48.41.514 N050.04.52.595 E019.48.41.425 Color_252ACI
N050.04.52.595 E019.48.41.425 N050.04.52.548 E019.48.41.353 Color_252ACI
N050.04.52.548 E019.48.41.353 N050.04.52.492 E019.48.41.336 Color_252ACI
N050.04.52.492 E019.48.41.336 N050.04.52.431 E019.48.41.379 Color_252ACI
N050.04.52.431 E019.48.41.379 N050.04.52.400 E019.48.41.462 Color_252ACI
N050.04.52.400 E019.48.41.462 N050.04.52.406 E019.48.41.563 Color_252ACI
N050.04.52.406 E019.48.41.563 N050.04.52.446 E019.48.41.635 Color_252ACI
N050.04.52.446 E019.48.41.635 N050.04.52.509 E019.48.41.660 Color_252ACI
N050.04.52.509 E019.48.41.660 N050.04.52.559 E019.48.41.633 Color_252ACI
N050.04.52.559 E019.48.41.633 N050.04.52.595 E019.48.41.570 Color_252ACI
N050.04.52.595 E019.48.41.570 N050.04.52.605 E019.48.41.514 Color_252ACI
N050.04.52.879 E019.48.41.422 N050.04.52.869 E019.48.41.332 Color_252ACI
N050.04.52.869 E019.48.41.332 N050.04.52.823 E019.48.41.260 Color_252ACI
N050.04.52.823 E019.48.41.260 N050.04.52.767 E019.48.41.243 Color_252ACI
N050.04.52.767 E019.48.41.243 N050.04.52.705 E019.48.41.286 Color_252ACI
N050.04.52.705 E019.48.41.286 N050.04.52.674 E019.48.41.370 Color_252ACI
N050.04.52.674 E019.48.41.370 N050.04.52.680 E019.48.41.470 Color_252ACI
N050.04.52.680 E019.48.41.470 N050.04.52.720 E019.48.41.542 Color_252ACI
N050.04.52.720 E019.48.41.542 N050.04.52.783 E019.48.41.567 Color_252ACI
N050.04.52.783 E019.48.41.567 N050.04.52.833 E019.48.41.540 Color_252ACI
N050.04.52.833 E019.48.41.540 N050.04.52.869 E019.48.41.478 Color_252ACI
N050.04.52.869 E019.48.41.478 N050.04.52.879 E019.48.41.422 Color_252ACI
N050.04.53.453 E019.48.41.228 N050.04.53.443 E019.48.41.138 Color_252ACI
N050.04.53.443 E019.48.41.138 N050.04.53.397 E019.48.41.066 Color_252ACI
N050.04.53.397 E019.48.41.066 N050.04.53.341 E019.48.41.049 Color_252ACI
N050.04.53.341 E019.48.41.049 N050.04.53.279 E019.48.41.092 Color_252ACI
N050.04.53.279 E019.48.41.092 N050.04.53.248 E019.48.41.176 Color_252ACI
N050.04.53.248 E019.48.41.176 N050.04.53.254 E019.48.41.277 Color_252ACI
N050.04.53.254 E019.48.41.277 N050.04.53.294 E019.48.41.348 Color_252ACI
N050.04.53.294 E019.48.41.348 N050.04.53.357 E019.48.41.373 Color_252ACI
N050.04.53.357 E019.48.41.373 N050.04.53.407 E019.48.41.346 Color_252ACI
N050.04.53.407 E019.48.41.346 N050.04.53.443 E019.48.41.284 Color_252ACI
N050.04.53.443 E019.48.41.284 N050.04.53.453 E019.48.41.228 Color_252ACI
N050.04.53.721 E019.48.41.137 N050.04.53.710 E019.48.41.048 Color_252ACI
N050.04.53.710 E019.48.41.048 N050.04.53.664 E019.48.40.976 Color_252ACI
N050.04.53.664 E019.48.40.976 N050.04.53.608 E019.48.40.959 Color_252ACI
N050.04.53.608 E019.48.40.959 N050.04.53.546 E019.48.41.002 Color_252ACI
N050.04.53.546 E019.48.41.002 N050.04.53.516 E019.48.41.085 Color_252ACI
N050.04.53.516 E019.48.41.085 N050.04.53.522 E019.48.41.186 Color_252ACI
N050.04.53.522 E019.48.41.186 N050.04.53.561 E019.48.41.258 Color_252ACI
N050.04.53.561 E019.48.41.258 N050.04.53.625 E019.48.41.283 Color_252ACI
N050.04.53.625 E019.48.41.283 N050.04.53.675 E019.48.41.256 Color_252ACI
N050.04.53.675 E019.48.41.256 N050.04.53.710 E019.48.41.193 Color_252ACI
N050.04.53.710 E019.48.41.193 N050.04.53.721 E019.48.41.137 Color_252ACI
N050.04.52.386 E019.48.40.030 N050.04.52.375 E019.48.39.940 Color_252ACI
N050.04.52.375 E019.48.39.940 N050.04.52.329 E019.48.39.868 Color_252ACI
N050.04.52.329 E019.48.39.868 N050.04.52.273 E019.48.39.851 Color_252ACI
N050.04.52.273 E019.48.39.851 N050.04.52.211 E019.48.39.894 Color_252ACI
N050.04.52.211 E019.48.39.894 N050.04.52.180 E019.48.39.978 Color_252ACI
N050.04.52.180 E019.48.39.978 N050.04.52.187 E019.48.40.078 Color_252ACI
N050.04.52.187 E019.48.40.078 N050.04.52.226 E019.48.40.150 Color_252ACI
N050.04.52.226 E019.48.40.150 N050.04.52.290 E019.48.40.175 Color_252ACI
N050.04.52.290 E019.48.40.175 N050.04.52.340 E019.48.40.148 Color_252ACI
N050.04.52.340 E019.48.40.148 N050.04.52.375 E019.48.40.086 Color_252ACI
N050.04.52.375 E019.48.40.086 N050.04.52.386 E019.48.40.030 Color_252ACI
N050.04.52.672 E019.48.39.933 N050.04.52.662 E019.48.39.843 Color_252ACI
N050.04.52.662 E019.48.39.843 N050.04.52.615 E019.48.39.771 Color_252ACI
N050.04.52.615 E019.48.39.771 N050.04.52.560 E019.48.39.754 Color_252ACI
N050.04.52.560 E019.48.39.754 N050.04.52.498 E019.48.39.797 Color_252ACI
N050.04.52.498 E019.48.39.797 N050.04.52.467 E019.48.39.881 Color_252ACI
N050.04.52.467 E019.48.39.881 N050.04.52.473 E019.48.39.982 Color_252ACI
N050.04.52.473 E019.48.39.982 N050.04.52.513 E019.48.40.053 Color_252ACI
N050.04.52.513 E019.48.40.053 N050.04.52.576 E019.48.40.078 Color_252ACI
N050.04.52.576 E019.48.40.078 N050.04.52.626 E019.48.40.052 Color_252ACI
N050.04.52.626 E019.48.40.052 N050.04.52.662 E019.48.39.989 Color_252ACI
N050.04.52.662 E019.48.39.989 N050.04.52.672 E019.48.39.933 Color_252ACI
N050.04.53.244 E019.48.39.739 N050.04.53.234 E019.48.39.650 Color_252ACI
N050.04.53.234 E019.48.39.650 N050.04.53.188 E019.48.39.578 Color_252ACI
N050.04.53.188 E019.48.39.578 N050.04.53.132 E019.48.39.561 Color_252ACI
N050.04.53.132 E019.48.39.561 N050.04.53.070 E019.48.39.604 Color_252ACI
N050.04.53.070 E019.48.39.604 N050.04.53.039 E019.48.39.687 Color_252ACI
N050.04.53.039 E019.48.39.687 N050.04.53.045 E019.48.39.788 Color_252ACI
N050.04.53.045 E019.48.39.788 N050.04.53.085 E019.48.39.860 Color_252ACI
N050.04.53.085 E019.48.39.860 N050.04.53.148 E019.48.39.885 Color_252ACI
N050.04.53.148 E019.48.39.885 N050.04.53.198 E019.48.39.858 Color_252ACI
N050.04.53.198 E019.48.39.858 N050.04.53.234 E019.48.39.796 Color_252ACI
N050.04.53.234 E019.48.39.796 N050.04.53.244 E019.48.39.739 Color_252ACI
N050.04.53.527 E019.48.39.644 N050.04.53.517 E019.48.39.555 Color_252ACI
N050.04.53.517 E019.48.39.555 N050.04.53.470 E019.48.39.482 Color_252ACI
N050.04.53.470 E019.48.39.482 N050.04.53.414 E019.48.39.466 Color_252ACI
N050.04.53.414 E019.48.39.466 N050.04.53.353 E019.48.39.508 Color_252ACI
N050.04.53.353 E019.48.39.508 N050.04.53.322 E019.48.39.592 Color_252ACI
N050.04.53.322 E019.48.39.592 N050.04.53.328 E019.48.39.693 Color_252ACI
N050.04.53.328 E019.48.39.693 N050.04.53.367 E019.48.39.764 Color_252ACI
N050.04.53.367 E019.48.39.764 N050.04.53.431 E019.48.39.789 Color_252ACI
N050.04.53.431 E019.48.39.789 N050.04.53.481 E019.48.39.763 Color_252ACI
N050.04.53.481 E019.48.39.763 N050.04.53.517 E019.48.39.700 Color_252ACI
N050.04.53.517 E019.48.39.700 N050.04.53.527 E019.48.39.644 Color_252ACI
N050.04.52.189 E019.48.38.562 N050.04.52.179 E019.48.38.473 Color_252ACI
N050.04.52.179 E019.48.38.473 N050.04.52.133 E019.48.38.401 Color_252ACI
N050.04.52.133 E019.48.38.401 N050.04.52.077 E019.48.38.384 Color_252ACI
N050.04.52.077 E019.48.38.384 N050.04.52.015 E019.48.38.427 Color_252ACI
N050.04.52.015 E019.48.38.427 N050.04.51.984 E019.48.38.510 Color_252ACI
N050.04.51.984 E019.48.38.510 N050.04.51.990 E019.48.38.611 Color_252ACI
N050.04.51.990 E019.48.38.611 N050.04.52.030 E019.48.38.683 Color_252ACI
N050.04.52.030 E019.48.38.683 N050.04.52.094 E019.48.38.708 Color_252ACI
N050.04.52.094 E019.48.38.708 N050.04.52.143 E019.48.38.681 Color_252ACI
N050.04.52.143 E019.48.38.681 N050.04.52.179 E019.48.38.618 Color_252ACI
N050.04.52.179 E019.48.38.618 N050.04.52.189 E019.48.38.562 Color_252ACI
N050.04.52.470 E019.48.38.467 N050.04.52.460 E019.48.38.378 Color_252ACI
N050.04.52.460 E019.48.38.378 N050.04.52.413 E019.48.38.306 Color_252ACI
N050.04.52.413 E019.48.38.306 N050.04.52.357 E019.48.38.289 Color_252ACI
N050.04.52.357 E019.48.38.289 N050.04.52.296 E019.48.38.332 Color_252ACI
N050.04.52.296 E019.48.38.332 N050.04.52.265 E019.48.38.415 Color_252ACI
N050.04.52.265 E019.48.38.415 N050.04.52.271 E019.48.38.516 Color_252ACI
N050.04.52.271 E019.48.38.516 N050.04.52.311 E019.48.38.588 Color_252ACI
N050.04.52.311 E019.48.38.588 N050.04.52.374 E019.48.38.613 Color_252ACI
N050.04.52.374 E019.48.38.613 N050.04.52.424 E019.48.38.586 Color_252ACI
N050.04.52.424 E019.48.38.586 N050.04.52.460 E019.48.38.523 Color_252ACI
N050.04.52.460 E019.48.38.523 N050.04.52.470 E019.48.38.467 Color_252ACI
N050.04.53.051 E019.48.38.271 N050.04.53.040 E019.48.38.182 Color_252ACI
N050.04.53.040 E019.48.38.182 N050.04.52.994 E019.48.38.110 Color_252ACI
N050.04.52.994 E019.48.38.110 N050.04.52.938 E019.48.38.093 Color_252ACI
N050.04.52.938 E019.48.38.093 N050.04.52.876 E019.48.38.135 Color_252ACI
N050.04.52.876 E019.48.38.135 N050.04.52.846 E019.48.38.219 Color_252ACI
N050.04.52.846 E019.48.38.219 N050.04.52.852 E019.48.38.320 Color_252ACI
N050.04.52.852 E019.48.38.320 N050.04.52.891 E019.48.38.391 Color_252ACI
N050.04.52.891 E019.48.38.391 N050.04.52.955 E019.48.38.416 Color_252ACI
N050.04.52.955 E019.48.38.416 N050.04.53.005 E019.48.38.390 Color_252ACI
N050.04.53.005 E019.48.38.390 N050.04.53.040 E019.48.38.327 Color_252ACI
N050.04.53.040 E019.48.38.327 N050.04.53.051 E019.48.38.271 Color_252ACI
N050.04.53.326 E019.48.38.178 N050.04.53.316 E019.48.38.089 Color_252ACI
N050.04.53.316 E019.48.38.089 N050.04.53.270 E019.48.38.016 Color_252ACI
N050.04.53.270 E019.48.38.016 N050.04.53.214 E019.48.38.000 Color_252ACI
N050.04.53.214 E019.48.38.000 N050.04.53.152 E019.48.38.042 Color_252ACI
N050.04.53.152 E019.48.38.042 N050.04.53.121 E019.48.38.126 Color_252ACI
N050.04.53.121 E019.48.38.126 N050.04.53.127 E019.48.38.227 Color_252ACI
N050.04.53.127 E019.48.38.227 N050.04.53.167 E019.48.38.298 Color_252ACI
N050.04.53.167 E019.48.38.298 N050.04.53.230 E019.48.38.323 Color_252ACI
N050.04.53.230 E019.48.38.323 N050.04.53.280 E019.48.38.297 Color_252ACI
N050.04.53.280 E019.48.38.297 N050.04.53.316 E019.48.38.234 Color_252ACI
N050.04.53.316 E019.48.38.234 N050.04.53.326 E019.48.38.178 Color_252ACI
N050.04.51.981 E019.48.37.083 N050.04.51.970 E019.48.36.994 Color_252ACI
N050.04.51.970 E019.48.36.994 N050.04.51.924 E019.48.36.922 Color_252ACI
N050.04.51.924 E019.48.36.922 N050.04.51.868 E019.48.36.905 Color_252ACI
N050.04.51.868 E019.48.36.905 N050.04.51.806 E019.48.36.948 Color_252ACI
N050.04.51.806 E019.48.36.948 N050.04.51.775 E019.48.37.031 Color_252ACI
N050.04.51.775 E019.48.37.031 N050.04.51.782 E019.48.37.132 Color_252ACI
N050.04.51.782 E019.48.37.132 N050.04.51.821 E019.48.37.204 Color_252ACI
N050.04.51.821 E019.48.37.204 N050.04.51.885 E019.48.37.229 Color_252ACI
N050.04.51.885 E019.48.37.229 N050.04.51.934 E019.48.37.202 Color_252ACI
N050.04.51.934 E019.48.37.202 N050.04.51.970 E019.48.37.139 Color_252ACI
N050.04.51.970 E019.48.37.139 N050.04.51.981 E019.48.37.083 Color_252ACI
N050.04.52.258 E019.48.36.990 N050.04.52.247 E019.48.36.900 Color_252ACI
N050.04.52.247 E019.48.36.900 N050.04.52.201 E019.48.36.828 Color_252ACI
N050.04.52.201 E019.48.36.828 N050.04.52.145 E019.48.36.811 Color_252ACI
N050.04.52.145 E019.48.36.811 N050.04.52.083 E019.48.36.854 Color_252ACI
N050.04.52.083 E019.48.36.854 N050.04.52.052 E019.48.36.938 Color_252ACI
N050.04.52.052 E019.48.36.938 N050.04.52.059 E019.48.37.038 Color_252ACI
N050.04.52.059 E019.48.37.038 N050.04.52.098 E019.48.37.110 Color_252ACI
N050.04.52.098 E019.48.37.110 N050.04.52.162 E019.48.37.135 Color_252ACI
N050.04.52.162 E019.48.37.135 N050.04.52.212 E019.48.37.108 Color_252ACI
N050.04.52.212 E019.48.37.108 N050.04.52.247 E019.48.37.046 Color_252ACI
N050.04.52.247 E019.48.37.046 N050.04.52.258 E019.48.36.990 Color_252ACI
N050.04.52.834 E019.48.36.795 N050.04.52.823 E019.48.36.706 Color_252ACI
N050.04.52.823 E019.48.36.706 N050.04.52.777 E019.48.36.634 Color_252ACI
N050.04.52.777 E019.48.36.634 N050.04.52.721 E019.48.36.617 Color_252ACI
N050.04.52.721 E019.48.36.617 N050.04.52.659 E019.48.36.659 Color_252ACI
N050.04.52.659 E019.48.36.659 N050.04.52.628 E019.48.36.743 Color_252ACI
N050.04.52.628 E019.48.36.743 N050.04.52.635 E019.48.36.844 Color_252ACI
N050.04.52.635 E019.48.36.844 N050.04.52.674 E019.48.36.915 Color_252ACI
N050.04.52.674 E019.48.36.915 N050.04.52.738 E019.48.36.940 Color_252ACI
N050.04.52.738 E019.48.36.940 N050.04.52.787 E019.48.36.914 Color_252ACI
N050.04.52.787 E019.48.36.914 N050.04.52.823 E019.48.36.851 Color_252ACI
N050.04.52.823 E019.48.36.851 N050.04.52.834 E019.48.36.795 Color_252ACI
N050.04.53.106 E019.48.36.703 N050.04.53.095 E019.48.36.614 Color_252ACI
N050.04.53.095 E019.48.36.614 N050.04.53.049 E019.48.36.542 Color_252ACI
N050.04.53.049 E019.48.36.542 N050.04.52.993 E019.48.36.525 Color_252ACI
N050.04.52.993 E019.48.36.525 N050.04.52.931 E019.48.36.567 Color_252ACI
N050.04.52.931 E019.48.36.567 N050.04.52.900 E019.48.36.651 Color_252ACI
N050.04.52.900 E019.48.36.651 N050.04.52.907 E019.48.36.752 Color_252ACI
N050.04.52.907 E019.48.36.752 N050.04.52.946 E019.48.36.824 Color_252ACI
N050.04.52.946 E019.48.36.824 N050.04.53.010 E019.48.36.848 Color_252ACI
N050.04.53.010 E019.48.36.848 N050.04.53.059 E019.48.36.822 Color_252ACI
N050.04.53.059 E019.48.36.822 N050.04.53.095 E019.48.36.759 Color_252ACI
N050.04.53.095 E019.48.36.759 N050.04.53.106 E019.48.36.703 Color_252ACI
N050.04.51.769 E019.48.35.589 N050.04.51.758 E019.48.35.500 Color_252ACI
N050.04.51.758 E019.48.35.500 N050.04.51.712 E019.48.35.428 Color_252ACI
N050.04.51.712 E019.48.35.428 N050.04.51.656 E019.48.35.411 Color_252ACI
N050.04.51.656 E019.48.35.411 N050.04.51.594 E019.48.35.453 Color_252ACI
N050.04.51.594 E019.48.35.453 N050.04.51.563 E019.48.35.537 Color_252ACI
N050.04.51.563 E019.48.35.537 N050.04.51.570 E019.48.35.638 Color_252ACI
N050.04.51.570 E019.48.35.638 N050.04.51.609 E019.48.35.710 Color_252ACI
N050.04.51.609 E019.48.35.710 N050.04.51.673 E019.48.35.734 Color_252ACI
N050.04.51.673 E019.48.35.734 N050.04.51.723 E019.48.35.708 Color_252ACI
N050.04.51.723 E019.48.35.708 N050.04.51.758 E019.48.35.645 Color_252ACI
N050.04.51.758 E019.48.35.645 N050.04.51.769 E019.48.35.589 Color_252ACI
N050.04.52.049 E019.48.35.494 N050.04.52.039 E019.48.35.405 Color_252ACI
N050.04.52.039 E019.48.35.405 N050.04.51.993 E019.48.35.333 Color_252ACI
N050.04.51.993 E019.48.35.333 N050.04.51.937 E019.48.35.316 Color_252ACI
N050.04.51.937 E019.48.35.316 N050.04.51.875 E019.48.35.359 Color_252ACI
N050.04.51.875 E019.48.35.359 N050.04.51.844 E019.48.35.442 Color_252ACI
N050.04.51.844 E019.48.35.442 N050.04.51.850 E019.48.35.543 Color_252ACI
N050.04.51.850 E019.48.35.543 N050.04.51.890 E019.48.35.615 Color_252ACI
N050.04.51.890 E019.48.35.615 N050.04.51.954 E019.48.35.640 Color_252ACI
N050.04.51.954 E019.48.35.640 N050.04.52.003 E019.48.35.613 Color_252ACI
N050.04.52.003 E019.48.35.613 N050.04.52.039 E019.48.35.550 Color_252ACI
N050.04.52.039 E019.48.35.550 N050.04.52.049 E019.48.35.494 Color_252ACI
N050.04.52.619 E019.48.35.302 N050.04.52.608 E019.48.35.212 Color_252ACI
N050.04.52.608 E019.48.35.212 N050.04.52.562 E019.48.35.140 Color_252ACI
N050.04.52.562 E019.48.35.140 N050.04.52.506 E019.48.35.124 Color_252ACI
N050.04.52.506 E019.48.35.124 N050.04.52.444 E019.48.35.166 Color_252ACI
N050.04.52.444 E019.48.35.166 N050.04.52.414 E019.48.35.250 Color_252ACI
N050.04.52.414 E019.48.35.250 N050.04.52.420 E019.48.35.351 Color_252ACI
N050.04.52.420 E019.48.35.351 N050.04.52.459 E019.48.35.422 Color_252ACI
N050.04.52.459 E019.48.35.422 N050.04.52.523 E019.48.35.447 Color_252ACI
N050.04.52.523 E019.48.35.447 N050.04.52.573 E019.48.35.421 Color_252ACI
N050.04.52.573 E019.48.35.421 N050.04.52.608 E019.48.35.358 Color_252ACI
N050.04.52.608 E019.48.35.358 N050.04.52.619 E019.48.35.302 Color_252ACI
N050.04.52.903 E019.48.35.206 N050.04.52.893 E019.48.35.116 Color_252ACI
N050.04.52.893 E019.48.35.116 N050.04.52.847 E019.48.35.044 Color_252ACI
N050.04.52.847 E019.48.35.044 N050.04.52.791 E019.48.35.027 Color_252ACI
N050.04.52.791 E019.48.35.027 N050.04.52.729 E019.48.35.070 Color_252ACI
N050.04.52.729 E019.48.35.070 N050.04.52.698 E019.48.35.154 Color_252ACI
N050.04.52.698 E019.48.35.154 N050.04.52.704 E019.48.35.254 Color_252ACI
N050.04.52.704 E019.48.35.254 N050.04.52.744 E019.48.35.326 Color_252ACI
N050.04.52.744 E019.48.35.326 N050.04.52.808 E019.48.35.351 Color_252ACI
N050.04.52.808 E019.48.35.351 N050.04.52.857 E019.48.35.324 Color_252ACI
N050.04.52.857 E019.48.35.324 N050.04.52.893 E019.48.35.262 Color_252ACI
N050.04.52.893 E019.48.35.262 N050.04.52.903 E019.48.35.206 Color_252ACI
N050.04.51.555 E019.48.34.107 N050.04.51.544 E019.48.34.017 Color_252ACI
N050.04.51.544 E019.48.34.017 N050.04.51.498 E019.48.33.945 Color_252ACI
N050.04.51.498 E019.48.33.945 N050.04.51.442 E019.48.33.928 Color_252ACI
N050.04.51.442 E019.48.33.928 N050.04.51.380 E019.48.33.971 Color_252ACI
N050.04.51.380 E019.48.33.971 N050.04.51.349 E019.48.34.055 Color_252ACI
N050.04.51.349 E019.48.34.055 N050.04.51.356 E019.48.34.156 Color_252ACI
N050.04.51.356 E019.48.34.156 N050.04.51.395 E019.48.34.227 Color_252ACI
N050.04.51.395 E019.48.34.227 N050.04.51.459 E019.48.34.252 Color_252ACI
N050.04.51.459 E019.48.34.252 N050.04.51.509 E019.48.34.226 Color_252ACI
N050.04.51.509 E019.48.34.226 N050.04.51.544 E019.48.34.163 Color_252ACI
N050.04.51.544 E019.48.34.163 N050.04.51.555 E019.48.34.107 Color_252ACI
N050.04.51.848 E019.48.34.008 N050.04.51.838 E019.48.33.918 Color_252ACI
N050.04.51.838 E019.48.33.918 N050.04.51.792 E019.48.33.846 Color_252ACI
N050.04.51.792 E019.48.33.846 N050.04.51.736 E019.48.33.829 Color_252ACI
N050.04.51.736 E019.48.33.829 N050.04.51.674 E019.48.33.872 Color_252ACI
N050.04.51.674 E019.48.33.872 N050.04.51.643 E019.48.33.956 Color_252ACI
N050.04.51.643 E019.48.33.956 N050.04.51.649 E019.48.34.056 Color_252ACI
N050.04.51.649 E019.48.34.056 N050.04.51.689 E019.48.34.128 Color_252ACI
N050.04.51.689 E019.48.34.128 N050.04.51.752 E019.48.34.153 Color_252ACI
N050.04.51.752 E019.48.34.153 N050.04.51.802 E019.48.34.126 Color_252ACI
N050.04.51.802 E019.48.34.126 N050.04.51.838 E019.48.34.064 Color_252ACI
N050.04.51.838 E019.48.34.064 N050.04.51.848 E019.48.34.008 Color_252ACI
N050.04.52.411 E019.48.33.818 N050.04.52.400 E019.48.33.728 Color_252ACI
N050.04.52.400 E019.48.33.728 N050.04.52.354 E019.48.33.656 Color_252ACI
N050.04.52.354 E019.48.33.656 N050.04.52.298 E019.48.33.639 Color_252ACI
N050.04.52.298 E019.48.33.639 N050.04.52.236 E019.48.33.682 Color_252ACI
N050.04.52.236 E019.48.33.682 N050.04.52.206 E019.48.33.765 Color_252ACI
N050.04.52.206 E019.48.33.765 N050.04.52.212 E019.48.33.866 Color_252ACI
N050.04.52.212 E019.48.33.866 N050.04.52.251 E019.48.33.938 Color_252ACI
N050.04.52.251 E019.48.33.938 N050.04.52.315 E019.48.33.963 Color_252ACI
N050.04.52.315 E019.48.33.963 N050.04.52.365 E019.48.33.936 Color_252ACI
N050.04.52.365 E019.48.33.936 N050.04.52.400 E019.48.33.874 Color_252ACI
N050.04.52.400 E019.48.33.874 N050.04.52.411 E019.48.33.818 Color_252ACI
N050.04.52.689 E019.48.33.724 N050.04.52.678 E019.48.33.634 Color_252ACI
N050.04.52.678 E019.48.33.634 N050.04.52.632 E019.48.33.562 Color_252ACI
N050.04.52.632 E019.48.33.562 N050.04.52.576 E019.48.33.545 Color_252ACI
N050.04.52.576 E019.48.33.545 N050.04.52.514 E019.48.33.588 Color_252ACI
N050.04.52.514 E019.48.33.588 N050.04.52.484 E019.48.33.671 Color_252ACI
N050.04.52.484 E019.48.33.671 N050.04.52.490 E019.48.33.772 Color_252ACI
N050.04.52.490 E019.48.33.772 N050.04.52.529 E019.48.33.844 Color_252ACI
N050.04.52.529 E019.48.33.844 N050.04.52.593 E019.48.33.869 Color_252ACI
N050.04.52.593 E019.48.33.869 N050.04.52.643 E019.48.33.842 Color_252ACI
N050.04.52.643 E019.48.33.842 N050.04.52.678 E019.48.33.780 Color_252ACI
N050.04.52.678 E019.48.33.780 N050.04.52.689 E019.48.33.724 Color_252ACI
N050.04.51.356 E019.48.32.645 N050.04.51.345 E019.48.32.556 Color_252ACI
N050.04.51.345 E019.48.32.556 N050.04.51.299 E019.48.32.484 Color_252ACI
N050.04.51.299 E019.48.32.484 N050.04.51.243 E019.48.32.467 Color_252ACI
N050.04.51.243 E019.48.32.467 N050.04.51.181 E019.48.32.510 Color_252ACI
N050.04.51.181 E019.48.32.510 N050.04.51.151 E019.48.32.593 Color_252ACI
N050.04.51.151 E019.48.32.593 N050.04.51.157 E019.48.32.694 Color_252ACI
N050.04.51.157 E019.48.32.694 N050.04.51.196 E019.48.32.766 Color_252ACI
N050.04.51.196 E019.48.32.766 N050.04.51.260 E019.48.32.791 Color_252ACI
N050.04.51.260 E019.48.32.791 N050.04.51.310 E019.48.32.764 Color_252ACI
N050.04.51.310 E019.48.32.764 N050.04.51.345 E019.48.32.701 Color_252ACI
N050.04.51.345 E019.48.32.701 N050.04.51.356 E019.48.32.645 Color_252ACI
N050.04.51.649 E019.48.32.546 N050.04.51.638 E019.48.32.457 Color_252ACI
N050.04.51.638 E019.48.32.457 N050.04.51.592 E019.48.32.385 Color_252ACI
N050.04.51.592 E019.48.32.385 N050.04.51.536 E019.48.32.368 Color_252ACI
N050.04.51.536 E019.48.32.368 N050.04.51.474 E019.48.32.411 Color_252ACI
N050.04.51.474 E019.48.32.411 N050.04.51.444 E019.48.32.494 Color_252ACI
N050.04.51.444 E019.48.32.494 N050.04.51.450 E019.48.32.595 Color_252ACI
N050.04.51.450 E019.48.32.595 N050.04.51.489 E019.48.32.667 Color_252ACI
N050.04.51.489 E019.48.32.667 N050.04.51.553 E019.48.32.692 Color_252ACI
N050.04.51.553 E019.48.32.692 N050.04.51.603 E019.48.32.665 Color_252ACI
N050.04.51.603 E019.48.32.665 N050.04.51.638 E019.48.32.602 Color_252ACI
N050.04.51.638 E019.48.32.602 N050.04.51.649 E019.48.32.546 Color_252ACI
N050.04.52.212 E019.48.32.356 N050.04.52.201 E019.48.32.267 Color_252ACI
N050.04.52.201 E019.48.32.267 N050.04.52.155 E019.48.32.195 Color_252ACI
N050.04.52.155 E019.48.32.195 N050.04.52.099 E019.48.32.178 Color_252ACI
N050.04.52.099 E019.48.32.178 N050.04.52.037 E019.48.32.220 Color_252ACI
N050.04.52.037 E019.48.32.220 N050.04.52.006 E019.48.32.304 Color_252ACI
N050.04.52.006 E019.48.32.304 N050.04.52.013 E019.48.32.405 Color_252ACI
N050.04.52.013 E019.48.32.405 N050.04.52.052 E019.48.32.476 Color_252ACI
N050.04.52.052 E019.48.32.476 N050.04.52.116 E019.48.32.501 Color_252ACI
N050.04.52.116 E019.48.32.501 N050.04.52.165 E019.48.32.475 Color_252ACI
N050.04.52.165 E019.48.32.475 N050.04.52.201 E019.48.32.412 Color_252ACI
N050.04.52.201 E019.48.32.412 N050.04.52.212 E019.48.32.356 Color_252ACI
N050.04.52.488 E019.48.32.263 N050.04.52.477 E019.48.32.173 Color_252ACI
N050.04.52.477 E019.48.32.173 N050.04.52.431 E019.48.32.101 Color_252ACI
N050.04.52.431 E019.48.32.101 N050.04.52.375 E019.48.32.084 Color_252ACI
N050.04.52.375 E019.48.32.084 N050.04.52.313 E019.48.32.127 Color_252ACI
N050.04.52.313 E019.48.32.127 N050.04.52.282 E019.48.32.211 Color_252ACI
N050.04.52.282 E019.48.32.211 N050.04.52.289 E019.48.32.312 Color_252ACI
N050.04.52.289 E019.48.32.312 N050.04.52.328 E019.48.32.383 Color_252ACI
N050.04.52.328 E019.48.32.383 N050.04.52.392 E019.48.32.408 Color_252ACI
N050.04.52.392 E019.48.32.408 N050.04.52.442 E019.48.32.381 Color_252ACI
N050.04.52.442 E019.48.32.381 N050.04.52.477 E019.48.32.319 Color_252ACI
N050.04.52.477 E019.48.32.319 N050.04.52.488 E019.48.32.263 Color_252ACI
N050.04.51.134 E019.48.31.162 N050.04.51.124 E019.48.31.073 Color_252ACI
N050.04.51.124 E019.48.31.073 N050.04.51.078 E019.48.31.001 Color_252ACI
N050.04.51.078 E019.48.31.001 N050.04.51.022 E019.48.30.984 Color_252ACI
N050.04.51.022 E019.48.30.984 N050.04.50.960 E019.48.31.027 Color_252ACI
N050.04.50.960 E019.48.31.027 N050.04.50.929 E019.48.31.110 Color_252ACI
N050.04.50.929 E019.48.31.110 N050.04.50.935 E019.48.31.211 Color_252ACI
N050.04.50.935 E019.48.31.211 N050.04.50.975 E019.48.31.283 Color_252ACI
N050.04.50.975 E019.48.31.283 N050.04.51.038 E019.48.31.308 Color_252ACI
N050.04.51.038 E019.48.31.308 N050.04.51.088 E019.48.31.281 Color_252ACI
N050.04.51.088 E019.48.31.281 N050.04.51.124 E019.48.31.219 Color_252ACI
N050.04.51.124 E019.48.31.219 N050.04.51.134 E019.48.31.162 Color_252ACI
N050.04.51.448 E019.48.31.056 N050.04.51.438 E019.48.30.967 Color_252ACI
N050.04.51.438 E019.48.30.967 N050.04.51.391 E019.48.30.895 Color_252ACI
N050.04.51.391 E019.48.30.895 N050.04.51.336 E019.48.30.878 Color_252ACI
N050.04.51.336 E019.48.30.878 N050.04.51.274 E019.48.30.921 Color_252ACI
N050.04.51.274 E019.48.30.921 N050.04.51.243 E019.48.31.004 Color_252ACI
N050.04.51.243 E019.48.31.004 N050.04.51.249 E019.48.31.105 Color_252ACI
N050.04.51.249 E019.48.31.105 N050.04.51.289 E019.48.31.177 Color_252ACI
N050.04.51.289 E019.48.31.177 N050.04.51.352 E019.48.31.202 Color_252ACI
N050.04.51.352 E019.48.31.202 N050.04.51.402 E019.48.31.175 Color_252ACI
N050.04.51.402 E019.48.31.175 N050.04.51.438 E019.48.31.113 Color_252ACI
N050.04.51.438 E019.48.31.113 N050.04.51.448 E019.48.31.056 Color_252ACI
N050.04.51.996 E019.48.30.871 N050.04.51.985 E019.48.30.782 Color_252ACI
N050.04.51.985 E019.48.30.782 N050.04.51.939 E019.48.30.710 Color_252ACI
N050.04.51.939 E019.48.30.710 N050.04.51.883 E019.48.30.693 Color_252ACI
N050.04.51.883 E019.48.30.693 N050.04.51.821 E019.48.30.736 Color_252ACI
N050.04.51.821 E019.48.30.736 N050.04.51.791 E019.48.30.819 Color_252ACI
N050.04.51.791 E019.48.30.819 N050.04.51.797 E019.48.30.920 Color_252ACI
N050.04.51.797 E019.48.30.920 N050.04.51.836 E019.48.30.992 Color_252ACI
N050.04.51.836 E019.48.30.992 N050.04.51.900 E019.48.31.017 Color_252ACI
N050.04.51.900 E019.48.31.017 N050.04.51.950 E019.48.30.990 Color_252ACI
N050.04.51.950 E019.48.30.990 N050.04.51.985 E019.48.30.927 Color_252ACI
N050.04.51.985 E019.48.30.927 N050.04.51.996 E019.48.30.871 Color_252ACI
N050.04.52.285 E019.48.30.774 N050.04.52.274 E019.48.30.684 Color_252ACI
N050.04.52.274 E019.48.30.684 N050.04.52.228 E019.48.30.612 Color_252ACI
N050.04.52.228 E019.48.30.612 N050.04.52.172 E019.48.30.595 Color_252ACI
N050.04.52.172 E019.48.30.595 N050.04.52.110 E019.48.30.638 Color_252ACI
N050.04.52.110 E019.48.30.638 N050.04.52.080 E019.48.30.722 Color_252ACI
N050.04.52.080 E019.48.30.722 N050.04.52.086 E019.48.30.822 Color_252ACI
N050.04.52.086 E019.48.30.822 N050.04.52.125 E019.48.30.894 Color_252ACI
N050.04.52.125 E019.48.30.894 N050.04.52.189 E019.48.30.919 Color_252ACI
N050.04.52.189 E019.48.30.919 N050.04.52.239 E019.48.30.892 Color_252ACI
N050.04.52.239 E019.48.30.892 N050.04.52.274 E019.48.30.830 Color_252ACI
N050.04.52.274 E019.48.30.830 N050.04.52.285 E019.48.30.774 Color_252ACI
N050.04.50.945 E019.48.29.697 N050.04.50.935 E019.48.29.607 Color_252ACI
N050.04.50.935 E019.48.29.607 N050.04.50.888 E019.48.29.535 Color_252ACI
N050.04.50.888 E019.48.29.535 N050.04.50.832 E019.48.29.519 Color_252ACI
N050.04.50.832 E019.48.29.519 N050.04.50.771 E019.48.29.561 Color_252ACI
N050.04.50.771 E019.48.29.561 N050.04.50.740 E019.48.29.645 Color_252ACI
N050.04.50.740 E019.48.29.645 N050.04.50.746 E019.48.29.746 Color_252ACI
N050.04.50.746 E019.48.29.746 N050.04.50.785 E019.48.29.817 Color_252ACI
N050.04.50.785 E019.48.29.817 N050.04.50.849 E019.48.29.842 Color_252ACI
N050.04.50.849 E019.48.29.842 N050.04.50.899 E019.48.29.816 Color_252ACI
N050.04.50.899 E019.48.29.816 N050.04.50.935 E019.48.29.753 Color_252ACI
N050.04.50.935 E019.48.29.753 N050.04.50.945 E019.48.29.697 Color_252ACI
N050.04.51.232 E019.48.29.600 N050.04.51.221 E019.48.29.511 Color_252ACI
N050.04.51.221 E019.48.29.511 N050.04.51.175 E019.48.29.438 Color_252ACI
N050.04.51.175 E019.48.29.438 N050.04.51.119 E019.48.29.422 Color_252ACI
N050.04.51.119 E019.48.29.422 N050.04.51.057 E019.48.29.464 Color_252ACI
N050.04.51.057 E019.48.29.464 N050.04.51.027 E019.48.29.548 Color_252ACI
N050.04.51.027 E019.48.29.548 N050.04.51.033 E019.48.29.649 Color_252ACI
N050.04.51.033 E019.48.29.649 N050.04.51.072 E019.48.29.720 Color_252ACI
N050.04.51.072 E019.48.29.720 N050.04.51.136 E019.48.29.745 Color_252ACI
N050.04.51.136 E019.48.29.745 N050.04.51.186 E019.48.29.719 Color_252ACI
N050.04.51.186 E019.48.29.719 N050.04.51.221 E019.48.29.656 Color_252ACI
N050.04.51.221 E019.48.29.656 N050.04.51.232 E019.48.29.600 Color_252ACI
N050.04.51.792 E019.48.29.411 N050.04.51.782 E019.48.29.321 Color_252ACI
N050.04.51.782 E019.48.29.321 N050.04.51.736 E019.48.29.249 Color_252ACI
N050.04.51.736 E019.48.29.249 N050.04.51.680 E019.48.29.232 Color_252ACI
N050.04.51.680 E019.48.29.232 N050.04.51.618 E019.48.29.275 Color_252ACI
N050.04.51.618 E019.48.29.275 N050.04.51.587 E019.48.29.358 Color_252ACI
N050.04.51.587 E019.48.29.358 N050.04.51.593 E019.48.29.459 Color_252ACI
N050.04.51.593 E019.48.29.459 N050.04.51.633 E019.48.29.531 Color_252ACI
N050.04.51.633 E019.48.29.531 N050.04.51.697 E019.48.29.556 Color_252ACI
N050.04.51.697 E019.48.29.556 N050.04.51.746 E019.48.29.529 Color_252ACI
N050.04.51.746 E019.48.29.529 N050.04.51.782 E019.48.29.467 Color_252ACI
N050.04.51.782 E019.48.29.467 N050.04.51.792 E019.48.29.411 Color_252ACI
N050.04.52.095 E019.48.29.308 N050.04.52.085 E019.48.29.219 Color_252ACI
N050.04.52.085 E019.48.29.219 N050.04.52.039 E019.48.29.147 Color_252ACI
N050.04.52.039 E019.48.29.147 N050.04.51.983 E019.48.29.130 Color_252ACI
N050.04.51.983 E019.48.29.130 N050.04.51.921 E019.48.29.172 Color_252ACI
N050.04.51.921 E019.48.29.172 N050.04.51.890 E019.48.29.256 Color_252ACI
N050.04.51.890 E019.48.29.256 N050.04.51.896 E019.48.29.357 Color_252ACI
N050.04.51.896 E019.48.29.357 N050.04.51.936 E019.48.29.429 Color_252ACI
N050.04.51.936 E019.48.29.429 N050.04.51.999 E019.48.29.453 Color_252ACI
N050.04.51.999 E019.48.29.453 N050.04.52.049 E019.48.29.427 Color_252ACI
N050.04.52.049 E019.48.29.427 N050.04.52.085 E019.48.29.364 Color_252ACI
N050.04.52.085 E019.48.29.364 N050.04.52.095 E019.48.29.308 Color_252ACI
N050.04.50.751 E019.48.28.247 N050.04.50.741 E019.48.28.157 Color_252ACI
N050.04.50.741 E019.48.28.157 N050.04.50.695 E019.48.28.085 Color_252ACI
N050.04.50.695 E019.48.28.085 N050.04.50.639 E019.48.28.068 Color_252ACI
N050.04.50.639 E019.48.28.068 N050.04.50.577 E019.48.28.111 Color_252ACI
N050.04.50.577 E019.48.28.111 N050.04.50.546 E019.48.28.195 Color_252ACI
N050.04.50.546 E019.48.28.195 N050.04.50.552 E019.48.28.296 Color_252ACI
N050.04.50.552 E019.48.28.296 N050.04.50.592 E019.48.28.367 Color_252ACI
N050.04.50.592 E019.48.28.367 N050.04.50.655 E019.48.28.392 Color_252ACI
N050.04.50.655 E019.48.28.392 N050.04.50.705 E019.48.28.366 Color_252ACI
N050.04.50.705 E019.48.28.366 N050.04.50.741 E019.48.28.303 Color_252ACI
N050.04.50.741 E019.48.28.303 N050.04.50.751 E019.48.28.247 Color_252ACI
N050.04.51.034 E019.48.28.151 N050.04.51.024 E019.48.28.062 Color_252ACI
N050.04.51.024 E019.48.28.062 N050.04.50.978 E019.48.27.990 Color_252ACI
N050.04.50.978 E019.48.27.990 N050.04.50.922 E019.48.27.973 Color_252ACI
N050.04.50.922 E019.48.27.973 N050.04.50.860 E019.48.28.016 Color_252ACI
N050.04.50.860 E019.48.28.016 N050.04.50.829 E019.48.28.099 Color_252ACI
N050.04.50.829 E019.48.28.099 N050.04.50.835 E019.48.28.200 Color_252ACI
N050.04.50.835 E019.48.28.200 N050.04.50.875 E019.48.28.272 Color_252ACI
N050.04.50.875 E019.48.28.272 N050.04.50.938 E019.48.28.297 Color_252ACI
N050.04.50.938 E019.48.28.297 N050.04.50.988 E019.48.28.270 Color_252ACI
N050.04.50.988 E019.48.28.270 N050.04.51.024 E019.48.28.207 Color_252ACI
N050.04.51.024 E019.48.28.207 N050.04.51.034 E019.48.28.151 Color_252ACI
N050.04.51.589 E019.48.27.964 N050.04.51.579 E019.48.27.874 Color_252ACI
N050.04.51.579 E019.48.27.874 N050.04.51.532 E019.48.27.802 Color_252ACI
N050.04.51.532 E019.48.27.802 N050.04.51.477 E019.48.27.785 Color_252ACI
N050.04.51.477 E019.48.27.785 N050.04.51.415 E019.48.27.828 Color_252ACI
N050.04.51.415 E019.48.27.828 N050.04.51.384 E019.48.27.912 Color_252ACI
N050.04.51.384 E019.48.27.912 N050.04.51.390 E019.48.28.012 Color_252ACI
N050.04.51.390 E019.48.28.012 N050.04.51.430 E019.48.28.084 Color_252ACI
N050.04.51.430 E019.48.28.084 N050.04.51.493 E019.48.28.109 Color_252ACI
N050.04.51.493 E019.48.28.109 N050.04.51.543 E019.48.28.082 Color_252ACI
N050.04.51.543 E019.48.28.082 N050.04.51.579 E019.48.28.020 Color_252ACI
N050.04.51.579 E019.48.28.020 N050.04.51.589 E019.48.27.964 Color_252ACI
N050.04.51.874 E019.48.27.867 N050.04.51.863 E019.48.27.778 Color_252ACI
N050.04.51.863 E019.48.27.778 N050.04.51.817 E019.48.27.706 Color_252ACI
N050.04.51.817 E019.48.27.706 N050.04.51.761 E019.48.27.689 Color_252ACI
N050.04.51.761 E019.48.27.689 N050.04.51.699 E019.48.27.732 Color_252ACI
N050.04.51.699 E019.48.27.732 N050.04.51.668 E019.48.27.815 Color_252ACI
N050.04.51.668 E019.48.27.815 N050.04.51.675 E019.48.27.916 Color_252ACI
N050.04.51.675 E019.48.27.916 N050.04.51.714 E019.48.27.988 Color_252ACI
N050.04.51.714 E019.48.27.988 N050.04.51.778 E019.48.28.013 Color_252ACI
N050.04.51.778 E019.48.28.013 N050.04.51.828 E019.48.27.986 Color_252ACI
N050.04.51.828 E019.48.27.986 N050.04.51.863 E019.48.27.924 Color_252ACI
N050.04.51.863 E019.48.27.924 N050.04.51.874 E019.48.27.867 Color_252ACI
N050.04.50.536 E019.48.26.751 N050.04.50.526 E019.48.26.662 Color_252ACI
N050.04.50.526 E019.48.26.662 N050.04.50.480 E019.48.26.589 Color_252ACI
N050.04.50.480 E019.48.26.589 N050.04.50.424 E019.48.26.573 Color_252ACI
N050.04.50.424 E019.48.26.573 N050.04.50.362 E019.48.26.615 Color_252ACI
N050.04.50.362 E019.48.26.615 N050.04.50.331 E019.48.26.699 Color_252ACI
N050.04.50.331 E019.48.26.699 N050.04.50.337 E019.48.26.800 Color_252ACI
N050.04.50.337 E019.48.26.800 N050.04.50.377 E019.48.26.871 Color_252ACI
N050.04.50.377 E019.48.26.871 N050.04.50.440 E019.48.26.896 Color_252ACI
N050.04.50.440 E019.48.26.896 N050.04.50.490 E019.48.26.870 Color_252ACI
N050.04.50.490 E019.48.26.870 N050.04.50.526 E019.48.26.807 Color_252ACI
N050.04.50.526 E019.48.26.807 N050.04.50.536 E019.48.26.751 Color_252ACI
N050.04.50.828 E019.48.26.652 N050.04.50.818 E019.48.26.563 Color_252ACI
N050.04.50.818 E019.48.26.563 N050.04.50.772 E019.48.26.491 Color_252ACI
N050.04.50.772 E019.48.26.491 N050.04.50.716 E019.48.26.474 Color_252ACI
N050.04.50.716 E019.48.26.474 N050.04.50.654 E019.48.26.517 Color_252ACI
N050.04.50.654 E019.48.26.517 N050.04.50.623 E019.48.26.600 Color_252ACI
N050.04.50.623 E019.48.26.600 N050.04.50.629 E019.48.26.701 Color_252ACI
N050.04.50.629 E019.48.26.701 N050.04.50.669 E019.48.26.773 Color_252ACI
N050.04.50.669 E019.48.26.773 N050.04.50.732 E019.48.26.798 Color_252ACI
N050.04.50.732 E019.48.26.798 N050.04.50.782 E019.48.26.771 Color_252ACI
N050.04.50.782 E019.48.26.771 N050.04.50.818 E019.48.26.708 Color_252ACI
N050.04.50.818 E019.48.26.708 N050.04.50.828 E019.48.26.652 Color_252ACI
N050.04.51.387 E019.48.26.463 N050.04.51.377 E019.48.26.374 Color_252ACI
N050.04.51.377 E019.48.26.374 N050.04.51.330 E019.48.26.302 Color_252ACI
N050.04.51.330 E019.48.26.302 N050.04.51.274 E019.48.26.285 Color_252ACI
N050.04.51.274 E019.48.26.285 N050.04.51.213 E019.48.26.328 Color_252ACI
N050.04.51.213 E019.48.26.328 N050.04.51.182 E019.48.26.411 Color_252ACI
N050.04.51.182 E019.48.26.411 N050.04.51.188 E019.48.26.512 Color_252ACI
N050.04.51.188 E019.48.26.512 N050.04.51.227 E019.48.26.584 Color_252ACI
N050.04.51.227 E019.48.26.584 N050.04.51.291 E019.48.26.609 Color_252ACI
N050.04.51.291 E019.48.26.609 N050.04.51.341 E019.48.26.582 Color_252ACI
N050.04.51.341 E019.48.26.582 N050.04.51.377 E019.48.26.520 Color_252ACI
N050.04.51.377 E019.48.26.520 N050.04.51.387 E019.48.26.463 Color_252ACI
N050.04.51.682 E019.48.26.364 N050.04.51.672 E019.48.26.274 Color_252ACI
N050.04.51.672 E019.48.26.274 N050.04.51.626 E019.48.26.202 Color_252ACI
N050.04.51.626 E019.48.26.202 N050.04.51.570 E019.48.26.185 Color_252ACI
N050.04.51.570 E019.48.26.185 N050.04.51.508 E019.48.26.228 Color_252ACI
N050.04.51.508 E019.48.26.228 N050.04.51.477 E019.48.26.312 Color_252ACI
N050.04.51.477 E019.48.26.312 N050.04.51.483 E019.48.26.412 Color_252ACI
N050.04.51.483 E019.48.26.412 N050.04.51.523 E019.48.26.484 Color_252ACI
N050.04.51.523 E019.48.26.484 N050.04.51.586 E019.48.26.509 Color_252ACI
N050.04.51.586 E019.48.26.509 N050.04.51.636 E019.48.26.482 Color_252ACI
N050.04.51.636 E019.48.26.482 N050.04.51.672 E019.48.26.420 Color_252ACI
N050.04.51.672 E019.48.26.420 N050.04.51.682 E019.48.26.364 Color_252ACI
N050.04.50.334 E019.48.25.253 N050.04.50.323 E019.48.25.163 Color_252ACI
N050.04.50.323 E019.48.25.163 N050.04.50.277 E019.48.25.091 Color_252ACI
N050.04.50.277 E019.48.25.091 N050.04.50.221 E019.48.25.074 Color_252ACI
N050.04.50.221 E019.48.25.074 N050.04.50.160 E019.48.25.117 Color_252ACI
N050.04.50.160 E019.48.25.117 N050.04.50.129 E019.48.25.201 Color_252ACI
N050.04.50.129 E019.48.25.201 N050.04.50.135 E019.48.25.301 Color_252ACI
N050.04.50.135 E019.48.25.301 N050.04.50.174 E019.48.25.373 Color_252ACI
N050.04.50.174 E019.48.25.373 N050.04.50.238 E019.48.25.398 Color_252ACI
N050.04.50.238 E019.48.25.398 N050.04.50.288 E019.48.25.371 Color_252ACI
N050.04.50.288 E019.48.25.371 N050.04.50.323 E019.48.25.309 Color_252ACI
N050.04.50.323 E019.48.25.309 N050.04.50.334 E019.48.25.253 Color_252ACI
N050.04.50.614 E019.48.25.158 N050.04.50.603 E019.48.25.069 Color_252ACI
N050.04.50.603 E019.48.25.069 N050.04.50.557 E019.48.24.997 Color_252ACI
N050.04.50.557 E019.48.24.997 N050.04.50.501 E019.48.24.980 Color_252ACI
N050.04.50.501 E019.48.24.980 N050.04.50.439 E019.48.25.022 Color_252ACI
N050.04.50.439 E019.48.25.022 N050.04.50.408 E019.48.25.106 Color_252ACI
N050.04.50.408 E019.48.25.106 N050.04.50.415 E019.48.25.207 Color_252ACI
N050.04.50.415 E019.48.25.207 N050.04.50.454 E019.48.25.279 Color_252ACI
N050.04.50.454 E019.48.25.279 N050.04.50.518 E019.48.25.303 Color_252ACI
N050.04.50.518 E019.48.25.303 N050.04.50.568 E019.48.25.277 Color_252ACI
N050.04.50.568 E019.48.25.277 N050.04.50.603 E019.48.25.214 Color_252ACI
N050.04.50.603 E019.48.25.214 N050.04.50.614 E019.48.25.158 Color_252ACI
N050.04.51.182 E019.48.24.966 N050.04.51.172 E019.48.24.877 Color_252ACI
N050.04.51.172 E019.48.24.877 N050.04.51.126 E019.48.24.804 Color_252ACI
N050.04.51.126 E019.48.24.804 N050.04.51.070 E019.48.24.788 Color_252ACI
N050.04.51.070 E019.48.24.788 N050.04.51.008 E019.48.24.830 Color_252ACI
N050.04.51.008 E019.48.24.830 N050.04.50.977 E019.48.24.914 Color_252ACI
N050.04.50.977 E019.48.24.914 N050.04.50.983 E019.48.25.015 Color_252ACI
N050.04.50.983 E019.48.25.015 N050.04.51.023 E019.48.25.086 Color_252ACI
N050.04.51.023 E019.48.25.086 N050.04.51.086 E019.48.25.111 Color_252ACI
N050.04.51.086 E019.48.25.111 N050.04.51.136 E019.48.25.085 Color_252ACI
N050.04.51.136 E019.48.25.085 N050.04.51.172 E019.48.25.022 Color_252ACI
N050.04.51.172 E019.48.25.022 N050.04.51.182 E019.48.24.966 Color_252ACI
N050.04.51.471 E019.48.24.868 N050.04.51.461 E019.48.24.779 Color_252ACI
N050.04.51.461 E019.48.24.779 N050.04.51.414 E019.48.24.707 Color_252ACI
N050.04.51.414 E019.48.24.707 N050.04.51.358 E019.48.24.690 Color_252ACI
N050.04.51.358 E019.48.24.690 N050.04.51.297 E019.48.24.733 Color_252ACI
N050.04.51.297 E019.48.24.733 N050.04.51.266 E019.48.24.816 Color_252ACI
N050.04.51.266 E019.48.24.816 N050.04.51.272 E019.48.24.917 Color_252ACI
N050.04.51.272 E019.48.24.917 N050.04.51.312 E019.48.24.989 Color_252ACI
N050.04.51.312 E019.48.24.989 N050.04.51.375 E019.48.25.014 Color_252ACI
N050.04.51.375 E019.48.25.014 N050.04.51.425 E019.48.24.987 Color_252ACI
N050.04.51.425 E019.48.24.987 N050.04.51.461 E019.48.24.924 Color_252ACI
N050.04.51.461 E019.48.24.924 N050.04.51.471 E019.48.24.868 Color_252ACI
N050.04.51.257 E019.48.23.411 N050.04.51.247 E019.48.23.321 Color_252ACI
N050.04.51.247 E019.48.23.321 N050.04.51.200 E019.48.23.249 Color_252ACI
N050.04.51.200 E019.48.23.249 N050.04.51.144 E019.48.23.232 Color_252ACI
N050.04.51.144 E019.48.23.232 N050.04.51.083 E019.48.23.275 Color_252ACI
N050.04.51.083 E019.48.23.275 N050.04.51.052 E019.48.23.359 Color_252ACI
N050.04.51.052 E019.48.23.359 N050.04.51.058 E019.48.23.460 Color_252ACI
N050.04.51.058 E019.48.23.460 N050.04.51.097 E019.48.23.531 Color_252ACI
N050.04.51.097 E019.48.23.531 N050.04.51.161 E019.48.23.556 Color_252ACI
N050.04.51.161 E019.48.23.556 N050.04.51.211 E019.48.23.530 Color_252ACI
N050.04.51.211 E019.48.23.530 N050.04.51.247 E019.48.23.467 Color_252ACI
N050.04.51.247 E019.48.23.467 N050.04.51.257 E019.48.23.411 Color_252ACI
N050.04.50.983 E019.48.23.503 N050.04.50.972 E019.48.23.414 Color_252ACI
N050.04.50.972 E019.48.23.414 N050.04.50.926 E019.48.23.342 Color_252ACI
N050.04.50.926 E019.48.23.342 N050.04.50.870 E019.48.23.325 Color_252ACI
N050.04.50.870 E019.48.23.325 N050.04.50.808 E019.48.23.368 Color_252ACI
N050.04.50.808 E019.48.23.368 N050.04.50.778 E019.48.23.451 Color_252ACI
N050.04.50.778 E019.48.23.451 N050.04.50.784 E019.48.23.552 Color_252ACI
N050.04.50.784 E019.48.23.552 N050.04.50.823 E019.48.23.624 Color_252ACI
N050.04.50.823 E019.48.23.624 N050.04.50.887 E019.48.23.649 Color_252ACI
N050.04.50.887 E019.48.23.649 N050.04.50.937 E019.48.23.622 Color_252ACI
N050.04.50.937 E019.48.23.622 N050.04.50.972 E019.48.23.560 Color_252ACI
N050.04.50.972 E019.48.23.560 N050.04.50.983 E019.48.23.503 Color_252ACI
N050.04.50.418 E019.48.23.694 N050.04.50.408 E019.48.23.605 Color_252ACI
N050.04.50.408 E019.48.23.605 N050.04.50.361 E019.48.23.533 Color_252ACI
N050.04.50.361 E019.48.23.533 N050.04.50.306 E019.48.23.516 Color_252ACI
N050.04.50.306 E019.48.23.516 N050.04.50.244 E019.48.23.559 Color_252ACI
N050.04.50.244 E019.48.23.559 N050.04.50.213 E019.48.23.642 Color_252ACI
N050.04.50.213 E019.48.23.642 N050.04.50.219 E019.48.23.743 Color_252ACI
N050.04.50.219 E019.48.23.743 N050.04.50.259 E019.48.23.815 Color_252ACI
N050.04.50.259 E019.48.23.815 N050.04.50.322 E019.48.23.840 Color_252ACI
N050.04.50.322 E019.48.23.840 N050.04.50.372 E019.48.23.813 Color_252ACI
N050.04.50.372 E019.48.23.813 N050.04.50.408 E019.48.23.750 Color_252ACI
N050.04.50.408 E019.48.23.750 N050.04.50.418 E019.48.23.694 Color_252ACI
N050.04.50.130 E019.48.23.792 N050.04.50.119 E019.48.23.702 Color_252ACI
N050.04.50.119 E019.48.23.702 N050.04.50.073 E019.48.23.630 Color_252ACI
N050.04.50.073 E019.48.23.630 N050.04.50.017 E019.48.23.613 Color_252ACI
N050.04.50.017 E019.48.23.613 N050.04.49.955 E019.48.23.656 Color_252ACI
N050.04.49.955 E019.48.23.656 N050.04.49.924 E019.48.23.740 Color_252ACI
N050.04.49.924 E019.48.23.740 N050.04.49.931 E019.48.23.841 Color_252ACI
N050.04.49.931 E019.48.23.841 N050.04.49.970 E019.48.23.912 Color_252ACI
N050.04.49.970 E019.48.23.912 N050.04.50.034 E019.48.23.937 Color_252ACI
N050.04.50.034 E019.48.23.937 N050.04.50.084 E019.48.23.910 Color_252ACI
N050.04.50.084 E019.48.23.910 N050.04.50.119 E019.48.23.848 Color_252ACI
N050.04.50.119 E019.48.23.848 N050.04.50.130 E019.48.23.792 Color_252ACI
N050.04.49.914 E019.48.22.345 N050.04.49.903 E019.48.22.256 Color_252ACI
N050.04.49.903 E019.48.22.256 N050.04.49.857 E019.48.22.183 Color_252ACI
N050.04.49.857 E019.48.22.183 N050.04.49.801 E019.48.22.167 Color_252ACI
N050.04.49.801 E019.48.22.167 N050.04.49.739 E019.48.22.209 Color_252ACI
N050.04.49.739 E019.48.22.209 N050.04.49.708 E019.48.22.293 Color_252ACI
N050.04.49.708 E019.48.22.293 N050.04.49.715 E019.48.22.394 Color_252ACI
N050.04.49.715 E019.48.22.394 N050.04.49.754 E019.48.22.465 Color_252ACI
N050.04.49.754 E019.48.22.465 N050.04.49.818 E019.48.22.490 Color_252ACI
N050.04.49.818 E019.48.22.490 N050.04.49.867 E019.48.22.464 Color_252ACI
N050.04.49.867 E019.48.22.464 N050.04.49.903 E019.48.22.401 Color_252ACI
N050.04.49.903 E019.48.22.401 N050.04.49.914 E019.48.22.345 Color_252ACI
N050.04.50.213 E019.48.22.244 N050.04.50.202 E019.48.22.154 Color_252ACI
N050.04.50.202 E019.48.22.154 N050.04.50.156 E019.48.22.082 Color_252ACI
N050.04.50.156 E019.48.22.082 N050.04.50.100 E019.48.22.065 Color_252ACI
N050.04.50.100 E019.48.22.065 N050.04.50.038 E019.48.22.108 Color_252ACI
N050.04.50.038 E019.48.22.108 N050.04.50.008 E019.48.22.192 Color_252ACI
N050.04.50.008 E019.48.22.192 N050.04.50.014 E019.48.22.293 Color_252ACI
N050.04.50.014 E019.48.22.293 N050.04.50.053 E019.48.22.364 Color_252ACI
N050.04.50.053 E019.48.22.364 N050.04.50.117 E019.48.22.389 Color_252ACI
N050.04.50.117 E019.48.22.389 N050.04.50.167 E019.48.22.363 Color_252ACI
N050.04.50.167 E019.48.22.363 N050.04.50.202 E019.48.22.300 Color_252ACI
N050.04.50.202 E019.48.22.300 N050.04.50.213 E019.48.22.244 Color_252ACI
N050.04.50.783 E019.48.22.051 N050.04.50.773 E019.48.21.962 Color_252ACI
N050.04.50.773 E019.48.21.962 N050.04.50.727 E019.48.21.890 Color_252ACI
N050.04.50.727 E019.48.21.890 N050.04.50.671 E019.48.21.873 Color_252ACI
N050.04.50.671 E019.48.21.873 N050.04.50.609 E019.48.21.915 Color_252ACI
N050.04.50.609 E019.48.21.915 N050.04.50.578 E019.48.21.999 Color_252ACI
N050.04.50.578 E019.48.21.999 N050.04.50.584 E019.48.22.100 Color_252ACI
N050.04.50.584 E019.48.22.100 N050.04.50.624 E019.48.22.171 Color_252ACI
N050.04.50.624 E019.48.22.171 N050.04.50.687 E019.48.22.196 Color_252ACI
N050.04.50.687 E019.48.22.196 N050.04.50.737 E019.48.22.170 Color_252ACI
N050.04.50.737 E019.48.22.170 N050.04.50.773 E019.48.22.107 Color_252ACI
N050.04.50.773 E019.48.22.107 N050.04.50.783 E019.48.22.051 Color_252ACI
N050.04.51.059 E019.48.21.958 N050.04.51.048 E019.48.21.869 Color_252ACI
N050.04.51.048 E019.48.21.869 N050.04.51.002 E019.48.21.796 Color_252ACI
N050.04.51.002 E019.48.21.796 N050.04.50.946 E019.48.21.780 Color_252ACI
N050.04.50.946 E019.48.21.780 N050.04.50.884 E019.48.21.822 Color_252ACI
N050.04.50.884 E019.48.21.822 N050.04.50.853 E019.48.21.906 Color_252ACI
N050.04.50.853 E019.48.21.906 N050.04.50.860 E019.48.22.007 Color_252ACI
N050.04.50.860 E019.48.22.007 N050.04.50.899 E019.48.22.078 Color_252ACI
N050.04.50.899 E019.48.22.078 N050.04.50.963 E019.48.22.103 Color_252ACI
N050.04.50.963 E019.48.22.103 N050.04.51.013 E019.48.22.077 Color_252ACI
N050.04.51.013 E019.48.22.077 N050.04.51.048 E019.48.22.014 Color_252ACI
N050.04.51.048 E019.48.22.014 N050.04.51.059 E019.48.21.958 Color_252ACI
N050.04.49.717 E019.48.20.838 N050.04.49.706 E019.48.20.749 Color_252ACI
N050.04.49.706 E019.48.20.749 N050.04.49.660 E019.48.20.677 Color_252ACI
N050.04.49.660 E019.48.20.677 N050.04.49.604 E019.48.20.660 Color_252ACI
N050.04.49.604 E019.48.20.660 N050.04.49.542 E019.48.20.703 Color_252ACI
N050.04.49.542 E019.48.20.703 N050.04.49.512 E019.48.20.786 Color_252ACI
N050.04.49.512 E019.48.20.786 N050.04.49.518 E019.48.20.887 Color_252ACI
N050.04.49.518 E019.48.20.887 N050.04.49.557 E019.48.20.959 Color_252ACI
N050.04.49.557 E019.48.20.959 N050.04.49.621 E019.48.20.984 Color_252ACI
N050.04.49.621 E019.48.20.984 N050.04.49.671 E019.48.20.957 Color_252ACI
N050.04.49.671 E019.48.20.957 N050.04.49.706 E019.48.20.895 Color_252ACI
N050.04.49.706 E019.48.20.895 N050.04.49.717 E019.48.20.838 Color_252ACI
N050.04.49.999 E019.48.20.743 N050.04.49.988 E019.48.20.654 Color_252ACI
N050.04.49.988 E019.48.20.654 N050.04.49.942 E019.48.20.582 Color_252ACI
N050.04.49.942 E019.48.20.582 N050.04.49.886 E019.48.20.565 Color_252ACI
N050.04.49.886 E019.48.20.565 N050.04.49.824 E019.48.20.607 Color_252ACI
N050.04.49.824 E019.48.20.607 N050.04.49.794 E019.48.20.691 Color_252ACI
N050.04.49.794 E019.48.20.691 N050.04.49.800 E019.48.20.792 Color_252ACI
N050.04.49.800 E019.48.20.792 N050.04.49.839 E019.48.20.864 Color_252ACI
N050.04.49.839 E019.48.20.864 N050.04.49.903 E019.48.20.888 Color_252ACI
N050.04.49.903 E019.48.20.888 N050.04.49.953 E019.48.20.862 Color_252ACI
N050.04.49.953 E019.48.20.862 N050.04.49.988 E019.48.20.799 Color_252ACI
N050.04.49.988 E019.48.20.799 N050.04.49.999 E019.48.20.743 Color_252ACI
N050.04.50.578 E019.48.20.547 N050.04.50.567 E019.48.20.458 Color_252ACI
N050.04.50.567 E019.48.20.458 N050.04.50.521 E019.48.20.386 Color_252ACI
N050.04.50.521 E019.48.20.386 N050.04.50.465 E019.48.20.369 Color_252ACI
N050.04.50.465 E019.48.20.369 N050.04.50.403 E019.48.20.412 Color_252ACI
N050.04.50.403 E019.48.20.412 N050.04.50.373 E019.48.20.495 Color_252ACI
N050.04.50.373 E019.48.20.495 N050.04.50.379 E019.48.20.596 Color_252ACI
N050.04.50.379 E019.48.20.596 N050.04.50.418 E019.48.20.668 Color_252ACI
N050.04.50.418 E019.48.20.668 N050.04.50.482 E019.48.20.693 Color_252ACI
N050.04.50.482 E019.48.20.693 N050.04.50.532 E019.48.20.666 Color_252ACI
N050.04.50.532 E019.48.20.666 N050.04.50.567 E019.48.20.604 Color_252ACI
N050.04.50.567 E019.48.20.604 N050.04.50.578 E019.48.20.547 Color_252ACI
N050.04.50.862 E019.48.20.451 N050.04.50.852 E019.48.20.362 Color_252ACI
N050.04.50.852 E019.48.20.362 N050.04.50.805 E019.48.20.290 Color_252ACI
N050.04.50.805 E019.48.20.290 N050.04.50.749 E019.48.20.273 Color_252ACI
N050.04.50.749 E019.48.20.273 N050.04.50.688 E019.48.20.316 Color_252ACI
N050.04.50.688 E019.48.20.316 N050.04.50.657 E019.48.20.399 Color_252ACI
N050.04.50.657 E019.48.20.399 N050.04.50.663 E019.48.20.500 Color_252ACI
N050.04.50.663 E019.48.20.500 N050.04.50.702 E019.48.20.572 Color_252ACI
N050.04.50.702 E019.48.20.572 N050.04.50.766 E019.48.20.597 Color_252ACI
N050.04.50.766 E019.48.20.597 N050.04.50.816 E019.48.20.570 Color_252ACI
N050.04.50.816 E019.48.20.570 N050.04.50.852 E019.48.20.508 Color_252ACI
N050.04.50.852 E019.48.20.508 N050.04.50.862 E019.48.20.451 Color_252ACI
N050.04.49.525 E019.48.19.381 N050.04.49.514 E019.48.19.291 Color_252ACI
N050.04.49.514 E019.48.19.291 N050.04.49.468 E019.48.19.219 Color_252ACI
N050.04.49.468 E019.48.19.219 N050.04.49.412 E019.48.19.202 Color_252ACI
N050.04.49.412 E019.48.19.202 N050.04.49.350 E019.48.19.245 Color_252ACI
N050.04.49.350 E019.48.19.245 N050.04.49.319 E019.48.19.329 Color_252ACI
N050.04.49.319 E019.48.19.329 N050.04.49.326 E019.48.19.430 Color_252ACI
N050.04.49.326 E019.48.19.430 N050.04.49.365 E019.48.19.501 Color_252ACI
N050.04.49.365 E019.48.19.501 N050.04.49.429 E019.48.19.526 Color_252ACI
N050.04.49.429 E019.48.19.526 N050.04.49.479 E019.48.19.500 Color_252ACI
N050.04.49.479 E019.48.19.500 N050.04.49.514 E019.48.19.437 Color_252ACI
N050.04.49.514 E019.48.19.437 N050.04.49.525 E019.48.19.381 Color_252ACI
N050.04.49.788 E019.48.19.292 N050.04.49.777 E019.48.19.202 Color_252ACI
N050.04.49.777 E019.48.19.202 N050.04.49.731 E019.48.19.130 Color_252ACI
N050.04.49.731 E019.48.19.130 N050.04.49.675 E019.48.19.113 Color_252ACI
N050.04.49.675 E019.48.19.113 N050.04.49.614 E019.48.19.156 Color_252ACI
N050.04.49.614 E019.48.19.156 N050.04.49.583 E019.48.19.240 Color_252ACI
N050.04.49.583 E019.48.19.240 N050.04.49.589 E019.48.19.341 Color_252ACI
N050.04.49.589 E019.48.19.341 N050.04.49.628 E019.48.19.412 Color_252ACI
N050.04.49.628 E019.48.19.412 N050.04.49.692 E019.48.19.437 Color_252ACI
N050.04.49.692 E019.48.19.437 N050.04.49.742 E019.48.19.411 Color_252ACI
N050.04.49.742 E019.48.19.411 N050.04.49.778 E019.48.19.348 Color_252ACI
N050.04.49.778 E019.48.19.348 N050.04.49.788 E019.48.19.292 Color_252ACI
N050.04.50.363 E019.48.19.097 N050.04.50.353 E019.48.19.008 Color_252ACI
N050.04.50.353 E019.48.19.008 N050.04.50.307 E019.48.18.936 Color_252ACI
N050.04.50.307 E019.48.18.936 N050.04.50.251 E019.48.18.919 Color_252ACI
N050.04.50.251 E019.48.18.919 N050.04.50.189 E019.48.18.962 Color_252ACI
N050.04.50.189 E019.48.18.962 N050.04.50.158 E019.48.19.045 Color_252ACI
N050.04.50.158 E019.48.19.045 N050.04.50.164 E019.48.19.146 Color_252ACI
N050.04.50.164 E019.48.19.146 N050.04.50.204 E019.48.19.218 Color_252ACI
N050.04.50.204 E019.48.19.218 N050.04.50.268 E019.48.19.243 Color_252ACI
N050.04.50.268 E019.48.19.243 N050.04.50.317 E019.48.19.216 Color_252ACI
N050.04.50.317 E019.48.19.216 N050.04.50.353 E019.48.19.153 Color_252ACI
N050.04.50.353 E019.48.19.153 N050.04.50.363 E019.48.19.097 Color_252ACI
N050.04.50.636 E019.48.19.005 N050.04.50.625 E019.48.18.916 Color_252ACI
N050.04.50.625 E019.48.18.916 N050.04.50.579 E019.48.18.844 Color_252ACI
N050.04.50.579 E019.48.18.844 N050.04.50.523 E019.48.18.827 Color_252ACI
N050.04.50.523 E019.48.18.827 N050.04.50.461 E019.48.18.870 Color_252ACI
N050.04.50.461 E019.48.18.870 N050.04.50.431 E019.48.18.953 Color_252ACI
N050.04.50.431 E019.48.18.953 N050.04.50.437 E019.48.19.054 Color_252ACI
N050.04.50.437 E019.48.19.054 N050.04.50.476 E019.48.19.126 Color_252ACI
N050.04.50.476 E019.48.19.126 N050.04.50.540 E019.48.19.151 Color_252ACI
N050.04.50.540 E019.48.19.151 N050.04.50.590 E019.48.19.124 Color_252ACI
N050.04.50.590 E019.48.19.124 N050.04.50.625 E019.48.19.061 Color_252ACI
N050.04.50.625 E019.48.19.061 N050.04.50.636 E019.48.19.005 Color_252ACI
N050.04.49.299 E019.48.17.884 N050.04.49.289 E019.48.17.795 Color_252ACI
N050.04.49.289 E019.48.17.795 N050.04.49.243 E019.48.17.723 Color_252ACI
N050.04.49.243 E019.48.17.723 N050.04.49.187 E019.48.17.706 Color_252ACI
N050.04.49.187 E019.48.17.706 N050.04.49.125 E019.48.17.749 Color_252ACI
N050.04.49.125 E019.48.17.749 N050.04.49.094 E019.48.17.832 Color_252ACI
N050.04.49.094 E019.48.17.832 N050.04.49.100 E019.48.17.933 Color_252ACI
N050.04.49.100 E019.48.17.933 N050.04.49.140 E019.48.18.005 Color_252ACI
N050.04.49.140 E019.48.18.005 N050.04.49.203 E019.48.18.030 Color_252ACI
N050.04.49.203 E019.48.18.030 N050.04.49.253 E019.48.18.003 Color_252ACI
N050.04.49.253 E019.48.18.003 N050.04.49.289 E019.48.17.940 Color_252ACI
N050.04.49.289 E019.48.17.940 N050.04.49.299 E019.48.17.884 Color_252ACI
N050.04.49.600 E019.48.17.783 N050.04.49.589 E019.48.17.693 Color_252ACI
N050.04.49.589 E019.48.17.693 N050.04.49.543 E019.48.17.621 Color_252ACI
N050.04.49.543 E019.48.17.621 N050.04.49.487 E019.48.17.604 Color_252ACI
N050.04.49.487 E019.48.17.604 N050.04.49.425 E019.48.17.647 Color_252ACI
N050.04.49.425 E019.48.17.647 N050.04.49.394 E019.48.17.731 Color_252ACI
N050.04.49.394 E019.48.17.731 N050.04.49.401 E019.48.17.832 Color_252ACI
N050.04.49.401 E019.48.17.832 N050.04.49.440 E019.48.17.903 Color_252ACI
N050.04.49.440 E019.48.17.903 N050.04.49.504 E019.48.17.928 Color_252ACI
N050.04.49.504 E019.48.17.928 N050.04.49.554 E019.48.17.902 Color_252ACI
N050.04.49.554 E019.48.17.902 N050.04.49.589 E019.48.17.839 Color_252ACI
N050.04.49.589 E019.48.17.839 N050.04.49.600 E019.48.17.783 Color_252ACI
N050.04.50.158 E019.48.17.594 N050.04.50.148 E019.48.17.505 Color_252ACI
N050.04.50.148 E019.48.17.505 N050.04.50.102 E019.48.17.432 Color_252ACI
N050.04.50.102 E019.48.17.432 N050.04.50.046 E019.48.17.416 Color_252ACI
N050.04.50.046 E019.48.17.416 N050.04.49.984 E019.48.17.458 Color_252ACI
N050.04.49.984 E019.48.17.458 N050.04.49.953 E019.48.17.542 Color_252ACI
N050.04.49.953 E019.48.17.542 N050.04.49.959 E019.48.17.643 Color_252ACI
N050.04.49.959 E019.48.17.643 N050.04.49.999 E019.48.17.714 Color_252ACI
N050.04.49.999 E019.48.17.714 N050.04.50.063 E019.48.17.739 Color_252ACI
N050.04.50.063 E019.48.17.739 N050.04.50.112 E019.48.17.713 Color_252ACI
N050.04.50.112 E019.48.17.713 N050.04.50.148 E019.48.17.650 Color_252ACI
N050.04.50.148 E019.48.17.650 N050.04.50.158 E019.48.17.594 Color_252ACI
N050.04.50.442 E019.48.17.498 N050.04.50.431 E019.48.17.409 Color_252ACI
N050.04.50.431 E019.48.17.409 N050.04.50.385 E019.48.17.337 Color_252ACI
N050.04.50.385 E019.48.17.337 N050.04.50.329 E019.48.17.320 Color_252ACI
N050.04.50.329 E019.48.17.320 N050.04.50.267 E019.48.17.362 Color_252ACI
N050.04.50.267 E019.48.17.362 N050.04.50.237 E019.48.17.446 Color_252ACI
N050.04.50.237 E019.48.17.446 N050.04.50.243 E019.48.17.547 Color_252ACI
N050.04.50.243 E019.48.17.547 N050.04.50.282 E019.48.17.619 Color_252ACI
N050.04.50.282 E019.48.17.619 N050.04.50.346 E019.48.17.643 Color_252ACI
N050.04.50.346 E019.48.17.643 N050.04.50.396 E019.48.17.617 Color_252ACI
N050.04.50.396 E019.48.17.617 N050.04.50.431 E019.48.17.554 Color_252ACI
N050.04.50.431 E019.48.17.554 N050.04.50.442 E019.48.17.498 Color_252ACI
N050.04.49.083 E019.48.16.435 N050.04.49.073 E019.48.16.346 Color_252ACI
N050.04.49.073 E019.48.16.346 N050.04.49.026 E019.48.16.273 Color_252ACI
N050.04.49.026 E019.48.16.273 N050.04.48.971 E019.48.16.257 Color_252ACI
N050.04.48.971 E019.48.16.257 N050.04.48.909 E019.48.16.299 Color_252ACI
N050.04.48.909 E019.48.16.299 N050.04.48.878 E019.48.16.383 Color_252ACI
N050.04.48.878 E019.48.16.383 N050.04.48.884 E019.48.16.484 Color_252ACI
N050.04.48.884 E019.48.16.484 N050.04.48.924 E019.48.16.555 Color_252ACI
N050.04.48.924 E019.48.16.555 N050.04.48.987 E019.48.16.580 Color_252ACI
N050.04.48.987 E019.48.16.580 N050.04.49.037 E019.48.16.554 Color_252ACI
N050.04.49.037 E019.48.16.554 N050.04.49.073 E019.48.16.491 Color_252ACI
N050.04.49.073 E019.48.16.491 N050.04.49.083 E019.48.16.435 Color_252ACI
N050.04.49.392 E019.48.16.330 N050.04.49.382 E019.48.16.241 Color_252ACI
N050.04.49.382 E019.48.16.241 N050.04.49.336 E019.48.16.169 Color_252ACI
N050.04.49.336 E019.48.16.169 N050.04.49.280 E019.48.16.152 Color_252ACI
N050.04.49.280 E019.48.16.152 N050.04.49.218 E019.48.16.195 Color_252ACI
N050.04.49.218 E019.48.16.195 N050.04.49.187 E019.48.16.278 Color_252ACI
N050.04.49.187 E019.48.16.278 N050.04.49.193 E019.48.16.379 Color_252ACI
N050.04.49.193 E019.48.16.379 N050.04.49.233 E019.48.16.451 Color_252ACI
N050.04.49.233 E019.48.16.451 N050.04.49.296 E019.48.16.476 Color_252ACI
N050.04.49.296 E019.48.16.476 N050.04.49.346 E019.48.16.449 Color_252ACI
N050.04.49.346 E019.48.16.449 N050.04.49.382 E019.48.16.387 Color_252ACI
N050.04.49.382 E019.48.16.387 N050.04.49.392 E019.48.16.330 Color_252ACI
N050.04.49.959 E019.48.16.139 N050.04.49.948 E019.48.16.050 Color_252ACI
N050.04.49.948 E019.48.16.050 N050.04.49.902 E019.48.15.978 Color_252ACI
N050.04.49.902 E019.48.15.978 N050.04.49.846 E019.48.15.961 Color_252ACI
N050.04.49.846 E019.48.15.961 N050.04.49.784 E019.48.16.003 Color_252ACI
N050.04.49.784 E019.48.16.003 N050.04.49.753 E019.48.16.087 Color_252ACI
N050.04.49.753 E019.48.16.087 N050.04.49.760 E019.48.16.188 Color_252ACI
N050.04.49.760 E019.48.16.188 N050.04.49.799 E019.48.16.259 Color_252ACI
N050.04.49.799 E019.48.16.259 N050.04.49.863 E019.48.16.284 Color_252ACI
N050.04.49.863 E019.48.16.284 N050.04.49.913 E019.48.16.258 Color_252ACI
N050.04.49.913 E019.48.16.258 N050.04.49.948 E019.48.16.195 Color_252ACI
N050.04.49.948 E019.48.16.195 N050.04.49.959 E019.48.16.139 Color_252ACI
N050.04.50.234 E019.48.16.046 N050.04.50.224 E019.48.15.957 Color_252ACI
N050.04.50.224 E019.48.15.957 N050.04.50.177 E019.48.15.884 Color_252ACI
N050.04.50.177 E019.48.15.884 N050.04.50.121 E019.48.15.868 Color_252ACI
N050.04.50.121 E019.48.15.868 N050.04.50.060 E019.48.15.910 Color_252ACI
N050.04.50.060 E019.48.15.910 N050.04.50.029 E019.48.15.994 Color_252ACI
N050.04.50.029 E019.48.15.994 N050.04.50.035 E019.48.16.095 Color_252ACI
N050.04.50.035 E019.48.16.095 N050.04.50.074 E019.48.16.166 Color_252ACI
N050.04.50.074 E019.48.16.166 N050.04.50.138 E019.48.16.191 Color_252ACI
N050.04.50.138 E019.48.16.191 N050.04.50.188 E019.48.16.165 Color_252ACI
N050.04.50.188 E019.48.16.165 N050.04.50.224 E019.48.16.102 Color_252ACI
N050.04.50.224 E019.48.16.102 N050.04.50.234 E019.48.16.046 Color_252ACI
N050.04.48.887 E019.48.14.958 N050.04.48.876 E019.48.14.869 Color_252ACI
N050.04.48.876 E019.48.14.869 N050.04.48.830 E019.48.14.797 Color_252ACI
N050.04.48.830 E019.48.14.797 N050.04.48.774 E019.48.14.780 Color_252ACI
N050.04.48.774 E019.48.14.780 N050.04.48.713 E019.48.14.822 Color_252ACI
N050.04.48.713 E019.48.14.822 N050.04.48.682 E019.48.14.906 Color_252ACI
N050.04.48.682 E019.48.14.906 N050.04.48.688 E019.48.15.007 Color_252ACI
N050.04.48.688 E019.48.15.007 N050.04.48.727 E019.48.15.079 Color_252ACI
N050.04.48.727 E019.48.15.079 N050.04.48.791 E019.48.15.103 Color_252ACI
N050.04.48.791 E019.48.15.103 N050.04.48.841 E019.48.15.077 Color_252ACI
N050.04.48.841 E019.48.15.077 N050.04.48.877 E019.48.15.014 Color_252ACI
N050.04.48.877 E019.48.15.014 N050.04.48.887 E019.48.14.958 Color_252ACI
N050.04.49.175 E019.48.14.861 N050.04.49.165 E019.48.14.771 Color_252ACI
N050.04.49.165 E019.48.14.771 N050.04.49.119 E019.48.14.699 Color_252ACI
N050.04.49.119 E019.48.14.699 N050.04.49.063 E019.48.14.682 Color_252ACI
N050.04.49.063 E019.48.14.682 N050.04.49.001 E019.48.14.725 Color_252ACI
N050.04.49.001 E019.48.14.725 N050.04.48.970 E019.48.14.809 Color_252ACI
N050.04.48.970 E019.48.14.809 N050.04.48.976 E019.48.14.909 Color_252ACI
N050.04.48.976 E019.48.14.909 N050.04.49.016 E019.48.14.981 Color_252ACI
N050.04.49.016 E019.48.14.981 N050.04.49.080 E019.48.15.006 Color_252ACI
N050.04.49.080 E019.48.15.006 N050.04.49.129 E019.48.14.979 Color_252ACI
N050.04.49.129 E019.48.14.979 N050.04.49.165 E019.48.14.917 Color_252ACI
N050.04.49.165 E019.48.14.917 N050.04.49.175 E019.48.14.861 Color_252ACI
N050.04.49.748 E019.48.14.667 N050.04.49.737 E019.48.14.578 Color_252ACI
N050.04.49.737 E019.48.14.578 N050.04.49.691 E019.48.14.506 Color_252ACI
N050.04.49.691 E019.48.14.506 N050.04.49.635 E019.48.14.489 Color_252ACI
N050.04.49.635 E019.48.14.489 N050.04.49.573 E019.48.14.532 Color_252ACI
N050.04.49.573 E019.48.14.532 N050.04.49.542 E019.48.14.615 Color_252ACI
N050.04.49.542 E019.48.14.615 N050.04.49.549 E019.48.14.716 Color_252ACI
N050.04.49.549 E019.48.14.716 N050.04.49.588 E019.48.14.788 Color_252ACI
N050.04.49.588 E019.48.14.788 N050.04.49.652 E019.48.14.813 Color_252ACI
N050.04.49.652 E019.48.14.813 N050.04.49.702 E019.48.14.786 Color_252ACI
N050.04.49.702 E019.48.14.786 N050.04.49.737 E019.48.14.723 Color_252ACI
N050.04.49.737 E019.48.14.723 N050.04.49.748 E019.48.14.667 Color_252ACI
N050.04.50.038 E019.48.14.569 N050.04.50.028 E019.48.14.480 Color_252ACI
N050.04.50.028 E019.48.14.480 N050.04.49.982 E019.48.14.408 Color_252ACI
N050.04.49.982 E019.48.14.408 N050.04.49.926 E019.48.14.391 Color_252ACI
N050.04.49.926 E019.48.14.391 N050.04.49.864 E019.48.14.433 Color_252ACI
N050.04.49.864 E019.48.14.433 N050.04.49.833 E019.48.14.517 Color_252ACI
N050.04.49.833 E019.48.14.517 N050.04.49.839 E019.48.14.618 Color_252ACI
N050.04.49.839 E019.48.14.618 N050.04.49.879 E019.48.14.689 Color_252ACI
N050.04.49.879 E019.48.14.689 N050.04.49.943 E019.48.14.714 Color_252ACI
N050.04.49.943 E019.48.14.714 N050.04.49.992 E019.48.14.688 Color_252ACI
N050.04.49.992 E019.48.14.688 N050.04.50.028 E019.48.14.625 Color_252ACI
N050.04.50.028 E019.48.14.625 N050.04.50.038 E019.48.14.569 Color_252ACI
N050.04.46.986 E019.48.14.054 N050.04.46.976 E019.48.13.964 Color_252ACI
N050.04.46.976 E019.48.13.964 N050.04.46.929 E019.48.13.892 Color_252ACI
N050.04.46.929 E019.48.13.892 N050.04.46.873 E019.48.13.875 Color_252ACI
N050.04.46.873 E019.48.13.875 N050.04.46.812 E019.48.13.918 Color_252ACI
N050.04.46.812 E019.48.13.918 N050.04.46.781 E019.48.14.002 Color_252ACI
N050.04.46.781 E019.48.14.002 N050.04.46.787 E019.48.14.103 Color_252ACI
N050.04.46.787 E019.48.14.103 N050.04.46.827 E019.48.14.174 Color_252ACI
N050.04.46.827 E019.48.14.174 N050.04.46.890 E019.48.14.199 Color_252ACI
N050.04.46.890 E019.48.14.199 N050.04.46.940 E019.48.14.173 Color_252ACI
N050.04.46.940 E019.48.14.173 N050.04.46.976 E019.48.14.110 Color_252ACI
N050.04.46.976 E019.48.14.110 N050.04.46.986 E019.48.14.054 Color_252ACI
N050.04.47.265 E019.48.13.959 N050.04.47.255 E019.48.13.870 Color_252ACI
N050.04.47.255 E019.48.13.870 N050.04.47.209 E019.48.13.798 Color_252ACI
N050.04.47.209 E019.48.13.798 N050.04.47.153 E019.48.13.781 Color_252ACI
N050.04.47.153 E019.48.13.781 N050.04.47.091 E019.48.13.824 Color_252ACI
N050.04.47.091 E019.48.13.824 N050.04.47.060 E019.48.13.907 Color_252ACI
N050.04.47.060 E019.48.13.907 N050.04.47.066 E019.48.14.008 Color_252ACI
N050.04.47.066 E019.48.14.008 N050.04.47.106 E019.48.14.080 Color_252ACI
N050.04.47.106 E019.48.14.080 N050.04.47.169 E019.48.14.105 Color_252ACI
N050.04.47.169 E019.48.14.105 N050.04.47.219 E019.48.14.078 Color_252ACI
N050.04.47.219 E019.48.14.078 N050.04.47.255 E019.48.14.016 Color_252ACI
N050.04.47.255 E019.48.14.016 N050.04.47.265 E019.48.13.959 Color_252ACI
N050.04.47.557 E019.48.13.861 N050.04.47.546 E019.48.13.771 Color_252ACI
N050.04.47.546 E019.48.13.771 N050.04.47.500 E019.48.13.699 Color_252ACI
N050.04.47.500 E019.48.13.699 N050.04.47.444 E019.48.13.683 Color_252ACI
N050.04.47.444 E019.48.13.683 N050.04.47.382 E019.48.13.725 Color_252ACI
N050.04.47.382 E019.48.13.725 N050.04.47.352 E019.48.13.809 Color_252ACI
N050.04.47.352 E019.48.13.809 N050.04.47.358 E019.48.13.910 Color_252ACI
N050.04.47.358 E019.48.13.910 N050.04.47.397 E019.48.13.981 Color_252ACI
N050.04.47.397 E019.48.13.981 N050.04.47.461 E019.48.14.006 Color_252ACI
N050.04.47.461 E019.48.14.006 N050.04.47.511 E019.48.13.980 Color_252ACI
N050.04.47.511 E019.48.13.980 N050.04.47.546 E019.48.13.917 Color_252ACI
N050.04.47.546 E019.48.13.917 N050.04.47.557 E019.48.13.861 Color_252ACI
N050.04.47.848 E019.48.13.763 N050.04.47.837 E019.48.13.673 Color_252ACI
N050.04.47.837 E019.48.13.673 N050.04.47.791 E019.48.13.601 Color_252ACI
N050.04.47.791 E019.48.13.601 N050.04.47.735 E019.48.13.584 Color_252ACI
N050.04.47.735 E019.48.13.584 N050.04.47.673 E019.48.13.627 Color_252ACI
N050.04.47.673 E019.48.13.627 N050.04.47.642 E019.48.13.711 Color_252ACI
N050.04.47.642 E019.48.13.711 N050.04.47.648 E019.48.13.811 Color_252ACI
N050.04.47.648 E019.48.13.811 N050.04.47.688 E019.48.13.883 Color_252ACI
N050.04.47.688 E019.48.13.883 N050.04.47.752 E019.48.13.908 Color_252ACI
N050.04.47.752 E019.48.13.908 N050.04.47.801 E019.48.13.881 Color_252ACI
N050.04.47.801 E019.48.13.881 N050.04.47.837 E019.48.13.819 Color_252ACI
N050.04.47.837 E019.48.13.819 N050.04.47.848 E019.48.13.763 Color_252ACI
N050.04.48.112 E019.48.13.673 N050.04.48.101 E019.48.13.584 Color_252ACI
N050.04.48.101 E019.48.13.584 N050.04.48.055 E019.48.13.512 Color_252ACI
N050.04.48.055 E019.48.13.512 N050.04.47.999 E019.48.13.495 Color_252ACI
N050.04.47.999 E019.48.13.495 N050.04.47.937 E019.48.13.538 Color_252ACI
N050.04.47.937 E019.48.13.538 N050.04.47.907 E019.48.13.621 Color_252ACI
N050.04.47.907 E019.48.13.621 N050.04.47.913 E019.48.13.722 Color_252ACI
N050.04.47.913 E019.48.13.722 N050.04.47.952 E019.48.13.794 Color_252ACI
N050.04.47.952 E019.48.13.794 N050.04.48.016 E019.48.13.819 Color_252ACI
N050.04.48.016 E019.48.13.819 N050.04.48.066 E019.48.13.792 Color_252ACI
N050.04.48.066 E019.48.13.792 N050.04.48.101 E019.48.13.729 Color_252ACI
N050.04.48.101 E019.48.13.729 N050.04.48.112 E019.48.13.673 Color_252ACI
N050.04.48.409 E019.48.13.573 N050.04.48.398 E019.48.13.484 Color_252ACI
N050.04.48.398 E019.48.13.484 N050.04.48.352 E019.48.13.411 Color_252ACI
N050.04.48.352 E019.48.13.411 N050.04.48.296 E019.48.13.395 Color_252ACI
N050.04.48.296 E019.48.13.395 N050.04.48.234 E019.48.13.437 Color_252ACI
N050.04.48.234 E019.48.13.437 N050.04.48.203 E019.48.13.521 Color_252ACI
N050.04.48.203 E019.48.13.521 N050.04.48.210 E019.48.13.622 Color_252ACI
N050.04.48.210 E019.48.13.622 N050.04.48.249 E019.48.13.693 Color_252ACI
N050.04.48.249 E019.48.13.693 N050.04.48.313 E019.48.13.718 Color_252ACI
N050.04.48.313 E019.48.13.718 N050.04.48.363 E019.48.13.692 Color_252ACI
N050.04.48.363 E019.48.13.692 N050.04.48.398 E019.48.13.629 Color_252ACI
N050.04.48.398 E019.48.13.629 N050.04.48.409 E019.48.13.573 Color_252ACI
N050.04.48.694 E019.48.13.477 N050.04.48.684 E019.48.13.387 Color_252ACI
N050.04.48.684 E019.48.13.387 N050.04.48.637 E019.48.13.315 Color_252ACI
N050.04.48.637 E019.48.13.315 N050.04.48.581 E019.48.13.298 Color_252ACI
N050.04.48.581 E019.48.13.298 N050.04.48.520 E019.48.13.341 Color_252ACI
N050.04.48.520 E019.48.13.341 N050.04.48.489 E019.48.13.424 Color_252ACI
N050.04.48.489 E019.48.13.424 N050.04.48.495 E019.48.13.525 Color_252ACI
N050.04.48.495 E019.48.13.525 N050.04.48.535 E019.48.13.597 Color_252ACI
N050.04.48.535 E019.48.13.597 N050.04.48.598 E019.48.13.622 Color_252ACI
N050.04.48.598 E019.48.13.622 N050.04.48.648 E019.48.13.595 Color_252ACI
N050.04.48.648 E019.48.13.595 N050.04.48.684 E019.48.13.533 Color_252ACI
N050.04.48.684 E019.48.13.533 N050.04.48.694 E019.48.13.477 Color_252ACI
N050.04.48.976 E019.48.13.381 N050.04.48.965 E019.48.13.292 Color_252ACI
N050.04.48.965 E019.48.13.292 N050.04.48.919 E019.48.13.220 Color_252ACI
N050.04.48.919 E019.48.13.220 N050.04.48.863 E019.48.13.203 Color_252ACI
N050.04.48.863 E019.48.13.203 N050.04.48.801 E019.48.13.246 Color_252ACI
N050.04.48.801 E019.48.13.246 N050.04.48.770 E019.48.13.329 Color_252ACI
N050.04.48.770 E019.48.13.329 N050.04.48.777 E019.48.13.430 Color_252ACI
N050.04.48.777 E019.48.13.430 N050.04.48.816 E019.48.13.502 Color_252ACI
N050.04.48.816 E019.48.13.502 N050.04.48.880 E019.48.13.527 Color_252ACI
N050.04.48.880 E019.48.13.527 N050.04.48.930 E019.48.13.500 Color_252ACI
N050.04.48.930 E019.48.13.500 N050.04.48.965 E019.48.13.438 Color_252ACI
N050.04.48.965 E019.48.13.438 N050.04.48.976 E019.48.13.381 Color_252ACI
N050.04.49.544 E019.48.13.189 N050.04.49.534 E019.48.13.100 Color_252ACI
N050.04.49.534 E019.48.13.100 N050.04.49.488 E019.48.13.028 Color_252ACI
N050.04.49.488 E019.48.13.028 N050.04.49.432 E019.48.13.011 Color_252ACI
N050.04.49.432 E019.48.13.011 N050.04.49.370 E019.48.13.054 Color_252ACI
N050.04.49.370 E019.48.13.054 N050.04.49.339 E019.48.13.137 Color_252ACI
N050.04.49.339 E019.48.13.137 N050.04.49.345 E019.48.13.238 Color_252ACI
N050.04.49.345 E019.48.13.238 N050.04.49.385 E019.48.13.310 Color_252ACI
N050.04.49.385 E019.48.13.310 N050.04.49.448 E019.48.13.335 Color_252ACI
N050.04.49.448 E019.48.13.335 N050.04.49.498 E019.48.13.308 Color_252ACI
N050.04.49.498 E019.48.13.308 N050.04.49.534 E019.48.13.245 Color_252ACI
N050.04.49.534 E019.48.13.245 N050.04.49.544 E019.48.13.189 Color_252ACI
N050.04.49.837 E019.48.13.090 N050.04.49.827 E019.48.13.001 Color_252ACI
N050.04.49.827 E019.48.13.001 N050.04.49.780 E019.48.12.929 Color_252ACI
N050.04.49.780 E019.48.12.929 N050.04.49.725 E019.48.12.912 Color_252ACI
N050.04.49.725 E019.48.12.912 N050.04.49.663 E019.48.12.955 Color_252ACI
N050.04.49.663 E019.48.12.955 N050.04.49.632 E019.48.13.038 Color_252ACI
N050.04.49.632 E019.48.13.038 N050.04.49.638 E019.48.13.139 Color_252ACI
N050.04.49.638 E019.48.13.139 N050.04.49.678 E019.48.13.211 Color_252ACI
N050.04.49.678 E019.48.13.211 N050.04.49.741 E019.48.13.236 Color_252ACI
N050.04.49.741 E019.48.13.236 N050.04.49.791 E019.48.13.209 Color_252ACI
N050.04.49.791 E019.48.13.209 N050.04.49.827 E019.48.13.146 Color_252ACI
N050.04.49.827 E019.48.13.146 N050.04.49.837 E019.48.13.090 Color_252ACI
N050.04.50.106 E019.48.13.000 N050.04.50.095 E019.48.12.910 Color_252ACI
N050.04.50.095 E019.48.12.910 N050.04.50.049 E019.48.12.838 Color_252ACI
N050.04.50.049 E019.48.12.838 N050.04.49.993 E019.48.12.821 Color_252ACI
N050.04.49.993 E019.48.12.821 N050.04.49.931 E019.48.12.864 Color_252ACI
N050.04.49.931 E019.48.12.864 N050.04.49.900 E019.48.12.947 Color_252ACI
N050.04.49.900 E019.48.12.947 N050.04.49.907 E019.48.13.048 Color_252ACI
N050.04.49.907 E019.48.13.048 N050.04.49.946 E019.48.13.120 Color_252ACI
N050.04.49.946 E019.48.13.120 N050.04.50.010 E019.48.13.145 Color_252ACI
N050.04.50.010 E019.48.13.145 N050.04.50.060 E019.48.13.118 Color_252ACI
N050.04.50.060 E019.48.13.118 N050.04.50.095 E019.48.13.056 Color_252ACI
N050.04.50.095 E019.48.13.056 N050.04.50.106 E019.48.13.000 Color_252ACI
N050.04.50.395 E019.48.12.902 N050.04.50.384 E019.48.12.812 Color_252ACI
N050.04.50.384 E019.48.12.812 N050.04.50.338 E019.48.12.740 Color_252ACI
N050.04.50.338 E019.48.12.740 N050.04.50.282 E019.48.12.723 Color_252ACI
N050.04.50.282 E019.48.12.723 N050.04.50.221 E019.48.12.766 Color_252ACI
N050.04.50.221 E019.48.12.766 N050.04.50.190 E019.48.12.850 Color_252ACI
N050.04.50.190 E019.48.12.850 N050.04.50.196 E019.48.12.951 Color_252ACI
N050.04.50.196 E019.48.12.951 N050.04.50.235 E019.48.13.022 Color_252ACI
N050.04.50.235 E019.48.13.022 N050.04.50.299 E019.48.13.047 Color_252ACI
N050.04.50.299 E019.48.13.047 N050.04.50.349 E019.48.13.020 Color_252ACI
N050.04.50.349 E019.48.13.020 N050.04.50.385 E019.48.12.958 Color_252ACI
N050.04.50.385 E019.48.12.958 N050.04.50.395 E019.48.12.902 Color_252ACI
N050.04.50.677 E019.48.12.807 N050.04.50.666 E019.48.12.717 Color_252ACI
N050.04.50.666 E019.48.12.717 N050.04.50.620 E019.48.12.645 Color_252ACI
N050.04.50.620 E019.48.12.645 N050.04.50.564 E019.48.12.628 Color_252ACI
N050.04.50.564 E019.48.12.628 N050.04.50.502 E019.48.12.671 Color_252ACI
N050.04.50.502 E019.48.12.671 N050.04.50.472 E019.48.12.754 Color_252ACI
N050.04.50.472 E019.48.12.754 N050.04.50.478 E019.48.12.855 Color_252ACI
N050.04.50.478 E019.48.12.855 N050.04.50.517 E019.48.12.927 Color_252ACI
N050.04.50.517 E019.48.12.927 N050.04.50.581 E019.48.12.952 Color_252ACI
N050.04.50.581 E019.48.12.952 N050.04.50.631 E019.48.12.925 Color_252ACI
N050.04.50.631 E019.48.12.925 N050.04.50.666 E019.48.12.863 Color_252ACI
N050.04.50.666 E019.48.12.863 N050.04.50.677 E019.48.12.807 Color_252ACI
N050.04.50.962 E019.48.12.710 N050.04.50.952 E019.48.12.621 Color_252ACI
N050.04.50.952 E019.48.12.621 N050.04.50.906 E019.48.12.549 Color_252ACI
N050.04.50.906 E019.48.12.549 N050.04.50.850 E019.48.12.532 Color_252ACI
N050.04.50.850 E019.48.12.532 N050.04.50.788 E019.48.12.574 Color_252ACI
N050.04.50.788 E019.48.12.574 N050.04.50.757 E019.48.12.658 Color_252ACI
N050.04.50.757 E019.48.12.658 N050.04.50.763 E019.48.12.759 Color_252ACI
N050.04.50.763 E019.48.12.759 N050.04.50.803 E019.48.12.830 Color_252ACI
N050.04.50.803 E019.48.12.830 N050.04.50.866 E019.48.12.855 Color_252ACI
N050.04.50.866 E019.48.12.855 N050.04.50.916 E019.48.12.829 Color_252ACI
N050.04.50.916 E019.48.12.829 N050.04.50.952 E019.48.12.766 Color_252ACI
N050.04.50.952 E019.48.12.766 N050.04.50.962 E019.48.12.710 Color_252ACI
N050.04.51.256 E019.48.12.611 N050.04.51.245 E019.48.12.521 Color_252ACI
N050.04.51.245 E019.48.12.521 N050.04.51.199 E019.48.12.449 Color_252ACI
N050.04.51.199 E019.48.12.449 N050.04.51.143 E019.48.12.432 Color_252ACI
N050.04.51.143 E019.48.12.432 N050.04.51.081 E019.48.12.475 Color_252ACI
N050.04.51.081 E019.48.12.475 N050.04.51.050 E019.48.12.559 Color_252ACI
N050.04.51.050 E019.48.12.559 N050.04.51.057 E019.48.12.660 Color_252ACI
N050.04.51.057 E019.48.12.660 N050.04.51.096 E019.48.12.731 Color_252ACI
N050.04.51.096 E019.48.12.731 N050.04.51.160 E019.48.12.756 Color_252ACI
N050.04.51.160 E019.48.12.756 N050.04.51.210 E019.48.12.730 Color_252ACI
N050.04.51.210 E019.48.12.730 N050.04.51.245 E019.48.12.667 Color_252ACI
N050.04.51.245 E019.48.12.667 N050.04.51.256 E019.48.12.611 Color_252ACI
N050.04.51.536 E019.48.12.516 N050.04.51.525 E019.48.12.427 Color_252ACI
N050.04.51.525 E019.48.12.427 N050.04.51.479 E019.48.12.355 Color_252ACI
N050.04.51.479 E019.48.12.355 N050.04.51.423 E019.48.12.338 Color_252ACI
N050.04.51.423 E019.48.12.338 N050.04.51.361 E019.48.12.381 Color_252ACI
N050.04.51.361 E019.48.12.381 N050.04.51.330 E019.48.12.464 Color_252ACI
N050.04.51.330 E019.48.12.464 N050.04.51.337 E019.48.12.565 Color_252ACI
N050.04.51.337 E019.48.12.565 N050.04.51.376 E019.48.12.637 Color_252ACI
N050.04.51.376 E019.48.12.637 N050.04.51.440 E019.48.12.662 Color_252ACI
N050.04.51.440 E019.48.12.662 N050.04.51.489 E019.48.12.635 Color_252ACI
N050.04.51.489 E019.48.12.635 N050.04.51.525 E019.48.12.572 Color_252ACI
N050.04.51.525 E019.48.12.572 N050.04.51.536 E019.48.12.516 Color_252ACI
N050.04.47.771 E019.48.12.229 N050.04.47.760 E019.48.12.140 Color_252ACI
N050.04.47.760 E019.48.12.140 N050.04.47.714 E019.48.12.068 Color_252ACI
N050.04.47.714 E019.48.12.068 N050.04.47.658 E019.48.12.051 Color_252ACI
N050.04.47.658 E019.48.12.051 N050.04.47.596 E019.48.12.094 Color_252ACI
N050.04.47.596 E019.48.12.094 N050.04.47.565 E019.48.12.177 Color_252ACI
N050.04.47.565 E019.48.12.177 N050.04.47.572 E019.48.12.278 Color_252ACI
N050.04.47.572 E019.48.12.278 N050.04.47.611 E019.48.12.350 Color_252ACI
N050.04.47.611 E019.48.12.350 N050.04.47.675 E019.48.12.375 Color_252ACI
N050.04.47.675 E019.48.12.375 N050.04.47.724 E019.48.12.348 Color_252ACI
N050.04.47.724 E019.48.12.348 N050.04.47.760 E019.48.12.286 Color_252ACI
N050.04.47.760 E019.48.12.286 N050.04.47.771 E019.48.12.229 Color_252ACI
N050.04.48.038 E019.48.12.139 N050.04.48.027 E019.48.12.050 Color_252ACI
N050.04.48.027 E019.48.12.050 N050.04.47.981 E019.48.11.978 Color_252ACI
N050.04.47.981 E019.48.11.978 N050.04.47.925 E019.48.11.961 Color_252ACI
N050.04.47.925 E019.48.11.961 N050.04.47.863 E019.48.12.003 Color_252ACI
N050.04.47.863 E019.48.12.003 N050.04.47.832 E019.48.12.087 Color_252ACI
N050.04.47.832 E019.48.12.087 N050.04.47.839 E019.48.12.188 Color_252ACI
N050.04.47.839 E019.48.12.188 N050.04.47.878 E019.48.12.260 Color_252ACI
N050.04.47.878 E019.48.12.260 N050.04.47.942 E019.48.12.284 Color_252ACI
N050.04.47.942 E019.48.12.284 N050.04.47.992 E019.48.12.258 Color_252ACI
N050.04.47.992 E019.48.12.258 N050.04.48.027 E019.48.12.195 Color_252ACI
N050.04.48.027 E019.48.12.195 N050.04.48.038 E019.48.12.139 Color_252ACI
N050.04.48.331 E019.48.12.040 N050.04.48.321 E019.48.11.951 Color_252ACI
N050.04.48.321 E019.48.11.951 N050.04.48.274 E019.48.11.878 Color_252ACI
N050.04.48.274 E019.48.11.878 N050.04.48.219 E019.48.11.862 Color_252ACI
N050.04.48.219 E019.48.11.862 N050.04.48.157 E019.48.11.904 Color_252ACI
N050.04.48.157 E019.48.11.904 N050.04.48.126 E019.48.11.988 Color_252ACI
N050.04.48.126 E019.48.11.988 N050.04.48.132 E019.48.12.089 Color_252ACI
N050.04.48.132 E019.48.12.089 N050.04.48.172 E019.48.12.160 Color_252ACI
N050.04.48.172 E019.48.12.160 N050.04.48.235 E019.48.12.185 Color_252ACI
N050.04.48.235 E019.48.12.185 N050.04.48.285 E019.48.12.159 Color_252ACI
N050.04.48.285 E019.48.12.159 N050.04.48.321 E019.48.12.096 Color_252ACI
N050.04.48.321 E019.48.12.096 N050.04.48.331 E019.48.12.040 Color_252ACI
N050.04.48.618 E019.48.11.943 N050.04.48.608 E019.48.11.854 Color_252ACI
N050.04.48.608 E019.48.11.854 N050.04.48.561 E019.48.11.781 Color_252ACI
N050.04.48.561 E019.48.11.781 N050.04.48.506 E019.48.11.765 Color_252ACI
N050.04.48.506 E019.48.11.765 N050.04.48.444 E019.48.11.807 Color_252ACI
N050.04.48.444 E019.48.11.807 N050.04.48.413 E019.48.11.891 Color_252ACI
N050.04.48.413 E019.48.11.891 N050.04.48.419 E019.48.11.992 Color_252ACI
N050.04.48.419 E019.48.11.992 N050.04.48.459 E019.48.12.063 Color_252ACI
N050.04.48.459 E019.48.12.063 N050.04.48.522 E019.48.12.088 Color_252ACI
N050.04.48.522 E019.48.12.088 N050.04.48.572 E019.48.12.062 Color_252ACI
N050.04.48.572 E019.48.12.062 N050.04.48.608 E019.48.11.999 Color_252ACI
N050.04.48.608 E019.48.11.999 N050.04.48.618 E019.48.11.943 Color_252ACI
N050.04.48.902 E019.48.11.847 N050.04.48.892 E019.48.11.758 Color_252ACI
N050.04.48.892 E019.48.11.758 N050.04.48.845 E019.48.11.685 Color_252ACI
N050.04.48.845 E019.48.11.685 N050.04.48.789 E019.48.11.669 Color_252ACI
N050.04.48.789 E019.48.11.669 N050.04.48.728 E019.48.11.711 Color_252ACI
N050.04.48.728 E019.48.11.711 N050.04.48.697 E019.48.11.795 Color_252ACI
N050.04.48.697 E019.48.11.795 N050.04.48.703 E019.48.11.896 Color_252ACI
N050.04.48.703 E019.48.11.896 N050.04.48.742 E019.48.11.967 Color_252ACI
N050.04.48.742 E019.48.11.967 N050.04.48.806 E019.48.11.992 Color_252ACI
N050.04.48.806 E019.48.11.992 N050.04.48.856 E019.48.11.966 Color_252ACI
N050.04.48.856 E019.48.11.966 N050.04.48.892 E019.48.11.903 Color_252ACI
N050.04.48.892 E019.48.11.903 N050.04.48.902 E019.48.11.847 Color_252ACI
N050.04.49.191 E019.48.11.749 N050.04.49.181 E019.48.11.660 Color_252ACI
N050.04.49.181 E019.48.11.660 N050.04.49.135 E019.48.11.588 Color_252ACI
N050.04.49.135 E019.48.11.588 N050.04.49.079 E019.48.11.571 Color_252ACI
N050.04.49.079 E019.48.11.571 N050.04.49.017 E019.48.11.614 Color_252ACI
N050.04.49.017 E019.48.11.614 N050.04.48.986 E019.48.11.697 Color_252ACI
N050.04.48.986 E019.48.11.697 N050.04.48.992 E019.48.11.798 Color_252ACI
N050.04.48.992 E019.48.11.798 N050.04.49.032 E019.48.11.870 Color_252ACI
N050.04.49.032 E019.48.11.870 N050.04.49.095 E019.48.11.895 Color_252ACI
N050.04.49.095 E019.48.11.895 N050.04.49.145 E019.48.11.868 Color_252ACI
N050.04.49.145 E019.48.11.868 N050.04.49.181 E019.48.11.805 Color_252ACI
N050.04.49.181 E019.48.11.805 N050.04.49.191 E019.48.11.749 Color_252ACI
N050.04.49.464 E019.48.11.657 N050.04.49.453 E019.48.11.568 Color_252ACI
N050.04.49.453 E019.48.11.568 N050.04.49.407 E019.48.11.496 Color_252ACI
N050.04.49.407 E019.48.11.496 N050.04.49.351 E019.48.11.479 Color_252ACI
N050.04.49.351 E019.48.11.479 N050.04.49.290 E019.48.11.521 Color_252ACI
N050.04.49.290 E019.48.11.521 N050.04.49.259 E019.48.11.605 Color_252ACI
N050.04.49.259 E019.48.11.605 N050.04.49.265 E019.48.11.706 Color_252ACI
N050.04.49.265 E019.48.11.706 N050.04.49.304 E019.48.11.778 Color_252ACI
N050.04.49.304 E019.48.11.778 N050.04.49.368 E019.48.11.802 Color_252ACI
N050.04.49.368 E019.48.11.802 N050.04.49.418 E019.48.11.776 Color_252ACI
N050.04.49.418 E019.48.11.776 N050.04.49.453 E019.48.11.713 Color_252ACI
N050.04.49.453 E019.48.11.713 N050.04.49.464 E019.48.11.657 Color_252ACI
N050.04.49.745 E019.48.11.562 N050.04.49.735 E019.48.11.473 Color_252ACI
N050.04.49.735 E019.48.11.473 N050.04.49.688 E019.48.11.401 Color_252ACI
N050.04.49.688 E019.48.11.401 N050.04.49.633 E019.48.11.384 Color_252ACI
N050.04.49.633 E019.48.11.384 N050.04.49.571 E019.48.11.426 Color_252ACI
N050.04.49.571 E019.48.11.426 N050.04.49.540 E019.48.11.510 Color_252ACI
N050.04.49.540 E019.48.11.510 N050.04.49.546 E019.48.11.611 Color_252ACI
N050.04.49.546 E019.48.11.611 N050.04.49.586 E019.48.11.683 Color_252ACI
N050.04.49.586 E019.48.11.683 N050.04.49.649 E019.48.11.707 Color_252ACI
N050.04.49.649 E019.48.11.707 N050.04.49.699 E019.48.11.681 Color_252ACI
N050.04.49.699 E019.48.11.681 N050.04.49.735 E019.48.11.618 Color_252ACI
N050.04.49.735 E019.48.11.618 N050.04.49.745 E019.48.11.562 Color_252ACI
N050.04.50.048 E019.48.11.460 N050.04.50.037 E019.48.11.370 Color_252ACI
N050.04.50.037 E019.48.11.370 N050.04.49.991 E019.48.11.298 Color_252ACI
N050.04.49.991 E019.48.11.298 N050.04.49.935 E019.48.11.282 Color_252ACI
N050.04.49.935 E019.48.11.282 N050.04.49.873 E019.48.11.324 Color_252ACI
N050.04.49.873 E019.48.11.324 N050.04.49.842 E019.48.11.408 Color_252ACI
N050.04.49.842 E019.48.11.408 N050.04.49.849 E019.48.11.509 Color_252ACI
N050.04.49.849 E019.48.11.509 N050.04.49.888 E019.48.11.580 Color_252ACI
N050.04.49.888 E019.48.11.580 N050.04.49.952 E019.48.11.605 Color_252ACI
N050.04.49.952 E019.48.11.605 N050.04.50.002 E019.48.11.579 Color_252ACI
N050.04.50.002 E019.48.11.579 N050.04.50.037 E019.48.11.516 Color_252ACI
N050.04.50.037 E019.48.11.516 N050.04.50.048 E019.48.11.460 Color_252ACI
N050.04.50.329 E019.48.11.365 N050.04.50.319 E019.48.11.275 Color_252ACI
N050.04.50.319 E019.48.11.275 N050.04.50.273 E019.48.11.203 Color_252ACI
N050.04.50.273 E019.48.11.203 N050.04.50.217 E019.48.11.186 Color_252ACI
N050.04.50.217 E019.48.11.186 N050.04.50.155 E019.48.11.229 Color_252ACI
N050.04.50.155 E019.48.11.229 N050.04.50.124 E019.48.11.313 Color_252ACI
N050.04.50.124 E019.48.11.313 N050.04.50.130 E019.48.11.414 Color_252ACI
N050.04.50.130 E019.48.11.414 N050.04.50.170 E019.48.11.485 Color_252ACI
N050.04.50.170 E019.48.11.485 N050.04.50.233 E019.48.11.510 Color_252ACI
N050.04.50.233 E019.48.11.510 N050.04.50.283 E019.48.11.483 Color_252ACI
N050.04.50.283 E019.48.11.483 N050.04.50.319 E019.48.11.421 Color_252ACI
N050.04.50.319 E019.48.11.421 N050.04.50.329 E019.48.11.365 Color_252ACI
N050.04.46.950 E019.47.56.797 N050.04.46.940 E019.47.56.708 Color_252ACI
N050.04.46.940 E019.47.56.708 N050.04.46.894 E019.47.56.635 Color_252ACI
N050.04.46.894 E019.47.56.635 N050.04.46.838 E019.47.56.619 Color_252ACI
N050.04.46.838 E019.47.56.619 N050.04.46.776 E019.47.56.661 Color_252ACI
N050.04.46.776 E019.47.56.661 N050.04.46.745 E019.47.56.745 Color_252ACI
N050.04.46.745 E019.47.56.745 N050.04.46.751 E019.47.56.846 Color_252ACI
N050.04.46.751 E019.47.56.846 N050.04.46.791 E019.47.56.917 Color_252ACI
N050.04.46.791 E019.47.56.917 N050.04.46.854 E019.47.56.942 Color_252ACI
N050.04.46.854 E019.47.56.942 N050.04.46.904 E019.47.56.916 Color_252ACI
N050.04.46.904 E019.47.56.916 N050.04.46.940 E019.47.56.853 Color_252ACI
N050.04.46.940 E019.47.56.853 N050.04.46.950 E019.47.56.797 Color_252ACI
N050.04.46.745 E019.47.55.324 N050.04.46.734 E019.47.55.235 Color_252ACI
N050.04.46.734 E019.47.55.235 N050.04.46.688 E019.47.55.163 Color_252ACI
N050.04.46.688 E019.47.55.163 N050.04.46.632 E019.47.55.146 Color_252ACI
N050.04.46.632 E019.47.55.146 N050.04.46.570 E019.47.55.189 Color_252ACI
N050.04.46.570 E019.47.55.189 N050.04.46.539 E019.47.55.272 Color_252ACI
N050.04.46.539 E019.47.55.272 N050.04.46.546 E019.47.55.373 Color_252ACI
N050.04.46.546 E019.47.55.373 N050.04.46.585 E019.47.55.445 Color_252ACI
N050.04.46.585 E019.47.55.445 N050.04.46.649 E019.47.55.470 Color_252ACI
N050.04.46.649 E019.47.55.470 N050.04.46.699 E019.47.55.443 Color_252ACI
N050.04.46.699 E019.47.55.443 N050.04.46.734 E019.47.55.380 Color_252ACI
N050.04.46.734 E019.47.55.380 N050.04.46.745 E019.47.55.324 Color_252ACI
N050.04.46.539 E019.47.53.851 N050.04.46.529 E019.47.53.762 Color_252ACI
N050.04.46.529 E019.47.53.762 N050.04.46.482 E019.47.53.690 Color_252ACI
N050.04.46.482 E019.47.53.690 N050.04.46.427 E019.47.53.673 Color_252ACI
N050.04.46.427 E019.47.53.673 N050.04.46.365 E019.47.53.716 Color_252ACI
N050.04.46.365 E019.47.53.716 N050.04.46.334 E019.47.53.799 Color_252ACI
N050.04.46.334 E019.47.53.799 N050.04.46.340 E019.47.53.900 Color_252ACI
N050.04.46.340 E019.47.53.900 N050.04.46.380 E019.47.53.972 Color_252ACI
N050.04.46.380 E019.47.53.972 N050.04.46.443 E019.47.53.997 Color_252ACI
N050.04.46.443 E019.47.53.997 N050.04.46.493 E019.47.53.970 Color_252ACI
N050.04.46.493 E019.47.53.970 N050.04.46.529 E019.47.53.908 Color_252ACI
N050.04.46.529 E019.47.53.908 N050.04.46.539 E019.47.53.851 Color_252ACI
N050.04.46.334 E019.47.52.379 N050.04.46.323 E019.47.52.289 Color_252ACI
N050.04.46.323 E019.47.52.289 N050.04.46.277 E019.47.52.217 Color_252ACI
N050.04.46.277 E019.47.52.217 N050.04.46.221 E019.47.52.200 Color_252ACI
N050.04.46.221 E019.47.52.200 N050.04.46.159 E019.47.52.243 Color_252ACI
N050.04.46.159 E019.47.52.243 N050.04.46.128 E019.47.52.327 Color_252ACI
N050.04.46.128 E019.47.52.327 N050.04.46.135 E019.47.52.428 Color_252ACI
N050.04.46.135 E019.47.52.428 N050.04.46.174 E019.47.52.499 Color_252ACI
N050.04.46.174 E019.47.52.499 N050.04.46.238 E019.47.52.524 Color_252ACI
N050.04.46.238 E019.47.52.524 N050.04.46.288 E019.47.52.498 Color_252ACI
N050.04.46.288 E019.47.52.498 N050.04.46.323 E019.47.52.435 Color_252ACI
N050.04.46.323 E019.47.52.435 N050.04.46.334 E019.47.52.379 Color_252ACI
N050.04.46.128 E019.47.50.906 N050.04.46.118 E019.47.50.817 Color_252ACI
N050.04.46.118 E019.47.50.817 N050.04.46.071 E019.47.50.745 Color_252ACI
N050.04.46.071 E019.47.50.745 N050.04.46.015 E019.47.50.728 Color_252ACI
N050.04.46.015 E019.47.50.728 N050.04.45.954 E019.47.50.770 Color_252ACI
N050.04.45.954 E019.47.50.770 N050.04.45.923 E019.47.50.854 Color_252ACI
N050.04.45.923 E019.47.50.854 N050.04.45.929 E019.47.50.955 Color_252ACI
N050.04.45.929 E019.47.50.955 N050.04.45.969 E019.47.51.026 Color_252ACI
N050.04.45.969 E019.47.51.026 N050.04.46.032 E019.47.51.051 Color_252ACI
N050.04.46.032 E019.47.51.051 N050.04.46.082 E019.47.51.025 Color_252ACI
N050.04.46.082 E019.47.51.025 N050.04.46.118 E019.47.50.962 Color_252ACI
N050.04.46.118 E019.47.50.962 N050.04.46.128 E019.47.50.906 Color_252ACI
N050.04.45.923 E019.47.49.433 N050.04.45.912 E019.47.49.344 Color_252ACI
N050.04.45.912 E019.47.49.344 N050.04.45.866 E019.47.49.272 Color_252ACI
N050.04.45.866 E019.47.49.272 N050.04.45.810 E019.47.49.255 Color_252ACI
N050.04.45.810 E019.47.49.255 N050.04.45.748 E019.47.49.298 Color_252ACI
N050.04.45.748 E019.47.49.298 N050.04.45.717 E019.47.49.381 Color_252ACI
N050.04.45.717 E019.47.49.381 N050.04.45.724 E019.47.49.482 Color_252ACI
N050.04.45.724 E019.47.49.482 N050.04.45.763 E019.47.49.554 Color_252ACI
N050.04.45.763 E019.47.49.554 N050.04.45.827 E019.47.49.579 Color_252ACI
N050.04.45.827 E019.47.49.579 N050.04.45.876 E019.47.49.552 Color_252ACI
N050.04.45.876 E019.47.49.552 N050.04.45.912 E019.47.49.490 Color_252ACI
N050.04.45.912 E019.47.49.490 N050.04.45.923 E019.47.49.433 Color_252ACI
N050.04.45.717 E019.47.47.961 N050.04.45.706 E019.47.47.871 Color_252ACI
N050.04.45.706 E019.47.47.871 N050.04.45.660 E019.47.47.799 Color_252ACI
N050.04.45.660 E019.47.47.799 N050.04.45.604 E019.47.47.782 Color_252ACI
N050.04.45.604 E019.47.47.782 N050.04.45.542 E019.47.47.825 Color_252ACI
N050.04.45.542 E019.47.47.825 N050.04.45.512 E019.47.47.909 Color_252ACI
N050.04.45.512 E019.47.47.909 N050.04.45.518 E019.47.48.009 Color_252ACI
N050.04.45.518 E019.47.48.009 N050.04.45.557 E019.47.48.081 Color_252ACI
N050.04.45.557 E019.47.48.081 N050.04.45.621 E019.47.48.106 Color_252ACI
N050.04.45.621 E019.47.48.106 N050.04.45.671 E019.47.48.079 Color_252ACI
N050.04.45.671 E019.47.48.079 N050.04.45.706 E019.47.48.017 Color_252ACI
N050.04.45.706 E019.47.48.017 N050.04.45.717 E019.47.47.961 Color_252ACI
N050.04.45.511 E019.47.46.488 N050.04.45.501 E019.47.46.399 Color_252ACI
N050.04.45.501 E019.47.46.399 N050.04.45.455 E019.47.46.326 Color_252ACI
N050.04.45.455 E019.47.46.326 N050.04.45.399 E019.47.46.310 Color_252ACI
N050.04.45.399 E019.47.46.310 N050.04.45.337 E019.47.46.352 Color_252ACI
N050.04.45.337 E019.47.46.352 N050.04.45.306 E019.47.46.436 Color_252ACI
N050.04.45.306 E019.47.46.436 N050.04.45.312 E019.47.46.537 Color_252ACI
N050.04.45.312 E019.47.46.537 N050.04.45.352 E019.47.46.608 Color_252ACI
N050.04.45.352 E019.47.46.608 N050.04.45.416 E019.47.46.633 Color_252ACI
N050.04.45.416 E019.47.46.633 N050.04.45.465 E019.47.46.607 Color_252ACI
N050.04.45.465 E019.47.46.607 N050.04.45.501 E019.47.46.544 Color_252ACI
N050.04.45.501 E019.47.46.544 N050.04.45.511 E019.47.46.488 Color_252ACI
N050.04.45.306 E019.47.45.015 N050.04.45.295 E019.47.44.926 Color_252ACI
N050.04.45.295 E019.47.44.926 N050.04.45.249 E019.47.44.854 Color_252ACI
N050.04.45.249 E019.47.44.854 N050.04.45.193 E019.47.44.837 Color_252ACI
N050.04.45.193 E019.47.44.837 N050.04.45.131 E019.47.44.880 Color_252ACI
N050.04.45.131 E019.47.44.880 N050.04.45.101 E019.47.44.963 Color_252ACI
N050.04.45.101 E019.47.44.963 N050.04.45.107 E019.47.45.064 Color_252ACI
N050.04.45.107 E019.47.45.064 N050.04.45.146 E019.47.45.136 Color_252ACI
N050.04.45.146 E019.47.45.136 N050.04.45.210 E019.47.45.161 Color_252ACI
N050.04.45.210 E019.47.45.161 N050.04.45.260 E019.47.45.134 Color_252ACI
N050.04.45.260 E019.47.45.134 N050.04.45.295 E019.47.45.071 Color_252ACI
N050.04.45.295 E019.47.45.071 N050.04.45.306 E019.47.45.015 Color_252ACI
N050.04.45.100 E019.47.43.543 N050.04.45.090 E019.47.43.453 Color_252ACI
N050.04.45.090 E019.47.43.453 N050.04.45.044 E019.47.43.381 Color_252ACI
N050.04.45.044 E019.47.43.381 N050.04.44.988 E019.47.43.364 Color_252ACI
N050.04.44.988 E019.47.43.364 N050.04.44.926 E019.47.43.407 Color_252ACI
N050.04.44.926 E019.47.43.407 N050.04.44.895 E019.47.43.490 Color_252ACI
N050.04.44.895 E019.47.43.490 N050.04.44.901 E019.47.43.591 Color_252ACI
N050.04.44.901 E019.47.43.591 N050.04.44.941 E019.47.43.663 Color_252ACI
N050.04.44.941 E019.47.43.663 N050.04.45.004 E019.47.43.688 Color_252ACI
N050.04.45.004 E019.47.43.688 N050.04.45.054 E019.47.43.661 Color_252ACI
N050.04.45.054 E019.47.43.661 N050.04.45.090 E019.47.43.599 Color_252ACI
N050.04.45.090 E019.47.43.599 N050.04.45.100 E019.47.43.543 Color_252ACI
N050.04.44.895 E019.47.42.070 N050.04.44.884 E019.47.41.980 Color_252ACI
N050.04.44.884 E019.47.41.980 N050.04.44.838 E019.47.41.908 Color_252ACI
N050.04.44.838 E019.47.41.908 N050.04.44.782 E019.47.41.891 Color_252ACI
N050.04.44.782 E019.47.41.891 N050.04.44.720 E019.47.41.934 Color_252ACI
N050.04.44.720 E019.47.41.934 N050.04.44.689 E019.47.42.018 Color_252ACI
N050.04.44.689 E019.47.42.018 N050.04.44.696 E019.47.42.119 Color_252ACI
N050.04.44.696 E019.47.42.119 N050.04.44.735 E019.47.42.190 Color_252ACI
N050.04.44.735 E019.47.42.190 N050.04.44.799 E019.47.42.215 Color_252ACI
N050.04.44.799 E019.47.42.215 N050.04.44.849 E019.47.42.189 Color_252ACI
N050.04.44.849 E019.47.42.189 N050.04.44.884 E019.47.42.126 Color_252ACI
N050.04.44.884 E019.47.42.126 N050.04.44.895 E019.47.42.070 Color_252ACI
N050.04.44.689 E019.47.40.597 N050.04.44.679 E019.47.40.508 Color_252ACI
N050.04.44.679 E019.47.40.508 N050.04.44.633 E019.47.40.436 Color_252ACI
N050.04.44.633 E019.47.40.436 N050.04.44.577 E019.47.40.419 Color_252ACI
N050.04.44.577 E019.47.40.419 N050.04.44.515 E019.47.40.461 Color_252ACI
N050.04.44.515 E019.47.40.461 N050.04.44.484 E019.47.40.545 Color_252ACI
N050.04.44.484 E019.47.40.545 N050.04.44.490 E019.47.40.646 Color_252ACI
N050.04.44.490 E019.47.40.646 N050.04.44.530 E019.47.40.718 Color_252ACI
N050.04.44.530 E019.47.40.718 N050.04.44.593 E019.47.40.742 Color_252ACI
N050.04.44.593 E019.47.40.742 N050.04.44.643 E019.47.40.716 Color_252ACI
N050.04.44.643 E019.47.40.716 N050.04.44.679 E019.47.40.653 Color_252ACI
N050.04.44.679 E019.47.40.653 N050.04.44.689 E019.47.40.597 Color_252ACI
N050.04.44.484 E019.47.39.124 N050.04.44.473 E019.47.39.035 Color_252ACI
N050.04.44.473 E019.47.39.035 N050.04.44.427 E019.47.38.963 Color_252ACI
N050.04.44.427 E019.47.38.963 N050.04.44.371 E019.47.38.946 Color_252ACI
N050.04.44.371 E019.47.38.946 N050.04.44.309 E019.47.38.989 Color_252ACI
N050.04.44.309 E019.47.38.989 N050.04.44.278 E019.47.39.072 Color_252ACI
N050.04.44.278 E019.47.39.072 N050.04.44.285 E019.47.39.173 Color_252ACI
N050.04.44.285 E019.47.39.173 N050.04.44.324 E019.47.39.245 Color_252ACI
N050.04.44.324 E019.47.39.245 N050.04.44.388 E019.47.39.270 Color_252ACI
N050.04.44.388 E019.47.39.270 N050.04.44.438 E019.47.39.243 Color_252ACI
N050.04.44.438 E019.47.39.243 N050.04.44.473 E019.47.39.181 Color_252ACI
N050.04.44.473 E019.47.39.181 N050.04.44.484 E019.47.39.124 Color_252ACI
N050.04.44.278 E019.47.37.652 N050.04.44.268 E019.47.37.562 Color_252ACI
N050.04.44.268 E019.47.37.562 N050.04.44.221 E019.47.37.490 Color_252ACI
N050.04.44.221 E019.47.37.490 N050.04.44.166 E019.47.37.473 Color_252ACI
N050.04.44.166 E019.47.37.473 N050.04.44.104 E019.47.37.516 Color_252ACI
N050.04.44.104 E019.47.37.516 N050.04.44.073 E019.47.37.600 Color_252ACI
N050.04.44.073 E019.47.37.600 N050.04.44.079 E019.47.37.701 Color_252ACI
N050.04.44.079 E019.47.37.701 N050.04.44.119 E019.47.37.772 Color_252ACI
N050.04.44.119 E019.47.37.772 N050.04.44.182 E019.47.37.797 Color_252ACI
N050.04.44.182 E019.47.37.797 N050.04.44.232 E019.47.37.770 Color_252ACI
N050.04.44.232 E019.47.37.770 N050.04.44.268 E019.47.37.708 Color_252ACI
N050.04.44.268 E019.47.37.708 N050.04.44.278 E019.47.37.652 Color_252ACI
N050.04.44.073 E019.47.36.179 N050.04.44.062 E019.47.36.090 Color_252ACI
N050.04.44.062 E019.47.36.090 N050.04.44.016 E019.47.36.017 Color_252ACI
N050.04.44.016 E019.47.36.017 N050.04.43.960 E019.47.36.001 Color_252ACI
N050.04.43.960 E019.47.36.001 N050.04.43.898 E019.47.36.043 Color_252ACI
N050.04.43.898 E019.47.36.043 N050.04.43.867 E019.47.36.127 Color_252ACI
N050.04.43.867 E019.47.36.127 N050.04.43.874 E019.47.36.228 Color_252ACI
N050.04.43.874 E019.47.36.228 N050.04.43.913 E019.47.36.299 Color_252ACI
N050.04.43.913 E019.47.36.299 N050.04.43.977 E019.47.36.324 Color_252ACI
N050.04.43.977 E019.47.36.324 N050.04.44.027 E019.47.36.298 Color_252ACI
N050.04.44.027 E019.47.36.298 N050.04.44.062 E019.47.36.235 Color_252ACI
N050.04.44.062 E019.47.36.235 N050.04.44.073 E019.47.36.179 Color_252ACI
N050.04.43.867 E019.47.34.706 N050.04.43.857 E019.47.34.617 Color_252ACI
N050.04.43.857 E019.47.34.617 N050.04.43.810 E019.47.34.545 Color_252ACI
N050.04.43.810 E019.47.34.545 N050.04.43.754 E019.47.34.528 Color_252ACI
N050.04.43.754 E019.47.34.528 N050.04.43.693 E019.47.34.571 Color_252ACI
N050.04.43.693 E019.47.34.571 N050.04.43.662 E019.47.34.654 Color_252ACI
N050.04.43.662 E019.47.34.654 N050.04.43.668 E019.47.34.755 Color_252ACI
N050.04.43.668 E019.47.34.755 N050.04.43.707 E019.47.34.827 Color_252ACI
N050.04.43.707 E019.47.34.827 N050.04.43.771 E019.47.34.852 Color_252ACI
N050.04.43.771 E019.47.34.852 N050.04.43.821 E019.47.34.825 Color_252ACI
N050.04.43.821 E019.47.34.825 N050.04.43.857 E019.47.34.762 Color_252ACI
N050.04.43.857 E019.47.34.762 N050.04.43.867 E019.47.34.706 Color_252ACI
N050.04.43.662 E019.47.33.234 N050.04.43.651 E019.47.33.144 Color_252ACI
N050.04.43.651 E019.47.33.144 N050.04.43.605 E019.47.33.072 Color_252ACI
N050.04.43.605 E019.47.33.072 N050.04.43.549 E019.47.33.055 Color_252ACI
N050.04.43.549 E019.47.33.055 N050.04.43.487 E019.47.33.098 Color_252ACI
N050.04.43.487 E019.47.33.098 N050.04.43.456 E019.47.33.181 Color_252ACI
N050.04.43.456 E019.47.33.181 N050.04.43.462 E019.47.33.282 Color_252ACI
N050.04.43.462 E019.47.33.282 N050.04.43.502 E019.47.33.354 Color_252ACI
N050.04.43.502 E019.47.33.354 N050.04.43.566 E019.47.33.379 Color_252ACI
N050.04.43.566 E019.47.33.379 N050.04.43.615 E019.47.33.352 Color_252ACI
N050.04.43.615 E019.47.33.352 N050.04.43.651 E019.47.33.290 Color_252ACI
N050.04.43.651 E019.47.33.290 N050.04.43.662 E019.47.33.234 Color_252ACI
N050.04.43.456 E019.47.31.761 N050.04.43.445 E019.47.31.671 Color_252ACI
N050.04.43.445 E019.47.31.671 N050.04.43.399 E019.47.31.599 Color_252ACI
N050.04.43.399 E019.47.31.599 N050.04.43.343 E019.47.31.582 Color_252ACI
N050.04.43.343 E019.47.31.582 N050.04.43.281 E019.47.31.625 Color_252ACI
N050.04.43.281 E019.47.31.625 N050.04.43.251 E019.47.31.709 Color_252ACI
N050.04.43.251 E019.47.31.709 N050.04.43.257 E019.47.31.810 Color_252ACI
N050.04.43.257 E019.47.31.810 N050.04.43.296 E019.47.31.881 Color_252ACI
N050.04.43.296 E019.47.31.881 N050.04.43.360 E019.47.31.906 Color_252ACI
N050.04.43.360 E019.47.31.906 N050.04.43.410 E019.47.31.880 Color_252ACI
N050.04.43.410 E019.47.31.880 N050.04.43.445 E019.47.31.817 Color_252ACI
N050.04.43.445 E019.47.31.817 N050.04.43.456 E019.47.31.761 Color_252ACI
N050.04.43.250 E019.47.30.288 N050.04.43.240 E019.47.30.199 Color_252ACI
N050.04.43.240 E019.47.30.199 N050.04.43.194 E019.47.30.127 Color_252ACI
N050.04.43.194 E019.47.30.127 N050.04.43.138 E019.47.30.110 Color_252ACI
N050.04.43.138 E019.47.30.110 N050.04.43.076 E019.47.30.152 Color_252ACI
N050.04.43.076 E019.47.30.152 N050.04.43.045 E019.47.30.236 Color_252ACI
N050.04.43.045 E019.47.30.236 N050.04.43.051 E019.47.30.337 Color_252ACI
N050.04.43.051 E019.47.30.337 N050.04.43.091 E019.47.30.409 Color_252ACI
N050.04.43.091 E019.47.30.409 N050.04.43.155 E019.47.30.433 Color_252ACI
N050.04.43.155 E019.47.30.433 N050.04.43.204 E019.47.30.407 Color_252ACI
N050.04.43.204 E019.47.30.407 N050.04.43.240 E019.47.30.344 Color_252ACI
N050.04.43.240 E019.47.30.344 N050.04.43.250 E019.47.30.288 Color_252ACI
N050.04.43.045 E019.47.28.815 N050.04.43.034 E019.47.28.726 Color_252ACI
N050.04.43.034 E019.47.28.726 N050.04.42.988 E019.47.28.654 Color_252ACI
N050.04.42.988 E019.47.28.654 N050.04.42.932 E019.47.28.637 Color_252ACI
N050.04.42.932 E019.47.28.637 N050.04.42.870 E019.47.28.680 Color_252ACI
N050.04.42.870 E019.47.28.680 N050.04.42.840 E019.47.28.763 Color_252ACI
N050.04.42.840 E019.47.28.763 N050.04.42.846 E019.47.28.864 Color_252ACI
N050.04.42.846 E019.47.28.864 N050.04.42.885 E019.47.28.936 Color_252ACI
N050.04.42.885 E019.47.28.936 N050.04.42.949 E019.47.28.961 Color_252ACI
N050.04.42.949 E019.47.28.961 N050.04.42.999 E019.47.28.934 Color_252ACI
N050.04.42.999 E019.47.28.934 N050.04.43.034 E019.47.28.872 Color_252ACI
N050.04.43.034 E019.47.28.872 N050.04.43.045 E019.47.28.815 Color_252ACI
N050.04.42.839 E019.47.27.343 N050.04.42.829 E019.47.27.253 Color_252ACI
N050.04.42.829 E019.47.27.253 N050.04.42.783 E019.47.27.181 Color_252ACI
N050.04.42.783 E019.47.27.181 N050.04.42.727 E019.47.27.164 Color_252ACI
N050.04.42.727 E019.47.27.164 N050.04.42.665 E019.47.27.207 Color_252ACI
N050.04.42.665 E019.47.27.207 N050.04.42.634 E019.47.27.291 Color_252ACI
N050.04.42.634 E019.47.27.291 N050.04.42.640 E019.47.27.392 Color_252ACI
N050.04.42.640 E019.47.27.392 N050.04.42.680 E019.47.27.463 Color_252ACI
N050.04.42.680 E019.47.27.463 N050.04.42.743 E019.47.27.488 Color_252ACI
N050.04.42.743 E019.47.27.488 N050.04.42.793 E019.47.27.461 Color_252ACI
N050.04.42.793 E019.47.27.461 N050.04.42.829 E019.47.27.399 Color_252ACI
N050.04.42.829 E019.47.27.399 N050.04.42.839 E019.47.27.343 Color_252ACI
N050.04.42.634 E019.47.25.870 N050.04.42.623 E019.47.25.781 Color_252ACI
N050.04.42.623 E019.47.25.781 N050.04.42.577 E019.47.25.708 Color_252ACI
N050.04.42.577 E019.47.25.708 N050.04.42.521 E019.47.25.692 Color_252ACI
N050.04.42.521 E019.47.25.692 N050.04.42.459 E019.47.25.734 Color_252ACI
N050.04.42.459 E019.47.25.734 N050.04.42.428 E019.47.25.818 Color_252ACI
N050.04.42.428 E019.47.25.818 N050.04.42.435 E019.47.25.919 Color_252ACI
N050.04.42.435 E019.47.25.919 N050.04.42.474 E019.47.25.990 Color_252ACI
N050.04.42.474 E019.47.25.990 N050.04.42.538 E019.47.26.015 Color_252ACI
N050.04.42.538 E019.47.26.015 N050.04.42.588 E019.47.25.989 Color_252ACI
N050.04.42.588 E019.47.25.989 N050.04.42.623 E019.47.25.926 Color_252ACI
N050.04.42.623 E019.47.25.926 N050.04.42.634 E019.47.25.870 Color_252ACI
N050.04.42.428 E019.47.24.397 N050.04.42.418 E019.47.24.308 Color_252ACI
N050.04.42.418 E019.47.24.308 N050.04.42.372 E019.47.24.236 Color_252ACI
N050.04.42.372 E019.47.24.236 N050.04.42.316 E019.47.24.219 Color_252ACI
N050.04.42.316 E019.47.24.219 N050.04.42.254 E019.47.24.262 Color_252ACI
N050.04.42.254 E019.47.24.262 N050.04.42.223 E019.47.24.345 Color_252ACI
N050.04.42.223 E019.47.24.345 N050.04.42.229 E019.47.24.446 Color_252ACI
N050.04.42.229 E019.47.24.446 N050.04.42.269 E019.47.24.518 Color_252ACI
N050.04.42.269 E019.47.24.518 N050.04.42.332 E019.47.24.543 Color_252ACI
N050.04.42.332 E019.47.24.543 N050.04.42.382 E019.47.24.516 Color_252ACI
N050.04.42.382 E019.47.24.516 N050.04.42.418 E019.47.24.453 Color_252ACI
N050.04.42.418 E019.47.24.453 N050.04.42.428 E019.47.24.397 Color_252ACI
N050.04.42.223 E019.47.22.925 N050.04.42.212 E019.47.22.835 Color_252ACI
N050.04.42.212 E019.47.22.835 N050.04.42.166 E019.47.22.763 Color_252ACI
N050.04.42.166 E019.47.22.763 N050.04.42.110 E019.47.22.746 Color_252ACI
N050.04.42.110 E019.47.22.746 N050.04.42.048 E019.47.22.789 Color_252ACI
N050.04.42.048 E019.47.22.789 N050.04.42.017 E019.47.22.873 Color_252ACI
N050.04.42.017 E019.47.22.873 N050.04.42.024 E019.47.22.973 Color_252ACI
N050.04.42.024 E019.47.22.973 N050.04.42.063 E019.47.23.045 Color_252ACI
N050.04.42.063 E019.47.23.045 N050.04.42.127 E019.47.23.070 Color_252ACI
N050.04.42.127 E019.47.23.070 N050.04.42.177 E019.47.23.043 Color_252ACI
N050.04.42.177 E019.47.23.043 N050.04.42.212 E019.47.22.981 Color_252ACI
N050.04.42.212 E019.47.22.981 N050.04.42.223 E019.47.22.925 Color_252ACI
N050.04.42.017 E019.47.21.452 N050.04.42.007 E019.47.21.362 Color_252ACI
N050.04.42.007 E019.47.21.362 N050.04.41.960 E019.47.21.290 Color_252ACI
N050.04.41.960 E019.47.21.290 N050.04.41.905 E019.47.21.274 Color_252ACI
N050.04.41.905 E019.47.21.274 N050.04.41.843 E019.47.21.316 Color_252ACI
N050.04.41.843 E019.47.21.316 N050.04.41.812 E019.47.21.400 Color_252ACI
N050.04.41.812 E019.47.21.400 N050.04.41.818 E019.47.21.501 Color_252ACI
N050.04.41.818 E019.47.21.501 N050.04.41.858 E019.47.21.572 Color_252ACI
N050.04.41.858 E019.47.21.572 N050.04.41.921 E019.47.21.597 Color_252ACI
N050.04.41.921 E019.47.21.597 N050.04.41.971 E019.47.21.571 Color_252ACI
N050.04.41.971 E019.47.21.571 N050.04.42.007 E019.47.21.508 Color_252ACI
N050.04.42.007 E019.47.21.508 N050.04.42.017 E019.47.21.452 Color_252ACI
N050.04.41.812 E019.47.19.979 N050.04.41.801 E019.47.19.890 Color_252ACI
N050.04.41.801 E019.47.19.890 N050.04.41.755 E019.47.19.818 Color_252ACI
N050.04.41.755 E019.47.19.818 N050.04.41.699 E019.47.19.801 Color_252ACI
N050.04.41.699 E019.47.19.801 N050.04.41.637 E019.47.19.844 Color_252ACI
N050.04.41.637 E019.47.19.844 N050.04.41.606 E019.47.19.927 Color_252ACI
N050.04.41.606 E019.47.19.927 N050.04.41.613 E019.47.20.028 Color_252ACI
N050.04.41.613 E019.47.20.028 N050.04.41.652 E019.47.20.100 Color_252ACI
N050.04.41.652 E019.47.20.100 N050.04.41.716 E019.47.20.124 Color_252ACI
N050.04.41.716 E019.47.20.124 N050.04.41.765 E019.47.20.098 Color_252ACI
N050.04.41.765 E019.47.20.098 N050.04.41.801 E019.47.20.035 Color_252ACI
N050.04.41.801 E019.47.20.035 N050.04.41.812 E019.47.19.979 Color_252ACI
N050.04.41.606 E019.47.18.506 N050.04.41.595 E019.47.18.417 Color_252ACI
N050.04.41.595 E019.47.18.417 N050.04.41.549 E019.47.18.345 Color_252ACI
N050.04.41.549 E019.47.18.345 N050.04.41.493 E019.47.18.328 Color_252ACI
N050.04.41.493 E019.47.18.328 N050.04.41.432 E019.47.18.371 Color_252ACI
N050.04.41.432 E019.47.18.371 N050.04.41.401 E019.47.18.454 Color_252ACI
N050.04.41.401 E019.47.18.454 N050.04.41.407 E019.47.18.555 Color_252ACI
N050.04.41.407 E019.47.18.555 N050.04.41.446 E019.47.18.627 Color_252ACI
N050.04.41.446 E019.47.18.627 N050.04.41.510 E019.47.18.652 Color_252ACI
N050.04.41.510 E019.47.18.652 N050.04.41.560 E019.47.18.625 Color_252ACI
N050.04.41.560 E019.47.18.625 N050.04.41.596 E019.47.18.563 Color_252ACI
N050.04.41.596 E019.47.18.563 N050.04.41.606 E019.47.18.506 Color_252ACI
N050.04.41.400 E019.47.17.034 N050.04.41.390 E019.47.16.944 Color_252ACI
N050.04.41.390 E019.47.16.944 N050.04.41.344 E019.47.16.872 Color_252ACI
N050.04.41.344 E019.47.16.872 N050.04.41.288 E019.47.16.855 Color_252ACI
N050.04.41.288 E019.47.16.855 N050.04.41.226 E019.47.16.898 Color_252ACI
N050.04.41.226 E019.47.16.898 N050.04.41.195 E019.47.16.982 Color_252ACI
N050.04.41.195 E019.47.16.982 N050.04.41.201 E019.47.17.083 Color_252ACI
N050.04.41.201 E019.47.17.083 N050.04.41.241 E019.47.17.154 Color_252ACI
N050.04.41.241 E019.47.17.154 N050.04.41.305 E019.47.17.179 Color_252ACI
N050.04.41.305 E019.47.17.179 N050.04.41.354 E019.47.17.153 Color_252ACI
N050.04.41.354 E019.47.17.153 N050.04.41.390 E019.47.17.090 Color_252ACI
N050.04.41.390 E019.47.17.090 N050.04.41.400 E019.47.17.034 Color_252ACI
N050.04.41.195 E019.47.15.561 N050.04.41.184 E019.47.15.472 Color_252ACI
N050.04.41.184 E019.47.15.472 N050.04.41.138 E019.47.15.400 Color_252ACI
N050.04.41.138 E019.47.15.400 N050.04.41.082 E019.47.15.383 Color_252ACI
N050.04.41.082 E019.47.15.383 N050.04.41.020 E019.47.15.425 Color_252ACI
N050.04.41.020 E019.47.15.425 N050.04.40.990 E019.47.15.509 Color_252ACI
N050.04.40.990 E019.47.15.509 N050.04.40.996 E019.47.15.610 Color_252ACI
N050.04.40.996 E019.47.15.610 N050.04.41.035 E019.47.15.681 Color_252ACI
N050.04.41.035 E019.47.15.681 N050.04.41.099 E019.47.15.706 Color_252ACI
N050.04.41.099 E019.47.15.706 N050.04.41.149 E019.47.15.680 Color_252ACI
N050.04.41.149 E019.47.15.680 N050.04.41.184 E019.47.15.617 Color_252ACI
N050.04.41.184 E019.47.15.617 N050.04.41.195 E019.47.15.561 Color_252ACI
N050.04.40.989 E019.47.14.088 N050.04.40.979 E019.47.13.999 Color_252ACI
N050.04.40.979 E019.47.13.999 N050.04.40.933 E019.47.13.927 Color_252ACI
N050.04.40.933 E019.47.13.927 N050.04.40.877 E019.47.13.910 Color_252ACI
N050.04.40.877 E019.47.13.910 N050.04.40.815 E019.47.13.953 Color_252ACI
N050.04.40.815 E019.47.13.953 N050.04.40.784 E019.47.14.036 Color_252ACI
N050.04.40.784 E019.47.14.036 N050.04.40.790 E019.47.14.137 Color_252ACI
N050.04.40.790 E019.47.14.137 N050.04.40.830 E019.47.14.209 Color_252ACI
N050.04.40.830 E019.47.14.209 N050.04.40.893 E019.47.14.234 Color_252ACI
N050.04.40.893 E019.47.14.234 N050.04.40.943 E019.47.14.207 Color_252ACI
N050.04.40.943 E019.47.14.207 N050.04.40.979 E019.47.14.144 Color_252ACI
N050.04.40.979 E019.47.14.144 N050.04.40.989 E019.47.14.088 Color_252ACI
N050.04.40.784 E019.47.12.616 N050.04.40.773 E019.47.12.526 Color_252ACI
N050.04.40.773 E019.47.12.526 N050.04.40.727 E019.47.12.454 Color_252ACI
N050.04.40.727 E019.47.12.454 N050.04.40.671 E019.47.12.437 Color_252ACI
N050.04.40.671 E019.47.12.437 N050.04.40.609 E019.47.12.480 Color_252ACI
N050.04.40.609 E019.47.12.480 N050.04.40.578 E019.47.12.564 Color_252ACI
N050.04.40.578 E019.47.12.564 N050.04.40.585 E019.47.12.664 Color_252ACI
N050.04.40.585 E019.47.12.664 N050.04.40.624 E019.47.12.736 Color_252ACI
N050.04.40.624 E019.47.12.736 N050.04.40.688 E019.47.12.761 Color_252ACI
N050.04.40.688 E019.47.12.761 N050.04.40.738 E019.47.12.734 Color_252ACI
N050.04.40.738 E019.47.12.734 N050.04.40.773 E019.47.12.672 Color_252ACI
N050.04.40.773 E019.47.12.672 N050.04.40.784 E019.47.12.616 Color_252ACI
N050.04.40.578 E019.47.11.143 N050.04.40.568 E019.47.11.054 Color_252ACI
N050.04.40.568 E019.47.11.054 N050.04.40.522 E019.47.10.981 Color_252ACI
N050.04.40.522 E019.47.10.981 N050.04.40.466 E019.47.10.965 Color_252ACI
N050.04.40.466 E019.47.10.965 N050.04.40.404 E019.47.11.007 Color_252ACI
N050.04.40.404 E019.47.11.007 N050.04.40.373 E019.47.11.091 Color_252ACI
N050.04.40.373 E019.47.11.091 N050.04.40.379 E019.47.11.192 Color_252ACI
N050.04.40.379 E019.47.11.192 N050.04.40.419 E019.47.11.263 Color_252ACI
N050.04.40.419 E019.47.11.263 N050.04.40.482 E019.47.11.288 Color_252ACI
N050.04.40.482 E019.47.11.288 N050.04.40.532 E019.47.11.262 Color_252ACI
N050.04.40.532 E019.47.11.262 N050.04.40.568 E019.47.11.199 Color_252ACI
N050.04.40.568 E019.47.11.199 N050.04.40.578 E019.47.11.143 Color_252ACI
N050.04.40.373 E019.47.09.670 N050.04.40.362 E019.47.09.581 Color_252ACI
N050.04.40.362 E019.47.09.581 N050.04.40.316 E019.47.09.509 Color_252ACI
N050.04.40.316 E019.47.09.509 N050.04.40.260 E019.47.09.492 Color_252ACI
N050.04.40.260 E019.47.09.492 N050.04.40.198 E019.47.09.535 Color_252ACI
N050.04.40.198 E019.47.09.535 N050.04.40.167 E019.47.09.618 Color_252ACI
N050.04.40.167 E019.47.09.618 N050.04.40.174 E019.47.09.719 Color_252ACI
N050.04.40.174 E019.47.09.719 N050.04.40.213 E019.47.09.791 Color_252ACI
N050.04.40.213 E019.47.09.791 N050.04.40.277 E019.47.09.816 Color_252ACI
N050.04.40.277 E019.47.09.816 N050.04.40.327 E019.47.09.789 Color_252ACI
N050.04.40.327 E019.47.09.789 N050.04.40.362 E019.47.09.726 Color_252ACI
N050.04.40.362 E019.47.09.726 N050.04.40.373 E019.47.09.670 Color_252ACI
N050.04.40.167 E019.47.08.198 N050.04.40.157 E019.47.08.108 Color_252ACI
N050.04.40.157 E019.47.08.108 N050.04.40.110 E019.47.08.036 Color_252ACI
N050.04.40.110 E019.47.08.036 N050.04.40.055 E019.47.08.019 Color_252ACI
N050.04.40.055 E019.47.08.019 N050.04.39.993 E019.47.08.062 Color_252ACI
N050.04.39.993 E019.47.08.062 N050.04.39.962 E019.47.08.145 Color_252ACI
N050.04.39.962 E019.47.08.145 N050.04.39.968 E019.47.08.246 Color_252ACI
N050.04.39.968 E019.47.08.246 N050.04.40.008 E019.47.08.318 Color_252ACI
N050.04.40.008 E019.47.08.318 N050.04.40.071 E019.47.08.343 Color_252ACI
N050.04.40.071 E019.47.08.343 N050.04.40.121 E019.47.08.316 Color_252ACI
N050.04.40.121 E019.47.08.316 N050.04.40.157 E019.47.08.254 Color_252ACI
N050.04.40.157 E019.47.08.254 N050.04.40.167 E019.47.08.198 Color_252ACI
N050.04.39.962 E019.47.06.725 N050.04.39.951 E019.47.06.635 Color_252ACI
N050.04.39.951 E019.47.06.635 N050.04.39.905 E019.47.06.563 Color_252ACI
N050.04.39.905 E019.47.06.563 N050.04.39.849 E019.47.06.546 Color_252ACI
N050.04.39.849 E019.47.06.546 N050.04.39.787 E019.47.06.589 Color_252ACI
N050.04.39.787 E019.47.06.589 N050.04.39.756 E019.47.06.673 Color_252ACI
N050.04.39.756 E019.47.06.673 N050.04.39.763 E019.47.06.774 Color_252ACI
N050.04.39.763 E019.47.06.774 N050.04.39.802 E019.47.06.845 Color_252ACI
N050.04.39.802 E019.47.06.845 N050.04.39.866 E019.47.06.870 Color_252ACI
N050.04.39.866 E019.47.06.870 N050.04.39.916 E019.47.06.844 Color_252ACI
N050.04.39.916 E019.47.06.844 N050.04.39.951 E019.47.06.781 Color_252ACI
N050.04.39.951 E019.47.06.781 N050.04.39.962 E019.47.06.725 Color_252ACI
;drogi N000.00.00.000 E000.00.00.000 N000.00.00.000 E000.00.00.000
N050.04.24.193 E019.47.15.873 N050.04.24.348 E019.47.16.728 Color_251ACI
N050.04.24.348 E019.47.16.728 N050.04.24.303 E019.47.17.034 Color_251ACI
N050.04.24.303 E019.47.17.034 N050.04.25.574 E019.47.24.847 Color_251ACI
N050.04.23.228 E019.47.23.339 N050.04.23.519 E019.47.25.372 Color_251ACI
N050.04.23.931 E019.47.26.049 N050.04.23.884 E019.47.26.116 Color_251ACI
N050.04.23.884 E019.47.26.116 N050.04.23.827 E019.47.26.224 Color_251ACI
N050.04.23.827 E019.47.26.224 N050.04.23.790 E019.47.26.249 Color_251ACI
N050.04.23.790 E019.47.26.249 N050.04.23.739 E019.47.26.456 Color_251ACI
N050.04.23.739 E019.47.26.456 N050.04.23.745 E019.47.26.555 Color_251ACI
N050.04.23.745 E019.47.26.555 N050.04.23.751 E019.47.26.654 Color_251ACI
N050.04.23.751 E019.47.26.654 N050.04.23.730 E019.47.26.737 Color_251ACI
N050.04.23.249 E019.47.25.352 N050.04.23.090 E019.47.24.637 Color_251ACI
N050.04.31.424 E019.48.05.465 N050.04.31.387 E019.48.05.491 Color_251ACI
N050.04.31.387 E019.48.05.491 N050.04.31.387 E019.48.05.491 Color_251ACI
N050.04.31.387 E019.48.05.491 N050.04.31.350 E019.48.05.516 Color_251ACI
N050.04.31.350 E019.48.05.516 N050.04.31.340 E019.48.05.557 Color_251ACI
N050.04.31.340 E019.48.05.557 N050.04.31.303 E019.48.05.583 Color_251ACI
N050.04.31.303 E019.48.05.583 N050.04.31.272 E019.48.05.707 Color_251ACI
N050.04.31.449 E019.48.05.242 N050.04.31.359 E019.48.05.235 Color_251ACI
N050.04.31.359 E019.48.05.235 N050.04.31.322 E019.48.05.261 Color_251ACI
N050.04.31.322 E019.48.05.261 N050.04.31.258 E019.48.05.270 Color_251ACI
N050.04.31.258 E019.48.05.270 N050.04.31.211 E019.48.05.337 Color_251ACI
N050.04.31.211 E019.48.05.337 N050.04.31.191 E019.48.05.420 Color_251ACI
N050.04.31.191 E019.48.05.420 N050.04.31.143 E019.48.05.487 Color_251ACI
N050.04.31.143 E019.48.05.487 N050.04.31.096 E019.48.05.554 Color_251ACI
N050.04.31.096 E019.48.05.554 N050.04.31.102 E019.48.05.653 Color_251ACI
N050.04.31.272 E019.48.05.707 N050.04.31.084 E019.48.07.451 Color_251ACI
N050.04.31.084 E019.48.07.451 N050.04.31.059 E019.48.08.293 Color_251ACI
N050.04.30.920 E019.48.08.114 N050.04.30.914 E019.48.07.397 Color_251ACI
N050.04.30.914 E019.48.07.397 N050.04.31.102 E019.48.05.653 Color_251ACI
N050.04.24.402 E019.47.53.237 N050.04.27.383 E019.47.51.937 Color_251ACI
N050.04.27.383 E019.47.51.937 N050.04.29.197 E019.47.51.648 Color_251ACI
N050.04.29.197 E019.47.51.648 N050.04.29.805 E019.47.51.538 Color_251ACI
N050.04.29.805 E019.47.51.538 N050.04.30.126 E019.47.51.350 Color_251ACI
N050.04.25.435 E019.47.53.383 N050.04.25.423 E019.47.53.185 Color_251ACI
N050.04.25.423 E019.47.53.185 N050.04.27.417 E019.47.52.291 Color_251ACI
N050.04.27.417 E019.47.52.291 N050.04.29.231 E019.47.52.002 Color_251ACI
N050.04.29.231 E019.47.52.002 N050.04.29.876 E019.47.51.866 Color_251ACI
N050.04.29.876 E019.47.51.866 N050.04.30.234 E019.47.51.653 Color_251ACI
N050.04.17.224 E019.48.36.964 N050.04.17.034 E019.48.36.993 Color_251ACI
N050.04.17.034 E019.48.36.993 N050.04.16.453 E019.48.37.119 Color_251ACI
N050.04.16.453 E019.48.37.119 N050.04.15.881 E019.48.37.204 Color_251ACI
N050.04.15.881 E019.48.37.204 N050.04.14.395 E019.48.37.404 Color_251ACI
N050.04.14.395 E019.48.37.404 N050.04.12.909 E019.48.37.605 Color_251ACI
N050.04.12.909 E019.48.37.605 N050.04.12.084 E019.48.37.727 Color_251ACI
N050.04.12.084 E019.48.37.727 N050.04.11.253 E019.48.37.750 Color_251ACI
N050.04.11.253 E019.48.37.750 N050.04.10.639 E019.48.37.762 Color_251ACI
N050.04.10.639 E019.48.37.762 N050.04.10.051 E019.48.37.789 Color_251ACI
N050.04.17.397 E019.48.38.116 N050.04.16.763 E019.48.38.210 Color_251ACI
N050.04.16.763 E019.48.38.210 N050.04.16.155 E019.48.38.320 Color_251ACI
N050.04.16.155 E019.48.38.320 N050.04.14.949 E019.48.38.499 Color_251ACI
N050.04.14.949 E019.48.38.499 N050.04.13.780 E019.48.38.653 Color_251ACI
N050.04.13.780 E019.48.38.653 N050.04.12.324 E019.48.38.729 Color_251ACI
N050.04.12.324 E019.48.38.729 N050.04.10.906 E019.48.38.780 Color_251ACI
N050.04.10.906 E019.48.38.780 N050.04.10.472 E019.48.38.804 Color_251ACI
N050.04.10.472 E019.48.38.804 N050.04.10.075 E019.48.38.803 Color_251ACI
N050.04.17.298 E019.48.37.532 N050.04.16.653 E019.48.37.668 Color_251ACI
N050.04.16.653 E019.48.37.668 N050.04.16.018 E019.48.37.762 Color_251ACI
N050.04.16.018 E019.48.37.762 N050.04.14.595 E019.48.37.953 Color_251ACI
N050.04.14.595 E019.48.37.953 N050.04.13.183 E019.48.38.103 Color_251ACI
N050.04.13.183 E019.48.38.103 N050.04.12.749 E019.48.38.127 Color_251ACI
N050.04.12.749 E019.48.38.127 N050.04.12.341 E019.48.38.168 Color_251ACI
N050.04.12.341 E019.48.38.168 N050.04.11.256 E019.48.38.229 Color_251ACI
N050.04.11.256 E019.48.38.229 N050.04.10.198 E019.48.38.306 Color_251ACI
N050.04.20.519 E019.48.37.853 N050.04.20.300 E019.48.37.626 Color_251ACI
N050.04.20.300 E019.48.37.626 N050.04.17.456 E019.48.38.247 Color_251ACI
N050.04.17.456 E019.48.38.247 N050.04.17.274 E019.48.38.613 Color_251ACI
N050.04.20.243 E019.48.35.639 N050.04.20.056 E019.48.36.145 Color_251ACI
N050.04.20.056 E019.48.36.145 N050.04.17.085 E019.48.36.786 Color_251ACI
N050.04.17.085 E019.48.36.786 N050.04.16.963 E019.48.36.664 Color_251ACI
N050.05.05.211 E019.48.28.429 N050.05.04.873 E019.48.28.559 Color_251ACI
N050.05.04.873 E019.48.28.559 N050.05.04.499 E019.48.28.715 Color_251ACI
N050.05.04.499 E019.48.28.715 N050.05.03.707 E019.48.28.952 Color_251ACI
N050.05.03.707 E019.48.28.952 N050.05.02.961 E019.48.29.122 Color_251ACI
N050.05.02.961 E019.48.29.122 N050.05.02.253 E019.48.29.267 Color_251ACI
N050.05.02.253 E019.48.29.267 N050.05.01.592 E019.48.29.345 Color_251ACI
N050.05.01.592 E019.48.29.345 N050.05.00.301 E019.48.29.377 Color_251ACI
N050.05.00.301 E019.48.29.377 N050.04.58.993 E019.48.29.352 Color_251ACI
N050.04.58.993 E019.48.29.352 N050.04.56.378 E019.48.29.301 Color_251ACI
N050.04.56.378 E019.48.29.301 N050.04.53.736 E019.48.29.234 Color_251ACI
N050.04.53.736 E019.48.29.234 N050.04.52.138 E019.48.29.271 Color_251ACI
N050.04.52.138 E019.48.29.271 N050.04.50.556 E019.48.29.366 Color_251ACI
N050.04.50.556 E019.48.29.366 N050.04.49.795 E019.48.29.479 Color_251ACI
N050.04.49.795 E019.48.29.479 N050.04.49.007 E019.48.29.576 Color_251ACI
N050.04.49.007 E019.48.29.576 N050.04.46.501 E019.48.30.068 Color_251ACI
N050.04.46.501 E019.48.30.068 N050.04.44.002 E019.48.30.658 Color_251ACI
N050.04.44.002 E019.48.30.658 N050.04.41.445 E019.48.31.356 Color_251ACI
N050.04.41.445 E019.48.31.356 N050.04.38.861 E019.48.32.039 Color_251ACI
N050.04.38.861 E019.48.32.039 N050.04.35.887 E019.48.32.819 Color_251ACI
N050.04.35.887 E019.48.32.819 N050.04.32.912 E019.48.33.600 Color_251ACI
N050.04.32.912 E019.48.33.600 N050.04.30.239 E019.48.34.276 Color_251ACI
N050.04.30.239 E019.48.34.276 N050.04.27.565 E019.48.34.952 Color_251ACI
N050.04.27.565 E019.48.34.952 N050.04.23.908 E019.48.35.893 Color_251ACI
N050.04.23.908 E019.48.35.893 N050.04.20.242 E019.48.36.876 Color_251ACI
N050.05.06.488 E019.48.25.865 N050.05.06.412 E019.48.26.296 Color_251ACI
N050.05.06.412 E019.48.26.296 N050.05.06.171 E019.48.26.531 Color_251ACI
N050.05.06.171 E019.48.26.531 N050.05.05.855 E019.48.26.817 Color_251ACI
N050.05.05.855 E019.48.26.817 N050.05.05.476 E019.48.27.113 Color_251ACI
N050.05.05.476 E019.48.27.113 N050.05.05.218 E019.48.27.291 Color_251ACI
N050.05.05.218 E019.48.27.291 N050.05.04.932 E019.48.27.214 Color_251ACI
N050.05.07.427 E019.48.28.240 N050.05.07.051 E019.48.28.156 Color_251ACI
N050.05.07.051 E019.48.28.156 N050.05.06.646 E019.48.28.436 Color_251ACI
N050.05.06.646 E019.48.28.436 N050.05.06.240 E019.48.28.716 Color_251ACI
N050.05.06.240 E019.48.28.716 N050.05.05.829 E019.48.28.897 Color_251ACI
N050.05.05.829 E019.48.28.897 N050.05.05.581 E019.48.29.033 Color_251ACI
N050.05.05.581 E019.48.29.033 N050.05.05.425 E019.48.29.415 Color_251ACI
N050.05.06.129 E019.48.28.792 N050.05.07.080 E019.48.31.983 Color_251ACI
N050.05.07.698 E019.48.33.927 N050.05.07.616 E019.48.33.640 Color_251ACI
N050.05.07.616 E019.48.33.640 N050.05.07.508 E019.48.33.337 Color_251ACI
N050.05.07.508 E019.48.33.337 N050.05.07.422 E019.48.33.190 Color_251ACI
N050.05.07.422 E019.48.33.190 N050.05.07.289 E019.48.33.110 Color_251ACI
N050.05.07.289 E019.48.33.110 N050.05.07.146 E019.48.33.071 Color_251ACI
N050.05.07.146 E019.48.33.071 N050.05.07.046 E019.48.33.106 Color_251ACI
N050.05.07.046 E019.48.33.106 N050.05.04.792 E019.48.33.939 Color_251ACI
N050.05.04.792 E019.48.33.939 N050.05.03.736 E019.48.34.256 Color_251ACI
N050.05.03.736 E019.48.34.256 N050.05.03.345 E019.48.34.353 Color_251ACI
N050.05.03.345 E019.48.34.353 N050.05.03.054 E019.48.34.417 Color_251ACI
N050.05.03.054 E019.48.34.417 N050.05.02.837 E019.48.34.429 Color_251ACI
N050.05.02.837 E019.48.34.429 N050.05.02.504 E019.48.34.418 Color_251ACI
N050.05.02.504 E019.48.34.418 N050.05.02.164 E019.48.34.309 Color_251ACI
N050.05.02.164 E019.48.34.309 N050.05.01.878 E019.48.34.232 Color_251ACI
N050.05.01.878 E019.48.34.232 N050.05.01.559 E019.48.34.040 Color_251ACI
N050.05.01.559 E019.48.34.040 N050.05.01.037 E019.48.33.678 Color_251ACI
N050.05.01.037 E019.48.33.678 N050.05.00.616 E019.48.33.282 Color_251ACI
N050.05.00.616 E019.48.33.282 N050.05.00.328 E019.48.32.965 Color_251ACI
N050.05.00.328 E019.48.32.965 N050.04.59.917 E019.48.32.527 Color_251ACI
N050.04.59.917 E019.48.32.527 N050.04.59.619 E019.48.32.252 Color_251ACI
N050.04.59.619 E019.48.32.252 N050.04.59.224 E019.48.31.872 Color_251ACI
N050.04.59.224 E019.48.31.872 N050.04.58.915 E019.48.31.638 Color_251ACI
N050.04.58.915 E019.48.31.638 N050.04.58.527 E019.48.31.357 Color_251ACI
N050.04.58.527 E019.48.31.357 N050.04.58.214 E019.48.31.263 Color_251ACI
N050.04.58.214 E019.48.31.263 N050.04.57.848 E019.48.31.138 Color_251ACI
N050.04.57.848 E019.48.31.138 N050.04.57.254 E019.48.31.067 Color_251ACI
N050.04.57.254 E019.48.31.067 N050.04.55.951 E019.48.30.901 Color_251ACI
N050.04.55.951 E019.48.30.901 N050.04.54.230 E019.48.30.817 Color_251ACI
N050.04.54.230 E019.48.30.817 N050.04.53.579 E019.48.30.853 Color_251ACI
N050.04.53.579 E019.48.30.853 N050.04.52.818 E019.48.30.966 Color_251ACI
N050.04.52.818 E019.48.30.966 N050.04.52.183 E019.48.31.061 Color_251ACI
N050.04.52.183 E019.48.31.061 N050.04.51.612 E019.48.31.145 Color_251ACI
N050.04.51.612 E019.48.31.145 N050.04.50.587 E019.48.31.337 Color_251ACI
N050.04.50.587 E019.48.31.337 N050.04.50.470 E019.48.31.315 Color_251ACI
N050.05.07.080 E019.48.31.983 N050.05.07.129 E019.48.32.156 Color_251ACI
N050.05.07.129 E019.48.32.156 N050.05.07.141 E019.48.32.354 Color_251ACI
N050.05.07.141 E019.48.32.354 N050.05.07.110 E019.48.32.478 Color_251ACI
N050.05.07.110 E019.48.32.478 N050.05.07.063 E019.48.32.545 Color_251ACI
N050.05.07.063 E019.48.32.545 N050.05.06.952 E019.48.32.621 Color_251ACI
N050.05.06.952 E019.48.32.621 N050.05.04.725 E019.48.33.470 Color_251ACI
N050.05.04.725 E019.48.33.470 N050.05.03.669 E019.48.33.787 Color_251ACI
N050.05.03.669 E019.48.33.787 N050.05.03.278 E019.48.33.884 Color_251ACI
N050.05.03.278 E019.48.33.884 N050.05.03.024 E019.48.33.922 Color_251ACI
N050.05.03.024 E019.48.33.922 N050.05.02.844 E019.48.33.909 Color_251ACI
N050.05.02.844 E019.48.33.909 N050.05.02.537 E019.48.33.915 Color_251ACI
N050.05.02.537 E019.48.33.915 N050.05.02.224 E019.48.33.821 Color_251ACI
N050.05.02.224 E019.48.33.821 N050.05.01.964 E019.48.33.760 Color_251ACI
N050.05.01.964 E019.48.33.760 N050.05.01.672 E019.48.33.584 Color_251ACI
N050.05.01.672 E019.48.33.584 N050.05.01.177 E019.48.33.238 Color_251ACI
N050.05.01.177 E019.48.33.238 N050.05.00.799 E019.48.32.915 Color_251ACI
N050.05.00.799 E019.48.32.915 N050.05.00.511 E019.48.32.599 Color_251ACI
N050.05.00.511 E019.48.32.599 N050.05.00.083 E019.48.32.104 Color_251ACI
N050.05.00.083 E019.48.32.104 N050.04.59.785 E019.48.31.829 Color_251ACI
N050.04.59.785 E019.48.31.829 N050.04.59.390 E019.48.31.448 Color_251ACI
N050.04.59.390 E019.48.31.448 N050.04.59.082 E019.48.31.215 Color_251ACI
N050.04.59.082 E019.48.31.215 N050.04.58.613 E019.48.30.885 Color_251ACI
N050.04.58.613 E019.48.30.885 N050.04.58.274 E019.48.30.776 Color_251ACI
N050.04.58.274 E019.48.30.776 N050.04.57.907 E019.48.30.650 Color_251ACI
N050.04.57.907 E019.48.30.650 N050.04.57.288 E019.48.30.563 Color_251ACI
N050.04.57.288 E019.48.30.563 N050.04.55.947 E019.48.30.422 Color_251ACI
N050.04.55.947 E019.48.30.422 N050.04.54.232 E019.48.30.437 Color_251ACI
N050.04.54.232 E019.48.30.437 N050.04.53.608 E019.48.30.490 Color_251ACI
N050.04.53.608 E019.48.30.490 N050.04.52.947 E019.48.30.568 Color_251ACI
N050.04.52.947 E019.48.30.568 N050.04.52.059 E019.48.30.700 Color_251ACI
N050.04.52.059 E019.48.30.700 N050.04.51.578 E019.48.30.791 Color_251ACI
N050.04.51.578 E019.48.30.791 N050.04.50.546 E019.48.30.884 Color_251ACI
N050.04.50.546 E019.48.30.884 N050.04.47.934 E019.48.31.312 Color_251ACI
N050.04.47.934 E019.48.31.312 N050.04.45.947 E019.48.31.686 Color_251ACI
N050.04.45.947 E019.48.31.686 N050.04.45.165 E019.48.31.882 Color_251ACI
N050.05.08.399 E019.48.32.825 N050.05.09.457 E019.48.32.748 Color_251ACI
N050.05.09.457 E019.48.32.748 N050.05.11.853 E019.48.32.572 Color_251ACI
N050.05.11.853 E019.48.32.572 N050.05.12.604 E019.48.32.501 Color_251ACI
N050.05.10.018 E019.48.40.467 N050.05.08.031 E019.48.33.938 Color_251ACI
N050.05.08.031 E019.48.33.938 N050.05.07.923 E019.48.33.634 Color_251ACI
N050.05.07.923 E019.48.33.634 N050.05.07.852 E019.48.33.306 Color_251ACI
N050.05.07.852 E019.48.33.306 N050.05.07.856 E019.48.33.165 Color_251ACI
N050.05.07.856 E019.48.33.165 N050.05.07.961 E019.48.32.990 Color_251ACI
N050.05.07.961 E019.48.32.990 N050.05.08.118 E019.48.32.847 Color_251ACI
N050.05.08.118 E019.48.32.847 N050.05.08.272 E019.48.32.844 Color_251ACI
N050.05.08.272 E019.48.32.844 N050.05.08.436 E019.48.32.800 Color_251ACI
N050.05.09.760 E019.48.40.645 N050.05.07.698 E019.48.33.927 Color_251ACI
N050.05.06.811 E019.48.26.536 N050.05.07.434 E019.48.25.625 Color_251ACI
N050.05.07.434 E019.48.25.625 N050.05.08.067 E019.48.24.673 Color_251ACI
N050.05.08.067 E019.48.24.673 N050.05.08.449 E019.48.23.998 Color_251ACI
N050.05.08.449 E019.48.23.998 N050.05.08.777 E019.48.23.291 Color_251ACI
N050.05.08.777 E019.48.23.291 N050.05.09.099 E019.48.22.485 Color_251ACI
N050.05.09.099 E019.48.22.485 N050.05.09.378 E019.48.21.605 Color_251ACI
N050.05.09.378 E019.48.21.605 N050.05.09.631 E019.48.20.710 Color_251ACI
N050.05.09.631 E019.48.20.710 N050.05.09.820 E019.48.19.824 Color_251ACI
N050.05.09.820 E019.48.19.824 N050.05.09.962 E019.48.19.004 Color_251ACI
N050.05.09.962 E019.48.19.004 N050.05.10.040 E019.48.18.195 Color_251ACI
N050.05.10.040 E019.48.18.195 N050.05.10.119 E019.48.17.385 Color_251ACI
N050.05.10.119 E019.48.17.385 N050.05.10.134 E019.48.16.584 Color_251ACI
N050.05.10.134 E019.48.16.584 N050.05.10.103 E019.48.15.232 Color_251ACI
N050.05.10.103 E019.48.15.232 N050.05.10.008 E019.48.13.889 Color_251ACI
N050.05.10.008 E019.48.13.889 N050.05.09.966 E019.48.13.197 Color_251ACI
N050.05.09.966 E019.48.13.197 N050.05.09.850 E019.48.12.556 Color_251ACI
N050.05.09.850 E019.48.12.556 N050.05.09.605 E019.48.11.694 Color_251ACI
N050.05.09.605 E019.48.11.694 N050.05.09.360 E019.48.10.833 Color_251ACI
N050.05.11.447 E019.48.20.899 N050.05.11.234 E019.48.21.390 Color_251ACI
N050.05.11.234 E019.48.21.390 N050.05.10.957 E019.48.21.890 Color_251ACI
N050.05.10.957 E019.48.21.890 N050.05.09.969 E019.48.23.533 Color_251ACI
N050.05.09.969 E019.48.23.533 N050.05.08.832 E019.48.25.039 Color_251ACI
N050.05.08.832 E019.48.25.039 N050.05.08.076 E019.48.25.869 Color_251ACI
N050.05.08.076 E019.48.25.869 N050.05.07.267 E019.48.26.668 Color_251ACI
N050.05.07.267 E019.48.26.668 N050.05.07.167 E019.48.26.703 Color_251ACI
N050.05.07.167 E019.48.26.703 N050.05.07.046 E019.48.26.820 Color_251ACI
N050.05.07.046 E019.48.26.820 N050.05.06.882 E019.48.26.864 Color_251ACI
N050.05.06.882 E019.48.26.864 N050.05.06.708 E019.48.26.950 Color_251ACI
N050.05.06.708 E019.48.26.950 N050.05.06.655 E019.48.26.918 Color_251ACI
N050.05.06.655 E019.48.26.918 N050.05.06.623 E019.48.26.803 Color_251ACI
N050.05.06.623 E019.48.26.803 N050.05.06.643 E019.48.26.720 Color_251ACI
N050.05.06.643 E019.48.26.720 N050.05.06.811 E019.48.26.536 Color_251ACI
N050.05.03.265 E019.47.51.543 N050.05.03.500 E019.47.52.446 Color_251ACI
N050.05.03.500 E019.47.52.446 N050.05.03.707 E019.47.53.333 Color_251ACI
N050.05.03.707 E019.47.53.333 N050.05.05.080 E019.47.58.397 Color_251ACI
N050.05.05.080 E019.47.58.397 N050.05.06.572 E019.48.03.344 Color_251ACI
N050.05.06.572 E019.48.03.344 N050.05.07.331 E019.48.05.706 Color_251ACI
N050.05.07.331 E019.48.05.706 N050.05.08.127 E019.48.08.042 Color_251ACI
N050.05.08.127 E019.48.08.042 N050.05.08.615 E019.48.09.526 Color_251ACI
N050.05.08.615 E019.48.09.526 N050.05.09.145 E019.48.11.084 Color_251ACI
N050.05.09.145 E019.48.11.084 N050.05.09.412 E019.48.12.102 Color_251ACI
N050.05.09.412 E019.48.12.102 N050.05.09.595 E019.48.13.212 Color_251ACI
N050.05.09.595 E019.48.13.212 N050.05.09.753 E019.48.14.546 Color_251ACI
N050.05.09.753 E019.48.14.546 N050.05.09.838 E019.48.15.930 Color_251ACI
N050.05.09.838 E019.48.15.930 N050.05.09.854 E019.48.16.606 Color_251ACI
N050.05.09.854 E019.48.16.606 N050.05.09.806 E019.48.17.292 Color_251ACI
N050.05.09.806 E019.48.17.292 N050.05.09.694 E019.48.18.605 Color_251ACI
N050.05.09.694 E019.48.18.605 N050.05.09.492 E019.48.19.912 Color_251ACI
N050.05.09.492 E019.48.19.912 N050.05.09.153 E019.48.21.280 Color_251ACI
N050.05.09.153 E019.48.21.280 N050.05.08.718 E019.48.22.541 Color_251ACI
N050.05.08.718 E019.48.22.541 N050.05.08.495 E019.48.23.073 Color_251ACI
N050.05.08.495 E019.48.23.073 N050.05.08.244 E019.48.23.589 Color_251ACI
N050.05.08.244 E019.48.23.589 N050.05.07.392 E019.48.24.933 Color_251ACI
N050.05.07.392 E019.48.24.933 N050.05.06.550 E019.48.26.235 Color_251ACI
N050.05.11.736 E019.48.21.216 N050.05.11.381 E019.48.21.907 Color_251ACI
N050.05.11.381 E019.48.21.907 N050.05.11.016 E019.48.22.639 Color_251ACI
N050.05.11.016 E019.48.22.639 N050.05.10.446 E019.48.23.582 Color_251ACI
N050.05.10.446 E019.48.23.582 N050.05.09.487 E019.48.24.862 Color_251ACI
N050.05.09.487 E019.48.24.862 N050.05.08.469 E019.48.26.010 Color_251ACI
N050.05.08.469 E019.48.26.010 N050.05.07.687 E019.48.26.825 Color_251ACI
N050.05.07.687 E019.48.26.825 N050.05.06.808 E019.48.27.534 Color_251ACI
N050.05.13.925 E019.48.16.820 N050.05.13.731 E019.48.16.989 Color_251ACI
N050.05.13.731 E019.48.16.989 N050.05.13.536 E019.48.17.776 Color_251ACI
N050.05.13.536 E019.48.17.776 N050.05.13.437 E019.48.18.050 Color_251ACI
N050.05.13.437 E019.48.18.050 N050.05.13.355 E019.48.18.381 Color_251ACI
N050.05.13.355 E019.48.18.381 N050.05.13.209 E019.48.18.722 Color_251ACI
N050.05.13.209 E019.48.18.722 N050.05.13.070 E019.48.19.162 Color_251ACI
N050.05.13.070 E019.48.19.162 N050.05.12.914 E019.48.19.544 Color_251ACI
N050.05.12.914 E019.48.19.544 N050.05.12.805 E019.48.19.860 Color_251ACI
N050.05.12.805 E019.48.19.860 N050.05.12.618 E019.48.20.366 Color_251ACI
N050.05.12.618 E019.48.20.366 N050.05.12.415 E019.48.20.815 Color_251ACI
N050.05.12.415 E019.48.20.815 N050.05.12.270 E019.48.21.156 Color_251ACI
N050.05.12.270 E019.48.21.156 N050.05.12.210 E019.48.21.644 Color_251ACI
N050.05.11.261 E019.48.20.787 N050.05.11.462 E019.48.20.717 Color_251ACI
N050.05.11.462 E019.48.20.717 N050.05.11.733 E019.48.20.119 Color_251ACI
N050.05.11.733 E019.48.20.119 N050.05.11.977 E019.48.19.504 Color_251ACI
N050.05.11.977 E019.48.19.504 N050.05.12.153 E019.48.19.039 Color_251ACI
N050.05.12.153 E019.48.19.039 N050.05.12.350 E019.48.18.490 Color_251ACI
N050.05.12.350 E019.48.18.490 N050.05.12.588 E019.48.17.777 Color_251ACI
N050.05.12.588 E019.48.17.777 N050.05.12.738 E019.48.17.295 Color_251ACI
N050.05.12.738 E019.48.17.295 N050.05.12.867 E019.48.16.897 Color_251ACI
N050.05.12.867 E019.48.16.897 N050.05.12.997 E019.48.16.499 Color_251ACI
N050.05.12.997 E019.48.16.499 N050.05.13.120 E019.48.16.002 Color_251ACI
N050.05.13.120 E019.48.16.002 N050.05.13.059 E019.48.15.632 Color_251ACI
N050.05.12.857 E019.48.16.939 N050.05.12.086 E019.48.14.998 Color_251ACI
N050.05.12.086 E019.48.14.998 N050.05.11.324 E019.48.13.015 Color_251ACI
N050.05.11.324 E019.48.13.015 N050.05.10.645 E019.48.11.320 Color_251ACI
N050.05.10.645 E019.48.11.320 N050.05.09.975 E019.48.09.584 Color_251ACI
N050.05.09.975 E019.48.09.584 N050.05.09.786 E019.48.08.993 Color_251ACI
N050.05.09.786 E019.48.08.993 N050.05.09.596 E019.48.08.403 Color_251ACI
N050.05.09.596 E019.48.08.403 N050.05.09.482 E019.48.08.001 Color_251ACI
N050.05.09.482 E019.48.08.001 N050.05.09.431 E019.48.07.589 Color_251ACI
N050.05.09.431 E019.48.07.589 N050.05.09.423 E019.48.07.251 Color_251ACI
N050.05.09.423 E019.48.07.251 N050.05.09.430 E019.48.06.731 Color_251ACI
N050.05.09.430 E019.48.06.731 N050.05.09.510 E019.48.06.161 Color_251ACI
N050.05.09.510 E019.48.06.161 N050.05.09.613 E019.48.05.746 Color_251ACI
N050.05.09.613 E019.48.05.746 N050.05.09.752 E019.48.05.307 Color_251ACI
N050.05.09.752 E019.48.05.307 N050.05.10.046 E019.48.04.864 Color_251ACI
N050.05.10.046 E019.48.04.864 N050.05.10.381 E019.48.04.495 Color_251ACI
N050.05.10.381 E019.48.04.495 N050.05.10.650 E019.48.04.276 Color_251ACI
N050.05.10.650 E019.48.04.276 N050.05.10.951 E019.48.04.171 Color_251ACI
N050.05.10.951 E019.48.04.171 N050.05.11.168 E019.48.04.159 Color_251ACI
N050.05.11.168 E019.48.04.159 N050.05.11.364 E019.48.04.230 Color_251ACI
N050.05.11.364 E019.48.04.230 N050.05.11.693 E019.48.04.380 Color_251ACI
N050.05.11.693 E019.48.04.380 N050.05.12.012 E019.48.04.572 Color_251ACI
N050.05.12.012 E019.48.04.572 N050.05.12.306 E019.48.04.988 Color_251ACI
N050.05.12.306 E019.48.04.988 N050.05.12.601 E019.48.05.403 Color_251ACI
N050.05.12.601 E019.48.05.403 N050.05.12.772 E019.48.05.697 Color_251ACI
N050.05.12.772 E019.48.05.697 N050.05.12.907 E019.48.06.016 Color_251ACI
N050.05.12.907 E019.48.06.016 N050.05.13.195 E019.48.06.951 Color_251ACI
N050.05.13.195 E019.48.06.951 N050.05.13.408 E019.48.07.937 Color_251ACI
N050.05.13.408 E019.48.07.937 N050.05.13.531 E019.48.08.677 Color_251ACI
N050.05.13.531 E019.48.08.677 N050.05.13.626 E019.48.09.401 Color_251ACI
N050.05.13.626 E019.48.09.401 N050.05.13.680 E019.48.10.910 Color_251ACI
N050.05.13.680 E019.48.10.910 N050.05.13.680 E019.48.12.387 Color_251ACI
N050.05.13.680 E019.48.12.387 N050.05.13.618 E019.48.13.254 Color_251ACI
N050.05.13.618 E019.48.13.254 N050.05.13.519 E019.48.14.147 Color_251ACI
N050.05.13.519 E019.48.14.147 N050.05.13.356 E019.48.15.049 Color_251ACI
N050.05.13.356 E019.48.15.049 N050.05.13.167 E019.48.15.935 Color_251ACI
N050.05.03.565 E019.47.50.580 N050.05.03.630 E019.47.50.810 Color_251ACI
N050.05.03.630 E019.47.50.810 N050.05.03.695 E019.47.51.040 Color_251ACI
N050.05.03.695 E019.47.51.040 N050.05.04.425 E019.47.53.765 Color_251ACI
N050.05.04.425 E019.47.53.765 N050.05.05.155 E019.47.56.490 Color_251ACI
N050.05.05.155 E019.47.56.490 N050.05.06.497 E019.48.01.060 Color_251ACI
N050.05.06.497 E019.48.01.060 N050.05.07.966 E019.48.05.612 Color_251ACI
N050.05.07.966 E019.48.05.612 N050.05.08.621 E019.48.07.530 Color_251ACI
N050.05.08.621 E019.48.07.530 N050.05.09.276 E019.48.09.448 Color_251ACI
N050.05.09.276 E019.48.09.448 N050.05.10.053 E019.48.11.488 Color_251ACI
N050.05.10.053 E019.48.11.488 N050.05.10.841 E019.48.13.486 Color_251ACI
N050.05.10.841 E019.48.13.486 N050.05.11.704 E019.48.15.673 Color_251ACI
N050.05.11.704 E019.48.15.673 N050.05.12.568 E019.48.17.860 Color_251ACI
N050.05.09.360 E019.48.10.833 N050.05.09.685 E019.48.11.742 Color_251ACI
N050.05.09.685 E019.48.11.742 N050.05.09.982 E019.48.12.636 Color_251ACI
N050.05.09.982 E019.48.12.636 N050.05.10.842 E019.48.14.963 Color_251ACI
N050.05.10.842 E019.48.14.963 N050.05.11.748 E019.48.17.223 Color_251ACI
N050.05.11.748 E019.48.17.223 N050.05.12.034 E019.48.17.919 Color_251ACI
N050.05.12.034 E019.48.17.919 N050.05.12.319 E019.48.18.615 Color_251ACI
N050.05.05.986 E019.48.26.658 N050.05.05.915 E019.48.26.330 Color_251ACI
N050.05.05.915 E019.48.26.330 N050.05.05.870 E019.48.26.017 Color_251ACI
N050.05.05.870 E019.48.26.017 N050.05.05.815 E019.48.25.746 Color_251ACI
N050.05.05.815 E019.48.25.746 N050.05.05.760 E019.48.25.474 Color_251ACI
N050.05.05.760 E019.48.25.474 N050.05.05.742 E019.48.25.178 Color_251ACI
N050.05.05.742 E019.48.25.178 N050.05.05.718 E019.48.24.782 Color_251ACI
N050.05.05.718 E019.48.24.782 N050.05.05.694 E019.48.24.387 Color_251ACI
N050.05.05.694 E019.48.24.387 N050.05.05.703 E019.48.23.488 Color_251ACI
N050.05.05.703 E019.48.23.488 N050.05.05.712 E019.48.22.588 Color_251ACI
N050.05.05.712 E019.48.22.588 N050.05.05.694 E019.48.20.196 Color_251ACI
N050.05.05.694 E019.48.20.196 N050.05.05.676 E019.48.17.804 Color_251ACI
N050.05.05.676 E019.48.17.804 N050.05.05.631 E019.48.16.015 Color_251ACI
N050.05.05.631 E019.48.16.015 N050.05.05.575 E019.48.14.268 Color_251ACI
N050.05.05.575 E019.48.14.268 N050.05.05.421 E019.48.12.794 Color_251ACI
N050.05.05.421 E019.48.12.794 N050.05.05.130 E019.48.11.380 Color_251ACI
N050.05.05.130 E019.48.11.380 N050.05.05.075 E019.48.11.109 Color_251ACI
N050.05.06.137 E019.48.03.129 N050.05.06.032 E019.48.05.400 Color_251ACI
N050.05.06.032 E019.48.05.400 N050.05.05.928 E019.48.07.670 Color_251ACI
N050.05.05.928 E019.48.07.670 N050.05.05.903 E019.48.07.893 Color_251ACI
N050.05.05.903 E019.48.07.893 N050.05.05.894 E019.48.08.174 Color_251ACI
N050.05.05.894 E019.48.08.174 N050.05.05.833 E019.48.08.423 Color_251ACI
N050.05.05.833 E019.48.08.423 N050.05.05.751 E019.48.08.754 Color_251ACI
N050.05.05.751 E019.48.08.754 N050.05.05.572 E019.48.08.980 Color_251ACI
N050.05.05.572 E019.48.08.980 N050.05.05.341 E019.48.09.174 Color_251ACI
N050.05.05.341 E019.48.09.174 N050.05.05.083 E019.48.09.352 Color_251ACI
N050.05.05.083 E019.48.09.352 N050.05.04.935 E019.48.09.454 Color_251ACI
N050.05.04.935 E019.48.09.454 N050.05.04.745 E019.48.09.482 Color_251ACI
N050.05.04.745 E019.48.09.482 N050.05.04.606 E019.48.09.303 Color_251ACI
N050.05.04.606 E019.48.09.303 N050.05.04.519 E019.48.08.917 Color_251ACI
N050.05.04.519 E019.48.08.917 N050.05.04.404 E019.48.08.515 Color_251ACI
N050.05.06.372 E019.48.03.414 N050.05.06.253 E019.48.05.247 Color_251ACI
N050.05.06.253 E019.48.05.247 N050.05.06.172 E019.48.07.055 Color_251ACI
N050.05.06.172 E019.48.07.055 N050.05.06.139 E019.48.07.559 Color_251ACI
N050.05.06.139 E019.48.07.559 N050.05.06.105 E019.48.08.063 Color_251ACI
N050.05.06.105 E019.48.08.063 N050.05.06.050 E019.48.08.410 Color_251ACI
N050.05.06.050 E019.48.08.410 N050.05.05.968 E019.48.08.742 Color_251ACI
N050.05.05.968 E019.48.08.742 N050.05.05.906 E019.48.08.990 Color_251ACI
N050.05.05.906 E019.48.08.990 N050.05.05.812 E019.48.09.124 Color_251ACI
N050.05.05.812 E019.48.09.124 N050.05.05.543 E019.48.09.343 Color_251ACI
N050.05.05.543 E019.48.09.343 N050.05.05.275 E019.48.09.563 Color_251ACI
N050.05.05.275 E019.48.09.563 N050.05.05.070 E019.48.09.773 Color_251ACI
N050.05.05.070 E019.48.09.773 N050.05.04.988 E019.48.10.104 Color_251ACI
N050.05.04.988 E019.48.10.104 N050.05.04.947 E019.48.10.270 Color_251ACI
N050.05.04.947 E019.48.10.270 N050.05.04.986 E019.48.10.484 Color_251ACI
N050.05.04.986 E019.48.10.484 N050.05.05.030 E019.48.10.796 Color_251ACI
N050.05.05.030 E019.48.10.796 N050.05.05.075 E019.48.11.109 Color_251ACI
N050.04.21.066 E019.48.23.324 N050.04.21.168 E019.48.22.910 Color_251ACI
N050.04.21.168 E019.48.22.910 N050.04.21.330 E019.48.22.627 Color_251ACI
N050.04.21.330 E019.48.22.627 N050.04.21.595 E019.48.22.548 Color_251ACI
N050.04.21.595 E019.48.22.548 N050.04.21.908 E019.48.22.641 Color_251ACI
N050.04.21.908 E019.48.22.641 N050.04.22.221 E019.48.22.734 Color_251ACI
N050.04.22.221 E019.48.22.734 N050.04.23.299 E019.48.23.193 Color_251ACI
N050.04.23.299 E019.48.23.193 N050.04.24.367 E019.48.23.693 Color_251ACI
N050.04.24.367 E019.48.23.693 N050.04.24.706 E019.48.23.802 Color_251ACI
N050.04.24.706 E019.48.23.802 N050.04.25.036 E019.48.23.953 Color_251ACI
N050.04.25.036 E019.48.23.953 N050.04.25.132 E019.48.24.058 Color_251ACI
N050.04.25.132 E019.48.24.058 N050.04.25.134 E019.48.24.297 Color_251ACI
N050.04.25.134 E019.48.24.297 N050.04.24.684 E019.48.25.741 Color_251ACI
N050.04.24.684 E019.48.25.741 N050.04.24.261 E019.48.27.201 Color_251ACI
N050.04.27.780 E019.48.26.938 N050.04.27.829 E019.48.26.492 Color_251ACI
N050.04.27.829 E019.48.26.492 N050.04.27.932 E019.48.26.077 Color_251ACI
N050.04.27.932 E019.48.26.077 N050.04.27.957 E019.48.25.854 Color_251ACI
N050.04.27.957 E019.48.25.854 N050.04.27.928 E019.48.25.599 Color_251ACI
N050.04.27.928 E019.48.25.599 N050.04.27.757 E019.48.25.305 Color_251ACI
N050.04.27.757 E019.48.25.305 N050.04.27.411 E019.48.25.097 Color_251ACI
N050.04.27.411 E019.48.25.097 N050.04.27.071 E019.48.24.988 Color_251ACI
N050.04.27.071 E019.48.24.988 N050.04.26.466 E019.48.24.719 Color_251ACI
N050.04.26.466 E019.48.24.719 N050.04.25.877 E019.48.24.507 Color_251ACI
N050.04.25.877 E019.48.24.507 N050.04.25.686 E019.48.24.535 Color_251ACI
N050.04.25.686 E019.48.24.535 N050.04.25.518 E019.48.24.719 Color_251ACI
N050.04.25.518 E019.48.24.719 N050.04.25.366 E019.48.24.961 Color_251ACI
N050.04.25.366 E019.48.24.961 N050.04.25.157 E019.48.25.312 Color_251ACI
N050.04.25.157 E019.48.25.312 N050.04.24.991 E019.48.25.735 Color_251ACI
N050.04.24.991 E019.48.25.735 N050.04.24.882 E019.48.26.051 Color_251ACI
N050.04.24.882 E019.48.26.051 N050.04.24.800 E019.48.26.382 Color_251ACI
N050.04.19.538 E019.48.36.262 N050.04.19.375 E019.48.35.688 Color_251ACI
N050.04.19.375 E019.48.35.688 N050.04.19.195 E019.48.35.056 Color_251ACI
N050.04.19.195 E019.48.35.056 N050.04.19.030 E019.48.34.242 Color_251ACI
N050.04.19.030 E019.48.34.242 N050.04.18.929 E019.48.33.419 Color_251ACI
N050.04.18.929 E019.48.33.419 N050.04.18.848 E019.48.32.513 Color_251ACI
N050.04.18.848 E019.48.32.513 N050.04.18.894 E019.48.31.589 Color_251ACI
N050.04.18.894 E019.48.31.589 N050.04.19.077 E019.48.30.604 Color_251ACI
N050.04.19.077 E019.48.30.604 N050.04.19.260 E019.48.29.619 Color_251ACI
N050.04.19.260 E019.48.29.619 N050.04.19.634 E019.48.27.987 Color_251ACI
N050.04.19.634 E019.48.27.987 N050.04.20.003 E019.48.26.256 Color_251ACI
N050.04.20.003 E019.48.26.256 N050.04.20.253 E019.48.25.121 Color_251ACI
N050.04.20.253 E019.48.25.121 N050.04.20.467 E019.48.24.012 Color_251ACI
N050.04.27.976 E019.48.27.009 N050.04.28.038 E019.48.26.760 Color_251ACI
N050.04.28.038 E019.48.26.760 N050.04.28.083 E019.48.26.454 Color_251ACI
N050.04.28.083 E019.48.26.454 N050.04.28.212 E019.48.26.056 Color_251ACI
N050.04.28.212 E019.48.26.056 N050.04.28.354 E019.48.25.855 Color_251ACI
N050.04.28.354 E019.48.25.855 N050.04.28.501 E019.48.25.754 Color_251ACI
N050.04.28.501 E019.48.25.754 N050.04.28.765 E019.48.25.674 Color_251ACI
N050.04.28.765 E019.48.25.674 N050.04.29.870 E019.48.26.149 Color_251ACI
N050.04.29.870 E019.48.26.149 N050.04.30.965 E019.48.26.665 Color_251ACI
N050.04.30.965 E019.48.26.665 N050.04.32.448 E019.48.27.463 Color_251ACI
N050.04.32.448 E019.48.27.463 N050.04.33.914 E019.48.28.203 Color_251ACI
N050.04.33.914 E019.48.28.203 N050.04.34.902 E019.48.28.655 Color_251ACI
N050.04.34.902 E019.48.28.655 N050.04.35.891 E019.48.29.107 Color_251ACI
N050.04.35.891 E019.48.29.107 N050.04.36.353 E019.48.29.338 Color_251ACI
N050.04.36.353 E019.48.29.338 N050.04.36.862 E019.48.29.502 Color_251ACI
N050.04.36.862 E019.48.29.502 N050.04.37.202 E019.48.29.611 Color_251ACI
N050.04.37.202 E019.48.29.611 N050.04.37.558 E019.48.29.778 Color_251ACI
N050.04.37.558 E019.48.29.778 N050.04.38.401 E019.48.29.952 Color_251ACI
N050.04.38.401 E019.48.29.952 N050.04.39.254 E019.48.30.085 Color_251ACI
N050.04.39.254 E019.48.30.085 N050.04.40.022 E019.48.30.071 Color_251ACI
N050.04.40.022 E019.48.30.071 N050.04.40.746 E019.48.29.983 Color_251ACI
N050.04.40.746 E019.48.29.983 N050.04.42.796 E019.48.29.360 Color_251ACI
N050.04.42.796 E019.48.29.360 N050.04.44.845 E019.48.28.737 Color_251ACI
N050.04.44.845 E019.48.28.737 N050.04.46.175 E019.48.28.300 Color_251ACI
N050.04.46.175 E019.48.28.300 N050.04.47.522 E019.48.27.921 Color_251ACI
N050.04.47.522 E019.48.27.921 N050.04.48.505 E019.48.27.655 Color_251ACI
N050.04.48.505 E019.48.27.655 N050.04.49.504 E019.48.27.447 Color_251ACI
N050.04.49.504 E019.48.27.447 N050.04.50.218 E019.48.27.401 Color_251ACI
N050.04.50.218 E019.48.27.401 N050.04.50.896 E019.48.27.380 Color_251ACI
N050.04.50.896 E019.48.27.380 N050.04.52.134 E019.48.27.316 Color_251ACI
N050.04.52.134 E019.48.27.316 N050.04.53.362 E019.48.27.294 Color_251ACI
N050.04.53.362 E019.48.27.294 N050.04.54.800 E019.48.27.160 Color_251ACI
N050.04.54.800 E019.48.27.160 N050.04.56.256 E019.48.27.084 Color_251ACI
N050.04.56.256 E019.48.27.084 N050.04.57.700 E019.48.27.049 Color_251ACI
N050.04.57.700 E019.48.27.049 N050.04.59.155 E019.48.26.973 Color_251ACI
N050.04.59.155 E019.48.26.973 N050.05.00.050 E019.48.26.940 Color_251ACI
N050.05.00.050 E019.48.26.940 N050.05.00.938 E019.48.26.809 Color_251ACI
N050.05.00.938 E019.48.26.809 N050.05.02.449 E019.48.26.385 Color_251ACI
N050.05.02.449 E019.48.26.385 N050.05.03.969 E019.48.25.920 Color_251ACI
N050.05.03.969 E019.48.25.920 N050.05.04.371 E019.48.25.780 Color_251ACI
N050.05.04.371 E019.48.25.780 N050.05.04.756 E019.48.25.584 Color_251ACI
N050.05.04.756 E019.48.25.584 N050.05.04.919 E019.48.25.539 Color_251ACI
N050.05.04.919 E019.48.25.539 N050.05.05.099 E019.48.25.553 Color_251ACI
N050.05.05.099 E019.48.25.553 N050.05.05.312 E019.48.25.681 Color_251ACI
N050.05.05.312 E019.48.25.681 N050.05.05.451 E019.48.25.860 Color_251ACI
N050.05.05.451 E019.48.25.860 N050.05.05.543 E019.48.26.105 Color_251ACI
N050.05.05.543 E019.48.26.105 N050.05.05.620 E019.48.26.533 Color_251ACI
N050.05.05.620 E019.48.26.533 N050.05.05.745 E019.48.26.894 Color_251ACI
N050.04.29.001 E019.48.25.340 N050.04.30.016 E019.48.25.808 Color_251ACI
N050.04.30.016 E019.48.25.808 N050.04.31.057 E019.48.26.292 Color_251ACI
N050.04.31.057 E019.48.26.292 N050.04.32.524 E019.48.27.033 Color_251ACI
N050.04.32.524 E019.48.27.033 N050.04.34.017 E019.48.27.789 Color_251ACI
N050.04.34.017 E019.48.27.789 N050.04.34.968 E019.48.28.266 Color_251ACI
N050.04.34.968 E019.48.28.266 N050.04.35.956 E019.48.28.718 Color_251ACI
N050.04.35.956 E019.48.28.718 N050.04.36.572 E019.48.28.946 Color_251ACI
N050.04.36.572 E019.48.28.946 N050.04.37.204 E019.48.29.232 Color_251ACI
N050.04.37.204 E019.48.29.232 N050.04.37.650 E019.48.29.405 Color_251ACI
N050.04.37.650 E019.48.29.405 N050.04.38.080 E019.48.29.521 Color_251ACI
N050.04.38.080 E019.48.29.521 N050.04.38.673 E019.48.29.593 Color_251ACI
N050.04.38.673 E019.48.29.593 N050.04.39.267 E019.48.29.664 Color_251ACI
N050.04.39.267 E019.48.29.664 N050.04.39.998 E019.48.29.675 Color_251ACI
N050.04.39.998 E019.48.29.675 N050.04.40.732 E019.48.29.547 Color_251ACI
N050.04.40.732 E019.48.29.547 N050.04.42.771 E019.48.28.965 Color_251ACI
N050.04.42.771 E019.48.28.965 N050.04.44.794 E019.48.28.325 Color_251ACI
N050.04.44.794 E019.48.28.325 N050.04.46.151 E019.48.27.905 Color_251ACI
N050.04.46.151 E019.48.27.905 N050.04.47.498 E019.48.27.525 Color_251ACI
N050.04.47.498 E019.48.27.525 N050.04.48.528 E019.48.27.193 Color_251ACI
N050.04.48.528 E019.48.27.193 N050.04.49.580 E019.48.27.017 Color_251ACI
N050.04.49.580 E019.48.27.017 N050.04.50.305 E019.48.26.929 Color_251ACI
N050.04.50.305 E019.48.26.929 N050.04.51.045 E019.48.26.899 Color_251ACI
N050.04.51.045 E019.48.26.899 N050.04.52.183 E019.48.26.870 Color_251ACI
N050.04.52.183 E019.48.26.870 N050.04.53.348 E019.48.26.857 Color_251ACI
N050.04.53.348 E019.48.26.857 N050.04.54.803 E019.48.26.781 Color_251ACI
N050.04.54.803 E019.48.26.781 N050.04.56.268 E019.48.26.663 Color_251ACI
N050.04.56.268 E019.48.26.663 N050.04.57.840 E019.48.26.610 Color_251ACI
N050.04.57.840 E019.48.26.610 N050.04.59.401 E019.48.26.597 Color_251ACI
N050.04.59.401 E019.48.26.597 N050.05.00.369 E019.48.26.514 Color_251ACI
N050.05.00.369 E019.48.26.514 N050.05.01.331 E019.48.26.331 Color_251ACI
N050.05.01.331 E019.48.26.331 N050.05.02.615 E019.48.25.961 Color_251ACI
N050.05.02.615 E019.48.25.961 N050.05.03.892 E019.48.25.492 Color_251ACI
N050.05.03.892 E019.48.25.492 N050.05.04.293 E019.48.25.353 Color_251ACI
N050.05.04.293 E019.48.25.353 N050.05.04.631 E019.48.25.223 Color_251ACI
N050.04.23.263 E019.48.22.600 N050.04.22.641 E019.48.22.273 Color_251ACI
N050.04.22.641 E019.48.22.273 N050.04.21.827 E019.48.21.735 Color_251ACI
N050.04.50.470 E019.48.31.315 N050.04.50.450 E019.48.31.398 Color_251ACI
N050.04.50.450 E019.48.31.398 N050.04.50.472 E019.48.31.554 Color_251ACI
N050.04.50.472 E019.48.31.554 N050.04.50.897 E019.48.34.524 Color_251ACI
N050.04.50.897 E019.48.34.524 N050.04.51.825 E019.48.41.131 Color_251ACI
N050.04.51.825 E019.48.41.131 N050.04.52.368 E019.48.44.981 Color_251ACI
N050.04.52.368 E019.48.44.981 N050.04.53.040 E019.48.49.910 Color_251ACI
N050.04.53.040 E019.48.49.910 N050.04.53.089 E019.48.50.083 Color_251ACI
N050.04.53.089 E019.48.50.083 N050.04.53.185 E019.48.50.188 Color_251ACI
N050.04.53.185 E019.48.50.188 N050.04.53.398 E019.48.50.316 Color_251ACI
N050.04.53.398 E019.48.50.316 N050.04.54.055 E019.48.50.378 Color_251ACI
N050.04.54.055 E019.48.50.378 N050.04.54.112 E019.48.50.889 Color_251ACI
N050.04.54.112 E019.48.50.889 N050.04.54.177 E019.48.51.119 Color_251ACI
N050.04.54.177 E019.48.51.119 N050.04.54.209 E019.48.51.233 Color_251ACI
N050.04.54.209 E019.48.51.233 N050.04.54.226 E019.48.51.291 Color_251ACI
N050.04.54.226 E019.48.51.291 N050.04.54.292 E019.48.50.902 Color_251ACI
N050.04.54.292 E019.48.50.902 N050.04.54.302 E019.48.50.861 Color_251ACI
N050.04.54.302 E019.48.50.861 N050.04.54.269 E019.48.50.746 Color_251ACI
N050.04.54.269 E019.48.50.746 N050.04.54.259 E019.48.50.787 Color_251ACI
N050.04.54.259 E019.48.50.787 N050.04.54.202 E019.48.50.277 Color_251ACI
N050.04.54.202 E019.48.50.277 N050.04.54.403 E019.48.50.207 Color_251ACI
N050.04.54.403 E019.48.50.207 N050.04.54.460 E019.48.50.717 Color_251ACI
N050.04.54.460 E019.48.50.717 N050.04.54.460 E019.48.50.717 Color_251ACI
N050.04.54.460 E019.48.50.717 N050.04.54.449 E019.48.50.759 Color_251ACI
N050.04.54.449 E019.48.50.759 N050.04.54.461 E019.48.50.957 Color_251ACI
N050.04.54.461 E019.48.50.957 N050.04.54.426 E019.48.51.221 Color_251ACI
N050.04.54.426 E019.48.51.221 N050.04.54.385 E019.48.51.387 Color_251ACI
N050.04.54.385 E019.48.51.387 N050.04.54.385 E019.48.51.387 Color_251ACI
N050.04.54.385 E019.48.51.387 N050.04.54.606 E019.48.51.234 Color_251ACI
N050.04.54.606 E019.48.51.234 N050.04.54.673 E019.48.51.703 Color_251ACI
N050.04.54.673 E019.48.51.703 N050.04.54.426 E019.48.51.840 Color_251ACI
N050.04.54.426 E019.48.51.840 N050.04.54.503 E019.48.52.267 Color_251ACI
N050.04.54.503 E019.48.52.267 N050.04.54.614 E019.48.52.191 Color_251ACI
N050.04.54.614 E019.48.52.191 N050.04.54.658 E019.48.52.504 Color_251ACI
N050.04.54.658 E019.48.52.504 N050.04.54.310 E019.48.52.675 Color_251ACI
N050.04.54.310 E019.48.52.675 N050.04.54.321 E019.48.52.634 Color_251ACI
N050.04.54.321 E019.48.52.634 N050.04.54.183 E019.48.52.694 Color_251ACI
N050.04.54.183 E019.48.52.694 N050.04.54.161 E019.48.52.538 Color_251ACI
N050.04.54.161 E019.48.52.538 N050.04.54.108 E019.48.52.506 Color_251ACI
N050.04.54.108 E019.48.52.506 N050.04.53.908 E019.48.51.338 Color_251ACI
N050.04.53.908 E019.48.51.338 N050.04.53.876 E019.48.51.223 Color_251ACI
N050.04.53.876 E019.48.51.223 N050.04.53.837 E019.48.51.009 Color_251ACI
N050.04.53.837 E019.48.51.009 N050.04.53.751 E019.48.50.862 Color_251ACI
N050.04.53.751 E019.48.50.862 N050.04.53.629 E019.48.50.741 Color_251ACI
N050.04.53.629 E019.48.50.741 N050.04.53.512 E019.48.50.718 Color_251ACI
N050.04.53.512 E019.48.50.718 N050.04.53.199 E019.48.50.625 Color_251ACI
N050.04.53.199 E019.48.50.625 N050.04.52.902 E019.48.50.589 Color_251ACI
N050.04.52.902 E019.48.50.589 N050.04.52.856 E019.48.50.037 Color_251ACI
N050.04.52.856 E019.48.50.037 N050.04.52.318 E019.48.46.047 Color_251ACI
N050.04.52.318 E019.48.46.047 N050.04.51.349 E019.48.38.987 Color_251ACI
N050.04.51.349 E019.48.38.987 N050.04.50.302 E019.48.31.499 Color_251ACI
N050.04.50.302 E019.48.31.499 N050.04.50.259 E019.48.31.426 Color_251ACI
N050.04.50.259 E019.48.31.426 N050.04.50.190 E019.48.31.336 Color_251ACI
N050.04.50.190 E019.48.31.336 N050.04.50.020 E019.48.31.282 Color_251ACI
N050.04.50.020 E019.48.31.282 N050.04.49.332 E019.48.31.344 Color_251ACI
N050.04.49.332 E019.48.31.344 N050.04.48.327 E019.48.31.453 Color_251ACI
N050.04.48.327 E019.48.31.453 N050.04.46.346 E019.48.31.927 Color_251ACI
N050.04.46.346 E019.48.31.927 N050.04.45.283 E019.48.32.144 Color_251ACI
N050.04.45.283 E019.48.32.144 N050.04.45.120 E019.48.32.188 Color_251ACI
N050.05.12.161 E019.48.21.472 N050.05.11.749 E019.48.22.271 Color_251ACI
N050.05.11.749 E019.48.22.271 N050.05.11.300 E019.48.23.096 Color_251ACI
N050.05.11.300 E019.48.23.096 N050.05.10.441 E019.48.24.341 Color_251ACI
N050.05.10.441 E019.48.24.341 N050.05.09.540 E019.48.25.512 Color_251ACI
N050.05.09.540 E019.48.25.512 N050.05.09.120 E019.48.25.974 Color_251ACI
N050.05.09.120 E019.48.25.974 N050.05.08.700 E019.48.26.435 Color_251ACI
N050.05.08.700 E019.48.26.435 N050.05.08.921 E019.48.26.283 Color_251ACI
N050.05.08.921 E019.48.26.283 N050.05.09.105 E019.48.26.156 Color_251ACI
N050.05.09.105 E019.48.26.156 N050.05.09.464 E019.48.25.943 Color_251ACI
N050.05.09.464 E019.48.25.943 N050.05.09.838 E019.48.25.787 Color_251ACI
N050.05.09.838 E019.48.25.787 N050.05.10.340 E019.48.25.613 Color_251ACI
N050.05.10.340 E019.48.25.613 N050.05.10.841 E019.48.25.439 Color_251ACI
N050.05.10.841 E019.48.25.439 N050.05.11.259 E019.48.25.357 Color_251ACI
N050.05.11.259 E019.48.25.357 N050.05.11.666 E019.48.25.317 Color_251ACI
N050.05.11.666 E019.48.25.317 N050.05.12.307 E019.48.25.321 Color_251ACI
N050.05.12.307 E019.48.25.321 N050.05.12.937 E019.48.25.368 Color_251ACI
N050.05.12.937 E019.48.25.368 N050.05.13.366 E019.48.25.483 Color_251ACI
N050.05.13.366 E019.48.25.483 N050.05.13.759 E019.48.25.625 Color_251ACI
N050.05.13.759 E019.48.25.625 N050.05.14.168 E019.48.25.823 Color_251ACI
N050.05.14.168 E019.48.25.823 N050.05.14.514 E019.48.26.032 Color_251ACI
N050.05.12.863 E019.48.19.751 N050.05.13.089 E019.48.20.316 Color_251ACI
N050.05.13.089 E019.48.20.316 N050.05.13.316 E019.48.20.881 Color_251ACI
N050.05.13.316 E019.48.20.881 N050.05.14.155 E019.48.22.673 Color_251ACI
N050.05.14.155 E019.48.22.673 N050.05.15.021 E019.48.24.480 Color_251ACI
N050.05.13.197 E019.48.19.143 N050.05.13.429 E019.48.19.807 Color_251ACI
N050.05.13.429 E019.48.19.807 N050.05.13.662 E019.48.20.471 Color_251ACI
N050.05.13.662 E019.48.20.471 N050.05.14.395 E019.48.22.198 Color_251ACI
N050.05.14.395 E019.48.22.198 N050.05.15.128 E019.48.23.925 Color_251ACI
N050.05.13.402 E019.48.18.314 N050.05.13.845 E019.48.19.486 Color_251ACI
N050.05.13.845 E019.48.19.486 N050.05.14.278 E019.48.20.699 Color_251ACI
N050.05.14.278 E019.48.20.699 N050.05.14.710 E019.48.21.912 Color_251ACI
N050.05.14.710 E019.48.21.912 N050.05.15.216 E019.48.23.074 Color_251ACI
N050.05.15.216 E019.48.23.074 N050.05.15.341 E019.48.23.434 Color_251ACI
N050.05.04.404 E019.48.08.515 N050.05.04.186 E019.48.07.669 Color_251ACI
N050.05.04.186 E019.48.07.669 N050.05.03.995 E019.48.06.839 Color_251ACI
N050.05.03.995 E019.48.06.839 N050.05.03.324 E019.48.04.245 Color_251ACI
N050.05.03.324 E019.48.04.245 N050.05.02.653 E019.48.01.651 Color_251ACI
N050.05.02.653 E019.48.01.651 N050.05.02.407 E019.48.00.550 Color_251ACI
N050.05.02.407 E019.48.00.550 N050.05.02.234 E019.47.59.398 Color_251ACI
N050.05.02.234 E019.47.59.398 N050.05.02.119 E019.47.58.138 Color_251ACI
N050.05.02.119 E019.47.58.138 N050.05.02.093 E019.47.56.885 Color_251ACI
N050.05.02.093 E019.47.56.885 N050.05.02.158 E019.47.55.638 Color_251ACI
N050.05.02.158 E019.47.55.638 N050.05.02.356 E019.47.54.471 Color_251ACI
N050.05.02.356 E019.47.54.471 N050.05.02.639 E019.47.53.451 Color_251ACI
N050.05.02.639 E019.47.53.451 N050.05.02.912 E019.47.52.473 Color_251ACI
N050.04.18.224 E019.46.24.278 N050.04.18.917 E019.46.24.315 Color_251ACI
N050.04.18.917 E019.46.24.315 N050.04.19.047 E019.46.21.821 Color_251ACI
N050.04.19.124 E019.46.24.344 N050.04.19.264 E019.46.21.809 Color_251ACI
N050.04.18.429 E019.46.52.164 N050.04.19.868 E019.47.01.888 Color_251ACI
N050.04.19.868 E019.47.01.888 N050.04.20.619 E019.47.06.625 Color_251ACI
N050.04.20.195 E019.48.13.895 N050.04.20.035 E019.48.13.799 Color_251ACI
N050.04.20.035 E019.48.13.799 N050.04.19.843 E019.48.13.588 Color_251ACI
N050.04.19.843 E019.48.13.588 N050.04.19.766 E019.48.13.161 Color_251ACI
N050.04.19.766 E019.48.13.161 N050.04.19.703 E019.48.12.552 Color_251ACI
N050.04.19.703 E019.48.12.552 N050.04.19.624 E019.48.11.885 Color_251ACI
N050.04.19.624 E019.48.11.885 N050.04.19.484 E019.48.10.848 Color_251ACI
N050.04.19.484 E019.48.10.848 N050.04.19.370 E019.48.09.827 Color_251ACI
N050.04.19.370 E019.48.09.827 N050.04.19.330 E019.48.09.374 Color_251ACI
N050.04.19.330 E019.48.09.374 N050.04.19.400 E019.48.08.226 Color_251ACI
N050.04.19.400 E019.48.08.226 N050.04.19.418 E019.48.07.046 Color_251ACI
N050.04.19.248 E019.48.06.992 N050.04.19.223 E019.48.07.215 Color_251ACI
N050.04.19.223 E019.48.07.215 N050.04.19.241 E019.48.07.512 Color_251ACI
N050.04.19.241 E019.48.07.512 N050.04.19.217 E019.48.07.735 Color_251ACI
N050.04.19.217 E019.48.07.735 N050.04.19.212 E019.48.07.875 Color_251ACI
N050.04.19.212 E019.48.07.875 N050.04.19.176 E019.48.07.901 Color_251ACI
N050.04.19.176 E019.48.07.901 N050.04.19.149 E019.48.07.885 Color_251ACI
N050.04.19.149 E019.48.07.885 N050.04.19.078 E019.48.07.556 Color_251ACI
N050.04.19.078 E019.48.07.556 N050.04.19.023 E019.48.07.285 Color_251ACI
N050.04.19.023 E019.48.07.285 N050.04.18.984 E019.48.07.071 Color_251ACI
N050.04.18.984 E019.48.07.071 N050.04.18.994 E019.48.07.029 Color_251ACI
N050.04.18.994 E019.48.07.029 N050.04.19.095 E019.48.06.995 Color_251ACI
N050.04.19.095 E019.48.06.995 N050.04.19.222 E019.48.06.976 Color_251ACI
N050.04.20.195 E019.48.13.895 N050.04.20.110 E019.48.13.130 Color_251ACI
N050.04.20.110 E019.48.13.130 N050.04.19.919 E019.48.13.158 Color_251ACI
N050.04.19.919 E019.48.13.158 N050.04.19.739 E019.48.11.668 Color_251ACI
N050.04.18.071 E019.48.06.807 N050.04.18.285 E019.48.08.412 Color_251ACI
N050.04.18.448 E019.48.08.368 N050.04.18.121 E019.48.08.456 Color_251ACI
N050.04.17.598 E019.48.07.237 N050.04.17.773 E019.48.08.627 Color_251ACI
N050.04.17.937 E019.48.08.583 N050.04.17.609 E019.48.08.672 Color_251ACI
N050.04.18.126 E019.48.07.078 N050.04.17.060 E019.48.07.436 Color_251ACI
N050.04.20.955 E019.48.21.924 N050.04.21.055 E019.48.21.889 Color_251ACI
N050.04.21.055 E019.48.21.889 N050.04.21.165 E019.48.21.813 Color_251ACI
N050.04.21.165 E019.48.21.813 N050.04.21.223 E019.48.21.705 Color_251ACI
N050.04.21.223 E019.48.21.705 N050.04.21.264 E019.48.21.539 Color_251ACI
N050.04.21.264 E019.48.21.539 N050.04.21.295 E019.48.21.415 Color_251ACI
N050.04.21.295 E019.48.21.415 N050.04.21.272 E019.48.21.258 Color_251ACI
N050.04.21.272 E019.48.21.258 N050.04.21.224 E019.48.21.086 Color_251ACI
N050.04.21.224 E019.48.21.086 N050.04.21.154 E019.48.20.997 Color_251ACI
N050.04.21.154 E019.48.20.997 N050.04.21.058 E019.48.20.891 Color_251ACI
N050.04.21.058 E019.48.20.891 N050.04.20.968 E019.48.20.885 Color_251ACI
N050.04.20.968 E019.48.20.885 N050.04.20.868 E019.48.20.919 Color_251ACI
N050.04.20.868 E019.48.20.919 N050.04.20.757 E019.48.20.996 Color_251ACI
N050.04.20.757 E019.48.20.996 N050.04.20.700 E019.48.21.104 Color_251ACI
N050.04.20.700 E019.48.21.104 N050.04.20.669 E019.48.21.228 Color_251ACI
N050.04.20.669 E019.48.21.228 N050.04.20.628 E019.48.21.394 Color_251ACI
N050.04.20.628 E019.48.21.394 N050.04.20.650 E019.48.21.550 Color_251ACI
N050.04.20.650 E019.48.21.550 N050.04.20.709 E019.48.21.681 Color_251ACI
N050.04.20.709 E019.48.21.681 N050.04.20.768 E019.48.21.812 Color_251ACI
N050.04.20.768 E019.48.21.812 N050.04.20.875 E019.48.21.876 Color_251ACI
N050.04.20.875 E019.48.21.876 N050.04.20.955 E019.48.21.924 Color_251ACI
N050.04.29.557 E019.48.12.008 N050.04.29.541 E019.48.11.950 Color_251ACI
N050.04.29.541 E019.48.11.950 N050.04.29.375 E019.48.11.756 Color_251ACI
N050.04.29.375 E019.48.11.756 N050.04.29.172 E019.48.11.586 Color_251ACI
N050.04.29.172 E019.48.11.586 N050.04.28.960 E019.48.11.458 Color_251ACI
N050.04.28.960 E019.48.11.458 N050.04.28.831 E019.48.11.238 Color_251ACI
N050.04.28.831 E019.48.11.238 N050.04.28.760 E019.48.10.909 Color_251ACI
N050.04.28.760 E019.48.10.909 N050.04.28.768 E019.48.10.628 Color_251ACI
N050.04.28.768 E019.48.10.628 N050.04.28.814 E019.48.10.322 Color_251ACI
N050.04.28.814 E019.48.10.322 N050.04.28.949 E019.48.10.023 Color_251ACI
N050.04.28.949 E019.48.10.023 N050.04.29.084 E019.48.09.723 Color_251ACI
N050.04.29.084 E019.48.09.723 N050.04.29.183 E019.48.09.449 Color_251ACI
N050.04.29.183 E019.48.09.449 N050.04.29.271 E019.48.09.217 Color_251ACI
N050.04.29.271 E019.48.09.217 N050.04.29.280 E019.48.08.936 Color_251ACI
N050.04.29.280 E019.48.08.936 N050.04.29.284 E019.48.08.796 Color_251ACI
N050.04.29.284 E019.48.08.796 N050.04.29.261 E019.48.08.639 Color_251ACI
N050.04.29.261 E019.48.08.639 N050.04.29.176 E019.48.08.493 Color_251ACI
N050.04.29.176 E019.48.08.493 N050.04.28.824 E019.48.08.186 Color_251ACI
N050.04.28.824 E019.48.08.186 N050.04.28.472 E019.48.07.879 Color_251ACI
N050.04.30.557 E019.48.10.562 N050.04.30.126 E019.48.10.207 Color_251ACI
N050.04.30.126 E019.48.10.207 N050.04.29.678 E019.48.09.795 Color_251ACI
N050.04.29.678 E019.48.09.795 N050.04.29.582 E019.48.09.689 Color_251ACI
N050.04.29.582 E019.48.09.689 N050.04.29.432 E019.48.09.552 Color_251ACI
N050.04.29.432 E019.48.09.552 N050.04.29.394 E019.48.09.338 Color_251ACI
N050.04.29.394 E019.48.09.338 N050.04.29.408 E019.48.09.156 Color_251ACI
N050.04.29.408 E019.48.09.156 N050.04.29.587 E019.48.08.930 Color_251ACI
N050.04.29.587 E019.48.08.930 N050.04.29.650 E019.48.08.921 Color_251ACI
N050.04.29.650 E019.48.08.921 N050.04.29.756 E019.48.08.985 Color_251ACI
N050.04.29.756 E019.48.08.985 N050.04.29.906 E019.48.09.123 Color_251ACI
N050.04.29.906 E019.48.09.123 N050.04.30.065 E019.48.09.219 Color_251ACI
N050.04.30.065 E019.48.09.219 N050.04.30.256 E019.48.09.190 Color_251ACI
N050.04.30.256 E019.48.09.190 N050.04.30.376 E019.48.09.073 Color_251ACI
N050.04.30.376 E019.48.09.073 N050.04.30.512 E019.48.08.773 Color_251ACI
N050.04.30.512 E019.48.08.773 N050.04.30.621 E019.48.08.458 Color_251ACI
N050.04.30.621 E019.48.08.458 N050.04.30.731 E019.48.08.382 Color_251ACI
N050.04.30.731 E019.48.08.382 N050.04.30.858 E019.48.08.363 Color_251ACI
N050.04.30.858 E019.48.08.363 N050.04.30.928 E019.48.08.452 Color_251ACI
N050.04.30.928 E019.48.08.452 N050.04.30.987 E019.48.08.583 Color_251ACI
N050.04.30.987 E019.48.08.583 N050.04.31.027 E019.48.09.036 Color_251ACI
N050.04.30.557 E019.48.10.562 N050.04.30.663 E019.48.10.627 Color_251ACI
N050.04.30.663 E019.48.10.627 N050.04.30.807 E019.48.10.665 Color_251ACI
N050.04.30.807 E019.48.10.665 N050.04.30.964 E019.48.10.522 Color_251ACI
N050.04.30.964 E019.48.10.522 N050.04.31.069 E019.48.10.347 Color_251ACI
N050.04.31.069 E019.48.10.347 N050.04.31.082 E019.48.09.926 Color_251ACI
N050.04.31.082 E019.48.09.926 N050.04.31.041 E019.48.09.473 Color_251ACI
N050.04.31.041 E019.48.09.473 N050.04.31.027 E019.48.09.036 Color_251ACI
N050.04.29.867 E019.48.08.909 N050.04.30.000 E019.48.08.989 Color_251ACI
N050.04.30.000 E019.48.08.989 N050.04.30.106 E019.48.09.053 Color_251ACI
N050.04.30.106 E019.48.09.053 N050.04.30.233 E019.48.09.034 Color_251ACI
N050.04.30.233 E019.48.09.034 N050.04.30.317 E019.48.08.942 Color_251ACI
N050.04.30.317 E019.48.08.942 N050.04.30.436 E019.48.08.585 Color_251ACI
N050.04.29.867 E019.48.08.909 N050.04.28.550 E019.48.07.687 Color_251ACI
N050.04.28.550 E019.48.07.687 N050.04.28.472 E019.48.07.879 Color_251ACI
N050.04.19.323 E019.48.14.085 N050.04.19.370 E019.48.14.018 Color_251ACI
N050.04.19.370 E019.48.14.018 N050.04.19.444 E019.48.13.967 Color_251ACI
N050.04.19.444 E019.48.13.967 N050.04.19.491 E019.48.13.900 Color_251ACI
N050.04.19.491 E019.48.13.900 N050.04.19.485 E019.48.13.801 Color_251ACI
N050.04.19.485 E019.48.13.801 N050.04.19.463 E019.48.13.645 Color_251ACI
N050.04.19.463 E019.48.13.645 N050.04.19.246 E019.48.11.562 Color_251ACI
N050.04.19.246 E019.48.11.562 N050.04.18.992 E019.48.09.504 Color_251ACI
N050.04.18.992 E019.48.09.504 N050.04.18.951 E019.48.09.051 Color_251ACI
N050.04.18.951 E019.48.09.051 N050.04.18.935 E019.48.08.994 Color_251ACI
N050.04.18.935 E019.48.08.994 N050.04.18.855 E019.48.08.946 Color_251ACI
N050.04.18.855 E019.48.08.946 N050.04.18.802 E019.48.08.914 Color_251ACI
N050.04.18.802 E019.48.08.914 N050.04.18.739 E019.48.08.923 Color_251ACI
N050.04.18.523 E019.48.09.175 N050.04.18.222 E019.48.09.279 Color_251ACI
N050.04.19.057 E019.48.13.924 N050.04.18.729 E019.48.14.013 Color_251ACI
N050.04.18.539 E019.48.14.041 N050.04.18.238 E019.48.14.146 Color_251ACI
N050.04.18.011 E019.48.09.390 N050.04.17.700 E019.48.09.536 Color_251ACI
N050.04.17.501 E019.48.09.845 N050.04.17.174 E019.48.09.933 Color_251ACI
N050.04.18.037 E019.48.14.215 N050.04.17.699 E019.48.14.345 Color_251ACI
N050.04.18.503 E019.48.14.924 N050.04.18.724 E019.48.16.867 Color_251ACI
N050.04.18.724 E019.48.16.867 N050.04.18.743 E019.48.17.164 Color_251ACI
N050.04.18.743 E019.48.17.164 N050.04.18.781 E019.48.17.378 Color_251ACI
N050.04.18.781 E019.48.17.378 N050.04.19.077 E019.48.18.651 Color_251ACI
N050.04.17.975 E019.48.15.083 N050.04.18.265 E019.48.17.734 Color_251ACI
N050.04.19.158 E019.48.14.747 N050.04.18.857 E019.48.14.852 Color_251ACI
N050.04.19.971 E019.48.19.237 N050.04.19.649 E019.48.19.424 Color_251ACI
N050.04.19.214 E019.48.18.590 N050.04.18.929 E019.48.18.752 Color_251ACI
N050.04.18.667 E019.48.14.880 N050.04.18.340 E019.48.14.969 Color_251ACI
N050.04.18.139 E019.48.15.038 N050.04.17.811 E019.48.15.127 Color_251ACI
N050.04.18.429 E019.48.17.689 N050.04.18.101 E019.48.17.778 Color_251ACI
N050.04.17.093 E019.48.13.218 N050.04.17.497 E019.48.16.271 Color_251ACI
N050.04.17.638 E019.48.16.070 N050.04.17.319 E019.48.16.497 Color_251ACI
N050.04.17.287 E019.48.13.050 N050.04.16.941 E019.48.13.460 Color_251ACI
N050.04.31.140 E019.47.54.532 N050.04.30.991 E019.47.54.395 Color_251ACI
N050.04.30.991 E019.47.54.395 N050.04.30.246 E019.47.54.565 Color_251ACI
N050.04.30.246 E019.47.54.565 N050.04.30.234 E019.47.54.367 Color_251ACI
N050.04.30.234 E019.47.54.367 N050.04.30.915 E019.47.54.206 Color_251ACI
N050.04.30.915 E019.47.54.206 N050.04.30.950 E019.47.53.942 Color_251ACI
N050.04.27.639 E019.45.53.089 N050.04.27.412 E019.45.53.143 Color_251ACI
N050.04.27.412 E019.45.53.143 N050.04.27.441 E019.45.53.398 Color_251ACI
N050.04.27.441 E019.45.53.398 N050.04.27.668 E019.45.53.344 Color_251ACI
N050.04.27.668 E019.45.53.344 N050.04.27.639 E019.45.53.089 Color_251ACI
N050.04.19.060 E019.48.06.641 N050.04.18.986 E019.48.06.691 Color_251ACI
N050.04.18.986 E019.48.06.691 N050.04.18.896 E019.48.06.685 Color_251ACI
N050.04.18.896 E019.48.06.685 N050.04.18.837 E019.48.06.554 Color_251ACI
N050.04.18.837 E019.48.06.554 N050.04.18.797 E019.48.06.101 Color_251ACI
N050.04.18.797 E019.48.06.101 N050.04.18.756 E019.48.05.648 Color_251ACI
N050.04.18.756 E019.48.05.648 N050.04.18.744 E019.48.05.450 Color_251ACI
N050.04.18.744 E019.48.05.450 N050.04.18.785 E019.48.05.285 Color_251ACI
N050.04.18.785 E019.48.05.285 N050.04.18.751 E019.48.04.930 Color_251ACI
N050.04.18.751 E019.48.04.930 N050.04.18.679 E019.48.04.602 Color_251ACI
N050.04.18.679 E019.48.04.602 N050.04.18.550 E019.48.03.524 Color_251ACI
N050.04.18.550 E019.48.03.524 N050.04.18.393 E019.48.02.429 Color_251ACI
N050.04.18.393 E019.48.02.429 N050.04.18.265 E019.48.01.590 Color_251ACI
N050.04.18.265 E019.48.01.590 N050.04.18.147 E019.48.00.710 Color_251ACI
N050.04.18.147 E019.48.00.710 N050.04.18.086 E019.48.00.340 Color_251ACI
N050.04.18.086 E019.48.00.340 N050.04.18.074 E019.48.00.142 Color_251ACI
N050.04.18.074 E019.48.00.142 N050.04.18.031 E019.48.00.068 Color_251ACI
N050.04.18.031 E019.48.00.068 N050.04.17.945 E019.47.59.922 Color_251ACI
N050.04.17.945 E019.47.59.922 N050.04.17.929 E019.47.59.864 Color_251ACI
N050.04.17.929 E019.47.59.864 N050.04.17.991 E019.47.59.616 Color_251ACI
N050.04.17.991 E019.47.59.616 N050.04.18.011 E019.47.59.533 Color_251ACI
N050.04.18.011 E019.47.59.533 N050.04.18.075 E019.47.59.523 Color_251ACI
N050.04.18.075 E019.47.59.523 N050.04.18.091 E019.47.59.581 Color_251ACI
N050.04.18.091 E019.47.59.581 N050.04.18.160 E019.47.59.670 Color_251ACI
N050.04.18.160 E019.47.59.670 N050.04.18.203 E019.47.59.744 Color_251ACI
N050.04.18.203 E019.47.59.744 N050.04.18.215 E019.47.59.941 Color_251ACI
N050.04.18.215 E019.47.59.941 N050.04.18.579 E019.48.02.541 Color_251ACI
N050.04.18.579 E019.48.02.541 N050.04.18.906 E019.48.05.167 Color_251ACI
N050.04.18.906 E019.48.05.167 N050.04.18.977 E019.48.05.495 Color_251ACI
N050.04.18.977 E019.48.05.495 N050.04.19.022 E019.48.05.808 Color_251ACI
N050.04.19.022 E019.48.05.808 N050.04.19.055 E019.48.05.923 Color_251ACI
N050.04.19.055 E019.48.05.923 N050.04.19.130 E019.48.06.111 Color_251ACI
N050.04.19.130 E019.48.06.111 N050.04.19.206 E019.48.06.300 Color_251ACI
N050.04.19.206 E019.48.06.300 N050.04.19.218 E019.48.06.497 Color_251ACI
N050.04.19.218 E019.48.06.497 N050.04.19.197 E019.48.06.580 Color_251ACI
N050.04.19.197 E019.48.06.580 N050.04.19.161 E019.48.06.606 Color_251ACI
N050.04.19.161 E019.48.06.606 N050.04.19.060 E019.48.06.641 Color_251ACI
N050.04.19.470 E019.48.14.602 N050.04.19.466 E019.48.14.742 Color_251ACI
N050.04.19.466 E019.48.14.742 N050.04.19.375 E019.48.14.735 Color_251ACI
N050.04.19.375 E019.48.14.735 N050.04.19.380 E019.48.14.595 Color_251ACI
N050.04.19.380 E019.48.14.595 N050.04.19.470 E019.48.14.602 Color_251ACI
N050.04.22.667 E019.48.22.289 N050.04.22.641 E019.48.22.273 Color_251ACI
N050.04.22.641 E019.48.22.273 N050.04.21.827 E019.48.21.735 Color_251ACI
N050.04.24.329 E019.47.29.621 N050.04.24.594 E019.47.31.019 Color_251ACI
N050.04.24.594 E019.47.31.019 N050.04.24.924 E019.47.32.646 Color_251ACI
N050.04.24.976 E019.47.29.106 N050.04.24.776 E019.47.29.176 Color_251ACI
N050.04.24.776 E019.47.29.176 N050.04.24.290 E019.47.29.408 Color_251ACI
N050.04.24.329 E019.47.29.621 N050.04.24.952 E019.47.29.330 Color_251ACI
N050.04.24.952 E019.47.29.330 N050.04.26.518 E019.47.28.558 Color_251ACI
N050.04.25.444 E019.48.23.294 N050.04.25.495 E019.48.23.087 Color_251ACI
N050.04.25.495 E019.48.23.087 N050.04.25.489 E019.48.22.988 Color_251ACI
N050.04.25.489 E019.48.22.988 N050.04.25.440 E019.48.22.815 Color_251ACI
N050.04.25.440 E019.48.22.815 N050.04.25.387 E019.48.22.783 Color_251ACI
N050.04.25.387 E019.48.22.783 N050.04.24.016 E019.48.22.148 Color_251ACI
N050.04.24.016 E019.48.22.148 N050.04.23.937 E019.48.22.100 Color_251ACI
N050.04.23.937 E019.48.22.100 N050.04.23.873 E019.48.22.110 Color_251ACI
N050.04.23.873 E019.48.22.110 N050.04.23.826 E019.48.22.177 Color_251ACI
N050.04.23.826 E019.48.22.177 N050.04.23.779 E019.48.22.244 Color_251ACI
N050.04.23.779 E019.48.22.244 N050.04.23.748 E019.48.22.368 Color_251ACI
N050.04.23.748 E019.48.22.368 N050.04.23.744 E019.48.22.508 Color_251ACI
N050.04.23.744 E019.48.22.508 N050.04.23.729 E019.48.22.690 Color_251ACI
N050.04.23.729 E019.48.22.690 N050.04.23.752 E019.48.22.846 Color_251ACI
N050.04.23.752 E019.48.22.846 N050.04.23.741 E019.48.22.888 Color_251ACI
N050.04.47.451 E019.45.48.494 N050.04.47.302 E019.45.48.356 Color_251ACI
N050.04.47.302 E019.45.48.356 N050.04.47.291 E019.45.46.921 Color_251ACI
N050.04.46.160 E019.45.48.526 N050.04.46.275 E019.45.48.309 Color_251ACI
N050.04.46.275 E019.45.48.309 N050.04.46.219 E019.45.46.562 Color_251ACI
N050.04.46.778 E019.45.48.374 N050.04.46.823 E019.45.50.163 Color_251ACI
N050.04.46.823 E019.45.50.163 N050.04.46.869 E019.45.51.953 Color_251ACI
N050.04.46.869 E019.45.51.953 N050.04.46.956 E019.45.54.434 Color_251ACI
N050.04.46.956 E019.45.54.434 N050.04.47.107 E019.45.56.906 Color_251ACI
N050.04.47.107 E019.45.56.906 N050.04.47.349 E019.46.00.861 Color_251ACI
N050.04.47.349 E019.46.00.861 N050.04.47.691 E019.46.04.781 Color_251ACI
N050.04.47.691 E019.46.04.781 N050.04.48.204 E019.46.09.614 Color_251ACI
N050.04.48.204 E019.46.09.614 N050.04.48.807 E019.46.14.453 Color_251ACI
N050.04.48.807 E019.46.14.453 N050.04.49.558 E019.46.20.049 Color_251ACI
N050.04.49.558 E019.46.20.049 N050.04.50.310 E019.46.25.644 Color_251ACI
N050.04.50.310 E019.46.25.644 N050.04.50.728 E019.46.28.516 Color_251ACI
N050.04.50.728 E019.46.28.516 N050.04.51.121 E019.46.31.371 Color_251ACI
N050.04.51.121 E019.46.31.371 N050.04.52.612 E019.46.41.745 Color_251ACI
N050.04.52.612 E019.46.41.745 N050.04.54.088 E019.46.52.063 Color_251ACI
N050.04.54.088 E019.46.52.063 N050.04.55.364 E019.47.01.212 Color_251ACI
N050.04.55.364 E019.47.01.212 N050.04.56.676 E019.47.10.336 Color_251ACI
N050.04.56.676 E019.47.10.336 N050.04.58.131 E019.47.20.736 Color_251ACI
N050.04.58.131 E019.47.20.736 N050.04.59.606 E019.47.31.053 Color_251ACI
N050.04.59.606 E019.47.31.053 N050.05.00.233 E019.47.34.812 Color_251ACI
N050.05.00.233 E019.47.34.812 N050.05.00.896 E019.47.38.544 Color_251ACI
N050.05.00.896 E019.47.38.544 N050.05.01.222 E019.47.40.312 Color_251ACI
N050.05.01.222 E019.47.40.312 N050.05.01.595 E019.47.42.013 Color_251ACI
N050.05.01.595 E019.47.42.013 N050.05.01.992 E019.47.44.109 Color_251ACI
N050.05.01.992 E019.47.44.109 N050.05.02.479 E019.47.46.212 Color_251ACI
N050.05.02.479 E019.47.46.212 N050.05.02.937 E019.47.48.059 Color_251ACI
N050.05.02.937 E019.47.48.059 N050.05.03.379 E019.47.49.850 Color_251ACI
N050.04.39.248 E019.45.48.793 N050.04.39.366 E019.45.47.578 Color_251ACI
N050.04.39.366 E019.45.47.578 N050.04.39.484 E019.45.46.363 Color_251ACI
N050.04.39.484 E019.45.46.363 N050.04.39.666 E019.45.44.520 Color_251ACI
N050.04.39.666 E019.45.44.520 N050.04.39.858 E019.45.42.636 Color_251ACI
N050.04.39.209 E019.45.49.198 N050.04.38.226 E019.45.49.463 Color_251ACI
N050.04.38.226 E019.45.49.463 N050.04.37.244 E019.45.49.729 Color_251ACI
N050.04.37.244 E019.45.49.729 N050.04.37.000 E019.45.49.725 Color_251ACI
N050.04.37.000 E019.45.49.725 N050.04.36.746 E019.45.49.763 Color_251ACI
N050.04.36.746 E019.45.49.763 N050.04.36.075 E019.45.49.882 Color_251ACI
N050.04.36.075 E019.45.49.882 N050.04.35.430 E019.45.50.018 Color_251ACI
N050.04.35.430 E019.45.50.018 N050.04.34.118 E019.45.50.133 Color_251ACI
N050.04.34.118 E019.45.50.133 N050.04.32.796 E019.45.50.289 Color_251ACI
N050.04.32.796 E019.45.50.289 N050.04.32.104 E019.45.50.491 Color_251ACI
N050.04.32.104 E019.45.50.491 N050.04.31.412 E019.45.50.694 Color_251ACI
N050.04.31.412 E019.45.50.694 N050.04.30.921 E019.45.50.826 Color_251ACI
N050.04.30.921 E019.45.50.826 N050.04.30.386 E019.45.50.886 Color_251ACI
N050.04.30.386 E019.45.50.886 N050.04.29.666 E019.45.50.833 Color_251ACI
N050.04.29.666 E019.45.50.833 N050.04.28.929 E019.45.50.723 Color_251ACI
N050.04.28.929 E019.45.50.723 N050.04.28.235 E019.45.50.686 Color_251ACI
N050.04.28.235 E019.45.50.686 N050.04.27.548 E019.45.50.748 Color_251ACI
N050.04.27.548 E019.45.50.748 N050.04.27.357 E019.45.50.776 Color_251ACI
N050.04.27.357 E019.45.50.776 N050.04.27.167 E019.45.50.804 Color_251ACI
N050.04.26.501 E019.45.51.023 N050.04.26.667 E019.45.51.218 Color_251ACI
N050.04.26.667 E019.45.51.218 N050.04.26.765 E019.45.51.562 Color_251ACI
N050.04.26.765 E019.45.51.562 N050.04.26.777 E019.45.51.760 Color_251ACI
N050.04.27.167 E019.45.50.804 N050.04.27.046 E019.45.50.922 Color_251ACI
N050.04.27.046 E019.45.50.922 N050.04.26.931 E019.45.51.139 Color_251ACI
N050.04.26.931 E019.45.51.139 N050.04.26.912 E019.45.51.461 Color_251ACI
N050.04.26.912 E019.45.51.461 N050.04.26.941 E019.45.51.716 Color_251ACI
N050.04.47.309 E019.45.47.837 N050.04.47.515 E019.45.47.866 Color_251ACI
N050.04.47.515 E019.45.47.866 N050.04.47.695 E019.45.47.879 Color_251ACI
N050.04.47.695 E019.45.47.879 N050.04.47.902 E019.45.47.908 Color_251ACI
N050.04.47.902 E019.45.47.908 N050.04.48.125 E019.45.47.995 Color_251ACI
N050.04.48.125 E019.45.47.995 N050.04.48.305 E019.45.48.008 Color_251ACI
N050.04.48.305 E019.45.48.008 N050.04.48.624 E019.45.48.200 Color_251ACI
N050.04.48.624 E019.45.48.200 N050.04.48.774 E019.45.48.338 Color_251ACI
N050.04.47.301 E019.45.47.499 N050.04.47.518 E019.45.47.486 Color_251ACI
N050.04.47.518 E019.45.47.486 N050.04.47.724 E019.45.47.516 Color_251ACI
N050.04.47.724 E019.45.47.516 N050.04.47.958 E019.45.47.561 Color_251ACI
N050.04.47.958 E019.45.47.561 N050.04.48.154 E019.45.47.631 Color_251ACI
N050.04.48.154 E019.45.47.631 N050.04.48.377 E019.45.47.718 Color_251ACI
N050.04.48.377 E019.45.47.718 N050.04.48.696 E019.45.47.910 Color_251ACI
N050.04.48.696 E019.45.47.910 N050.04.48.856 E019.45.48.006 Color_251ACI
N050.04.46.271 E019.45.47.831 N050.04.46.064 E019.45.47.802 Color_251ACI
N050.04.46.064 E019.45.47.802 N050.04.45.530 E019.45.47.861 Color_251ACI
N050.04.45.530 E019.45.47.861 N050.04.45.006 E019.45.47.879 Color_251ACI
N050.04.45.006 E019.45.47.879 N050.04.43.817 E019.45.48.115 Color_251ACI
N050.04.43.817 E019.45.48.115 N050.04.42.644 E019.45.48.409 Color_251ACI
N050.04.42.644 E019.45.48.409 N050.04.41.254 E019.45.48.715 Color_251ACI
N050.04.41.254 E019.45.48.715 N050.04.39.854 E019.45.49.062 Color_251ACI
N050.04.39.854 E019.45.49.062 N050.04.39.627 E019.45.49.116 Color_251ACI
N050.04.39.627 E019.45.49.116 N050.04.39.399 E019.45.49.170 Color_251ACI
N050.04.39.399 E019.45.49.170 N050.04.39.183 E019.45.49.182 Color_251ACI
N050.04.46.263 E019.45.47.493 N050.04.46.083 E019.45.47.480 Color_251ACI
N050.04.46.083 E019.45.47.480 N050.04.45.660 E019.45.47.463 Color_251ACI
N050.04.45.660 E019.45.47.463 N050.04.45.236 E019.45.47.446 Color_251ACI
N050.04.45.236 E019.45.47.446 N050.04.44.210 E019.45.47.638 Color_251ACI
N050.04.44.210 E019.45.47.638 N050.04.43.201 E019.45.47.887 Color_251ACI
N050.04.43.201 E019.45.47.887 N050.04.42.028 E019.45.48.181 Color_251ACI
N050.04.42.028 E019.45.48.181 N050.04.40.839 E019.45.48.417 Color_251ACI
N050.04.40.839 E019.45.48.417 N050.04.40.348 E019.45.48.550 Color_251ACI
N050.04.40.348 E019.45.48.550 N050.04.39.867 E019.45.48.641 Color_251ACI
N050.04.39.867 E019.45.48.641 N050.04.39.740 E019.45.48.660 Color_251ACI
N050.04.39.740 E019.45.48.660 N050.04.39.611 E019.45.48.440 Color_251ACI
N050.04.39.611 E019.45.48.440 N050.04.39.613 E019.45.48.060 Color_251ACI
N050.04.39.613 E019.45.48.060 N050.04.39.657 E019.45.47.515 Color_251ACI
N050.04.39.657 E019.45.47.515 N050.04.39.717 E019.45.47.027 Color_251ACI
N050.04.39.717 E019.45.47.027 N050.04.39.895 E019.45.45.325 Color_251ACI
N050.04.39.895 E019.45.45.325 N050.04.40.035 E019.45.43.648 Color_251ACI
N050.04.40.035 E019.45.43.648 N050.04.40.095 E019.45.43.160 Color_251ACI
N050.04.40.095 E019.45.43.160 N050.04.40.118 E019.45.42.697 Color_251ACI
N050.05.09.083 E019.48.07.761 N050.05.08.714 E019.48.06.538 Color_251ACI
N050.05.08.714 E019.48.06.538 N050.05.08.334 E019.48.05.357 Color_251ACI
N050.05.08.334 E019.48.05.357 N050.05.07.690 E019.48.03.398 Color_251ACI
N050.05.07.690 E019.48.03.398 N050.05.07.045 E019.48.01.438 Color_251ACI
N050.05.07.045 E019.48.01.438 N050.05.06.264 E019.47.58.920 Color_251ACI
N050.05.06.264 E019.47.58.920 N050.05.05.520 E019.47.56.376 Color_251ACI
N050.05.05.520 E019.47.56.376 N050.05.05.275 E019.47.55.515 Color_251ACI
N050.05.05.275 E019.47.55.515 N050.05.05.030 E019.47.54.653 Color_251ACI
N050.05.09.083 E019.48.07.761 N050.05.09.053 E019.48.07.266 Color_251ACI
N050.05.09.053 E019.48.07.266 N050.05.09.053 E019.48.06.648 Color_251ACI
N050.05.09.053 E019.48.06.648 N050.05.09.154 E019.48.05.994 Color_251ACI
N050.05.09.154 E019.48.05.994 N050.05.09.261 E019.48.05.439 Color_251ACI
N050.05.09.261 E019.48.05.439 N050.05.09.464 E019.48.04.990 Color_251ACI
N050.05.09.464 E019.48.04.990 N050.05.09.815 E019.48.04.439 Color_251ACI
N050.05.09.815 E019.48.04.439 N050.05.10.224 E019.48.04.019 Color_251ACI
N050.05.10.224 E019.48.04.019 N050.05.10.566 E019.48.03.749 Color_251ACI
N050.05.10.566 E019.48.03.749 N050.05.10.904 E019.48.03.619 Color_251ACI
N050.05.10.904 E019.48.03.619 N050.05.11.184 E019.48.03.598 Color_251ACI
N050.05.11.184 E019.48.03.598 N050.05.11.444 E019.48.03.659 Color_251ACI
N050.05.11.444 E019.48.03.659 N050.05.11.827 E019.48.03.842 Color_251ACI
N050.05.11.827 E019.48.03.842 N050.05.12.189 E019.48.04.107 Color_251ACI
N050.05.12.189 E019.48.04.107 N050.05.12.546 E019.48.04.513 Color_251ACI
N050.05.12.546 E019.48.04.513 N050.05.12.847 E019.48.05.027 Color_251ACI
N050.05.12.847 E019.48.05.027 N050.05.13.045 E019.48.05.337 Color_251ACI
N050.05.13.045 E019.48.05.337 N050.05.13.222 E019.48.05.730 Color_251ACI
N050.05.13.222 E019.48.05.730 N050.05.13.353 E019.48.06.189 Color_251ACI
N050.05.13.353 E019.48.06.189 N050.05.13.477 E019.48.06.550 Color_251ACI
N050.04.20.421 E019.48.37.508 N050.04.21.267 E019.48.37.303 Color_251ACI
N050.04.21.267 E019.48.37.303 N050.04.22.112 E019.48.37.098 Color_251ACI
N050.04.22.112 E019.48.37.098 N050.04.23.021 E019.48.36.883 Color_251ACI
N050.04.23.021 E019.48.36.883 N050.04.23.914 E019.48.36.611 Color_251ACI
N050.04.23.914 E019.48.36.611 N050.04.25.097 E019.48.36.276 Color_251ACI
N050.04.25.097 E019.48.36.276 N050.04.26.281 E019.48.35.941 Color_251ACI
N050.04.26.281 E019.48.35.941 N050.04.26.407 E019.48.35.922 Color_251ACI
N050.04.26.407 E019.48.35.922 N050.04.26.678 E019.48.35.941 Color_251ACI
N050.04.26.678 E019.48.35.941 N050.04.26.901 E019.48.36.028 Color_251ACI
N050.04.26.901 E019.48.36.028 N050.04.27.203 E019.48.36.163 Color_251ACI
N050.04.27.203 E019.48.36.163 N050.04.27.475 E019.48.36.422 Color_251ACI
N050.04.27.475 E019.48.36.422 N050.04.27.710 E019.48.36.706 Color_251ACI
N050.04.27.710 E019.48.36.706 N050.04.27.888 E019.48.37.099 Color_251ACI
N050.04.27.888 E019.48.37.099 N050.04.28.007 E019.48.37.361 Color_251ACI
N050.04.28.007 E019.48.37.361 N050.04.28.078 E019.48.37.689 Color_251ACI
N050.04.28.078 E019.48.37.689 N050.04.28.096 E019.48.37.986 Color_251ACI
N050.04.28.096 E019.48.37.986 N050.04.28.124 E019.48.38.241 Color_251ACI
N050.04.28.124 E019.48.38.241 N050.04.28.116 E019.48.38.522 Color_251ACI
N050.04.28.116 E019.48.38.522 N050.04.28.071 E019.48.38.828 Color_251ACI
N050.04.28.071 E019.48.38.828 N050.04.28.009 E019.48.39.076 Color_251ACI
N050.04.28.009 E019.48.39.076 N050.04.27.947 E019.48.39.325 Color_251ACI
N050.04.27.947 E019.48.39.325 N050.04.27.822 E019.48.39.583 Color_251ACI
N050.04.27.822 E019.48.39.583 N050.04.27.707 E019.48.39.800 Color_251ACI
N050.04.27.707 E019.48.39.800 N050.04.27.529 E019.48.40.026 Color_251ACI
N050.04.27.529 E019.48.40.026 N050.04.27.351 E019.48.40.252 Color_251ACI
N050.04.27.351 E019.48.40.252 N050.04.27.082 E019.48.40.471 Color_251ACI
N050.04.27.082 E019.48.40.471 N050.04.26.845 E019.48.40.566 Color_251ACI
N050.04.26.845 E019.48.40.566 N050.04.26.089 E019.48.40.778 Color_251ACI
N050.04.26.089 E019.48.40.778 N050.04.25.307 E019.48.40.974 Color_251ACI
N050.04.25.307 E019.48.40.974 N050.04.24.652 E019.48.41.151 Color_251ACI
N050.04.24.652 E019.48.41.151 N050.04.23.960 E019.48.41.353 Color_251ACI
N050.04.23.960 E019.48.41.353 N050.04.23.643 E019.48.41.400 Color_251ACI
N050.04.23.643 E019.48.41.400 N050.04.23.299 E019.48.41.431 Color_251ACI
N050.04.23.299 E019.48.41.431 N050.04.23.029 E019.48.41.411 Color_251ACI
N050.04.23.029 E019.48.41.411 N050.04.22.822 E019.48.41.382 Color_251ACI
N050.04.22.822 E019.48.41.382 N050.04.22.589 E019.48.41.337 Color_251ACI
N050.04.22.589 E019.48.41.337 N050.04.22.403 E019.48.41.225 Color_251ACI
N050.04.22.403 E019.48.41.225 N050.04.22.073 E019.48.41.074 Color_251ACI
N050.04.22.073 E019.48.41.074 N050.04.21.791 E019.48.40.857 Color_251ACI
N050.04.21.791 E019.48.40.857 N050.04.21.556 E019.48.40.572 Color_251ACI
N050.04.21.556 E019.48.40.572 N050.04.21.321 E019.48.40.288 Color_251ACI
N050.04.21.321 E019.48.40.288 N050.04.21.086 E019.48.40.004 Color_251ACI
N050.04.21.086 E019.48.40.004 N050.04.20.871 E019.48.39.636 Color_251ACI
N050.04.20.871 E019.48.39.636 N050.04.20.694 E019.48.39.244 Color_251ACI
N050.04.20.694 E019.48.39.244 N050.04.20.542 E019.48.38.867 Color_251ACI
N050.04.20.542 E019.48.38.867 N050.04.20.353 E019.48.38.276 Color_251ACI
N050.04.20.353 E019.48.38.276 N050.04.20.173 E019.48.37.645 Color_251ACI
N050.04.27.294 E019.48.35.551 N050.04.27.300 E019.48.35.650 Color_251ACI
N050.04.27.300 E019.48.35.650 N050.04.27.413 E019.48.35.813 Color_251ACI
N050.04.27.413 E019.48.35.813 N050.04.27.615 E019.48.35.982 Color_251ACI
N050.04.27.615 E019.48.35.982 N050.04.27.791 E019.48.36.136 Color_251ACI
N050.04.27.791 E019.48.36.136 N050.04.27.999 E019.48.36.404 Color_251ACI
N050.04.27.999 E019.48.36.404 N050.04.28.144 E019.48.36.682 Color_251ACI
N050.04.28.144 E019.48.36.682 N050.04.28.322 E019.48.37.074 Color_251ACI
N050.04.28.322 E019.48.37.074 N050.04.28.399 E019.48.37.502 Color_251ACI
N050.04.28.399 E019.48.37.502 N050.04.28.460 E019.48.37.872 Color_251ACI
N050.04.28.460 E019.48.37.872 N050.04.28.468 E019.48.38.210 Color_251ACI
N050.04.28.468 E019.48.38.210 N050.04.28.433 E019.48.38.475 Color_251ACI
N050.04.28.433 E019.48.38.475 N050.04.28.435 E019.48.38.714 Color_251ACI
N050.04.28.435 E019.48.38.714 N050.04.28.363 E019.48.39.004 Color_251ACI
N050.04.28.363 E019.48.39.004 N050.04.28.328 E019.48.39.269 Color_251ACI
N050.04.28.328 E019.48.39.269 N050.04.28.271 E019.48.39.377 Color_251ACI
N050.04.28.271 E019.48.39.377 N050.04.28.287 E019.48.39.434 Color_251ACI
N050.04.28.287 E019.48.39.434 N050.04.28.287 E019.48.39.434 Color_251ACI
N050.04.28.287 E019.48.39.434 N050.04.28.471 E019.48.39.307 Color_251ACI
N050.04.28.471 E019.48.39.307 N050.04.28.613 E019.48.39.107 Color_251ACI
N050.04.28.613 E019.48.39.107 N050.04.29.041 E019.48.38.365 Color_251ACI
N050.04.29.041 E019.48.38.365 N050.04.29.459 E019.48.37.664 Color_251ACI
N050.04.29.459 E019.48.37.664 N050.04.30.035 E019.48.36.820 Color_251ACI
N050.04.30.035 E019.48.36.820 N050.04.30.648 E019.48.35.951 Color_251ACI
N050.04.30.648 E019.48.35.951 N050.04.31.079 E019.48.35.448 Color_251ACI
N050.04.31.079 E019.48.35.448 N050.04.31.578 E019.48.35.035 Color_251ACI
N050.04.31.578 E019.48.35.035 N050.04.31.994 E019.48.34.714 Color_251ACI
N050.04.31.994 E019.48.34.714 N050.04.32.437 E019.48.34.409 Color_251ACI
N050.04.32.437 E019.48.34.409 N050.04.32.484 E019.48.34.342 Color_251ACI
N050.04.32.484 E019.48.34.342 N050.04.32.484 E019.48.34.342 Color_251ACI
N050.04.32.484 E019.48.34.342 N050.04.32.478 E019.48.34.243 Color_251ACI
N050.04.32.478 E019.48.34.243 N050.04.32.478 E019.48.34.243 Color_251ACI
N050.04.32.478 E019.48.34.243 N050.04.32.441 E019.48.34.269 Color_251ACI
N050.04.32.441 E019.48.34.269 N050.04.32.287 E019.48.34.271 Color_251ACI
N050.04.32.287 E019.48.34.271 N050.04.32.033 E019.48.34.309 Color_251ACI
N050.04.32.033 E019.48.34.309 N050.04.31.743 E019.48.34.372 Color_251ACI
N050.05.05.501 E019.48.28.985 N050.05.04.989 E019.48.29.201 Color_251ACI
N050.05.04.989 E019.48.29.201 N050.05.04.478 E019.48.29.416 Color_251ACI
N050.05.04.478 E019.48.29.416 N050.05.04.013 E019.48.29.565 Color_251ACI
N050.05.04.013 E019.48.29.565 N050.05.03.522 E019.48.29.698 Color_251ACI
N050.05.03.522 E019.48.29.698 N050.05.02.206 E019.48.29.953 Color_251ACI
N050.05.02.206 E019.48.29.953 N050.05.00.877 E019.48.30.010 Color_251ACI
N050.05.00.877 E019.48.30.010 N050.04.59.856 E019.48.30.062 Color_251ACI
N050.04.59.856 E019.48.30.062 N050.04.58.856 E019.48.30.031 Color_251ACI
N050.04.58.856 E019.48.30.031 N050.04.57.368 E019.48.29.992 Color_251ACI
N050.04.57.368 E019.48.29.992 N050.04.55.880 E019.48.29.953 Color_251ACI
N050.04.55.880 E019.48.29.953 N050.04.53.572 E019.48.29.897 Color_251ACI
N050.04.53.572 E019.48.29.897 N050.04.51.259 E019.48.29.980 Color_251ACI
N050.04.51.259 E019.48.29.980 N050.04.50.508 E019.48.30.052 Color_251ACI
N050.04.50.508 E019.48.30.052 N050.04.49.773 E019.48.30.181 Color_251ACI
N050.04.49.773 E019.48.30.181 N050.04.48.388 E019.48.30.347 Color_251ACI
N050.04.48.388 E019.48.30.347 N050.04.46.982 E019.48.30.595 Color_251ACI
N050.04.46.982 E019.48.30.595 N050.04.45.782 E019.48.30.873 Color_251ACI
N050.04.45.782 E019.48.30.873 N050.04.44.572 E019.48.31.192 Color_251ACI
N050.04.44.572 E019.48.31.192 N050.04.42.089 E019.48.31.840 Color_251ACI
N050.04.42.089 E019.48.31.840 N050.04.39.632 E019.48.32.503 Color_251ACI
N050.04.39.632 E019.48.32.503 N050.04.36.695 E019.48.33.258 Color_251ACI
N050.04.36.695 E019.48.33.258 N050.04.33.800 E019.48.34.087 Color_251ACI
N050.04.33.800 E019.48.34.087 N050.04.33.610 E019.48.34.115 Color_251ACI
N050.04.33.610 E019.48.34.115 N050.04.33.024 E019.48.34.382 Color_251ACI
N050.04.33.024 E019.48.34.382 N050.04.32.444 E019.48.34.747 Color_251ACI
N050.04.32.444 E019.48.34.747 N050.04.31.834 E019.48.35.237 Color_251ACI
N050.04.31.834 E019.48.35.237 N050.04.31.267 E019.48.35.800 Color_251ACI
N050.04.31.267 E019.48.35.800 N050.04.30.726 E019.48.36.379 Color_251ACI
N050.04.30.726 E019.48.36.379 N050.04.30.254 E019.48.37.047 Color_251ACI
N050.04.30.254 E019.48.37.047 N050.04.29.752 E019.48.37.840 Color_251ACI
N050.04.29.752 E019.48.37.840 N050.04.29.223 E019.48.38.617 Color_251ACI
N050.04.29.223 E019.48.38.617 N050.04.28.873 E019.48.39.168 Color_251ACI
N050.04.28.873 E019.48.39.168 N050.04.28.475 E019.48.39.786 Color_251ACI
N050.04.28.475 E019.48.39.786 N050.04.28.176 E019.48.40.129 Color_251ACI
N050.04.28.176 E019.48.40.129 N050.04.27.877 E019.48.40.473 Color_251ACI
N050.04.27.877 E019.48.40.473 N050.04.27.582 E019.48.40.676 Color_251ACI
N050.04.27.582 E019.48.40.676 N050.04.27.270 E019.48.40.822 Color_251ACI
N050.04.27.270 E019.48.40.822 N050.04.26.541 E019.48.41.050 Color_251ACI
N050.04.26.541 E019.48.41.050 N050.04.25.802 E019.48.41.319 Color_251ACI
N050.04.25.802 E019.48.41.319 N050.04.24.783 E019.48.41.610 Color_251ACI
N050.04.24.783 E019.48.41.610 N050.04.23.710 E019.48.41.869 Color_251ACI
N050.04.23.710 E019.48.41.869 N050.04.23.430 E019.48.41.891 Color_251ACI
N050.04.23.430 E019.48.41.891 N050.04.23.139 E019.48.41.954 Color_251ACI
N050.04.23.139 E019.48.41.954 N050.04.22.869 E019.48.41.934 Color_251ACI
N050.04.22.869 E019.48.41.934 N050.04.22.646 E019.48.41.847 Color_251ACI
N050.04.22.646 E019.48.41.847 N050.04.22.120 E019.48.41.626 Color_251ACI
N050.04.22.120 E019.48.41.626 N050.04.21.635 E019.48.41.239 Color_251ACI
N050.04.21.635 E019.48.41.239 N050.04.21.241 E019.48.40.859 Color_251ACI
N050.04.21.241 E019.48.40.859 N050.04.20.877 E019.48.40.354 Color_251ACI
N050.04.20.877 E019.48.40.354 N050.04.20.533 E019.48.39.766 Color_251ACI
N050.04.20.533 E019.48.39.766 N050.04.20.274 E019.48.39.086 Color_251ACI
N050.04.20.274 E019.48.39.086 N050.04.20.078 E019.48.38.397 Color_251ACI
N050.04.20.078 E019.48.38.397 N050.04.19.856 E019.48.37.692 Color_251ACI
N050.04.26.476 E019.48.34.535 N050.04.26.957 E019.48.34.443 Color_251ACI
N050.04.26.957 E019.48.34.443 N050.04.27.428 E019.48.34.393 Color_251ACI
N050.04.27.428 E019.48.34.393 N050.04.28.163 E019.48.34.264 Color_251ACI
N050.04.28.163 E019.48.34.264 N050.04.28.882 E019.48.34.078 Color_251ACI
N050.04.28.882 E019.48.34.078 N050.04.29.146 E019.48.33.999 Color_251ACI
N050.04.29.146 E019.48.33.999 N050.04.29.383 E019.48.33.904 Color_251ACI
N050.04.31.787 E019.48.33.208 N050.04.31.824 E019.48.33.183 Color_251ACI
N050.04.31.824 E019.48.33.183 N050.04.31.701 E019.48.33.061 Color_251ACI
N050.04.31.701 E019.48.33.061 N050.04.31.361 E019.48.32.952 Color_251ACI
N050.04.31.361 E019.48.32.952 N050.04.31.012 E019.48.32.884 Color_251ACI
N050.04.31.012 E019.48.32.884 N050.04.30.173 E019.48.32.570 Color_251ACI
N050.04.30.173 E019.48.32.570 N050.04.29.354 E019.48.32.172 Color_251ACI
N050.04.29.354 E019.48.32.172 N050.04.28.939 E019.48.31.875 Color_251ACI
N050.04.28.939 E019.48.31.875 N050.04.28.571 E019.48.31.510 Color_251ACI
N050.04.28.571 E019.48.31.510 N050.04.28.246 E019.48.31.219 Color_251ACI
N050.04.28.246 E019.48.31.219 N050.04.27.941 E019.48.30.845 Color_251ACI
N050.04.27.941 E019.48.30.845 N050.04.27.786 E019.48.30.609 Color_251ACI
N050.04.27.786 E019.48.30.609 N050.04.27.694 E019.48.30.363 Color_251ACI
N050.04.27.694 E019.48.30.363 N050.04.27.570 E019.48.30.002 Color_251ACI
N050.04.27.570 E019.48.30.002 N050.04.27.537 E019.48.29.887 Color_251ACI
N050.04.27.537 E019.48.29.887 N050.04.27.511 E019.48.29.871 Color_251ACI
N050.04.27.511 E019.48.29.871 N050.04.27.500 E019.48.29.913 Color_251ACI
N050.04.27.500 E019.48.29.913 N050.04.27.449 E019.48.30.120 Color_251ACI
N050.04.27.449 E019.48.30.120 N050.04.27.373 E019.48.30.550 Color_251ACI
N050.04.27.373 E019.48.30.550 N050.04.27.286 E019.48.31.022 Color_251ACI
N050.04.27.286 E019.48.31.022 N050.04.27.185 E019.48.31.676 Color_251ACI
N050.04.27.185 E019.48.31.676 N050.04.27.058 E019.48.32.313 Color_251ACI
N050.04.27.058 E019.48.32.313 N050.04.26.961 E019.48.32.826 Color_251ACI
N050.04.26.961 E019.48.32.826 N050.04.26.786 E019.48.33.531 Color_251ACI
N050.04.26.786 E019.48.33.531 N050.04.26.661 E019.48.33.789 Color_251ACI
N050.04.26.661 E019.48.33.789 N050.04.26.573 E019.48.34.021 Color_251ACI
N050.04.26.573 E019.48.34.021 N050.04.26.391 E019.48.34.388 Color_251ACI
N050.04.26.391 E019.48.34.388 N050.04.26.370 E019.48.34.471 Color_251ACI
N050.04.26.370 E019.48.34.471 N050.04.26.370 E019.48.34.471 Color_251ACI
N050.04.26.370 E019.48.34.471 N050.04.26.423 E019.48.34.503 Color_251ACI
N050.04.26.423 E019.48.34.503 N050.04.26.487 E019.48.34.493 Color_251ACI
N050.04.29.383 E019.48.33.904 N050.04.30.340 E019.48.33.622 Color_251ACI
N050.04.30.340 E019.48.33.622 N050.04.31.296 E019.48.33.341 Color_251ACI
N050.04.31.296 E019.48.33.341 N050.04.31.459 E019.48.33.297 Color_251ACI
N050.04.31.459 E019.48.33.297 N050.04.31.623 E019.48.33.252 Color_251ACI
N050.04.31.623 E019.48.33.252 N050.04.31.713 E019.48.33.259 Color_251ACI
N050.04.31.713 E019.48.33.259 N050.04.31.787 E019.48.33.208 Color_251ACI
N050.04.33.488 E019.48.32.756 N050.04.33.054 E019.48.32.781 Color_251ACI
N050.04.33.054 E019.48.32.781 N050.04.32.620 E019.48.32.805 Color_251ACI
N050.04.32.620 E019.48.32.805 N050.04.31.757 E019.48.32.714 Color_251ACI
N050.04.31.757 E019.48.32.714 N050.04.30.897 E019.48.32.482 Color_251ACI
N050.04.30.897 E019.48.32.482 N050.04.29.989 E019.48.32.078 Color_251ACI
N050.04.29.989 E019.48.32.078 N050.04.29.069 E019.48.31.476 Color_251ACI
N050.04.29.069 E019.48.31.476 N050.04.28.664 E019.48.31.137 Color_251ACI
N050.04.28.664 E019.48.31.137 N050.04.28.253 E019.48.30.699 Color_251ACI
N050.04.28.253 E019.48.30.699 N050.04.28.012 E019.48.30.316 Color_251ACI
N050.04.28.012 E019.48.30.316 N050.04.27.844 E019.48.29.882 Color_251ACI
N050.04.27.844 E019.48.29.882 N050.04.27.743 E019.48.29.059 Color_251ACI
N050.04.27.743 E019.48.29.059 N050.04.27.795 E019.48.28.233 Color_251ACI
N050.04.27.795 E019.48.28.233 N050.04.27.885 E019.48.27.621 Color_251ACI
N050.04.27.885 E019.48.27.621 N050.04.27.976 E019.48.27.009 Color_251ACI
N050.04.27.780 E019.48.26.938 N050.04.27.525 E019.48.28.213 Color_251ACI
N050.04.27.525 E019.48.28.213 N050.04.27.259 E019.48.29.530 Color_251ACI
N050.04.27.259 E019.48.29.530 N050.04.27.103 E019.48.30.531 Color_251ACI
N050.04.27.103 E019.48.30.531 N050.04.26.946 E019.48.31.532 Color_251ACI
N050.04.26.946 E019.48.31.532 N050.04.26.814 E019.48.32.309 Color_251ACI
N050.04.26.814 E019.48.32.309 N050.04.26.640 E019.48.33.014 Color_251ACI
N050.04.26.640 E019.48.33.014 N050.04.26.557 E019.48.33.345 Color_251ACI
N050.04.26.557 E019.48.33.345 N050.04.26.412 E019.48.33.686 Color_251ACI
N050.04.26.412 E019.48.33.686 N050.04.26.256 E019.48.34.068 Color_251ACI
N050.04.26.256 E019.48.34.068 N050.04.26.047 E019.48.34.419 Color_251ACI
N050.04.26.047 E019.48.34.419 N050.04.25.879 E019.48.34.603 Color_251ACI
N050.04.25.879 E019.48.34.603 N050.04.25.657 E019.48.34.756 Color_251ACI
N050.04.25.657 E019.48.34.756 N050.04.25.647 E019.48.34.797 Color_251ACI
N050.04.25.647 E019.48.34.797 N050.04.24.892 E019.48.35.009 Color_251ACI
N050.04.24.892 E019.48.35.009 N050.04.24.099 E019.48.35.246 Color_251ACI
N050.04.24.099 E019.48.35.246 N050.04.22.836 E019.48.35.533 Color_251ACI
N050.04.22.836 E019.48.35.533 N050.04.21.536 E019.48.35.846 Color_251ACI
N050.04.21.536 E019.48.35.846 N050.04.20.891 E019.48.35.982 Color_251ACI
N050.04.20.891 E019.48.35.982 N050.04.20.246 E019.48.36.117 Color_251ACI
N050.04.48.618 E019.48.27.199 N050.04.48.717 E019.48.26.925 Color_251ACI
N050.04.48.717 E019.48.26.925 N050.04.48.805 E019.48.26.693 Color_251ACI
N050.04.48.805 E019.48.26.693 N050.04.48.856 E019.48.26.486 Color_251ACI
N050.04.48.856 E019.48.26.486 N050.04.47.771 E019.48.18.785 Color_251ACI
N050.04.47.771 E019.48.18.785 N050.04.47.548 E019.48.17.221 Color_251ACI
N050.04.47.548 E019.48.17.221 N050.04.46.814 E019.48.11.922 Color_251ACI
N050.04.46.814 E019.48.11.922 N050.04.46.759 E019.48.11.651 Color_251ACI
N050.04.46.759 E019.48.11.651 N050.04.46.520 E019.48.11.507 Color_251ACI
N050.04.47.185 E019.48.11.289 N050.04.46.997 E019.48.11.556 Color_251ACI
N050.04.46.997 E019.48.11.556 N050.04.47.015 E019.48.11.853 Color_251ACI
N050.04.47.015 E019.48.11.853 N050.04.47.939 E019.48.18.600 Color_251ACI
N050.04.47.939 E019.48.18.600 N050.04.48.471 E019.48.22.492 Color_251ACI
N050.04.48.471 E019.48.22.492 N050.04.48.673 E019.48.23.899 Color_251ACI
N050.04.48.673 E019.48.23.899 N050.04.49.030 E019.48.26.400 Color_251ACI
N050.04.49.030 E019.48.26.400 N050.04.49.490 E019.48.27.010 Color_251ACI
N050.04.31.743 E019.48.34.372 N050.04.30.596 E019.48.34.682 Color_251ACI
N050.04.30.596 E019.48.34.682 N050.04.29.423 E019.48.34.976 Color_251ACI
N050.04.29.423 E019.48.34.976 N050.04.28.451 E019.48.35.200 Color_251ACI
N050.04.28.451 E019.48.35.200 N050.04.27.442 E019.48.35.449 Color_251ACI
N050.04.27.442 E019.48.35.449 N050.04.27.304 E019.48.35.509 Color_251ACI
N050.04.27.304 E019.48.35.509 N050.04.27.294 E019.48.35.551 Color_251ACI
N050.04.23.263 E019.48.22.600 N050.04.23.390 E019.48.22.581 Color_251ACI
N050.04.23.390 E019.48.22.581 N050.04.23.484 E019.48.22.447 Color_251ACI
N050.04.23.484 E019.48.22.447 N050.04.23.525 E019.48.22.281 Color_251ACI
N050.04.23.525 E019.48.22.281 N050.04.23.550 E019.48.22.058 Color_251ACI
N050.04.23.550 E019.48.22.058 N050.04.23.533 E019.48.22.001 Color_251ACI
N050.04.23.533 E019.48.22.001 N050.04.23.491 E019.48.21.927 Color_251ACI
N050.04.23.491 E019.48.21.927 N050.04.23.421 E019.48.21.838 Color_251ACI
N050.04.23.421 E019.48.21.838 N050.04.22.157 E019.48.21.267 Color_251ACI
N050.04.22.157 E019.48.21.267 N050.04.22.233 E019.48.20.837 Color_251ACI
N050.04.22.233 E019.48.20.837 N050.04.21.967 E019.48.20.677 Color_251ACI
N050.04.21.967 E019.48.20.677 N050.04.21.775 E019.48.20.466 Color_251ACI
N050.04.21.775 E019.48.20.466 N050.04.21.642 E019.48.20.386 Color_251ACI
N050.04.21.642 E019.48.20.386 N050.04.21.529 E019.48.20.223 Color_251ACI
N050.04.21.529 E019.48.20.223 N050.04.21.337 E019.48.20.012 Color_251ACI
N050.04.21.337 E019.48.20.012 N050.04.21.176 E019.48.19.676 Color_251ACI
N050.04.21.176 E019.48.19.676 N050.04.20.988 E019.48.19.325 Color_251ACI
N050.04.20.988 E019.48.19.325 N050.04.20.923 E019.48.19.095 Color_251ACI
N050.04.20.923 E019.48.19.095 N050.04.20.863 E019.48.18.964 Color_251ACI
N050.04.20.863 E019.48.18.964 N050.04.20.790 E019.48.19.015 Color_251ACI
N050.04.21.827 E019.48.21.735 N050.04.21.704 E019.48.21.613 Color_251ACI
N050.04.21.704 E019.48.21.613 N050.04.21.592 E019.48.21.451 Color_251ACI
N050.04.21.592 E019.48.21.451 N050.04.21.522 E019.48.21.361 Color_251ACI
N050.04.21.522 E019.48.21.361 N050.04.21.510 E019.48.21.163 Color_251ACI
N050.04.21.510 E019.48.21.163 N050.04.21.461 E019.48.20.991 Color_251ACI
N050.04.21.461 E019.48.20.991 N050.04.21.359 E019.48.20.787 Color_251ACI
N050.04.21.359 E019.48.20.787 N050.04.21.230 E019.48.20.566 Color_251ACI
N050.04.21.230 E019.48.20.566 N050.04.21.161 E019.48.20.477 Color_251ACI
N050.04.21.161 E019.48.20.477 N050.04.21.095 E019.48.20.247 Color_251ACI
N050.04.21.095 E019.48.20.247 N050.04.21.018 E019.48.19.820 Color_251ACI
N050.04.21.018 E019.48.19.820 N050.04.20.936 E019.48.19.532 Color_251ACI
N050.04.20.936 E019.48.19.532 N050.04.20.892 E019.48.19.220 Color_251ACI
N050.04.20.892 E019.48.19.220 N050.04.20.790 E019.48.19.015 Color_251ACI
N050.04.20.843 E019.48.19.047 N050.04.20.626 E019.48.18.441 Color_251ACI
N050.04.20.626 E019.48.18.441 N050.04.20.447 E019.48.17.809 Color_251ACI
N050.04.20.447 E019.48.17.809 N050.04.20.365 E019.48.17.522 Color_251ACI
N050.04.20.365 E019.48.17.522 N050.04.20.284 E019.48.17.235 Color_251ACI
N050.04.20.284 E019.48.17.235 N050.04.20.162 E019.48.16.494 Color_251ACI
N050.04.20.162 E019.48.16.494 N050.04.20.066 E019.48.15.770 Color_251ACI
N050.04.20.066 E019.48.15.770 N050.04.19.999 E019.48.15.301 Color_251ACI
N050.04.19.999 E019.48.15.301 N050.04.19.948 E019.48.14.890 Color_251ACI
N050.04.19.948 E019.48.14.890 N050.04.19.957 E019.48.14.609 Color_251ACI
N050.04.19.957 E019.48.14.609 N050.04.20.035 E019.48.14.418 Color_251ACI
N050.04.20.035 E019.48.14.418 N050.04.20.139 E019.48.14.243 Color_251ACI
N050.04.20.139 E019.48.14.243 N050.04.20.541 E019.48.14.103 Color_251ACI
N050.04.20.541 E019.48.14.103 N050.04.20.969 E019.48.13.980 Color_251ACI
N050.04.20.969 E019.48.13.980 N050.04.21.196 E019.48.13.926 Color_251ACI
N050.04.21.196 E019.48.13.926 N050.04.21.302 E019.48.13.991 Color_251ACI
N050.04.21.302 E019.48.13.991 N050.04.21.345 E019.48.14.064 Color_251ACI
N050.04.21.345 E019.48.14.064 N050.04.21.351 E019.48.14.163 Color_251ACI
N050.04.21.351 E019.48.14.163 N050.04.21.341 E019.48.14.204 Color_251ACI
N050.04.21.341 E019.48.14.204 N050.04.21.310 E019.48.14.329 Color_251ACI
N050.04.21.310 E019.48.14.329 N050.04.21.263 E019.48.14.395 Color_251ACI
N050.04.21.263 E019.48.14.395 N050.04.21.210 E019.48.14.363 Color_251ACI
N050.04.23.839 E019.47.06.088 N050.04.24.797 E019.47.05.427 Color_251ACI
N050.04.24.797 E019.47.05.427 N050.04.24.924 E019.47.05.408 Color_251ACI
N050.04.24.924 E019.47.05.408 N050.04.25.041 E019.47.05.431 Color_251ACI
N050.04.25.041 E019.47.05.431 N050.04.25.147 E019.47.05.495 Color_251ACI
N050.04.20.780 E019.47.07.579 N050.04.21.058 E019.47.09.414 Color_251ACI
N050.04.23.706 E019.47.10.198 N050.04.23.870 E019.47.10.154 Color_251ACI
N050.04.23.870 E019.47.10.154 N050.04.23.835 E019.47.09.800 Color_251ACI
N050.04.23.835 E019.47.09.800 N050.04.24.136 E019.47.09.695 Color_251ACI
N050.04.24.136 E019.47.09.695 N050.04.24.132 E019.47.09.836 Color_251ACI
N050.04.24.132 E019.47.09.836 N050.04.24.070 E019.47.10.084 Color_251ACI
N050.04.24.070 E019.47.10.084 N050.04.24.013 E019.47.10.193 Color_251ACI
N050.04.24.013 E019.47.10.193 N050.04.23.955 E019.47.10.301 Color_251ACI
N050.04.23.955 E019.47.10.301 N050.04.23.908 E019.47.10.368 Color_251ACI
N050.04.23.908 E019.47.10.368 N050.04.23.835 E019.47.10.419 Color_251ACI
N050.04.23.835 E019.47.10.419 N050.04.23.734 E019.47.10.454 Color_251ACI
N050.04.23.734 E019.47.10.454 N050.04.22.393 E019.47.10.932 Color_251ACI
N050.04.22.367 E019.47.10.916 N050.04.22.356 E019.47.10.957 Color_251ACI
N050.04.22.356 E019.47.10.957 N050.04.22.330 E019.47.10.941 Color_251ACI
N050.04.22.330 E019.47.10.941 N050.04.22.303 E019.47.10.925 Color_251ACI
N050.04.22.303 E019.47.10.925 N050.04.22.266 E019.47.10.951 Color_251ACI
N050.04.22.266 E019.47.10.951 N050.04.22.240 E019.47.10.935 Color_251ACI
N050.04.22.240 E019.47.10.935 N050.04.22.203 E019.47.10.960 Color_251ACI
N050.04.22.203 E019.47.10.960 N050.04.22.176 E019.47.10.944 Color_251ACI
N050.04.22.176 E019.47.10.944 N050.04.22.150 E019.47.10.928 Color_251ACI
N050.04.22.150 E019.47.10.928 N050.04.22.150 E019.47.10.928 Color_251ACI
N050.04.22.150 E019.47.10.928 N050.04.22.123 E019.47.10.912 Color_251ACI
N050.04.22.123 E019.47.10.912 N050.04.22.096 E019.47.10.896 Color_251ACI
N050.04.22.096 E019.47.10.896 N050.04.22.107 E019.47.10.855 Color_251ACI
N050.04.22.107 E019.47.10.855 N050.04.22.080 E019.47.10.839 Color_251ACI
N050.04.22.080 E019.47.10.839 N050.04.22.090 E019.47.10.797 Color_251ACI
N050.04.22.090 E019.47.10.797 N050.04.22.064 E019.47.10.781 Color_251ACI
N050.04.22.090 E019.47.10.797 N050.04.22.829 E019.47.10.528 Color_251ACI
N050.04.21.190 E019.47.10.112 N050.04.21.880 E019.47.14.480 Color_251ACI
N050.04.21.880 E019.47.14.480 N050.04.22.215 E019.47.16.825 Color_251ACI
N050.04.23.839 E019.47.06.088 N050.04.23.985 E019.47.07.224 Color_251ACI
N050.04.23.985 E019.47.07.224 N050.04.24.018 E019.47.07.338 Color_251ACI
N050.04.24.018 E019.47.07.338 N050.04.24.050 E019.47.07.453 Color_251ACI
N050.04.24.050 E019.47.07.453 N050.04.24.120 E019.47.07.543 Color_251ACI
N050.04.24.120 E019.47.07.543 N050.04.24.189 E019.47.07.632 Color_251ACI
N050.04.24.189 E019.47.07.632 N050.04.24.259 E019.47.07.722 Color_251ACI
N050.04.24.259 E019.47.07.722 N050.04.24.392 E019.47.07.802 Color_251ACI
N050.04.24.392 E019.47.07.802 N050.04.24.482 E019.47.07.808 Color_251ACI
N050.04.21.385 E019.47.09.944 N050.04.21.395 E019.47.09.902 Color_251ACI
N050.04.21.395 E019.47.09.902 N050.04.21.422 E019.47.09.918 Color_251ACI
N050.04.21.422 E019.47.09.918 N050.04.21.528 E019.47.09.983 Color_251ACI
N050.04.21.528 E019.47.09.983 N050.04.21.555 E019.47.09.999 Color_251ACI
N050.04.21.555 E019.47.09.999 N050.04.21.571 E019.47.10.056 Color_251ACI
N050.04.21.571 E019.47.10.056 N050.04.21.587 E019.47.10.113 Color_251ACI
N050.04.21.587 E019.47.10.113 N050.04.21.616 E019.47.10.369 Color_251ACI
N050.04.22.438 E019.47.11.244 N050.04.23.779 E019.47.10.766 Color_251ACI
N050.04.23.779 E019.47.10.766 N050.04.23.879 E019.47.10.731 Color_251ACI
N050.04.23.879 E019.47.10.731 N050.04.23.943 E019.47.10.722 Color_251ACI
N050.04.23.943 E019.47.10.722 N050.04.24.027 E019.47.10.630 Color_251ACI
N050.04.24.027 E019.47.10.630 N050.04.24.101 E019.47.10.579 Color_251ACI
N050.04.24.101 E019.47.10.579 N050.04.24.158 E019.47.10.470 Color_251ACI
N050.04.24.158 E019.47.10.470 N050.04.24.215 E019.47.10.362 Color_251ACI
N050.04.24.215 E019.47.10.362 N050.04.24.246 E019.47.10.238 Color_251ACI
N050.04.24.246 E019.47.10.238 N050.04.24.277 E019.47.10.114 Color_251ACI
N050.04.24.568 E019.47.09.432 N050.04.24.521 E019.47.09.499 Color_251ACI
N050.04.24.521 E019.47.09.499 N050.04.24.521 E019.47.09.499 Color_251ACI
N050.04.24.521 E019.47.09.499 N050.04.24.484 E019.47.09.524 Color_251ACI
N050.04.24.484 E019.47.09.524 N050.04.24.437 E019.47.09.591 Color_251ACI
N050.04.24.437 E019.47.09.591 N050.04.24.427 E019.47.09.632 Color_251ACI
N050.04.24.427 E019.47.09.632 N050.04.24.390 E019.47.09.658 Color_251ACI
N050.04.24.390 E019.47.09.658 N050.04.24.380 E019.47.09.699 Color_251ACI
N050.04.24.380 E019.47.09.699 N050.04.24.369 E019.47.09.741 Color_251ACI
N050.04.24.277 E019.47.10.114 N050.04.24.318 E019.47.09.948 Color_251ACI
N050.04.24.318 E019.47.09.948 N050.04.24.339 E019.47.09.865 Color_251ACI
N050.04.24.339 E019.47.09.865 N050.04.24.369 E019.47.09.741 Color_251ACI
N050.04.24.482 E019.47.07.808 N050.04.25.747 E019.47.07.760 Color_251ACI
N050.04.24.568 E019.47.09.432 N050.04.25.607 E019.47.08.819 Color_251ACI
N050.04.22.337 E019.47.17.565 N050.04.23.228 E019.47.23.339 Color_251ACI
N050.04.22.669 E019.47.17.336 N050.04.22.950 E019.47.18.791 Color_251ACI
N050.04.22.950 E019.47.18.791 N050.04.23.405 E019.47.18.684 Color_251ACI
N050.04.23.405 E019.47.18.684 N050.04.23.704 E019.47.20.435 Color_251ACI
N050.04.23.704 E019.47.20.435 N050.04.24.627 E019.47.20.039 Color_251ACI
N050.04.19.797 E019.48.17.227 N050.04.19.770 E019.48.17.211 Color_251ACI
N050.04.19.770 E019.48.17.211 N050.04.19.713 E019.48.16.701 Color_251ACI
N050.04.19.713 E019.48.16.701 N050.04.19.640 E019.48.16.133 Color_251ACI
N050.04.19.640 E019.48.16.133 N050.04.19.522 E019.48.15.252 Color_251ACI
N050.04.19.522 E019.48.15.252 N050.04.19.466 E019.48.14.742 Color_251ACI
N050.04.19.466 E019.48.14.742 N050.04.19.470 E019.48.14.602 Color_251ACI
N050.04.19.934 E019.48.17.167 N050.04.19.857 E019.48.16.739 Color_251ACI
N050.04.19.857 E019.48.16.739 N050.04.19.789 E019.48.16.270 Color_251ACI
N050.04.19.789 E019.48.16.270 N050.04.19.733 E019.48.15.760 Color_251ACI
N050.04.19.733 E019.48.15.760 N050.04.19.660 E019.48.15.192 Color_251ACI
N050.04.19.660 E019.48.15.192 N050.04.19.603 E019.48.14.682 Color_251ACI
N050.04.19.603 E019.48.14.682 N050.04.19.570 E019.48.14.567 Color_251ACI
N050.04.19.570 E019.48.14.567 N050.04.19.501 E019.48.14.477 Color_251ACI
N050.04.19.501 E019.48.14.477 N050.04.19.474 E019.48.14.461 Color_251ACI
N050.04.19.474 E019.48.14.461 N050.04.19.411 E019.48.14.471 Color_251ACI
N050.04.19.411 E019.48.14.471 N050.04.19.357 E019.48.14.439 Color_251ACI
N050.04.19.907 E019.48.17.769 N050.04.19.907 E019.48.17.769 Color_251ACI
N050.04.19.907 E019.48.17.769 N050.04.19.937 E019.48.17.645 Color_251ACI
N050.04.19.937 E019.48.17.645 N050.04.19.948 E019.48.17.604 Color_251ACI
N050.04.19.948 E019.48.17.604 N050.04.20.028 E019.48.17.652 Color_251ACI
N050.04.18.805 E019.48.19.868 N050.04.18.981 E019.48.20.022 Color_251ACI
N050.04.18.981 E019.48.20.022 N050.04.19.210 E019.48.20.207 Color_251ACI
N050.04.19.210 E019.48.20.207 N050.04.19.476 E019.48.20.367 Color_251ACI
N050.04.19.476 E019.48.20.367 N050.04.19.769 E019.48.20.544 Color_251ACI
N050.04.19.769 E019.48.20.544 N050.04.19.912 E019.48.20.582 Color_251ACI
N050.04.19.912 E019.48.20.582 N050.04.20.066 E019.48.20.579 Color_251ACI
N050.04.20.066 E019.48.20.579 N050.04.20.287 E019.48.20.427 Color_251ACI
N050.04.20.287 E019.48.20.427 N050.04.20.412 E019.48.20.169 Color_251ACI
N050.04.20.412 E019.48.20.169 N050.04.20.494 E019.48.19.837 Color_251ACI
N050.04.20.494 E019.48.19.837 N050.04.20.490 E019.48.19.359 Color_251ACI
N050.04.20.490 E019.48.19.359 N050.04.20.272 E019.48.18.513 Color_251ACI
N050.04.20.272 E019.48.18.513 N050.04.20.028 E019.48.17.652 Color_251ACI
N050.04.14.841 E019.48.13.672 N050.04.16.511 E019.48.13.344 Color_251ACI
N050.04.16.587 E019.48.12.914 N050.04.14.647 E019.48.13.222 Color_251ACI
N050.04.14.254 E019.48.13.080 N050.04.14.440 E019.48.13.192 Color_251ACI
N050.04.14.440 E019.48.13.192 N050.04.14.493 E019.48.13.224 Color_251ACI
N050.04.14.493 E019.48.13.224 N050.04.14.557 E019.48.13.215 Color_251ACI
N050.04.14.557 E019.48.13.215 N050.04.14.610 E019.48.13.247 Color_251ACI
N050.04.14.610 E019.48.13.247 N050.04.14.673 E019.48.13.238 Color_251ACI
N050.04.11.214 E019.48.01.060 N050.04.10.776 E019.48.01.224 Color_251ACI
N050.04.10.776 E019.48.01.224 N050.04.10.358 E019.48.01.306 Color_251ACI
N050.04.10.358 E019.48.01.306 N050.04.10.147 E019.48.01.417 Color_251ACI
N050.04.10.147 E019.48.01.417 N050.04.09.946 E019.48.01.487 Color_251ACI
N050.04.09.946 E019.48.01.487 N050.04.09.234 E019.48.01.772 Color_251ACI
N050.04.09.234 E019.48.01.772 N050.04.08.548 E019.48.02.074 Color_251ACI
N050.04.08.548 E019.48.02.074 N050.04.08.284 E019.48.02.153 Color_251ACI
N050.04.08.284 E019.48.02.153 N050.04.08.073 E019.48.02.264 Color_251ACI
N050.04.08.073 E019.48.02.264 N050.04.07.952 E019.48.02.382 Color_251ACI
N050.04.07.952 E019.48.02.382 N050.04.07.884 E019.48.02.531 Color_251ACI
N050.04.07.884 E019.48.02.531 N050.04.07.853 E019.48.02.656 Color_251ACI
N050.04.07.853 E019.48.02.656 N050.04.07.882 E019.48.02.911 Color_251ACI
N050.04.07.882 E019.48.02.911 N050.04.08.027 E019.48.03.189 Color_251ACI
N050.04.08.027 E019.48.03.189 N050.04.08.172 E019.48.03.466 Color_251ACI
N050.04.08.172 E019.48.03.466 N050.04.08.472 E019.48.03.981 Color_251ACI
N050.04.08.472 E019.48.03.981 N050.04.08.773 E019.48.04.495 Color_251ACI
N050.04.08.773 E019.48.04.495 N050.04.08.971 E019.48.04.805 Color_251ACI
N050.04.08.971 E019.48.04.805 N050.04.09.185 E019.48.05.172 Color_251ACI
N050.04.09.185 E019.48.05.172 N050.04.09.394 E019.48.05.440 Color_251ACI
N050.04.09.394 E019.48.05.440 N050.04.09.566 E019.48.05.734 Color_251ACI
N050.04.09.566 E019.48.05.734 N050.04.09.737 E019.48.06.028 Color_251ACI
N050.04.09.737 E019.48.06.028 N050.04.09.919 E019.48.06.280 Color_251ACI
N050.04.09.919 E019.48.06.280 N050.04.10.455 E019.48.07.079 Color_251ACI
N050.04.10.455 E019.48.07.079 N050.04.10.953 E019.48.07.903 Color_251ACI
N050.04.10.953 E019.48.07.903 N050.04.12.609 E019.48.10.471 Color_251ACI
N050.04.12.609 E019.48.10.471 N050.04.14.254 E019.48.13.080 Color_251ACI
N050.04.14.779 E019.48.13.920 N050.04.16.038 E019.48.15.869 Color_251ACI
N050.04.16.038 E019.48.15.869 N050.04.17.313 E019.48.17.875 Color_251ACI
N050.04.17.313 E019.48.17.875 N050.04.17.908 E019.48.18.804 Color_251ACI
N050.04.17.908 E019.48.18.804 N050.04.18.533 E019.48.19.609 Color_251ACI
N050.04.18.533 E019.48.19.609 N050.04.18.805 E019.48.19.868 Color_251ACI
N050.04.16.901 E019.48.10.912 N050.04.16.699 E019.48.12.219 Color_251ACI
N050.04.16.699 E019.48.12.219 N050.04.16.587 E019.48.12.914 Color_251ACI
N050.04.17.060 E019.48.07.436 N050.04.17.298 E019.48.08.818 Color_251ACI
N050.04.17.298 E019.48.08.818 N050.04.17.435 E019.48.08.757 Color_251ACI
N050.04.17.435 E019.48.08.757 N050.04.17.451 E019.48.08.815 Color_251ACI
N050.04.17.451 E019.48.08.815 N050.04.17.410 E019.48.08.981 Color_251ACI
N050.04.17.410 E019.48.08.981 N050.04.17.363 E019.48.09.047 Color_251ACI
N050.04.17.363 E019.48.09.047 N050.04.17.300 E019.48.09.057 Color_251ACI
N050.04.17.300 E019.48.09.057 N050.04.17.019 E019.48.09.078 Color_251ACI
N050.04.17.019 E019.48.09.078 N050.04.16.940 E019.48.09.888 Color_251ACI
N050.04.16.940 E019.48.09.888 N050.04.16.926 E019.48.10.070 Color_251ACI
N050.04.16.926 E019.48.10.070 N050.04.16.948 E019.48.10.226 Color_251ACI
N050.04.16.948 E019.48.10.226 N050.04.16.993 E019.48.10.539 Color_251ACI
N050.04.16.993 E019.48.10.539 N050.04.17.060 E019.48.11.008 Color_251ACI
N050.04.17.060 E019.48.11.008 N050.04.16.901 E019.48.10.912 Color_251ACI
N050.04.16.388 E019.47.59.793 N050.04.17.334 E019.47.59.553 Color_251ACI
N050.04.20.219 E019.48.26.862 N050.04.20.368 E019.48.27.000 Color_251ACI
N050.04.20.137 E019.48.27.194 N050.04.20.296 E019.48.27.290 Color_251ACI
N050.04.20.245 E019.48.26.878 N050.04.20.363 E019.48.26.282 Color_251ACI
N050.04.20.363 E019.48.26.282 N050.04.20.507 E019.48.25.702 Color_251ACI
N050.04.20.507 E019.48.25.702 N050.04.20.794 E019.48.24.542 Color_251ACI
N050.04.20.794 E019.48.24.542 N050.04.21.066 E019.48.23.324 Color_251ACI
N050.04.19.829 E019.48.36.199 N050.04.19.649 E019.48.35.567 Color_251ACI
N050.04.19.649 E019.48.35.567 N050.04.19.480 E019.48.34.894 Color_251ACI
N050.04.19.480 E019.48.34.894 N050.04.19.305 E019.48.34.122 Color_251ACI
N050.04.19.305 E019.48.34.122 N050.04.19.193 E019.48.33.340 Color_251ACI
N050.04.19.193 E019.48.33.340 N050.04.19.128 E019.48.32.492 Color_251ACI
N050.04.19.128 E019.48.32.492 N050.04.19.191 E019.48.31.624 Color_251ACI
N050.04.19.191 E019.48.31.624 N050.04.19.327 E019.48.30.706 Color_251ACI
N050.04.19.327 E019.48.30.706 N050.04.19.500 E019.48.29.763 Color_251ACI
N050.04.19.500 E019.48.29.763 N050.04.19.818 E019.48.28.478 Color_251ACI
N050.04.19.818 E019.48.28.478 N050.04.20.163 E019.48.27.210 Color_251ACI
N050.04.20.664 E019.46.53.748 N050.04.20.791 E019.46.53.729 Color_251ACI
N050.04.20.791 E019.46.53.729 N050.04.20.765 E019.46.51.618 Color_251ACI
N050.04.20.765 E019.46.51.618 N050.04.20.906 E019.46.51.417 Color_251ACI
N050.04.25.229 E019.48.23.545 N050.04.23.741 E019.48.22.888 Color_251ACI
N050.04.25.229 E019.48.23.545 N050.04.25.292 E019.48.23.536 Color_251ACI
N050.04.25.292 E019.48.23.536 N050.04.25.356 E019.48.23.526 Color_251ACI
N050.04.25.356 E019.48.23.526 N050.04.25.403 E019.48.23.459 Color_251ACI
N050.04.25.403 E019.48.23.459 N050.04.25.444 E019.48.23.294 Color_251ACI
N050.04.29.001 E019.48.25.340 N050.04.25.744 E019.48.23.808 Color_251ACI
N050.05.14.431 E019.48.26.363 N050.05.14.209 E019.48.26.276 Color_251ACI
N050.05.14.209 E019.48.26.276 N050.05.13.996 E019.48.26.148 Color_251ACI
N050.05.13.996 E019.48.26.148 N050.05.13.757 E019.48.26.004 Color_251ACI
N050.05.13.757 E019.48.26.004 N050.05.13.534 E019.48.25.918 Color_251ACI
N050.05.13.534 E019.48.25.918 N050.05.12.924 E019.48.25.789 Color_251ACI
N050.05.12.924 E019.48.25.789 N050.05.12.294 E019.48.25.742 Color_251ACI
N050.05.12.294 E019.48.25.742 N050.05.11.780 E019.48.25.719 Color_251ACI
N050.05.11.780 E019.48.25.719 N050.05.11.283 E019.48.25.753 Color_251ACI
N050.05.11.283 E019.48.25.753 N050.05.10.755 E019.48.25.911 Color_251ACI
N050.05.10.755 E019.48.25.911 N050.05.10.180 E019.48.26.136 Color_251ACI
N050.05.10.180 E019.48.26.136 N050.05.09.604 E019.48.26.361 Color_251ACI
N050.05.09.604 E019.48.26.361 N050.05.09.046 E019.48.26.643 Color_251ACI
N050.05.09.046 E019.48.26.643 N050.05.08.255 E019.48.27.120 Color_251ACI
N050.05.08.255 E019.48.27.120 N050.05.07.508 E019.48.27.670 Color_251ACI
N050.05.07.508 E019.48.27.670 N050.05.07.276 E019.48.27.864 Color_251ACI
N050.05.07.276 E019.48.27.864 N050.05.07.055 E019.48.28.016 Color_251ACI
N050.04.27.746 E019.48.23.870 N050.04.25.982 E019.48.23.094 Color_251ACI
N050.04.26.009 E019.48.23.110 N050.04.25.919 E019.48.23.103 Color_251ACI
N050.04.25.919 E019.48.23.103 N050.04.25.845 E019.48.23.154 Color_251ACI
N050.04.25.845 E019.48.23.154 N050.04.25.761 E019.48.23.247 Color_251ACI
N050.04.25.761 E019.48.23.247 N050.04.25.741 E019.48.23.329 Color_251ACI
N050.04.25.741 E019.48.23.329 N050.04.25.710 E019.48.23.454 Color_251ACI
N050.04.25.710 E019.48.23.454 N050.04.25.706 E019.48.23.594 Color_251ACI
N050.04.25.706 E019.48.23.594 N050.04.25.738 E019.48.23.709 Color_251ACI
N050.04.25.738 E019.48.23.709 N050.04.25.771 E019.48.23.824 Color_251ACI
N050.04.17.334 E019.47.59.553 N050.04.17.397 E019.47.59.544 Color_251ACI
N050.04.17.397 E019.47.59.544 N050.04.17.450 E019.47.59.576 Color_251ACI
N050.04.17.450 E019.47.59.576 N050.04.17.530 E019.47.59.624 Color_251ACI
N050.04.17.530 E019.47.59.624 N050.04.17.583 E019.47.59.656 Color_251ACI
N050.04.17.583 E019.47.59.656 N050.04.17.653 E019.47.59.745 Color_251ACI
N050.04.17.653 E019.47.59.745 N050.04.17.659 E019.47.59.844 Color_251ACI
N050.04.17.659 E019.47.59.844 N050.04.17.702 E019.47.59.918 Color_251ACI
N050.04.17.702 E019.47.59.918 N050.04.17.708 E019.48.00.017 Color_251ACI
N050.04.17.708 E019.48.00.017 N050.04.17.740 E019.48.00.132 Color_251ACI
N050.04.17.740 E019.48.00.132 N050.04.17.746 E019.48.00.230 Color_251ACI
N050.04.17.746 E019.48.00.230 N050.04.17.674 E019.48.00.520 Color_251ACI
N050.04.17.674 E019.48.00.520 N050.04.17.627 E019.48.00.587 Color_251ACI
N050.04.17.627 E019.48.00.587 N050.04.17.554 E019.48.00.638 Color_251ACI
N050.04.17.554 E019.48.00.638 N050.04.17.506 E019.48.00.705 Color_251ACI
N050.04.17.506 E019.48.00.705 N050.04.17.242 E019.48.00.784 Color_251ACI
N050.04.17.242 E019.48.00.784 N050.04.17.539 E019.48.02.915 Color_251ACI
N050.04.17.539 E019.48.02.915 N050.04.17.703 E019.48.02.871 Color_251ACI
N050.04.17.703 E019.48.02.871 N050.04.17.748 E019.48.03.184 Color_251ACI
N050.04.17.748 E019.48.03.184 N050.04.17.584 E019.48.03.228 Color_251ACI
N050.04.17.584 E019.48.03.228 N050.04.17.931 E019.48.05.770 Color_251ACI
N050.04.17.931 E019.48.05.770 N050.04.18.095 E019.48.05.726 Color_251ACI
N050.04.18.095 E019.48.05.726 N050.04.18.172 E019.48.06.154 Color_251ACI
N050.04.18.172 E019.48.06.154 N050.04.16.567 E019.48.06.711 Color_251ACI
N050.04.16.567 E019.48.06.711 N050.04.16.514 E019.48.06.679 Color_251ACI
N050.04.16.514 E019.48.06.679 N050.04.16.477 E019.48.06.704 Color_251ACI
N050.04.16.477 E019.48.06.704 N050.04.16.450 E019.48.06.688 Color_251ACI
N050.04.16.450 E019.48.06.688 N050.04.16.434 E019.48.06.631 Color_251ACI
N050.04.16.434 E019.48.06.631 N050.04.16.407 E019.48.06.615 Color_251ACI
N050.04.16.407 E019.48.06.615 N050.04.16.365 E019.48.06.541 Color_251ACI
N050.04.16.365 E019.48.06.541 N050.04.16.375 E019.48.06.500 Color_251ACI
N050.04.16.375 E019.48.06.500 N050.04.16.359 E019.48.06.443 Color_251ACI
N050.04.16.493 E019.48.07.381 N050.04.16.493 E019.48.07.381 Color_251ACI
N050.04.16.493 E019.48.07.381 N050.04.16.487 E019.48.07.282 Color_251ACI
N050.04.16.487 E019.48.07.282 N050.04.16.528 E019.48.07.116 Color_251ACI
N050.04.16.528 E019.48.07.116 N050.04.16.565 E019.48.07.090 Color_251ACI
N050.04.16.565 E019.48.07.090 N050.04.16.601 E019.48.07.065 Color_251ACI
N050.04.16.601 E019.48.07.065 N050.04.16.612 E019.48.07.024 Color_251ACI
N050.04.16.031 E019.48.06.531 N050.04.16.155 E019.48.07.510 Color_251ACI
N050.04.16.155 E019.48.07.510 N050.04.16.493 E019.48.07.381 Color_251ACI
N050.04.16.612 E019.48.07.024 N050.04.17.859 E019.48.06.679 Color_251ACI
N050.04.17.856 E019.48.00.773 N050.04.18.537 E019.48.06.040 Color_251ACI
N050.04.17.830 E019.48.00.757 N050.04.17.803 E019.48.00.741 Color_251ACI
N050.04.17.803 E019.48.00.741 N050.04.17.766 E019.48.00.766 Color_251ACI
N050.04.17.766 E019.48.00.766 N050.04.17.719 E019.48.00.833 Color_251ACI
N050.04.17.719 E019.48.00.833 N050.04.17.682 E019.48.00.859 Color_251ACI
N050.04.17.682 E019.48.00.859 N050.04.17.662 E019.48.00.941 Color_251ACI
N050.04.17.662 E019.48.00.941 N050.04.17.652 E019.48.00.983 Color_251ACI
N050.04.17.652 E019.48.00.983 N050.04.17.615 E019.48.01.008 Color_251ACI
N050.04.17.615 E019.48.01.008 N050.04.17.621 E019.48.01.107 Color_251ACI
N050.04.17.621 E019.48.01.107 N050.04.17.671 E019.48.01.519 Color_251ACI
N050.04.17.671 E019.48.01.519 N050.04.17.835 E019.48.01.474 Color_251ACI
N050.04.17.835 E019.48.01.474 N050.04.18.004 E019.48.02.766 Color_251ACI
N050.04.18.004 E019.48.02.766 N050.04.17.840 E019.48.02.811 Color_251ACI
N050.04.17.840 E019.48.02.811 N050.04.17.911 E019.48.03.139 Color_251ACI
N050.04.17.911 E019.48.03.139 N050.04.18.049 E019.48.03.079 Color_251ACI
N050.04.18.049 E019.48.03.079 N050.04.18.412 E019.48.05.679 Color_251ACI
N050.04.18.412 E019.48.05.679 N050.04.18.275 E019.48.05.739 Color_251ACI
N050.04.18.553 E019.48.06.097 N050.04.18.500 E019.48.06.065 Color_251ACI
N050.04.18.500 E019.48.06.065 N050.04.18.436 E019.48.06.075 Color_251ACI
N050.04.18.436 E019.48.06.075 N050.04.18.330 E019.48.06.011 Color_251ACI
N050.04.18.330 E019.48.06.011 N050.04.18.314 E019.48.05.953 Color_251ACI
N050.04.18.314 E019.48.05.953 N050.04.18.271 E019.48.05.880 Color_251ACI
N050.04.18.271 E019.48.05.880 N050.04.18.255 E019.48.05.822 Color_251ACI
N050.04.18.255 E019.48.05.822 N050.04.18.275 E019.48.05.739 Color_251ACI
N050.04.18.071 E019.48.06.807 N050.04.18.045 E019.48.06.791 Color_251ACI
N050.04.18.045 E019.48.06.791 N050.04.18.028 E019.48.06.734 Color_251ACI
N050.04.18.028 E019.48.06.734 N050.04.17.896 E019.48.06.654 Color_251ACI
N050.04.17.896 E019.48.06.654 N050.04.17.859 E019.48.06.679 Color_251ACI
N050.04.18.371 E019.48.06.463 N050.04.18.381 E019.48.06.422 Color_251ACI
N050.04.18.381 E019.48.06.422 N050.04.18.418 E019.48.06.397 Color_251ACI
N050.04.18.418 E019.48.06.397 N050.04.18.471 E019.48.06.429 Color_251ACI
N050.04.18.471 E019.48.06.429 N050.04.18.551 E019.48.06.477 Color_251ACI
N050.04.18.551 E019.48.06.477 N050.04.18.577 E019.48.06.493 Color_251ACI
N050.04.18.577 E019.48.06.493 N050.04.18.620 E019.48.06.566 Color_251ACI
N050.04.18.620 E019.48.06.566 N050.04.18.637 E019.48.06.624 Color_251ACI
N050.04.18.726 E019.48.07.249 N050.04.18.866 E019.48.08.286 Color_251ACI
N050.04.18.739 E019.48.08.923 N050.04.18.783 E019.48.09.236 Color_251ACI
N050.04.18.783 E019.48.09.236 N050.04.18.974 E019.48.09.208 Color_251ACI
N050.04.18.626 E019.48.06.665 N050.04.18.671 E019.48.06.978 Color_251ACI
N050.04.18.671 E019.48.06.978 N050.04.18.587 E019.48.07.070 Color_251ACI
N050.04.18.587 E019.48.07.070 N050.04.18.563 E019.48.06.674 Color_251ACI
N050.04.18.563 E019.48.06.674 N050.04.18.399 E019.48.06.719 Color_251ACI
N050.04.18.399 E019.48.06.719 N050.04.18.371 E019.48.06.463 Color_251ACI
N050.04.18.726 E019.48.07.249 N050.04.18.642 E019.48.07.341 Color_251ACI
N050.04.18.642 E019.48.07.341 N050.04.18.743 E019.48.08.164 Color_251ACI
N050.04.18.743 E019.48.08.164 N050.04.18.606 E019.48.08.224 Color_251ACI
N050.04.18.606 E019.48.08.224 N050.04.18.645 E019.48.08.438 Color_251ACI
N050.04.18.866 E019.48.08.286 N050.04.18.835 E019.48.08.410 Color_251ACI
N050.04.18.835 E019.48.08.410 N050.04.18.809 E019.48.08.394 Color_251ACI
N050.04.18.809 E019.48.08.394 N050.04.18.788 E019.48.08.477 Color_251ACI
N050.04.18.788 E019.48.08.477 N050.04.18.735 E019.48.08.445 Color_251ACI
N050.04.18.735 E019.48.08.445 N050.04.18.698 E019.48.08.470 Color_251ACI
N050.04.18.698 E019.48.08.470 N050.04.18.645 E019.48.08.438 Color_251ACI
N050.04.19.323 E019.48.14.085 N050.04.19.290 E019.48.13.970 Color_251ACI
N050.04.19.290 E019.48.13.970 N050.04.19.252 E019.48.13.756 Color_251ACI
N050.04.19.252 E019.48.13.756 N050.04.19.479 E019.48.13.702 Color_251ACI
N050.04.19.229 E019.48.11.504 N050.04.19.029 E019.48.11.574 Color_251ACI
N050.04.19.029 E019.48.11.574 N050.04.19.081 E019.48.12.225 Color_251ACI
N050.04.19.081 E019.48.12.225 N050.04.19.292 E019.48.12.114 Color_251ACI
N050.04.18.901 E019.48.12.212 N050.04.18.574 E019.48.12.300 Color_251ACI
N050.04.18.574 E019.48.12.300 N050.04.18.466 E019.48.11.378 Color_251ACI
N050.04.18.466 E019.48.11.378 N050.04.18.603 E019.48.11.318 Color_251ACI
N050.04.18.632 E019.48.11.573 N050.04.18.806 E019.48.11.487 Color_251ACI
N050.04.18.806 E019.48.11.487 N050.04.18.901 E019.48.12.212 Color_251ACI
N050.04.18.360 E019.48.09.219 N050.04.18.632 E019.48.11.573 Color_251ACI
N050.04.18.700 E019.48.12.281 N050.04.18.893 E019.48.13.969 Color_251ACI
N050.04.18.316 E019.48.11.859 N050.04.17.952 E019.48.11.973 Color_251ACI
N050.04.17.952 E019.48.11.973 N050.04.18.019 E019.48.12.442 Color_251ACI
N050.04.18.019 E019.48.12.442 N050.04.18.373 E019.48.12.370 Color_251ACI
N050.04.18.373 E019.48.12.370 N050.04.18.316 E019.48.11.859 Color_251ACI
N050.04.17.837 E019.48.09.476 N050.04.18.115 E019.48.11.929 Color_251ACI
N050.04.18.182 E019.48.12.398 N050.04.18.402 E019.48.14.101 Color_251ACI
N050.04.17.788 E019.48.12.017 N050.04.17.434 E019.48.12.090 Color_251ACI
N050.04.17.434 E019.48.12.090 N050.04.17.501 E019.48.12.559 Color_251ACI
N050.04.17.501 E019.48.12.559 N050.04.17.828 E019.48.12.470 Color_251ACI
N050.04.17.788 E019.48.12.017 N050.04.17.828 E019.48.12.470 Color_251ACI
N050.04.17.338 E019.48.09.889 N050.04.17.597 E019.48.12.046 Color_251ACI
N050.04.17.664 E019.48.12.515 N050.04.17.863 E019.48.14.301 Color_251ACI
N050.04.16.511 E019.48.13.344 N050.04.16.581 E019.48.13.434 Color_251ACI
N050.04.16.581 E019.48.13.434 N050.04.16.613 E019.48.13.549 Color_251ACI
N050.04.16.613 E019.48.13.549 N050.04.16.566 E019.48.13.615 Color_251ACI
N050.04.16.566 E019.48.13.615 N050.04.16.280 E019.48.13.538 Color_251ACI
N050.04.16.280 E019.48.13.538 N050.04.16.125 E019.48.14.778 Color_251ACI
N050.04.16.125 E019.48.14.778 N050.04.16.068 E019.48.14.887 Color_251ACI
N050.04.16.068 E019.48.14.887 N050.04.15.967 E019.48.14.921 Color_251ACI
N050.04.15.967 E019.48.14.921 N050.04.15.834 E019.48.14.841 Color_251ACI
N050.04.15.834 E019.48.14.841 N050.04.15.624 E019.48.14.334 Color_251ACI
N050.04.15.624 E019.48.14.334 N050.04.15.709 E019.48.13.623 Color_251ACI
N050.04.15.709 E019.48.13.623 N050.04.15.592 E019.48.13.600 Color_251ACI
N050.04.15.592 E019.48.13.600 N050.04.15.284 E019.48.14.225 Color_251ACI
N050.04.15.284 E019.48.14.225 N050.04.15.900 E019.48.15.071 Color_251ACI
N050.04.15.900 E019.48.15.071 N050.04.16.327 E019.48.15.567 Color_251ACI
N050.04.16.327 E019.48.15.567 N050.04.16.239 E019.48.15.799 Color_251ACI
N050.04.16.239 E019.48.15.799 N050.04.17.128 E019.48.17.144 Color_251ACI
N050.04.17.128 E019.48.17.144 N050.04.18.129 E019.48.18.652 Color_251ACI
N050.04.18.129 E019.48.18.652 N050.04.18.391 E019.48.18.952 Color_251ACI
N050.04.18.391 E019.48.18.952 N050.04.19.362 E019.48.19.965 Color_251ACI
N050.04.19.362 E019.48.19.965 N050.04.19.624 E019.48.20.266 Color_251ACI
N050.04.19.624 E019.48.20.266 N050.04.19.757 E019.48.20.346 Color_251ACI
N050.04.19.757 E019.48.20.346 N050.04.19.873 E019.48.20.368 Color_251ACI
N050.04.19.873 E019.48.20.368 N050.04.19.963 E019.48.20.375 Color_251ACI
N050.04.19.963 E019.48.20.375 N050.04.20.074 E019.48.20.299 Color_251ACI
N050.04.20.074 E019.48.20.299 N050.04.20.148 E019.48.20.248 Color_251ACI
N050.04.20.148 E019.48.20.248 N050.04.20.242 E019.48.20.114 Color_251ACI
N050.04.20.242 E019.48.20.114 N050.04.20.310 E019.48.19.964 Color_251ACI
N050.04.20.310 E019.48.19.964 N050.04.20.382 E019.48.19.674 Color_251ACI
N050.04.20.382 E019.48.19.674 N050.04.20.370 E019.48.19.477 Color_251ACI
N050.04.20.370 E019.48.19.477 N050.04.20.321 E019.48.19.304 Color_251ACI
N050.04.20.321 E019.48.19.304 N050.04.20.060 E019.48.18.385 Color_251ACI
N050.04.20.060 E019.48.18.385 N050.04.19.907 E019.48.17.769 Color_251ACI
N050.04.19.357 E019.48.14.439 N050.04.19.380 E019.48.14.595 Color_251ACI
N050.04.19.506 E019.48.17.290 N050.04.19.168 E019.48.17.420 Color_251ACI
N050.04.19.659 E019.48.17.906 N050.04.19.337 E019.48.18.093 Color_251ACI
N050.04.19.485 E019.48.17.992 N050.04.19.797 E019.48.19.322 Color_251ACI
N050.04.18.995 E019.48.14.792 N050.04.19.259 E019.48.16.808 Color_251ACI
N050.04.19.259 E019.48.16.808 N050.04.19.332 E019.48.17.376 Color_251ACI
N050.04.17.993 E019.48.19.570 N050.04.18.292 E019.48.19.845 Color_251ACI
N050.04.18.292 E019.48.19.845 N050.04.18.580 E019.48.20.161 Color_251ACI
N050.04.18.580 E019.48.20.161 N050.04.19.187 E019.48.20.670 Color_251ACI
N050.04.19.187 E019.48.20.670 N050.04.19.805 E019.48.21.137 Color_251ACI
N050.04.19.805 E019.48.21.137 N050.04.20.044 E019.48.21.281 Color_251ACI
N050.04.20.044 E019.48.21.281 N050.04.20.257 E019.48.21.409 Color_251ACI
N050.04.20.257 E019.48.21.409 N050.04.20.386 E019.48.21.629 Color_251ACI
N050.04.20.386 E019.48.21.629 N050.04.20.494 E019.48.21.933 Color_251ACI
N050.04.20.494 E019.48.21.933 N050.04.20.639 E019.48.22.210 Color_251ACI
N050.04.20.639 E019.48.22.210 N050.04.20.684 E019.48.22.523 Color_251ACI
N050.04.20.684 E019.48.22.523 N050.04.20.638 E019.48.22.829 Color_251ACI
N050.04.20.638 E019.48.22.829 N050.04.20.574 E019.48.23.457 Color_251ACI
N050.04.20.574 E019.48.23.457 N050.04.20.467 E019.48.24.012 Color_251ACI
N050.04.16.462 E019.48.17.362 N050.04.16.965 E019.48.18.046 Color_251ACI
N050.04.16.965 E019.48.18.046 N050.04.17.431 E019.48.18.755 Color_251ACI
N050.04.17.431 E019.48.18.755 N050.04.17.656 E019.48.19.081 Color_251ACI
N050.04.16.388 E019.47.59.793 N050.04.15.669 E019.47.59.980 Color_251ACI
N050.04.14.924 E019.48.00.150 N050.04.14.306 E019.48.00.302 Color_251ACI
N050.04.14.306 E019.48.00.302 N050.04.13.306 E019.48.00.510 Color_251ACI
N050.04.13.306 E019.48.00.510 N050.04.12.989 E019.48.00.557 Color_251ACI
N050.04.12.989 E019.48.00.557 N050.04.12.197 E019.48.00.794 Color_251ACI
N050.04.12.197 E019.48.00.794 N050.04.11.214 E019.48.01.060 Color_251ACI
N050.04.11.214 E019.48.01.060 N050.04.11.140 E019.48.01.110 Color_251ACI
N050.04.15.503 E019.48.00.404 N050.04.15.476 E019.48.00.388 Color_251ACI
N050.04.15.476 E019.48.00.388 N050.04.15.487 E019.48.00.346 Color_251ACI
N050.04.15.487 E019.48.00.346 N050.04.15.497 E019.48.00.305 Color_251ACI
N050.04.15.497 E019.48.00.305 N050.04.15.481 E019.48.00.247 Color_251ACI
N050.04.15.481 E019.48.00.247 N050.04.15.511 E019.48.00.123 Color_251ACI
N050.04.15.511 E019.48.00.123 N050.04.15.548 E019.48.00.098 Color_251ACI
N050.04.15.548 E019.48.00.098 N050.04.15.558 E019.48.00.056 Color_251ACI
N050.04.15.558 E019.48.00.056 N050.04.15.569 E019.48.00.015 Color_251ACI
N050.04.15.569 E019.48.00.015 N050.04.15.606 E019.47.59.989 Color_251ACI
N050.04.15.606 E019.47.59.989 N050.04.15.606 E019.47.59.989 Color_251ACI
N050.04.15.606 E019.47.59.989 N050.04.15.632 E019.48.00.005 Color_251ACI
N050.04.15.632 E019.48.00.005 N050.04.15.669 E019.47.59.980 Color_251ACI
N050.04.15.192 E019.48.00.549 N050.04.15.202 E019.48.00.508 Color_251ACI
N050.04.15.202 E019.48.00.508 N050.04.15.186 E019.48.00.451 Color_251ACI
N050.04.15.186 E019.48.00.451 N050.04.15.186 E019.48.00.451 Color_251ACI
N050.04.15.186 E019.48.00.451 N050.04.15.206 E019.48.00.368 Color_251ACI
N050.04.15.206 E019.48.00.368 N050.04.15.153 E019.48.00.336 Color_251ACI
N050.04.15.153 E019.48.00.336 N050.04.15.163 E019.48.00.294 Color_251ACI
N050.04.15.163 E019.48.00.294 N050.04.15.137 E019.48.00.278 Color_251ACI
N050.04.15.137 E019.48.00.278 N050.04.15.120 E019.48.00.221 Color_251ACI
N050.04.15.120 E019.48.00.221 N050.04.14.987 E019.48.00.141 Color_251ACI
N050.04.14.987 E019.48.00.141 N050.04.14.977 E019.48.00.182 Color_251ACI
N050.04.14.977 E019.48.00.182 N050.04.14.924 E019.48.00.150 Color_251ACI
N050.04.18.128 E019.47.58.937 N050.04.16.865 E019.47.59.224 Color_251ACI
N050.04.16.865 E019.47.59.224 N050.04.16.761 E019.47.59.399 Color_251ACI
N050.04.16.761 E019.47.59.399 N050.04.16.623 E019.47.59.459 Color_251ACI
N050.04.16.623 E019.47.59.459 N050.04.16.437 E019.47.59.347 Color_251ACI
N050.04.16.437 E019.47.59.347 N050.04.12.041 E019.48.00.558 Color_251ACI
N050.04.12.041 E019.48.00.558 N050.04.11.196 E019.48.00.763 Color_251ACI
N050.04.11.196 E019.48.00.763 N050.04.09.955 E019.48.01.206 Color_251ACI
N050.04.09.955 E019.48.01.206 N050.04.09.363 E019.48.01.374 Color_251ACI
N050.04.09.363 E019.48.01.374 N050.04.08.952 E019.48.01.555 Color_251ACI
N050.04.08.952 E019.48.01.555 N050.04.08.540 E019.48.01.736 Color_251ACI
N050.04.08.540 E019.48.01.736 N050.04.08.145 E019.48.01.974 Color_251ACI
N050.04.08.145 E019.48.01.974 N050.04.07.743 E019.48.02.113 Color_251ACI
N050.04.15.573 E019.48.16.018 N050.04.15.937 E019.48.16.522 Color_251ACI
N050.04.15.937 E019.48.16.522 N050.04.16.291 E019.48.17.069 Color_251ACI
N050.04.13.687 E019.48.13.025 N050.04.14.057 E019.48.13.628 Color_251ACI
N050.04.14.057 E019.48.13.628 N050.04.14.427 E019.48.14.232 Color_251ACI
N050.04.14.427 E019.48.14.232 N050.04.14.893 E019.48.14.941 Color_251ACI
N050.04.14.893 E019.48.14.941 N050.04.15.348 E019.48.15.692 Color_251ACI
N050.04.13.178 E019.48.12.242 N050.04.12.940 E019.48.12.956 Color_251ACI
N050.04.13.687 E019.48.13.025 N050.04.13.462 E019.48.12.699 Color_251ACI
N050.04.13.462 E019.48.12.699 N050.04.13.390 E019.48.12.989 Color_251ACI
N050.04.05.842 E019.48.03.493 N050.04.06.354 E019.48.03.277 Color_251ACI
N050.04.06.354 E019.48.03.277 N050.04.06.876 E019.48.03.020 Color_251ACI
N050.04.06.876 E019.48.03.020 N050.04.07.093 E019.48.03.008 Color_251ACI
N050.04.07.093 E019.48.03.008 N050.04.07.327 E019.48.03.053 Color_251ACI
N050.04.07.327 E019.48.03.053 N050.04.07.540 E019.48.03.181 Color_251ACI
N050.04.07.540 E019.48.03.181 N050.04.07.599 E019.48.03.312 Color_251ACI
N050.04.07.599 E019.48.03.312 N050.04.07.728 E019.48.03.532 Color_251ACI
N050.04.07.728 E019.48.03.532 N050.04.07.883 E019.48.03.769 Color_251ACI
N050.04.07.883 E019.48.03.769 N050.04.08.012 E019.48.03.989 Color_251ACI
N050.04.08.012 E019.48.03.989 N050.04.08.140 E019.48.04.209 Color_251ACI
N050.04.08.140 E019.48.04.209 N050.04.08.302 E019.48.04.545 Color_251ACI
N050.04.08.302 E019.48.04.545 N050.04.08.447 E019.48.04.822 Color_251ACI
N050.04.08.447 E019.48.04.822 N050.04.08.672 E019.48.05.148 Color_251ACI
N050.04.08.672 E019.48.05.148 N050.04.08.886 E019.48.05.515 Color_251ACI
N050.04.08.886 E019.48.05.515 N050.04.09.336 E019.48.06.167 Color_251ACI
N050.04.09.336 E019.48.06.167 N050.04.09.775 E019.48.06.860 Color_251ACI
N050.04.09.775 E019.48.06.860 N050.04.10.016 E019.48.07.244 Color_251ACI
N050.04.10.016 E019.48.07.244 N050.04.10.231 E019.48.07.611 Color_251ACI
N050.04.10.499 E019.48.08.010 N050.04.10.697 E019.48.08.320 Color_251ACI
N050.04.10.697 E019.48.08.320 N050.04.11.956 E019.48.10.268 Color_251ACI
N050.04.11.956 E019.48.10.268 N050.04.13.178 E019.48.12.242 Color_251ACI
N050.04.07.089 E019.48.01.671 N050.04.07.099 E019.48.01.630 Color_251ACI
N050.04.07.099 E019.48.01.630 N050.04.07.056 E019.48.01.557 Color_251ACI
N050.04.07.056 E019.48.01.557 N050.04.07.040 E019.48.01.499 Color_251ACI
N050.04.07.040 E019.48.01.499 N050.04.06.997 E019.48.01.426 Color_251ACI
N050.04.06.997 E019.48.01.426 N050.04.06.890 E019.48.01.362 Color_251ACI
N050.04.06.890 E019.48.01.362 N050.04.06.854 E019.48.01.387 Color_251ACI
N050.04.06.854 E019.48.01.387 N050.04.06.520 E019.48.01.377 Color_251ACI
N050.04.06.520 E019.48.01.377 N050.04.06.467 E019.48.01.345 Color_251ACI
N050.04.06.467 E019.48.01.345 N050.04.06.440 E019.48.01.329 Color_251ACI
N050.04.06.440 E019.48.01.329 N050.04.06.403 E019.48.01.354 Color_251ACI
N050.04.06.403 E019.48.01.354 N050.04.06.377 E019.48.01.338 Color_251ACI
N050.04.06.377 E019.48.01.338 N050.04.06.360 E019.48.01.281 Color_251ACI
N050.04.06.360 E019.48.01.281 N050.04.06.307 E019.48.01.249 Color_251ACI
N050.04.06.307 E019.48.01.249 N050.04.06.281 E019.48.01.233 Color_251ACI
N050.04.05.725 E019.47.59.898 N050.04.05.719 E019.47.59.799 Color_251ACI
N050.04.05.719 E019.47.59.799 N050.04.05.713 E019.47.59.700 Color_251ACI
N050.04.05.713 E019.47.59.700 N050.04.05.707 E019.47.59.602 Color_251ACI
N050.04.05.707 E019.47.59.602 N050.04.05.738 E019.47.59.477 Color_251ACI
N050.04.05.738 E019.47.59.477 N050.04.05.789 E019.47.59.270 Color_251ACI
N050.04.05.789 E019.47.59.270 N050.04.05.847 E019.47.59.162 Color_251ACI
N050.04.05.847 E019.47.59.162 N050.04.05.894 E019.47.59.095 Color_251ACI
N050.04.05.989 E019.47.59.819 N050.04.05.946 E019.47.59.746 Color_251ACI
N050.04.05.946 E019.47.59.746 N050.04.05.967 E019.47.59.663 Color_251ACI
N050.04.05.967 E019.47.59.663 N050.04.05.998 E019.47.59.538 Color_251ACI
N050.04.05.998 E019.47.59.538 N050.04.06.035 E019.47.59.513 Color_251ACI
N050.04.06.035 E019.47.59.513 N050.04.06.108 E019.47.59.462 Color_251ACI
N050.04.06.108 E019.47.59.462 N050.04.06.162 E019.47.59.494 Color_251ACI
N050.04.06.162 E019.47.59.494 N050.04.06.215 E019.47.59.526 Color_251ACI
N050.04.06.215 E019.47.59.526 N050.04.06.258 E019.47.59.600 Color_251ACI
N050.04.06.594 E019.48.00.707 N050.04.06.611 E019.48.00.765 Color_251ACI
N050.04.06.611 E019.48.00.765 N050.04.06.590 E019.48.00.847 Color_251ACI
N050.04.06.590 E019.48.00.847 N050.04.06.580 E019.48.00.889 Color_251ACI
N050.04.06.580 E019.48.00.889 N050.04.06.543 E019.48.00.914 Color_251ACI
N050.04.06.543 E019.48.00.914 N050.04.06.506 E019.48.00.940 Color_251ACI
N050.04.06.506 E019.48.00.940 N050.04.06.469 E019.48.00.965 Color_251ACI
N050.04.06.469 E019.48.00.965 N050.04.06.416 E019.48.00.933 Color_251ACI
N050.04.06.416 E019.48.00.933 N050.04.06.400 E019.48.00.876 Color_251ACI
N050.04.06.231 E019.47.59.584 N050.04.06.594 E019.48.00.707 Color_251ACI
N050.04.06.400 E019.48.00.876 N050.04.05.989 E019.47.59.819 Color_251ACI
N050.04.07.187 E019.48.02.016 N050.04.07.193 E019.48.02.115 Color_251ACI
N050.04.07.193 E019.48.02.115 N050.04.07.172 E019.48.02.198 Color_251ACI
N050.04.07.172 E019.48.02.198 N050.04.07.162 E019.48.02.239 Color_251ACI
N050.04.07.162 E019.48.02.239 N050.04.07.131 E019.48.02.364 Color_251ACI
N050.04.07.131 E019.48.02.364 N050.04.07.084 E019.48.02.430 Color_251ACI
N050.04.07.084 E019.48.02.430 N050.04.07.047 E019.48.02.456 Color_251ACI
N050.04.07.047 E019.48.02.456 N050.04.06.973 E019.48.02.507 Color_251ACI
N050.04.06.973 E019.48.02.507 N050.04.06.936 E019.48.02.532 Color_251ACI
N050.04.06.920 E019.48.02.475 N050.04.05.765 E019.48.03.065 Color_251ACI
N050.04.07.115 E019.48.01.687 N050.04.07.197 E019.48.01.975 Color_251ACI
N050.04.07.547 E019.48.02.042 N050.04.07.547 E019.48.02.042 Color_251ACI
N050.04.07.547 E019.48.02.042 N050.04.07.653 E019.48.02.107 Color_251ACI
N050.04.07.653 E019.48.02.107 N050.04.07.706 E019.48.02.139 Color_251ACI
N050.04.07.706 E019.48.02.139 N050.04.07.706 E019.48.02.139 Color_251ACI
N050.04.07.706 E019.48.02.139 N050.04.07.743 E019.48.02.113 Color_251ACI
N050.04.07.547 E019.48.02.042 N050.04.07.185 E019.48.01.158 Color_251ACI
N050.04.07.185 E019.48.01.158 N050.04.06.975 E019.48.00.651 Color_251ACI
N050.04.06.975 E019.48.00.651 N050.04.06.797 E019.48.00.258 Color_251ACI
N050.04.06.797 E019.48.00.258 N050.04.06.548 E019.47.59.537 Color_251ACI
N050.04.06.548 E019.47.59.537 N050.04.06.483 E019.47.59.307 Color_251ACI
N050.04.06.483 E019.47.59.307 N050.04.06.467 E019.47.59.249 Color_251ACI
N050.04.06.467 E019.47.59.249 N050.04.06.424 E019.47.59.176 Color_251ACI
N050.04.06.424 E019.47.59.176 N050.04.06.371 E019.47.59.144 Color_251ACI
N050.04.06.371 E019.47.59.144 N050.04.06.354 E019.47.59.086 Color_251ACI
N050.04.06.354 E019.47.59.086 N050.04.06.311 E019.47.59.013 Color_251ACI
N050.04.06.311 E019.47.59.013 N050.04.06.178 E019.47.58.933 Color_251ACI
N050.04.05.764 E019.47.41.255 N050.04.05.537 E019.47.53.261 Color_251ACI
N050.04.05.537 E019.47.53.261 N050.04.05.446 E019.47.56.587 Color_251ACI
N050.04.06.028 E019.47.41.176 N050.04.05.787 E019.47.53.364 Color_251ACI
N050.04.05.787 E019.47.53.364 N050.04.05.690 E019.47.56.591 Color_251ACI
N050.04.05.446 E019.47.56.587 N050.04.05.468 E019.47.56.743 Color_251ACI
N050.04.05.468 E019.47.56.743 N050.04.05.480 E019.47.56.941 Color_251ACI
N050.04.05.480 E019.47.56.941 N050.04.05.492 E019.47.57.139 Color_251ACI
N050.04.05.492 E019.47.57.139 N050.04.05.505 E019.47.57.337 Color_251ACI
N050.04.05.505 E019.47.57.337 N050.04.05.554 E019.47.57.509 Color_251ACI
N050.04.05.554 E019.47.57.509 N050.04.05.602 E019.47.57.681 Color_251ACI
N050.04.05.602 E019.47.57.681 N050.04.05.651 E019.47.57.854 Color_251ACI
N050.04.05.651 E019.47.57.854 N050.04.05.700 E019.47.58.026 Color_251ACI
N050.04.05.895 E019.47.57.858 N050.04.06.178 E019.47.58.933 Color_251ACI
N050.04.05.894 E019.47.59.095 N050.04.05.941 E019.47.59.028 Color_251ACI
N050.04.05.941 E019.47.59.028 N050.04.05.700 E019.47.58.026 Color_251ACI
N050.04.05.690 E019.47.56.591 N050.04.05.685 E019.47.56.731 Color_251ACI
N050.04.05.685 E019.47.56.731 N050.04.05.708 E019.47.56.888 Color_251ACI
N050.04.05.708 E019.47.56.888 N050.04.05.720 E019.47.57.085 Color_251ACI
N050.04.05.720 E019.47.57.085 N050.04.05.742 E019.47.57.242 Color_251ACI
N050.04.05.742 E019.47.57.242 N050.04.05.764 E019.47.57.398 Color_251ACI
N050.04.05.764 E019.47.57.398 N050.04.05.813 E019.47.57.570 Color_251ACI
N050.04.05.813 E019.47.57.570 N050.04.05.846 E019.47.57.685 Color_251ACI
N050.04.05.846 E019.47.57.685 N050.04.05.895 E019.47.57.858 Color_251ACI
N050.04.47.314 E019.45.48.554 N050.04.47.342 E019.45.49.428 Color_251ACI
N050.04.47.342 E019.45.49.428 N050.04.47.370 E019.45.50.302 Color_251ACI
N050.04.47.370 E019.45.50.302 N050.04.47.384 E019.45.50.739 Color_251ACI
N050.04.47.384 E019.45.50.739 N050.04.47.397 E019.45.51.176 Color_251ACI
N050.04.47.397 E019.45.51.176 N050.04.47.425 E019.45.52.050 Color_251ACI
N050.04.47.425 E019.45.52.050 N050.04.47.480 E019.45.52.940 Color_251ACI
N050.04.47.480 E019.45.52.940 N050.04.47.524 E019.45.53.871 Color_251ACI
N050.04.47.524 E019.45.53.871 N050.04.47.568 E019.45.54.802 Color_251ACI
N050.04.47.568 E019.45.54.802 N050.04.47.757 E019.45.57.488 Color_251ACI
N050.04.47.757 E019.45.57.488 N050.04.47.937 E019.46.00.215 Color_251ACI
N050.04.47.937 E019.46.00.215 N050.04.48.313 E019.46.05.108 Color_251ACI
N050.04.48.313 E019.46.05.108 N050.04.48.825 E019.46.09.941 Color_251ACI
N050.04.48.825 E019.46.09.941 N050.04.48.893 E019.46.10.410 Color_251ACI
N050.04.48.893 E019.46.10.410 N050.04.48.960 E019.46.10.879 Color_251ACI
N050.04.49.083 E019.46.11.858 N050.04.49.437 E019.46.12.404 Color_251ACI
N050.04.49.437 E019.46.12.404 N050.04.49.598 E019.46.12.740 Color_251ACI
N050.04.48.960 E019.46.10.879 N050.04.48.998 E019.46.11.093 Color_251ACI
N050.04.48.998 E019.46.11.093 N050.04.49.090 E019.46.11.338 Color_251ACI
N050.04.49.090 E019.46.11.338 N050.04.49.192 E019.46.11.543 Color_251ACI
N050.04.49.192 E019.46.11.543 N050.04.49.460 E019.46.11.942 Color_251ACI
N050.04.49.460 E019.46.11.942 N050.04.49.583 E019.46.12.063 Color_251ACI
N050.04.28.237 E019.46.05.592 N050.04.28.372 E019.46.05.292 Color_251ACI
N050.04.28.372 E019.46.05.292 N050.04.27.800 E019.46.00.329 Color_251ACI
N050.04.27.800 E019.46.00.329 N050.04.27.682 E019.46.00.067 Color_251ACI
N050.04.27.682 E019.46.00.067 N050.04.27.574 E019.45.59.145 Color_251ACI
N050.04.27.574 E019.45.59.145 N050.04.27.646 E019.45.58.855 Color_251ACI
N050.04.27.646 E019.45.58.855 N050.04.27.143 E019.45.54.599 Color_251ACI
N050.04.27.143 E019.45.54.599 N050.04.27.004 E019.45.54.420 Color_251ACI
N050.04.27.004 E019.45.54.420 N050.04.26.941 E019.45.53.811 Color_251ACI
N050.04.26.941 E019.45.53.811 N050.04.26.744 E019.45.53.741 Color_251ACI
N050.04.26.744 E019.45.53.741 N050.04.26.327 E019.45.53.822 Color_251ACI
N050.04.26.327 E019.45.53.822 N050.04.26.298 E019.45.53.567 Color_251ACI
N050.04.26.298 E019.45.53.567 N050.04.26.700 E019.45.53.428 Color_251ACI
N050.04.26.700 E019.45.53.428 N050.04.26.962 E019.45.53.110 Color_251ACI
N050.04.26.962 E019.45.53.110 N050.04.26.777 E019.45.51.760 Color_251ACI
N050.04.49.057 E019.46.11.842 N050.04.49.741 E019.46.16.969 Color_251ACI
N050.04.49.741 E019.46.16.969 N050.04.50.410 E019.46.22.038 Color_251ACI
N050.04.50.410 E019.46.22.038 N050.04.51.074 E019.46.26.629 Color_251ACI
N050.04.51.074 E019.46.26.629 N050.04.51.712 E019.46.31.203 Color_251ACI
N050.04.52.059 E019.46.30.174 N050.04.51.712 E019.46.31.203 Color_251ACI
N050.04.52.278 E019.46.30.401 N050.04.52.019 E019.46.31.198 Color_251ACI
N050.04.52.019 E019.46.31.198 N050.04.51.927 E019.46.31.571 Color_251ACI
N050.04.51.927 E019.46.31.571 N050.04.51.902 E019.46.31.794 Color_251ACI
N050.04.51.902 E019.46.31.794 N050.04.51.883 E019.46.32.116 Color_251ACI
N050.04.51.883 E019.46.32.116 N050.04.51.901 E019.46.32.412 Color_251ACI
N050.04.51.901 E019.46.32.412 N050.04.51.919 E019.46.32.709 Color_251ACI
N050.05.01.804 E019.47.17.138 N050.05.01.837 E019.47.17.253 Color_251ACI
N050.05.01.837 E019.47.17.253 N050.05.01.879 E019.47.17.327 Color_251ACI
N050.05.01.879 E019.47.17.327 N050.05.01.922 E019.47.17.400 Color_251ACI
N050.05.01.922 E019.47.17.400 N050.05.01.992 E019.47.17.489 Color_251ACI
N050.05.01.992 E019.47.17.489 N050.05.02.045 E019.47.17.522 Color_251ACI
N050.05.02.045 E019.47.17.522 N050.05.02.125 E019.47.17.570 Color_251ACI
N050.05.02.125 E019.47.17.570 N050.05.02.205 E019.47.17.618 Color_251ACI
N050.05.02.205 E019.47.17.618 N050.05.02.278 E019.47.17.567 Color_251ACI
N050.05.02.329 E019.47.17.978 N050.05.02.249 E019.47.17.930 Color_251ACI
N050.05.02.249 E019.47.17.930 N050.05.02.202 E019.47.17.997 Color_251ACI
N050.05.02.202 E019.47.17.997 N050.05.02.139 E019.47.18.006 Color_251ACI
N050.05.02.139 E019.47.18.006 N050.05.02.055 E019.47.18.099 Color_251ACI
N050.05.02.055 E019.47.18.099 N050.05.02.018 E019.47.18.124 Color_251ACI
N050.05.02.018 E019.47.18.124 N050.05.01.960 E019.47.18.232 Color_251ACI
N050.05.01.960 E019.47.18.232 N050.05.01.909 E019.47.18.440 Color_251ACI
N050.05.01.804 E019.47.17.138 N050.05.01.620 E019.47.14.551 Color_251ACI
N050.05.01.620 E019.47.14.551 N050.05.01.447 E019.47.11.923 Color_251ACI
N050.04.17.442 E019.46.51.951 N050.04.18.034 E019.46.51.783 Color_251ACI
N050.04.18.034 E019.46.51.783 N050.04.18.176 E019.46.51.583 Color_251ACI
N050.04.18.176 E019.46.51.583 N050.04.18.162 E019.46.51.146 Color_251ACI
N050.04.18.162 E019.46.51.146 N050.04.18.890 E019.46.24.917 Color_251ACI
N050.04.18.890 E019.46.24.917 N050.04.17.926 E019.46.24.861 Color_251ACI
N050.04.18.429 E019.46.52.164 N050.04.18.548 E019.46.51.807 Color_251ACI
N050.04.18.548 E019.46.51.807 N050.04.18.685 E019.46.51.747 Color_251ACI
N050.04.18.875 E019.46.51.718 N050.04.19.473 E019.46.51.650 Color_251ACI
N050.04.19.473 E019.46.51.650 N050.04.19.526 E019.46.51.682 Color_251ACI
N050.04.19.526 E019.46.51.682 N050.04.19.555 E019.46.51.937 Color_251ACI
N050.04.19.555 E019.46.51.937 N050.04.20.316 E019.46.51.824 Color_251ACI
N050.04.20.316 E019.46.51.824 N050.04.20.331 E019.46.51.642 Color_251ACI
N050.04.20.664 E019.46.53.748 N050.04.20.653 E019.46.52.931 Color_251ACI
N050.04.20.653 E019.46.52.931 N050.04.20.631 E019.46.52.775 Color_251ACI
N050.04.20.631 E019.46.52.775 N050.04.20.561 E019.46.52.686 Color_251ACI
N050.04.20.561 E019.46.52.686 N050.04.20.471 E019.46.52.679 Color_251ACI
N050.04.20.471 E019.46.52.679 N050.04.20.457 E019.46.52.242 Color_251ACI
N050.04.20.331 E019.46.51.642 N050.04.20.351 E019.46.51.559 Color_251ACI
N050.04.20.351 E019.46.51.559 N050.04.20.452 E019.46.51.525 Color_251ACI
N050.04.20.452 E019.46.51.525 N050.04.20.558 E019.46.51.589 Color_251ACI
N050.04.20.558 E019.46.51.589 N050.04.20.617 E019.46.51.719 Color_251ACI
N050.04.20.617 E019.46.51.719 N050.04.20.629 E019.46.51.917 Color_251ACI
N050.04.20.629 E019.46.51.917 N050.04.20.578 E019.46.52.124 Color_251ACI
N050.04.20.578 E019.46.52.124 N050.04.20.521 E019.46.52.233 Color_251ACI
N050.04.20.521 E019.46.52.233 N050.04.20.457 E019.46.52.242 Color_251ACI
N050.04.22.748 E019.46.59.764 N050.04.22.896 E019.46.59.663 Color_251ACI
N050.04.22.896 E019.46.59.663 N050.04.22.830 E019.46.59.433 Color_251ACI
N050.04.22.830 E019.46.59.433 N050.04.23.347 E019.46.59.077 Color_251ACI
N050.04.22.552 E019.46.59.075 N050.04.22.716 E019.46.59.031 Color_251ACI
N050.04.22.716 E019.46.59.031 N050.04.22.765 E019.46.59.203 Color_251ACI
N050.04.22.765 E019.46.59.203 N050.04.23.265 E019.46.58.790 Color_251ACI
N050.05.01.591 E019.47.21.201 N050.05.01.652 E019.47.20.094 Color_251ACI
N050.05.01.652 E019.47.20.094 N050.05.01.712 E019.47.18.988 Color_251ACI
N050.05.01.702 E019.47.19.029 N050.05.01.825 E019.47.20.627 Color_251ACI
N050.05.01.825 E019.47.20.627 N050.05.01.931 E019.47.21.310 Color_251ACI
N050.05.01.591 E019.47.21.201 N050.05.01.597 E019.47.21.300 Color_251ACI
N050.05.01.597 E019.47.21.300 N050.05.01.630 E019.47.21.414 Color_251ACI
N050.05.01.630 E019.47.21.414 N050.05.01.656 E019.47.21.430 Color_251ACI
N050.05.01.656 E019.47.21.430 N050.05.01.736 E019.47.21.478 Color_251ACI
N050.05.01.736 E019.47.21.478 N050.05.01.789 E019.47.21.510 Color_251ACI
N050.05.01.789 E019.47.21.510 N050.05.01.836 E019.47.21.444 Color_251ACI
N050.05.01.836 E019.47.21.444 N050.05.01.910 E019.47.21.393 Color_251ACI
N050.05.01.910 E019.47.21.393 N050.05.01.931 E019.47.21.310 Color_251ACI
N050.05.01.909 E019.47.18.440 N050.05.02.077 E019.47.20.350 Color_251ACI
N050.05.02.077 E019.47.20.350 N050.05.02.178 E019.47.21.173 Color_251ACI
N050.05.02.178 E019.47.21.173 N050.05.02.184 E019.47.21.272 Color_251ACI
N050.05.02.184 E019.47.21.272 N050.05.02.217 E019.47.21.387 Color_251ACI
N050.05.02.217 E019.47.21.387 N050.05.02.250 E019.47.21.502 Color_251ACI
N050.05.02.250 E019.47.21.502 N050.05.02.293 E019.47.21.575 Color_251ACI
N050.05.02.293 E019.47.21.575 N050.05.02.336 E019.47.21.649 Color_251ACI
N050.05.02.336 E019.47.21.649 N050.05.02.405 E019.47.21.738 Color_251ACI
N050.05.02.405 E019.47.21.738 N050.05.02.485 E019.47.21.786 Color_251ACI
N050.05.02.485 E019.47.21.786 N050.05.02.565 E019.47.21.834 Color_251ACI
N050.05.01.484 E019.47.22.374 N050.05.01.541 E019.47.22.266 Color_251ACI
N050.05.01.541 E019.47.22.266 N050.05.01.598 E019.47.22.157 Color_251ACI
N050.05.01.598 E019.47.22.157 N050.05.01.672 E019.47.22.107 Color_251ACI
N050.05.01.672 E019.47.22.107 N050.05.01.746 E019.47.22.056 Color_251ACI
N050.05.01.746 E019.47.22.056 N050.05.01.819 E019.47.22.005 Color_251ACI
N050.05.01.819 E019.47.22.005 N050.05.01.883 E019.47.21.995 Color_251ACI
N050.05.01.883 E019.47.21.995 N050.05.01.983 E019.47.21.961 Color_251ACI
N050.05.01.983 E019.47.21.961 N050.05.02.036 E019.47.21.993 Color_251ACI
N050.05.02.063 E019.47.22.009 N050.05.02.955 E019.47.22.355 Color_251ACI
N050.05.02.565 E019.47.21.834 N050.05.03.010 E019.47.22.008 Color_251ACI
N050.04.20.917 E019.47.06.900 N050.04.21.155 E019.47.06.805 Color_251ACI
N050.04.21.155 E019.47.06.805 N050.04.22.058 E019.47.06.492 Color_251ACI
N050.04.22.058 E019.47.06.492 N050.04.22.670 E019.47.06.241 Color_251ACI
N050.04.22.670 E019.47.06.241 N050.04.22.998 E019.47.06.153 Color_251ACI
N050.04.22.971 E019.47.06.137 N050.04.23.018 E019.47.06.070 Color_251ACI
N050.04.23.018 E019.47.06.070 N050.04.23.082 E019.47.06.061 Color_251ACI
N050.04.23.082 E019.47.06.061 N050.04.23.102 E019.47.05.978 Color_251ACI
N050.04.23.102 E019.47.05.978 N050.04.23.154 E019.47.05.770 Color_251ACI
N050.04.23.154 E019.47.05.770 N050.04.23.164 E019.47.05.729 Color_251ACI
N050.04.23.164 E019.47.05.729 N050.04.23.158 E019.47.05.630 Color_251ACI
N050.04.23.158 E019.47.05.630 N050.04.23.103 E019.47.05.359 Color_251ACI
N050.04.23.103 E019.47.05.359 N050.04.22.876 E019.47.05.413 Color_251ACI
N050.04.22.766 E019.47.04.870 N050.04.22.709 E019.47.04.360 Color_251ACI
N050.04.22.709 E019.47.04.360 N050.04.22.809 E019.47.04.325 Color_251ACI
N050.04.22.809 E019.47.04.325 N050.04.22.903 E019.47.04.810 Color_251ACI
N050.04.22.903 E019.47.04.810 N050.04.23.140 E019.47.04.715 Color_251ACI
N050.04.23.140 E019.47.04.715 N050.04.23.285 E019.47.05.611 Color_251ACI
N050.04.23.285 E019.47.05.611 N050.04.23.274 E019.47.05.653 Color_251ACI
N050.04.23.274 E019.47.05.653 N050.04.23.280 E019.47.05.752 Color_251ACI
N050.04.23.280 E019.47.05.752 N050.04.23.307 E019.47.05.768 Color_251ACI
N050.04.23.307 E019.47.05.768 N050.04.23.323 E019.47.05.825 Color_251ACI
N050.04.23.323 E019.47.05.825 N050.04.23.340 E019.47.05.883 Color_251ACI
N050.04.23.340 E019.47.05.883 N050.04.23.356 E019.47.05.940 Color_251ACI
N050.04.23.356 E019.47.05.940 N050.04.23.383 E019.47.05.956 Color_251ACI
N050.04.23.383 E019.47.05.956 N050.04.23.399 E019.47.06.013 Color_251ACI
N050.04.23.409 E019.47.05.972 N050.04.23.452 E019.47.06.045 Color_251ACI
N050.04.23.452 E019.47.06.045 N050.04.23.479 E019.47.06.061 Color_251ACI
N050.04.23.479 E019.47.06.061 N050.04.23.542 E019.47.06.052 Color_251ACI
N050.04.23.542 E019.47.06.052 N050.04.23.569 E019.47.06.068 Color_251ACI
N050.04.23.569 E019.47.06.068 N050.04.23.569 E019.47.06.068 Color_251ACI
N050.04.23.569 E019.47.06.068 N050.04.23.632 E019.47.06.059 Color_251ACI
N050.04.23.632 E019.47.06.059 N050.04.23.643 E019.47.06.017 Color_251ACI
N050.04.24.925 E019.47.04.789 N050.04.24.921 E019.47.04.930 Color_251ACI
N050.04.24.921 E019.47.04.930 N050.04.24.833 E019.47.05.162 Color_251ACI
N050.04.24.833 E019.47.05.162 N050.04.24.701 E019.47.05.321 Color_251ACI
N050.04.24.701 E019.47.05.321 N050.04.23.790 E019.47.05.916 Color_251ACI
N050.04.23.790 E019.47.05.916 N050.04.23.643 E019.47.06.017 Color_251ACI
N050.04.20.780 E019.47.07.579 N050.04.20.790 E019.47.07.538 Color_251ACI
N050.04.20.790 E019.47.07.538 N050.04.20.827 E019.47.07.512 Color_251ACI
N050.04.20.827 E019.47.07.512 N050.04.20.837 E019.47.07.471 Color_251ACI
N050.04.20.837 E019.47.07.471 N050.04.20.847 E019.47.07.430 Color_251ACI
N050.04.20.847 E019.47.07.430 N050.04.20.894 E019.47.07.363 Color_251ACI
N050.04.20.894 E019.47.07.363 N050.04.20.921 E019.47.07.379 Color_251ACI
N050.04.20.921 E019.47.07.379 N050.04.20.958 E019.47.07.353 Color_251ACI
N050.04.20.958 E019.47.07.353 N050.04.20.968 E019.47.07.312 Color_251ACI
N050.04.20.968 E019.47.07.312 N050.04.21.005 E019.47.07.286 Color_251ACI
N050.04.21.005 E019.47.07.286 N050.04.21.032 E019.47.07.302 Color_251ACI
N050.04.21.032 E019.47.07.302 N050.04.21.058 E019.47.07.318 Color_251ACI
N050.04.21.058 E019.47.07.318 N050.04.21.111 E019.47.07.350 Color_251ACI
N050.04.21.111 E019.47.07.350 N050.04.21.138 E019.47.07.367 Color_251ACI
N050.04.21.138 E019.47.07.367 N050.04.21.181 E019.47.07.440 Color_251ACI
N050.04.21.181 E019.47.07.440 N050.04.21.197 E019.47.07.497 Color_251ACI
N050.04.21.701 E019.47.06.944 N050.04.21.728 E019.47.06.960 Color_251ACI
N050.04.21.728 E019.47.06.960 N050.04.21.781 E019.47.06.992 Color_251ACI
N050.04.21.781 E019.47.06.992 N050.04.21.824 E019.47.07.065 Color_251ACI
N050.04.21.824 E019.47.07.065 N050.04.21.803 E019.47.07.148 Color_251ACI
N050.04.21.803 E019.47.07.148 N050.04.21.766 E019.47.07.174 Color_251ACI
N050.04.21.766 E019.47.07.174 N050.04.21.740 E019.47.07.157 Color_251ACI
N050.04.21.740 E019.47.07.157 N050.04.21.640 E019.47.07.192 Color_251ACI
N050.04.21.640 E019.47.07.192 N050.04.21.823 E019.47.08.303 Color_251ACI
N050.04.21.823 E019.47.08.303 N050.04.21.923 E019.47.08.268 Color_251ACI
N050.04.21.923 E019.47.08.268 N050.04.21.950 E019.47.08.284 Color_251ACI
N050.04.21.950 E019.47.08.284 N050.04.22.003 E019.47.08.316 Color_251ACI
N050.04.22.003 E019.47.08.316 N050.04.22.003 E019.47.08.316 Color_251ACI
N050.04.22.003 E019.47.08.316 N050.04.21.972 E019.47.08.440 Color_251ACI
N050.04.21.972 E019.47.08.440 N050.04.21.972 E019.47.08.440 Color_251ACI
N050.04.21.945 E019.47.08.424 N050.04.21.908 E019.47.08.449 Color_251ACI
N050.04.21.908 E019.47.08.449 N050.04.21.845 E019.47.08.459 Color_251ACI
N050.04.21.845 E019.47.08.459 N050.04.21.685 E019.47.08.363 Color_251ACI
N050.04.21.685 E019.47.08.363 N050.04.21.643 E019.47.08.289 Color_251ACI
N050.04.21.643 E019.47.08.289 N050.04.21.600 E019.47.08.216 Color_251ACI
N050.04.21.600 E019.47.08.216 N050.04.21.557 E019.47.08.142 Color_251ACI
N050.04.21.557 E019.47.08.142 N050.04.21.530 E019.47.08.126 Color_251ACI
N050.04.21.530 E019.47.08.126 N050.04.21.498 E019.47.08.012 Color_251ACI
N050.04.21.498 E019.47.08.012 N050.04.21.481 E019.47.07.954 Color_251ACI
N050.04.21.481 E019.47.07.954 N050.04.21.449 E019.47.07.839 Color_251ACI
N050.04.21.449 E019.47.07.839 N050.04.21.459 E019.47.07.798 Color_251ACI
N050.04.21.459 E019.47.07.798 N050.04.21.426 E019.47.07.683 Color_251ACI
N050.04.21.426 E019.47.07.683 N050.04.21.447 E019.47.07.600 Color_251ACI
N050.04.21.447 E019.47.07.600 N050.04.21.430 E019.47.07.543 Color_251ACI
N050.04.21.430 E019.47.07.543 N050.04.21.441 E019.47.07.501 Color_251ACI
N050.04.21.441 E019.47.07.501 N050.04.21.461 E019.47.07.418 Color_251ACI
N050.04.21.461 E019.47.07.418 N050.04.21.492 E019.47.07.294 Color_251ACI
N050.04.21.492 E019.47.07.294 N050.04.21.502 E019.47.07.253 Color_251ACI
N050.04.21.502 E019.47.07.253 N050.04.21.523 E019.47.07.170 Color_251ACI
N050.04.21.523 E019.47.07.170 N050.04.21.560 E019.47.07.144 Color_251ACI
N050.04.21.560 E019.47.07.144 N050.04.21.560 E019.47.07.144 Color_251ACI
N050.04.21.560 E019.47.07.144 N050.04.21.580 E019.47.07.061 Color_251ACI
N050.04.21.580 E019.47.07.061 N050.04.21.580 E019.47.07.061 Color_251ACI
N050.04.21.580 E019.47.07.061 N050.04.21.617 E019.47.07.036 Color_251ACI
N050.04.21.617 E019.47.07.036 N050.04.21.654 E019.47.07.011 Color_251ACI
N050.04.21.654 E019.47.07.011 N050.04.21.664 E019.47.06.969 Color_251ACI
N050.04.21.664 E019.47.06.969 N050.04.21.691 E019.47.06.985 Color_251ACI
N050.04.21.197 E019.47.07.497 N050.04.21.437 E019.47.09.118 Color_251ACI
N050.04.21.068 E019.47.09.372 N050.04.21.085 E019.47.09.430 Color_251ACI
N050.04.21.085 E019.47.09.430 N050.04.21.111 E019.47.09.446 Color_251ACI
N050.04.21.111 E019.47.09.446 N050.04.21.128 E019.47.09.503 Color_251ACI
N050.04.21.128 E019.47.09.503 N050.04.21.207 E019.47.09.551 Color_251ACI
N050.04.21.207 E019.47.09.551 N050.04.21.244 E019.47.09.526 Color_251ACI
N050.04.21.244 E019.47.09.526 N050.04.21.271 E019.47.09.542 Color_251ACI
N050.04.21.271 E019.47.09.542 N050.04.21.308 E019.47.09.516 Color_251ACI
N050.04.21.308 E019.47.09.516 N050.04.21.318 E019.47.09.475 Color_251ACI
N050.04.21.318 E019.47.09.475 N050.04.21.355 E019.47.09.450 Color_251ACI
N050.04.21.355 E019.47.09.450 N050.04.21.365 E019.47.09.408 Color_251ACI
N050.04.21.365 E019.47.09.408 N050.04.21.402 E019.47.09.383 Color_251ACI
N050.04.21.402 E019.47.09.383 N050.04.21.443 E019.47.09.217 Color_251ACI
N050.04.21.443 E019.47.09.217 N050.04.21.437 E019.47.09.118 Color_251ACI
N050.04.22.067 E019.47.07.069 N050.04.22.131 E019.47.07.060 Color_251ACI
N050.04.22.131 E019.47.07.060 N050.04.22.314 E019.47.08.170 Color_251ACI
N050.04.22.314 E019.47.08.170 N050.04.22.214 E019.47.08.205 Color_251ACI
N050.04.22.214 E019.47.08.205 N050.04.22.177 E019.47.08.230 Color_251ACI
N050.04.22.177 E019.47.08.230 N050.04.22.177 E019.47.08.230 Color_251ACI
N050.04.22.177 E019.47.08.230 N050.04.22.167 E019.47.08.272 Color_251ACI
N050.04.22.167 E019.47.08.272 N050.04.22.156 E019.47.08.313 Color_251ACI
N050.04.22.156 E019.47.08.313 N050.04.22.173 E019.47.08.370 Color_251ACI
N050.04.22.173 E019.47.08.370 N050.04.22.173 E019.47.08.370 Color_251ACI
N050.04.22.173 E019.47.08.370 N050.04.22.226 E019.47.08.402 Color_251ACI
N050.04.22.226 E019.47.08.402 N050.04.22.226 E019.47.08.402 Color_251ACI
N050.04.22.226 E019.47.08.402 N050.04.22.527 E019.47.08.298 Color_251ACI
N050.04.22.067 E019.47.07.069 N050.04.22.041 E019.47.07.053 Color_251ACI
N050.04.22.041 E019.47.07.053 N050.04.22.014 E019.47.07.037 Color_251ACI
N050.04.22.014 E019.47.07.037 N050.04.21.988 E019.47.07.021 Color_251ACI
N050.04.21.988 E019.47.07.021 N050.04.21.971 E019.47.06.964 Color_251ACI
N050.04.21.971 E019.47.06.964 N050.04.21.971 E019.47.06.964 Color_251ACI
N050.04.21.971 E019.47.06.964 N050.04.21.971 E019.47.06.964 Color_251ACI
N050.04.21.971 E019.47.06.964 N050.04.21.955 E019.47.06.906 Color_251ACI
N050.04.21.955 E019.47.06.906 N050.04.21.965 E019.47.06.865 Color_251ACI
N050.04.21.965 E019.47.06.865 N050.04.22.002 E019.47.06.839 Color_251ACI
N050.04.22.002 E019.47.06.839 N050.04.22.002 E019.47.06.839 Color_251ACI
N050.04.22.002 E019.47.06.839 N050.04.22.012 E019.47.06.798 Color_251ACI
N050.04.22.012 E019.47.06.798 N050.04.22.023 E019.47.06.756 Color_251ACI
N050.04.22.023 E019.47.06.756 N050.04.22.049 E019.47.06.772 Color_251ACI
N050.04.22.049 E019.47.06.772 N050.04.22.451 E019.47.06.633 Color_251ACI
N050.04.22.520 E019.47.06.722 N050.04.22.543 E019.47.06.879 Color_251ACI
N050.04.22.543 E019.47.06.879 N050.04.23.091 E019.47.06.638 Color_251ACI
N050.04.23.091 E019.47.06.638 N050.04.23.069 E019.47.06.481 Color_251ACI
N050.04.23.069 E019.47.06.481 N050.04.23.089 E019.47.06.399 Color_251ACI
N050.04.23.089 E019.47.06.399 N050.04.23.126 E019.47.06.373 Color_251ACI
N050.04.23.126 E019.47.06.373 N050.04.23.126 E019.47.06.373 Color_251ACI
N050.04.23.126 E019.47.06.373 N050.04.23.126 E019.47.06.373 Color_251ACI
N050.04.23.126 E019.47.06.373 N050.04.23.190 E019.47.06.364 Color_251ACI
N050.04.23.190 E019.47.06.364 N050.04.23.227 E019.47.06.338 Color_251ACI
N050.04.23.227 E019.47.06.338 N050.04.23.280 E019.47.06.370 Color_251ACI
N050.04.23.280 E019.47.06.370 N050.04.23.317 E019.47.06.345 Color_251ACI
N050.04.23.317 E019.47.06.345 N050.04.23.370 E019.47.06.377 Color_251ACI
N050.04.23.370 E019.47.06.377 N050.04.23.476 E019.47.06.441 Color_251ACI
N050.04.23.430 E019.47.07.984 N050.04.23.477 E019.47.07.918 Color_251ACI
N050.04.23.477 E019.47.07.918 N050.04.23.540 E019.47.07.908 Color_251ACI
N050.04.23.540 E019.47.07.908 N050.04.23.614 E019.47.07.857 Color_251ACI
N050.04.23.614 E019.47.07.857 N050.04.23.671 E019.47.07.749 Color_251ACI
N050.04.23.671 E019.47.07.749 N050.04.23.719 E019.47.07.682 Color_251ACI
N050.04.23.719 E019.47.07.682 N050.04.23.770 E019.47.07.475 Color_251ACI
N050.04.23.770 E019.47.07.475 N050.04.23.774 E019.47.07.335 Color_251ACI
N050.04.23.801 E019.47.07.351 N050.04.23.805 E019.47.07.210 Color_251ACI
N050.04.23.805 E019.47.07.210 N050.04.23.783 E019.47.07.054 Color_251ACI
N050.04.23.783 E019.47.07.054 N050.04.23.777 E019.47.06.955 Color_251ACI
N050.04.23.777 E019.47.06.955 N050.04.23.728 E019.47.06.783 Color_251ACI
N050.04.23.728 E019.47.06.783 N050.04.23.685 E019.47.06.709 Color_251ACI
N050.04.23.685 E019.47.06.709 N050.04.23.626 E019.47.06.578 Color_251ACI
N050.04.23.626 E019.47.06.578 N050.04.23.556 E019.47.06.489 Color_251ACI
N050.04.23.556 E019.47.06.489 N050.04.23.487 E019.47.06.400 Color_251ACI
N050.05.01.973 E019.47.29.764 N050.05.01.684 E019.47.28.590 Color_251ACI
N050.05.01.684 E019.47.28.590 N050.05.01.448 E019.47.27.448 Color_251ACI
N050.05.01.448 E019.47.27.448 N050.05.01.230 E019.47.26.602 Color_251ACI
N050.05.01.230 E019.47.26.602 N050.05.01.085 E019.47.25.706 Color_251ACI
N050.05.01.085 E019.47.25.706 N050.05.01.058 E019.47.24.213 Color_251ACI
N050.05.01.058 E019.47.24.213 N050.05.01.174 E019.47.22.759 Color_251ACI
N050.05.01.174 E019.47.22.759 N050.05.01.251 E019.47.21.710 Color_251ACI
N050.05.01.251 E019.47.21.710 N050.05.01.301 E019.47.20.645 Color_251ACI
N050.05.01.301 E019.47.20.645 N050.05.01.355 E019.47.20.058 Color_251ACI
N050.05.01.355 E019.47.20.058 N050.05.01.409 E019.47.19.472 Color_251ACI
N050.05.01.409 E019.47.19.472 N050.05.01.506 E019.47.18.340 Color_251ACI
N050.05.01.506 E019.47.18.340 N050.05.01.513 E019.47.17.201 Color_251ACI
N050.05.01.513 E019.47.17.201 N050.05.01.340 E019.47.14.573 Color_251ACI
N050.05.01.340 E019.47.14.573 N050.05.01.183 E019.47.12.002 Color_251ACI
N050.05.00.922 E019.47.31.417 N050.05.01.229 E019.47.33.507 Color_251ACI
N050.05.01.229 E019.47.33.507 N050.05.01.546 E019.47.35.555 Color_251ACI
N050.05.01.546 E019.47.35.555 N050.05.01.959 E019.47.38.327 Color_251ACI
N050.05.01.959 E019.47.38.327 N050.05.02.345 E019.47.41.083 Color_251ACI
N050.05.02.345 E019.47.41.083 N050.05.02.605 E019.47.42.621 Color_251ACI
N050.05.02.605 E019.47.42.621 N050.05.02.865 E019.47.44.159 Color_251ACI
N050.05.02.865 E019.47.44.159 N050.05.03.030 E019.47.44.973 Color_251ACI
N050.05.03.030 E019.47.44.973 N050.05.03.195 E019.47.45.786 Color_251ACI
N050.05.03.195 E019.47.45.786 N050.05.03.497 E019.47.47.158 Color_251ACI
N050.05.03.497 E019.47.47.158 N050.05.03.798 E019.47.48.530 Color_251ACI
N050.05.00.778 E019.47.30.520 N050.05.00.847 E019.47.30.610 Color_251ACI
N050.05.00.847 E019.47.30.610 N050.05.00.910 E019.47.30.600 Color_251ACI
N050.05.00.910 E019.47.30.600 N050.05.01.001 E019.47.30.607 Color_251ACI
N050.05.01.001 E019.47.30.607 N050.05.01.048 E019.47.30.540 Color_251ACI
N050.05.01.048 E019.47.30.540 N050.05.01.121 E019.47.30.489 Color_251ACI
N050.05.01.121 E019.47.30.489 N050.05.01.142 E019.47.30.406 Color_251ACI
N050.05.01.142 E019.47.30.406 N050.05.01.173 E019.47.30.282 Color_251ACI
N050.05.01.173 E019.47.30.282 N050.05.01.150 E019.47.30.126 Color_251ACI
N050.05.01.388 E019.47.30.031 N050.05.01.394 E019.47.30.130 Color_251ACI
N050.05.01.394 E019.47.30.130 N050.05.01.427 E019.47.30.245 Color_251ACI
N050.05.01.427 E019.47.30.245 N050.05.01.469 E019.47.30.318 Color_251ACI
N050.05.01.469 E019.47.30.318 N050.05.01.523 E019.47.30.350 Color_251ACI
N050.05.01.523 E019.47.30.350 N050.05.01.656 E019.47.30.430 Color_251ACI
N050.05.01.656 E019.47.30.430 N050.05.01.719 E019.47.30.421 Color_251ACI
N050.05.01.719 E019.47.30.421 N050.05.01.793 E019.47.30.370 Color_251ACI
N050.05.01.782 E019.47.30.411 N050.05.01.803 E019.47.30.328 Color_251ACI
N050.05.01.803 E019.47.30.328 N050.05.01.850 E019.47.30.262 Color_251ACI
N050.05.01.850 E019.47.30.262 N050.05.01.897 E019.47.30.195 Color_251ACI
N050.05.01.897 E019.47.30.195 N050.05.01.959 E019.47.29.946 Color_251ACI
N050.05.01.959 E019.47.29.946 N050.05.01.963 E019.47.29.806 Color_251ACI
N050.05.01.963 E019.47.29.806 N050.05.01.947 E019.47.29.748 Color_251ACI
N050.05.01.388 E019.47.30.031 N050.05.01.554 E019.47.29.607 Color_251ACI
N050.05.01.554 E019.47.29.607 N050.05.00.744 E019.47.24.738 Color_251ACI
N050.05.01.150 E019.47.30.126 N050.05.00.836 E019.47.29.793 Color_251ACI
N050.05.00.836 E019.47.29.793 N050.05.00.518 E019.47.27.745 Color_251ACI
N050.05.00.518 E019.47.27.745 N050.05.00.811 E019.47.27.921 Color_251ACI
N050.05.00.811 E019.47.27.921 N050.05.01.075 E019.47.27.842 Color_251ACI
N050.05.01.075 E019.47.27.842 N050.05.00.662 E019.47.25.070 Color_251ACI
N050.05.00.662 E019.47.25.070 N050.05.00.646 E019.47.25.013 Color_251ACI
N050.05.00.646 E019.47.25.013 N050.05.00.603 E019.47.24.939 Color_251ACI
N050.05.00.603 E019.47.24.939 N050.05.00.587 E019.47.24.882 Color_251ACI
N050.05.00.587 E019.47.24.882 N050.05.00.570 E019.47.24.824 Color_251ACI
N050.05.00.570 E019.47.24.824 N050.05.00.544 E019.47.24.808 Color_251ACI
N050.05.00.544 E019.47.24.808 N050.05.00.464 E019.47.24.760 Color_251ACI
N050.05.00.464 E019.47.24.760 N050.05.00.411 E019.47.24.728 Color_251ACI
N050.05.00.438 E019.47.24.744 N050.05.00.411 E019.47.24.728 Color_251ACI
N050.05.00.411 E019.47.24.728 N050.05.00.374 E019.47.24.754 Color_251ACI
N050.05.00.374 E019.47.24.754 N050.05.00.364 E019.47.24.795 Color_251ACI
N050.05.00.364 E019.47.24.795 N050.05.00.337 E019.47.24.779 Color_251ACI
N050.05.00.337 E019.47.24.779 N050.05.00.327 E019.47.24.820 Color_251ACI
N050.05.00.327 E019.47.24.820 N050.05.00.300 E019.47.24.804 Color_251ACI
N050.05.00.300 E019.47.24.804 N050.05.00.280 E019.47.24.887 Color_251ACI
N050.05.00.253 E019.47.24.871 N050.05.00.083 E019.47.25.435 Color_251ACI
N050.05.00.083 E019.47.25.435 N050.05.00.073 E019.47.25.477 Color_251ACI
N050.05.00.073 E019.47.25.477 N050.05.00.062 E019.47.25.518 Color_251ACI
N050.05.00.062 E019.47.25.518 N050.05.00.042 E019.47.25.601 Color_251ACI
N050.05.00.042 E019.47.25.601 N050.05.00.058 E019.47.25.658 Color_251ACI
N050.05.00.058 E019.47.25.658 N050.05.00.037 E019.47.25.741 Color_251ACI
N050.05.00.037 E019.47.25.741 N050.05.00.259 E019.47.27.065 Color_251ACI
N050.05.00.259 E019.47.27.065 N050.05.00.471 E019.47.28.431 Color_251ACI
N050.05.00.471 E019.47.28.431 N050.05.00.637 E019.47.29.484 Color_251ACI
N050.05.00.637 E019.47.29.484 N050.05.00.778 E019.47.30.520 Color_251ACI
N050.05.00.744 E019.47.24.738 N050.05.00.712 E019.47.24.624 Color_251ACI
N050.05.00.712 E019.47.24.624 N050.05.00.669 E019.47.24.550 Color_251ACI
N050.05.00.669 E019.47.24.550 N050.05.00.626 E019.47.24.477 Color_251ACI
N050.05.00.626 E019.47.24.477 N050.05.00.620 E019.47.24.378 Color_251ACI
N050.05.00.620 E019.47.24.378 N050.05.00.577 E019.47.24.304 Color_251ACI
N050.05.00.577 E019.47.24.304 N050.05.00.534 E019.47.24.231 Color_251ACI
N050.05.00.534 E019.47.24.231 N050.05.00.491 E019.47.24.157 Color_251ACI
N050.05.00.491 E019.47.24.157 N050.05.00.459 E019.47.24.043 Color_251ACI
N050.05.00.459 E019.47.24.043 N050.05.00.743 E019.47.23.881 Color_251ACI
N050.05.00.743 E019.47.23.881 N050.05.00.020 E019.47.20.636 Color_251ACI
N050.05.00.020 E019.47.20.636 N050.04.59.572 E019.47.20.842 Color_251ACI
N050.04.59.572 E019.47.20.842 N050.04.59.643 E019.47.21.170 Color_251ACI
N050.04.59.643 E019.47.21.170 N050.04.59.479 E019.47.21.215 Color_251ACI
N050.04.59.479 E019.47.21.215 N050.04.58.962 E019.47.20.713 Color_251ACI
N050.04.51.919 E019.46.32.709 N050.04.52.271 E019.46.35.111 Color_251ACI
N050.04.52.271 E019.46.35.111 N050.04.52.612 E019.46.37.555 Color_251ACI
N050.04.52.612 E019.46.37.555 N050.04.53.639 E019.46.44.507 Color_251ACI
N050.04.53.639 E019.46.44.507 N050.04.54.618 E019.46.51.525 Color_251ACI
N050.04.54.618 E019.46.51.525 N050.04.55.762 E019.46.59.357 Color_251ACI
N050.04.55.762 E019.46.59.357 N050.04.56.833 E019.47.07.240 Color_251ACI
N050.04.56.833 E019.47.07.240 N050.04.57.797 E019.47.13.582 Color_251ACI
N050.04.57.797 E019.47.13.582 N050.04.58.797 E019.47.19.899 Color_251ACI
N050.04.58.797 E019.47.19.899 N050.04.58.874 E019.47.20.327 Color_251ACI
N050.04.58.874 E019.47.20.327 N050.04.58.962 E019.47.20.713 Color_251ACI
N050.04.59.211 E019.47.21.434 N050.04.59.410 E019.47.22.602 Color_251ACI
N050.04.59.410 E019.47.22.602 N050.04.59.610 E019.47.23.769 Color_251ACI
N050.04.59.610 E019.47.23.769 N050.04.59.726 E019.47.24.411 Color_251ACI
N050.04.59.726 E019.47.24.411 N050.04.59.842 E019.47.25.052 Color_251ACI
N050.05.00.922 E019.47.31.417 N050.05.00.932 E019.47.31.375 Color_251ACI
N050.05.00.932 E019.47.31.375 N050.05.00.953 E019.47.31.293 Color_251ACI
N050.05.00.953 E019.47.31.293 N050.05.00.973 E019.47.31.210 Color_251ACI
N050.05.00.973 E019.47.31.210 N050.05.01.010 E019.47.31.184 Color_251ACI
N050.05.01.010 E019.47.31.184 N050.05.01.037 E019.47.31.200 Color_251ACI
N050.05.01.037 E019.47.31.200 N050.05.01.057 E019.47.31.117 Color_251ACI
N050.05.01.057 E019.47.31.117 N050.05.01.084 E019.47.31.133 Color_251ACI
N050.05.01.084 E019.47.31.133 N050.05.01.121 E019.47.31.108 Color_251ACI
N050.05.01.121 E019.47.31.108 N050.05.01.158 E019.47.31.083 Color_251ACI
N050.05.01.158 E019.47.31.083 N050.05.01.184 E019.47.31.099 Color_251ACI
N050.05.01.184 E019.47.31.099 N050.05.01.248 E019.47.31.089 Color_251ACI
N050.05.01.248 E019.47.31.089 N050.05.01.274 E019.47.31.105 Color_251ACI
N050.05.01.274 E019.47.31.105 N050.05.01.317 E019.47.31.179 Color_251ACI
N050.05.01.317 E019.47.31.179 N050.05.01.333 E019.47.31.236 Color_251ACI
N050.05.01.333 E019.47.31.236 N050.05.01.360 E019.47.31.252 Color_251ACI
N050.05.01.360 E019.47.31.252 N050.05.01.689 E019.47.33.498 Color_251ACI
N050.05.01.689 E019.47.33.498 N050.05.01.843 E019.47.33.495 Color_251ACI
N050.05.01.843 E019.47.33.495 N050.05.01.497 E019.47.31.192 Color_251ACI
N050.05.01.497 E019.47.31.192 N050.05.01.481 E019.47.31.134 Color_251ACI
N050.05.01.481 E019.47.31.134 N050.05.01.465 E019.47.31.077 Color_251ACI
N050.05.01.465 E019.47.31.077 N050.05.01.495 E019.47.30.953 Color_251ACI
N050.05.01.495 E019.47.30.953 N050.05.01.532 E019.47.30.927 Color_251ACI
N050.05.01.532 E019.47.30.927 N050.05.01.569 E019.47.30.902 Color_251ACI
N050.05.01.569 E019.47.30.902 N050.05.01.579 E019.47.30.860 Color_251ACI
N050.05.01.579 E019.47.30.860 N050.05.01.606 E019.47.30.876 Color_251ACI
N050.05.01.606 E019.47.30.876 N050.05.02.107 E019.47.30.702 Color_251ACI
N050.05.02.107 E019.47.30.702 N050.05.02.171 E019.47.30.693 Color_251ACI
N050.05.02.171 E019.47.30.693 N050.05.02.198 E019.47.30.709 Color_251ACI
N050.05.02.198 E019.47.30.709 N050.05.02.234 E019.47.30.683 Color_251ACI
N050.05.02.234 E019.47.30.683 N050.05.02.314 E019.47.30.731 Color_251ACI
N050.05.02.314 E019.47.30.731 N050.05.02.357 E019.47.30.805 Color_251ACI
N050.05.02.357 E019.47.30.805 N050.05.02.373 E019.47.30.862 Color_251ACI
N050.05.02.373 E019.47.30.862 N050.05.02.400 E019.47.30.878 Color_251ACI
N050.04.20.946 E019.47.11.346 N050.04.20.982 E019.47.11.321 Color_251ACI
N050.04.20.982 E019.47.11.321 N050.04.20.993 E019.47.11.279 Color_251ACI
N050.04.20.993 E019.47.11.279 N050.04.21.030 E019.47.11.254 Color_251ACI
N050.04.21.030 E019.47.11.254 N050.04.21.066 E019.47.11.228 Color_251ACI
N050.04.21.066 E019.47.11.228 N050.04.21.108 E019.47.11.063 Color_251ACI
N050.04.21.108 E019.47.11.063 N050.04.21.091 E019.47.11.005 Color_251ACI
N050.04.20.984 E019.47.11.560 N050.04.21.011 E019.47.11.576 Color_251ACI
N050.04.21.011 E019.47.11.576 N050.04.21.021 E019.47.11.534 Color_251ACI
N050.04.21.021 E019.47.11.534 N050.04.21.074 E019.47.11.566 Color_251ACI
N050.04.21.074 E019.47.11.566 N050.04.21.074 E019.47.11.566 Color_251ACI
N050.04.21.074 E019.47.11.566 N050.04.21.154 E019.47.11.614 Color_251ACI
N050.04.21.154 E019.47.11.614 N050.04.21.154 E019.47.11.614 Color_251ACI
N050.04.21.154 E019.47.11.614 N050.04.21.181 E019.47.11.630 Color_251ACI
N050.04.21.180 E019.47.10.154 N050.04.21.201 E019.47.10.071 Color_251ACI
N050.04.21.201 E019.47.10.071 N050.04.21.221 E019.47.09.988 Color_251ACI
N050.04.21.221 E019.47.09.988 N050.04.21.221 E019.47.09.988 Color_251ACI
N050.04.21.221 E019.47.09.988 N050.04.21.258 E019.47.09.963 Color_251ACI
N050.04.21.258 E019.47.09.963 N050.04.21.295 E019.47.09.937 Color_251ACI
N050.04.21.295 E019.47.09.937 N050.04.21.332 E019.47.09.912 Color_251ACI
N050.04.21.332 E019.47.09.912 N050.04.21.358 E019.47.09.928 Color_251ACI
N050.04.17.524 E019.46.52.238 N050.04.18.026 E019.46.52.064 Color_251ACI
N050.04.18.026 E019.46.52.064 N050.04.18.212 E019.46.52.176 Color_251ACI
N050.04.18.212 E019.46.52.176 N050.04.19.631 E019.47.01.983 Color_251ACI
N050.04.19.631 E019.47.01.983 N050.04.20.768 E019.47.08.858 Color_251ACI
N050.04.20.768 E019.47.08.858 N050.04.21.091 E019.47.11.005 Color_251ACI
N050.04.21.709 E019.47.17.139 N050.04.21.773 E019.47.17.130 Color_251ACI
N050.04.21.773 E019.47.17.130 N050.04.21.820 E019.47.17.063 Color_251ACI
N050.04.21.820 E019.47.17.063 N050.04.21.857 E019.47.17.038 Color_251ACI
N050.04.21.857 E019.47.17.038 N050.04.21.914 E019.47.16.929 Color_251ACI
N050.04.21.914 E019.47.16.929 N050.04.21.945 E019.47.16.805 Color_251ACI
N050.04.21.945 E019.47.16.805 N050.04.21.949 E019.47.16.665 Color_251ACI
N050.04.21.949 E019.47.16.665 N050.04.21.970 E019.47.16.582 Color_251ACI
N050.04.21.830 E019.47.17.640 N050.04.21.867 E019.47.17.615 Color_251ACI
N050.04.21.867 E019.47.17.615 N050.04.21.893 E019.47.17.631 Color_251ACI
N050.04.21.893 E019.47.17.631 N050.04.21.957 E019.47.17.621 Color_251ACI
N050.04.21.957 E019.47.17.621 N050.04.21.993 E019.47.17.596 Color_251ACI
N050.04.21.993 E019.47.17.596 N050.04.22.073 E019.47.17.644 Color_251ACI
N050.04.22.073 E019.47.17.644 N050.04.22.116 E019.47.17.718 Color_251ACI
N050.04.22.116 E019.47.17.718 N050.04.22.132 E019.47.17.775 Color_251ACI
N050.04.21.181 E019.47.11.630 N050.04.21.642 E019.47.14.575 Color_251ACI
N050.04.21.642 E019.47.14.575 N050.04.21.970 E019.47.16.582 Color_251ACI
N050.04.21.702 E019.47.11.992 N050.04.21.806 E019.47.10.959 Color_251ACI
N050.04.21.616 E019.47.10.369 N050.04.21.622 E019.47.10.468 Color_251ACI
N050.04.21.622 E019.47.10.468 N050.04.21.638 E019.47.10.525 Color_251ACI
N050.04.21.638 E019.47.10.525 N050.04.21.655 E019.47.10.582 Color_251ACI
N050.04.21.655 E019.47.10.582 N050.04.21.671 E019.47.10.640 Color_251ACI
N050.04.21.671 E019.47.10.640 N050.04.21.714 E019.47.10.713 Color_251ACI
N050.04.21.714 E019.47.10.713 N050.04.21.720 E019.47.10.812 Color_251ACI
N050.04.21.720 E019.47.10.812 N050.04.21.763 E019.47.10.886 Color_251ACI
N050.04.21.763 E019.47.10.886 N050.04.21.816 E019.47.10.918 Color_251ACI
N050.04.21.849 E019.47.11.033 N050.04.21.928 E019.47.11.081 Color_251ACI
N050.04.21.928 E019.47.11.081 N050.04.21.971 E019.47.11.154 Color_251ACI
N050.04.21.971 E019.47.11.154 N050.04.22.051 E019.47.11.202 Color_251ACI
N050.04.22.051 E019.47.11.202 N050.04.22.114 E019.47.11.193 Color_251ACI
N050.04.22.114 E019.47.11.193 N050.04.22.194 E019.47.11.241 Color_251ACI
N050.04.22.194 E019.47.11.241 N050.04.22.284 E019.47.11.247 Color_251ACI
N050.04.22.284 E019.47.11.247 N050.04.22.348 E019.47.11.238 Color_251ACI
N050.04.22.348 E019.47.11.238 N050.04.22.411 E019.47.11.228 Color_251ACI
N050.04.21.949 E019.47.10.998 N050.04.21.854 E019.47.11.750 Color_251ACI
N050.04.21.864 E019.47.11.709 N050.04.21.854 E019.47.11.750 Color_251ACI
N050.04.21.854 E019.47.11.750 N050.04.21.844 E019.47.11.792 Color_251ACI
N050.04.21.844 E019.47.11.792 N050.04.21.833 E019.47.11.833 Color_251ACI
N050.04.21.833 E019.47.11.833 N050.04.21.850 E019.47.11.890 Color_251ACI
N050.04.21.850 E019.47.11.890 N050.04.21.839 E019.47.11.932 Color_251ACI
N050.04.21.839 E019.47.11.932 N050.04.21.839 E019.47.11.932 Color_251ACI
N050.04.21.839 E019.47.11.932 N050.04.21.846 E019.47.12.031 Color_251ACI
N050.04.21.846 E019.47.12.031 N050.04.21.872 E019.47.12.047 Color_251ACI
N050.04.21.872 E019.47.12.047 N050.04.22.440 E019.47.15.674 Color_251ACI
N050.04.22.536 E019.47.15.780 N050.04.22.791 E019.47.15.981 Color_251ACI
N050.04.22.791 E019.47.15.981 N050.04.23.040 E019.47.15.226 Color_251ACI
N050.04.23.096 E019.47.14.260 N050.04.23.129 E019.47.14.375 Color_251ACI
N050.04.23.129 E019.47.14.375 N050.04.23.124 E019.47.14.515 Color_251ACI
N050.04.23.124 E019.47.14.515 N050.04.23.120 E019.47.14.655 Color_251ACI
N050.04.23.120 E019.47.14.655 N050.04.23.126 E019.47.14.754 Color_251ACI
N050.04.23.126 E019.47.14.754 N050.04.23.106 E019.47.14.837 Color_251ACI
N050.04.23.106 E019.47.14.837 N050.04.23.101 E019.47.14.977 Color_251ACI
N050.04.23.101 E019.47.14.977 N050.04.23.071 E019.47.15.102 Color_251ACI
N050.04.23.071 E019.47.15.102 N050.04.23.040 E019.47.15.226 Color_251ACI
N050.04.24.167 E019.47.11.666 N050.04.24.410 E019.47.13.765 Color_251ACI
N050.04.24.410 E019.47.13.765 N050.04.24.406 E019.47.13.906 Color_251ACI
N050.04.24.406 E019.47.13.906 N050.04.24.402 E019.47.14.046 Color_251ACI
N050.04.24.402 E019.47.14.046 N050.04.24.371 E019.47.14.170 Color_251ACI
N050.04.24.371 E019.47.14.170 N050.04.24.314 E019.47.14.279 Color_251ACI
N050.04.24.314 E019.47.14.279 N050.04.24.256 E019.47.14.387 Color_251ACI
N050.04.24.256 E019.47.14.387 N050.04.24.209 E019.47.14.454 Color_251ACI
N050.04.24.209 E019.47.14.454 N050.04.24.125 E019.47.14.546 Color_251ACI
N050.04.24.125 E019.47.14.546 N050.04.24.035 E019.47.14.539 Color_251ACI
N050.04.24.054 E019.47.13.599 N050.04.24.134 E019.47.13.647 Color_251ACI
N050.04.24.134 E019.47.13.647 N050.04.24.151 E019.47.13.704 Color_251ACI
N050.04.24.151 E019.47.13.704 N050.04.24.193 E019.47.13.778 Color_251ACI
N050.04.24.193 E019.47.13.778 N050.04.24.200 E019.47.13.877 Color_251ACI
N050.04.24.200 E019.47.13.877 N050.04.24.206 E019.47.13.975 Color_251ACI
N050.04.24.206 E019.47.13.975 N050.04.24.185 E019.47.14.058 Color_251ACI
N050.04.24.185 E019.47.14.058 N050.04.24.138 E019.47.14.125 Color_251ACI
N050.04.24.138 E019.47.14.125 N050.04.24.128 E019.47.14.167 Color_251ACI
N050.04.23.230 E019.47.11.626 N050.04.23.885 E019.47.11.449 Color_251ACI
N050.04.23.885 E019.47.11.449 N050.04.23.948 E019.47.11.439 Color_251ACI
N050.04.23.948 E019.47.11.439 N050.04.23.975 E019.47.11.455 Color_251ACI
N050.04.23.975 E019.47.11.455 N050.04.24.108 E019.47.11.536 Color_251ACI
N050.04.24.108 E019.47.11.536 N050.04.24.134 E019.47.11.552 Color_251ACI
N050.04.24.134 E019.47.11.552 N050.04.24.177 E019.47.11.625 Color_251ACI
N050.04.24.177 E019.47.11.625 N050.04.24.167 E019.47.11.666 Color_251ACI
N050.04.23.230 E019.47.11.626 N050.04.23.156 E019.47.11.677 Color_251ACI
N050.04.23.156 E019.47.11.677 N050.04.23.119 E019.47.11.702 Color_251ACI
N050.04.23.119 E019.47.11.702 N050.04.23.062 E019.47.11.810 Color_251ACI
N050.04.23.062 E019.47.11.810 N050.04.23.014 E019.47.11.877 Color_251ACI
N050.04.23.014 E019.47.11.877 N050.04.22.963 E019.47.12.084 Color_251ACI
N050.04.22.963 E019.47.12.084 N050.04.22.969 E019.47.12.183 Color_251ACI
N050.04.22.969 E019.47.12.183 N050.04.22.949 E019.47.12.266 Color_251ACI
N050.04.23.242 E019.47.11.824 N050.04.23.221 E019.47.11.906 Color_251ACI
N050.04.23.221 E019.47.11.906 N050.04.23.184 E019.47.11.932 Color_251ACI
N050.04.23.184 E019.47.11.932 N050.04.23.164 E019.47.12.015 Color_251ACI
N050.04.23.164 E019.47.12.015 N050.04.23.112 E019.47.12.222 Color_251ACI
N050.04.23.112 E019.47.12.222 N050.04.23.102 E019.47.12.263 Color_251ACI
N050.04.23.102 E019.47.12.263 N050.04.23.108 E019.47.12.362 Color_251ACI
N050.04.23.108 E019.47.12.362 N050.04.23.255 E019.47.14.356 Color_251ACI
N050.04.23.255 E019.47.14.356 N050.04.23.309 E019.47.14.388 Color_251ACI
N050.04.23.309 E019.47.14.388 N050.04.23.468 E019.47.14.484 Color_251ACI
N050.04.23.468 E019.47.14.484 N050.04.23.495 E019.47.14.500 Color_251ACI
N050.04.23.495 E019.47.14.500 N050.04.23.532 E019.47.14.474 Color_251ACI
N050.04.23.532 E019.47.14.474 N050.04.23.558 E019.47.14.490 Color_251ACI
N050.04.23.677 E019.47.14.752 N050.04.23.576 E019.47.14.787 Color_251ACI
N050.04.23.576 E019.47.14.787 N050.04.23.519 E019.47.14.895 Color_251ACI
N050.04.23.519 E019.47.14.895 N050.04.23.445 E019.47.14.946 Color_251ACI
N050.04.23.445 E019.47.14.946 N050.04.23.398 E019.47.15.013 Color_251ACI
N050.04.23.398 E019.47.15.013 N050.04.23.341 E019.47.15.121 Color_251ACI
N050.04.23.341 E019.47.15.121 N050.04.23.294 E019.47.15.188 Color_251ACI
N050.04.23.294 E019.47.15.188 N050.04.23.236 E019.47.15.297 Color_251ACI
N050.04.23.236 E019.47.15.297 N050.04.23.179 E019.47.15.405 Color_251ACI
N050.04.23.179 E019.47.15.405 N050.04.22.914 E019.47.16.103 Color_251ACI
N050.04.22.438 E019.47.16.911 N050.04.22.682 E019.47.16.297 Color_251ACI
N050.04.22.682 E019.47.16.297 N050.04.22.298 E019.47.15.875 Color_251ACI
N050.04.22.914 E019.47.16.103 N050.04.24.193 E019.47.15.873 Color_251ACI
N050.04.23.123 E019.47.14.276 N050.04.22.938 E019.47.12.308 Color_251ACI
N050.04.24.100 E019.47.16.865 N050.04.24.749 E019.47.20.779 Color_251ACI
N050.04.24.749 E019.47.20.779 N050.04.25.067 E019.47.22.827 Color_251ACI
N050.04.25.067 E019.47.22.827 N050.04.25.323 E019.47.24.505 Color_251ACI
N050.04.25.323 E019.47.24.505 N050.04.25.222 E019.47.24.540 Color_251ACI
N050.04.22.975 E019.47.16.473 N050.04.22.829 E019.47.16.814 Color_251ACI
N050.04.22.829 E019.47.16.814 N050.04.22.592 E019.47.16.909 Color_251ACI
N050.04.22.592 E019.47.16.909 N050.04.22.779 E019.47.16.402 Color_251ACI
N050.04.22.189 E019.47.16.809 N050.04.22.205 E019.47.16.866 Color_251ACI
N050.04.22.205 E019.47.16.866 N050.04.22.211 E019.47.16.965 Color_251ACI
N050.04.22.211 E019.47.16.965 N050.04.22.227 E019.47.17.023 Color_251ACI
N050.04.22.227 E019.47.17.023 N050.04.22.281 E019.47.17.055 Color_251ACI
N050.04.22.281 E019.47.17.055 N050.04.22.317 E019.47.17.029 Color_251ACI
N050.04.22.317 E019.47.17.029 N050.04.22.381 E019.47.17.020 Color_251ACI
N050.04.22.381 E019.47.17.020 N050.04.22.391 E019.47.16.978 Color_251ACI
N050.04.22.391 E019.47.16.978 N050.04.22.438 E019.47.16.911 Color_251ACI
N050.04.22.879 E019.47.16.367 N050.04.23.294 E019.47.16.665 Color_251ACI
N050.04.23.294 E019.47.16.665 N050.04.24.072 E019.47.16.609 Color_251ACI
N050.04.22.337 E019.47.17.565 N050.04.22.415 E019.47.17.374 Color_251ACI
N050.04.22.415 E019.47.17.374 N050.04.22.526 E019.47.17.298 Color_251ACI
N050.04.22.526 E019.47.17.298 N050.04.22.669 E019.47.17.336 Color_251ACI
N050.04.22.216 E019.47.20.397 N050.04.22.290 E019.47.20.346 Color_251ACI
N050.04.22.290 E019.47.20.346 N050.04.22.326 E019.47.20.320 Color_251ACI
N050.04.22.326 E019.47.20.320 N050.04.22.363 E019.47.20.295 Color_251ACI
N050.04.22.363 E019.47.20.295 N050.04.22.410 E019.47.20.228 Color_251ACI
N050.04.22.410 E019.47.20.228 N050.04.22.431 E019.47.20.145 Color_251ACI
N050.04.22.431 E019.47.20.145 N050.04.22.482 E019.47.19.938 Color_251ACI
N050.04.22.132 E019.47.17.775 N050.04.22.482 E019.47.19.938 Color_251ACI
N050.04.22.277 E019.47.20.767 N050.04.22.303 E019.47.20.783 Color_251ACI
N050.04.22.303 E019.47.20.783 N050.04.22.436 E019.47.20.863 Color_251ACI
N050.04.22.436 E019.47.20.863 N050.04.22.516 E019.47.20.911 Color_251ACI
N050.04.22.516 E019.47.20.911 N050.04.22.559 E019.47.20.984 Color_251ACI
N050.04.22.559 E019.47.20.984 N050.04.22.602 E019.47.21.058 Color_251ACI
N050.04.22.602 E019.47.21.058 N050.04.22.645 E019.47.21.131 Color_251ACI
N050.04.22.645 E019.47.21.131 N050.04.22.678 E019.47.21.246 Color_251ACI
N050.04.59.636 E019.47.40.547 N050.05.00.129 E019.47.42.749 Color_251ACI
N050.05.00.139 E019.47.42.708 N050.05.00.188 E019.47.42.880 Color_251ACI
N050.05.00.188 E019.47.42.880 N050.05.00.210 E019.47.43.036 Color_251ACI
N050.05.00.210 E019.47.43.036 N050.05.00.259 E019.47.43.209 Color_251ACI
N050.05.00.259 E019.47.43.209 N050.05.00.319 E019.47.43.339 Color_251ACI
N050.05.00.319 E019.47.43.339 N050.05.00.378 E019.47.43.470 Color_251ACI
N050.05.00.378 E019.47.43.470 N050.05.00.437 E019.47.43.601 Color_251ACI
N050.05.00.437 E019.47.43.601 N050.05.00.523 E019.47.43.748 Color_251ACI
N050.05.00.523 E019.47.43.748 N050.05.00.592 E019.47.43.838 Color_251ACI
N050.05.00.592 E019.47.43.838 N050.05.01.725 E019.47.45.186 Color_251ACI
N050.05.01.082 E019.47.43.466 N050.05.01.214 E019.47.44.164 Color_251ACI
N050.05.01.214 E019.47.44.164 N050.05.00.552 E019.47.43.385 Color_251ACI
N050.05.00.552 E019.47.43.385 N050.05.00.427 E019.47.43.024 Color_251ACI
N050.05.00.427 E019.47.43.024 N050.05.01.082 E019.47.43.466 Color_251ACI
N050.04.59.914 E019.47.40.905 N050.05.00.302 E019.47.41.187 Color_251ACI
N050.05.00.302 E019.47.41.187 N050.04.59.656 E019.47.38.369 Color_251ACI
N050.04.59.656 E019.47.38.369 N050.04.59.617 E019.47.38.774 Color_251ACI
N050.04.59.617 E019.47.38.774 N050.04.59.836 E019.47.40.478 Color_251ACI
N050.04.59.836 E019.47.40.478 N050.04.59.914 E019.47.40.905 Color_251ACI
N050.04.59.636 E019.47.40.547 N050.04.59.435 E019.47.39.140 Color_251ACI
N050.04.59.435 E019.47.39.140 N050.04.59.404 E019.47.38.646 Color_251ACI
N050.04.59.404 E019.47.38.646 N050.04.59.398 E019.47.38.547 Color_251ACI
N050.04.59.398 E019.47.38.547 N050.04.59.429 E019.47.38.423 Color_251ACI
N050.04.59.429 E019.47.38.423 N050.04.59.450 E019.47.38.340 Color_251ACI
N050.04.59.450 E019.47.38.340 N050.04.59.444 E019.47.38.241 Color_251ACI
N050.04.59.444 E019.47.38.241 N050.04.59.495 E019.47.38.034 Color_251ACI
N050.04.59.495 E019.47.38.034 N050.04.59.542 E019.47.37.967 Color_251ACI
N050.04.59.542 E019.47.37.967 N050.04.59.563 E019.47.37.884 Color_251ACI
N050.04.46.229 E019.45.48.615 N050.04.46.246 E019.45.50.149 Color_251ACI
N050.04.46.246 E019.45.50.149 N050.04.46.300 E019.45.51.658 Color_251ACI
N050.04.46.300 E019.45.51.658 N050.04.46.452 E019.45.55.606 Color_251ACI
N050.04.46.452 E019.45.55.606 N050.04.46.730 E019.45.59.536 Color_251ACI
N050.04.46.730 E019.45.59.536 N050.04.46.885 E019.46.01.868 Color_251ACI
N050.04.46.885 E019.46.01.868 N050.04.47.094 E019.46.04.231 Color_251ACI
N050.04.47.094 E019.46.04.231 N050.04.47.426 E019.46.07.574 Color_251ACI
N050.04.47.426 E019.46.07.574 N050.04.47.795 E019.46.10.892 Color_251ACI
N050.04.47.795 E019.46.10.892 N050.04.48.150 E019.46.13.772 Color_251ACI
N050.04.48.150 E019.46.13.772 N050.04.48.522 E019.46.16.711 Color_251ACI
N050.04.48.522 E019.46.16.711 N050.04.49.172 E019.46.21.483 Color_251ACI
N050.04.49.172 E019.46.21.483 N050.04.49.849 E019.46.26.272 Color_251ACI
N050.04.49.849 E019.46.26.272 N050.04.50.643 E019.46.31.941 Color_251ACI
N050.04.50.643 E019.46.31.941 N050.04.51.454 E019.46.37.667 Color_251ACI
N050.04.51.454 E019.46.37.667 N050.04.52.303 E019.46.43.607 Color_251ACI
N050.04.52.303 E019.46.43.607 N050.04.53.126 E019.46.49.531 Color_251ACI
N050.04.53.126 E019.46.49.531 N050.04.53.903 E019.46.54.904 Color_251ACI
N050.04.53.903 E019.46.54.904 N050.04.54.673 E019.47.00.177 Color_251ACI
N050.04.54.673 E019.47.00.177 N050.04.55.500 E019.47.05.961 Color_251ACI
N050.04.55.500 E019.47.05.961 N050.04.56.264 E019.47.11.754 Color_251ACI
N050.04.56.264 E019.47.11.754 N050.04.56.625 E019.47.14.734 Color_251ACI
N050.04.56.625 E019.47.14.734 N050.04.56.966 E019.47.19.273 Color_251ACI
N050.04.56.966 E019.47.19.273 N050.04.57.398 E019.47.23.818 Color_251ACI
N050.04.57.398 E019.47.23.818 N050.04.57.683 E019.47.26.609 Color_251ACI
N050.04.57.683 E019.47.26.609 N050.04.58.106 E019.47.29.340 Color_251ACI
N050.04.58.106 E019.47.29.340 N050.04.58.411 E019.47.31.191 Color_251ACI
N050.04.58.411 E019.47.31.191 N050.04.58.817 E019.47.33.006 Color_251ACI
N050.04.58.817 E019.47.33.006 N050.04.59.255 E019.47.34.937 Color_251ACI
N050.04.59.255 E019.47.34.937 N050.04.59.730 E019.47.36.842 Color_251ACI
N050.04.59.563 E019.47.37.884 N050.04.59.624 E019.47.37.636 Color_251ACI
N050.04.59.624 E019.47.37.636 N050.04.59.655 E019.47.37.511 Color_251ACI
N050.04.59.655 E019.47.37.511 N050.04.59.686 E019.47.37.387 Color_251ACI
N050.04.59.686 E019.47.37.387 N050.04.59.690 E019.47.37.247 Color_251ACI
N050.04.59.690 E019.47.37.247 N050.04.59.695 E019.47.37.106 Color_251ACI
N050.04.59.695 E019.47.37.106 N050.04.59.699 E019.47.36.966 Color_251ACI
N050.04.59.699 E019.47.36.966 N050.04.59.730 E019.47.36.842 Color_251ACI
N050.05.01.725 E019.47.45.186 N050.05.01.955 E019.47.46.230 Color_251ACI
N050.05.01.955 E019.47.46.230 N050.05.02.185 E019.47.47.273 Color_251ACI
N050.05.02.185 E019.47.47.273 N050.05.02.590 E019.47.49.089 Color_251ACI
N050.05.02.590 E019.47.49.089 N050.05.03.033 E019.47.50.879 Color_251ACI
N050.04.59.888 E019.47.37.557 N050.05.00.402 E019.47.39.675 Color_251ACI
N050.05.00.402 E019.47.39.675 N050.05.00.905 E019.47.41.836 Color_251ACI
N050.05.00.905 E019.47.41.836 N050.05.01.217 E019.47.43.166 Color_251ACI
N050.05.01.217 E019.47.43.166 N050.05.01.555 E019.47.44.513 Color_251ACI
N050.04.06.387 E019.47.24.201 N050.04.06.502 E019.47.23.984 Color_251ACI
N050.04.06.502 E019.47.23.984 N050.04.06.633 E019.47.23.825 Color_251ACI
N050.04.06.633 E019.47.23.825 N050.04.06.791 E019.47.23.682 Color_251ACI
N050.04.06.791 E019.47.23.682 N050.04.06.949 E019.47.23.539 Color_251ACI
N050.04.06.949 E019.47.23.539 N050.04.07.096 E019.47.23.437 Color_251ACI
N050.04.07.096 E019.47.23.437 N050.04.07.270 E019.47.23.352 Color_251ACI
N050.04.07.270 E019.47.23.352 N050.04.07.434 E019.47.23.307 Color_251ACI
N050.04.07.434 E019.47.23.307 N050.04.07.598 E019.47.23.263 Color_251ACI
N050.04.06.622 E019.47.24.485 N050.04.06.727 E019.47.24.310 Color_251ACI
N050.04.06.727 E019.47.24.310 N050.04.06.858 E019.47.24.151 Color_251ACI
N050.04.06.858 E019.47.24.151 N050.04.06.989 E019.47.23.992 Color_251ACI
N050.04.06.989 E019.47.23.992 N050.04.07.147 E019.47.23.849 Color_251ACI
N050.04.07.147 E019.47.23.849 N050.04.07.321 E019.47.23.763 Color_251ACI
N050.04.07.321 E019.47.23.763 N050.04.07.469 E019.47.23.661 Color_251ACI
N050.04.07.469 E019.47.23.661 N050.04.07.649 E019.47.23.675 Color_251ACI
N050.04.07.649 E019.47.23.675 N050.04.07.813 E019.47.23.630 Color_251ACI
N050.04.07.813 E019.47.23.630 N050.04.17.150 E019.47.24.061 Color_251ACI
N050.04.17.150 E019.47.24.061 N050.04.17.187 E019.47.24.036 Color_251ACI
N050.04.17.187 E019.47.24.036 N050.04.17.240 E019.47.24.068 Color_251ACI
N050.04.17.240 E019.47.24.068 N050.04.17.257 E019.47.24.125 Color_251ACI
N050.04.17.257 E019.47.24.125 N050.04.17.310 E019.47.24.157 Color_251ACI
N050.04.17.310 E019.47.24.157 N050.04.17.326 E019.47.24.215 Color_251ACI
N050.04.17.326 E019.47.24.215 N050.04.17.306 E019.47.24.298 Color_251ACI
N050.04.17.306 E019.47.24.298 N050.04.17.322 E019.47.24.355 Color_251ACI
N050.04.17.322 E019.47.24.355 N050.04.17.338 E019.47.24.413 Color_251ACI
N050.04.17.312 E019.47.24.397 N050.04.17.267 E019.47.26.179 Color_251ACI
N050.04.17.100 E019.47.23.650 N050.04.07.598 E019.47.23.263 Color_251ACI
N050.04.17.073 E019.47.23.634 N050.04.17.163 E019.47.23.640 Color_251ACI
N050.04.17.163 E019.47.23.640 N050.04.17.200 E019.47.23.615 Color_251ACI
N050.04.17.200 E019.47.23.615 N050.04.17.274 E019.47.23.564 Color_251ACI
N050.04.17.274 E019.47.23.564 N050.04.17.321 E019.47.23.497 Color_251ACI
N050.04.17.321 E019.47.23.497 N050.04.17.341 E019.47.23.414 Color_251ACI
N050.04.17.341 E019.47.23.414 N050.04.17.382 E019.47.23.249 Color_251ACI
N050.04.17.382 E019.47.23.249 N050.04.17.387 E019.47.23.108 Color_251ACI
N050.04.17.427 E019.47.21.466 N050.04.17.413 E019.47.23.124 Color_251ACI
N050.04.22.678 E019.47.21.246 N050.04.22.934 E019.47.22.924 Color_251ACI
N050.04.22.934 E019.47.22.924 N050.04.22.984 E019.47.23.336 Color_251ACI
N050.04.22.984 E019.47.23.336 N050.04.22.933 E019.47.23.543 Color_251ACI
N050.04.22.933 E019.47.23.543 N050.04.22.849 E019.47.23.635 Color_251ACI
N050.04.22.849 E019.47.23.635 N050.04.22.738 E019.47.23.711 Color_251ACI
N050.04.22.738 E019.47.23.711 N050.04.22.268 E019.47.23.761 Color_251ACI
N050.04.22.268 E019.47.23.761 N050.04.18.534 E019.47.23.656 Color_251ACI
N050.04.18.534 E019.47.23.656 N050.04.17.984 E019.47.23.658 Color_251ACI
N050.04.17.984 E019.47.23.658 N050.04.17.804 E019.47.23.645 Color_251ACI
N050.04.17.562 E019.47.23.262 N050.04.17.607 E019.47.21.479 Color_251ACI
N050.04.17.573 E019.47.23.220 N050.04.17.552 E019.47.23.303 Color_251ACI
N050.04.17.552 E019.47.23.303 N050.04.17.595 E019.47.23.377 Color_251ACI
N050.04.17.595 E019.47.23.377 N050.04.17.601 E019.47.23.476 Color_251ACI
N050.04.17.601 E019.47.23.476 N050.04.17.617 E019.47.23.533 Color_251ACI
N050.04.17.617 E019.47.23.533 N050.04.17.671 E019.47.23.565 Color_251ACI
N050.04.17.671 E019.47.23.565 N050.04.17.687 E019.47.23.623 Color_251ACI
N050.04.17.687 E019.47.23.623 N050.04.17.740 E019.47.23.655 Color_251ACI
N050.04.17.740 E019.47.23.655 N050.04.17.804 E019.47.23.645 Color_251ACI
N050.04.17.781 E019.47.24.108 N050.04.17.727 E019.47.24.075 Color_251ACI
N050.04.17.727 E019.47.24.075 N050.04.17.691 E019.47.24.101 Color_251ACI
N050.04.17.691 E019.47.24.101 N050.04.17.627 E019.47.24.110 Color_251ACI
N050.04.17.627 E019.47.24.110 N050.04.17.617 E019.47.24.152 Color_251ACI
N050.04.17.617 E019.47.24.152 N050.04.17.570 E019.47.24.219 Color_251ACI
N050.04.17.570 E019.47.24.219 N050.04.17.539 E019.47.24.343 Color_251ACI
N050.04.17.539 E019.47.24.343 N050.04.17.555 E019.47.24.400 Color_251ACI
N050.04.17.547 E019.47.26.158 N050.04.17.555 E019.47.24.400 Color_251ACI
N050.04.23.757 E019.47.26.753 N050.04.24.274 E019.47.29.350 Color_251ACI
N050.04.24.274 E019.47.29.350 N050.04.24.290 E019.47.29.408 Color_251ACI
N050.04.22.742 E019.47.24.190 N050.04.22.795 E019.47.24.222 Color_251ACI
N050.04.22.795 E019.47.24.222 N050.04.22.902 E019.47.24.286 Color_251ACI
N050.04.22.902 E019.47.24.286 N050.04.22.955 E019.47.24.318 Color_251ACI
N050.04.22.955 E019.47.24.318 N050.04.23.024 E019.47.24.407 Color_251ACI
N050.04.23.024 E019.47.24.407 N050.04.23.041 E019.47.24.465 Color_251ACI
N050.04.23.041 E019.47.24.465 N050.04.23.084 E019.47.24.538 Color_251ACI
N050.04.23.084 E019.47.24.538 N050.04.23.100 E019.47.24.596 Color_251ACI
N050.04.17.791 E019.47.24.066 N050.04.21.011 E019.47.24.147 Color_251ACI
N050.04.21.011 E019.47.24.147 N050.04.21.821 E019.47.24.207 Color_251ACI
N050.04.21.821 E019.47.24.207 N050.04.22.742 E019.47.24.190 Color_251ACI
N050.04.23.249 E019.47.25.352 N050.04.23.619 E019.47.27.432 Color_251ACI
N050.04.23.806 E019.47.28.402 N050.04.24.478 E019.47.31.854 Color_251ACI
N050.04.24.478 E019.47.31.854 N050.04.25.269 E019.47.35.568 Color_251ACI
N050.04.24.924 E019.47.32.646 N050.04.24.950 E019.47.32.662 Color_251ACI
N050.04.24.950 E019.47.32.662 N050.04.24.940 E019.47.32.704 Color_251ACI
N050.04.24.940 E019.47.32.704 N050.04.24.967 E019.47.32.720 Color_251ACI
N050.04.24.967 E019.47.32.720 N050.04.24.983 E019.47.32.777 Color_251ACI
N050.04.24.983 E019.47.32.777 N050.04.25.089 E019.47.32.841 Color_251ACI
N050.04.25.089 E019.47.32.841 N050.04.25.126 E019.47.32.816 Color_251ACI
N050.04.25.126 E019.47.32.816 N050.04.25.153 E019.47.32.832 Color_251ACI
N050.04.25.153 E019.47.32.832 N050.04.25.163 E019.47.32.790 Color_251ACI
N050.04.25.163 E019.47.32.790 N050.04.25.474 E019.47.32.644 Color_251ACI
N050.04.25.474 E019.47.32.644 N050.04.25.626 E019.47.32.402 Color_251ACI
N050.04.25.165 E019.47.33.029 N050.04.25.138 E019.47.33.013 Color_251ACI
N050.04.25.138 E019.47.33.013 N050.04.25.128 E019.47.33.055 Color_251ACI
N050.04.25.128 E019.47.33.055 N050.04.25.128 E019.47.33.055 Color_251ACI
N050.04.25.128 E019.47.33.055 N050.04.25.107 E019.47.33.138 Color_251ACI
N050.04.25.107 E019.47.33.138 N050.04.25.081 E019.47.33.122 Color_251ACI
N050.04.25.081 E019.47.33.122 N050.04.25.050 E019.47.33.246 Color_251ACI
N050.04.25.050 E019.47.33.246 N050.04.25.077 E019.47.33.262 Color_251ACI
N050.04.25.077 E019.47.33.262 N050.04.25.077 E019.47.33.262 Color_251ACI
N050.04.25.165 E019.47.33.029 N050.04.25.439 E019.47.32.909 Color_251ACI
N050.04.25.506 E019.47.35.473 N050.04.25.506 E019.47.35.473 Color_251ACI
N050.04.25.506 E019.47.35.473 N050.04.25.523 E019.47.35.531 Color_251ACI
N050.04.25.523 E019.47.35.531 N050.04.25.576 E019.47.35.563 Color_251ACI
N050.04.25.576 E019.47.35.563 N050.04.25.576 E019.47.35.563 Color_251ACI
N050.04.25.576 E019.47.35.563 N050.04.25.602 E019.47.35.579 Color_251ACI
N050.04.25.602 E019.47.35.579 N050.04.25.629 E019.47.35.595 Color_251ACI
N050.04.25.629 E019.47.35.595 N050.04.25.655 E019.47.35.611 Color_251ACI
N050.04.25.655 E019.47.35.611 N050.04.25.692 E019.47.35.585 Color_251ACI
N050.04.25.692 E019.47.35.585 N050.04.25.692 E019.47.35.585 Color_251ACI
N050.04.25.692 E019.47.35.585 N050.04.25.729 E019.47.35.560 Color_251ACI
N050.04.25.729 E019.47.35.560 N050.04.25.756 E019.47.35.576 Color_251ACI
N050.04.25.077 E019.47.33.262 N050.04.25.506 E019.47.35.473 Color_251ACI
N050.05.04.277 E019.47.48.200 N050.05.04.509 E019.47.47.387 Color_251ACI
N050.05.04.509 E019.47.47.387 N050.05.04.768 E019.47.46.590 Color_251ACI
N050.05.04.768 E019.47.46.590 N050.05.05.015 E019.47.45.596 Color_251ACI
N050.05.05.015 E019.47.45.596 N050.05.05.235 E019.47.44.586 Color_251ACI
N050.05.05.235 E019.47.44.586 N050.05.05.366 E019.47.43.808 Color_251ACI
N050.05.05.366 E019.47.43.808 N050.05.05.455 E019.47.42.957 Color_251ACI
N050.05.05.455 E019.47.42.957 N050.05.05.507 E019.47.42.131 Color_251ACI
N050.05.05.507 E019.47.42.131 N050.05.05.533 E019.47.41.289 Color_251ACI
N050.05.05.533 E019.47.41.289 N050.05.05.510 E019.47.39.656 Color_251ACI
N050.05.05.510 E019.47.39.656 N050.05.05.350 E019.47.38.083 Color_251ACI
N050.05.05.350 E019.47.38.083 N050.05.05.283 E019.47.37.614 Color_251ACI
N050.05.05.283 E019.47.37.614 N050.05.05.179 E019.47.37.171 Color_251ACI
N050.05.05.179 E019.47.37.171 N050.05.04.512 E019.47.35.055 Color_251ACI
N050.05.04.512 E019.47.35.055 N050.05.03.713 E019.47.33.098 Color_251ACI
N050.05.03.713 E019.47.33.098 N050.05.03.487 E019.47.32.533 Color_251ACI
N050.05.03.487 E019.47.32.533 N050.05.03.223 E019.47.31.993 Color_251ACI
N050.05.03.223 E019.47.31.993 N050.05.02.836 E019.47.31.093 Color_251ACI
N050.05.02.836 E019.47.31.093 N050.05.02.448 E019.47.30.193 Color_251ACI
N050.05.02.448 E019.47.30.193 N050.05.02.176 E019.47.29.315 Color_251ACI
N050.05.02.176 E019.47.29.315 N050.05.01.942 E019.47.28.412 Color_251ACI
N050.05.01.942 E019.47.28.412 N050.05.01.581 E019.47.26.909 Color_251ACI
N050.05.01.581 E019.47.26.909 N050.05.01.347 E019.47.25.387 Color_251ACI
N050.05.01.347 E019.47.25.387 N050.05.01.329 E019.47.25.091 Color_251ACI
N050.05.01.329 E019.47.25.091 N050.05.01.358 E019.47.24.727 Color_251ACI
N050.05.01.358 E019.47.24.727 N050.05.01.403 E019.47.23.563 Color_251ACI
N050.05.01.403 E019.47.23.563 N050.05.01.484 E019.47.22.374 Color_251ACI
N050.05.04.104 E019.47.47.667 N050.05.04.233 E019.47.47.268 Color_251ACI
N050.05.04.233 E019.47.47.268 N050.05.04.373 E019.47.46.829 Color_251ACI
N050.05.04.373 E019.47.46.829 N050.05.04.656 E019.47.45.809 Color_251ACI
N050.05.04.656 E019.47.45.809 N050.05.04.870 E019.47.44.700 Color_251ACI
N050.05.04.870 E019.47.44.700 N050.05.04.977 E019.47.44.145 Color_251ACI
N050.05.04.977 E019.47.44.145 N050.05.05.068 E019.47.43.533 Color_251ACI
N050.05.05.068 E019.47.43.533 N050.05.05.168 E019.47.42.021 Color_251ACI
N050.05.05.168 E019.47.42.021 N050.05.05.194 E019.47.40.561 Color_251ACI
N050.05.05.194 E019.47.40.561 N050.05.05.148 E019.47.39.390 Color_251ACI
N050.05.05.148 E019.47.39.390 N050.05.04.985 E019.47.38.197 Color_251ACI
N050.05.04.985 E019.47.38.197 N050.05.04.792 E019.47.37.128 Color_251ACI
N050.05.04.792 E019.47.37.128 N050.05.04.535 E019.47.36.069 Color_251ACI
N050.05.04.535 E019.47.36.069 N050.05.04.248 E019.47.35.134 Color_251ACI
N050.05.04.248 E019.47.35.134 N050.05.03.913 E019.47.34.266 Color_251ACI
N050.05.03.913 E019.47.34.266 N050.05.03.735 E019.47.33.873 Color_251ACI
N050.05.03.735 E019.47.33.873 N050.05.03.558 E019.47.33.480 Color_251ACI
N050.05.03.558 E019.47.33.480 N050.05.03.262 E019.47.32.826 Color_251ACI
N050.05.03.262 E019.47.32.826 N050.05.02.965 E019.47.32.171 Color_251ACI
N050.05.02.965 E019.47.32.171 N050.05.02.696 E019.47.31.533 Color_251ACI
N050.05.02.696 E019.47.31.533 N050.05.02.400 E019.47.30.878 Color_251ACI
N050.05.04.022 E019.47.47.380 N050.05.04.083 E019.47.47.750 Color_251ACI
N050.05.04.083 E019.47.47.750 N050.05.03.379 E019.47.49.850 Color_251ACI
N050.05.03.379 E019.47.49.850 N050.05.03.178 E019.47.50.538 Color_251ACI
N050.05.03.178 E019.47.50.538 N050.05.02.992 E019.47.51.045 Color_251ACI
N050.05.02.992 E019.47.51.045 N050.05.02.852 E019.47.51.484 Color_251ACI
N050.05.02.852 E019.47.51.484 N050.05.02.753 E019.47.51.758 Color_251ACI
N050.05.02.753 E019.47.51.758 N050.05.02.569 E019.47.51.885 Color_251ACI
N050.05.04.390 E019.47.48.363 N050.05.04.247 E019.47.48.324 Color_251ACI
N050.05.04.247 E019.47.48.324 N050.05.03.436 E019.47.50.979 Color_251ACI
N050.05.03.436 E019.47.50.979 N050.05.03.296 E019.47.51.418 Color_251ACI
N050.05.03.296 E019.47.51.418 N050.05.03.187 E019.47.51.734 Color_251ACI
N050.05.03.187 E019.47.51.734 N050.05.02.970 E019.47.52.365 Color_251ACI
N050.05.02.970 E019.47.52.365 N050.05.03.010 E019.47.52.818 Color_251ACI
N050.05.05.030 E019.47.54.653 N050.05.05.218 E019.47.55.004 Color_251ACI
N050.05.05.218 E019.47.55.004 N050.05.05.406 E019.47.55.356 Color_251ACI
N050.05.05.406 E019.47.55.356 N050.05.05.567 E019.47.55.691 Color_251ACI
N050.05.05.567 E019.47.55.691 N050.05.05.729 E019.47.56.026 Color_251ACI
N050.05.05.729 E019.47.56.026 N050.05.05.970 E019.47.56.409 Color_251ACI
N050.05.05.970 E019.47.56.409 N050.05.06.194 E019.47.56.735 Color_251ACI
N050.05.06.194 E019.47.56.735 N050.05.06.644 E019.47.57.387 Color_251ACI
N050.05.06.644 E019.47.57.387 N050.05.07.151 E019.47.57.930 Color_251ACI
N050.05.07.151 E019.47.57.930 N050.05.08.451 E019.47.59.094 Color_251ACI
N050.05.08.451 E019.47.59.094 N050.05.09.725 E019.48.00.242 Color_251ACI
N050.05.09.725 E019.48.00.242 N050.05.10.322 E019.48.00.792 Color_251ACI
N050.05.10.322 E019.48.00.792 N050.05.10.908 E019.48.01.384 Color_251ACI
N050.05.10.908 E019.48.01.384 N050.05.11.528 E019.48.02.090 Color_251ACI
N050.05.11.528 E019.48.02.090 N050.05.12.053 E019.48.02.930 Color_251ACI
N050.05.12.053 E019.48.02.930 N050.05.12.623 E019.48.04.083 Color_251ACI
N050.05.12.623 E019.48.04.083 N050.05.13.082 E019.48.05.312 Color_251ACI
N050.05.13.082 E019.48.05.312 N050.05.13.276 E019.48.05.762 Color_251ACI
N050.05.13.276 E019.48.05.762 N050.05.13.396 E019.48.06.263 Color_251ACI
N050.05.13.396 E019.48.06.263 N050.05.13.477 E019.48.06.550 Color_251ACI
N050.05.06.894 E019.47.56.871 N050.05.07.464 E019.47.57.405 Color_251ACI
N050.05.07.464 E019.47.57.405 N050.05.07.988 E019.47.58.006 Color_251ACI
N050.05.07.988 E019.47.58.006 N050.05.08.936 E019.47.58.863 Color_251ACI
N050.05.08.936 E019.47.58.863 N050.05.09.869 E019.47.59.662 Color_251ACI
N050.05.09.869 E019.47.59.662 N050.05.10.237 E019.48.00.027 Color_251ACI
N050.05.10.237 E019.48.00.027 N050.05.10.605 E019.48.00.391 Color_251ACI
N050.05.10.605 E019.48.00.391 N050.05.11.015 E019.48.00.829 Color_251ACI
N050.05.11.015 E019.48.00.829 N050.05.11.410 E019.48.01.210 Color_251ACI
N050.05.11.410 E019.48.01.210 N050.05.12.009 E019.48.01.999 Color_251ACI
N050.05.12.009 E019.48.01.999 N050.05.12.523 E019.48.02.880 Color_251ACI
N050.05.12.523 E019.48.02.880 N050.05.13.136 E019.48.04.106 Color_251ACI
N050.05.13.136 E019.48.04.106 N050.05.13.628 E019.48.05.450 Color_251ACI
N050.05.13.628 E019.48.05.450 N050.05.13.982 E019.48.06.854 Color_251ACI
N050.05.13.982 E019.48.06.854 N050.05.14.227 E019.48.08.335 Color_251ACI
N050.05.14.227 E019.48.08.335 N050.05.14.358 E019.48.09.652 Color_251ACI
N050.05.14.358 E019.48.09.652 N050.05.14.400 E019.48.10.963 Color_251ACI
N050.05.14.400 E019.48.10.963 N050.05.14.372 E019.48.12.184 Color_251ACI
N050.05.14.372 E019.48.12.184 N050.05.14.254 E019.48.13.399 Color_251ACI
N050.05.14.254 E019.48.13.399 N050.05.14.089 E019.48.14.681 Color_251ACI
N050.05.14.089 E019.48.14.681 N050.05.13.871 E019.48.15.930 Color_251ACI
N050.05.13.871 E019.48.15.930 N050.05.13.795 E019.48.16.360 Color_251ACI
N050.05.13.795 E019.48.16.360 N050.05.13.682 E019.48.16.816 Color_251ACI
N050.05.03.926 E019.47.49.369 N050.05.04.389 E019.47.51.077 Color_251ACI
N050.05.04.389 E019.47.51.077 N050.05.04.836 E019.47.52.726 Color_251ACI
N050.05.04.836 E019.47.52.726 N050.05.05.219 E019.47.53.767 Color_251ACI
N050.05.05.219 E019.47.53.767 N050.05.05.687 E019.47.54.715 Color_251ACI
N050.05.05.687 E019.47.54.715 N050.05.05.907 E019.47.55.182 Color_251ACI
N050.05.05.907 E019.47.55.182 N050.05.06.112 E019.47.55.590 Color_251ACI
N050.05.06.112 E019.47.55.590 N050.05.06.273 E019.47.55.925 Color_251ACI
N050.05.06.273 E019.47.55.925 N050.05.06.481 E019.47.56.194 Color_251ACI
N050.05.06.481 E019.47.56.194 N050.05.06.680 E019.47.56.504 Color_251ACI
N050.05.06.680 E019.47.56.504 N050.05.06.894 E019.47.56.871 Color_251ACI
N050.05.13.477 E019.48.06.550 N050.05.13.598 E019.48.07.051 Color_251ACI
N050.05.13.598 E019.48.07.051 N050.05.13.708 E019.48.07.593 Color_251ACI
N050.05.13.708 E019.48.07.593 N050.05.13.758 E019.48.08.005 Color_251ACI
N050.05.13.758 E019.48.08.005 N050.05.13.846 E019.48.08.391 Color_251ACI
N050.05.13.846 E019.48.08.391 N050.05.13.927 E019.48.09.297 Color_251ACI
N050.05.13.927 E019.48.09.297 N050.05.13.991 E019.48.10.145 Color_251ACI
N050.05.13.991 E019.48.10.145 N050.05.14.019 E019.48.11.019 Color_251ACI
N050.05.14.019 E019.48.11.019 N050.05.14.020 E019.48.11.877 Color_251ACI
N050.05.14.020 E019.48.11.877 N050.05.13.941 E019.48.13.306 Color_251ACI
N050.05.13.941 E019.48.13.306 N050.05.13.735 E019.48.14.753 Color_251ACI
N050.05.13.735 E019.48.14.753 N050.05.13.614 E019.48.15.489 Color_251ACI
N050.05.13.614 E019.48.15.489 N050.05.13.455 E019.48.16.251 Color_251ACI
N050.04.06.612 E019.47.24.527 N050.04.06.534 E019.47.24.718 Color_251ACI
N050.04.06.534 E019.47.24.718 N050.04.06.456 E019.47.24.909 Color_251ACI
N050.04.06.456 E019.47.24.909 N050.04.06.378 E019.47.25.100 Color_251ACI
N050.04.06.378 E019.47.25.100 N050.04.06.327 E019.47.25.307 Color_251ACI
N050.04.06.327 E019.47.25.307 N050.04.06.292 E019.47.25.572 Color_251ACI
N050.04.06.292 E019.47.25.572 N050.04.06.267 E019.47.25.795 Color_251ACI
N050.04.06.267 E019.47.25.795 N050.04.06.242 E019.47.26.018 Color_251ACI
N050.04.06.242 E019.47.26.018 N050.04.06.244 E019.47.26.258 Color_251ACI
N050.04.06.387 E019.47.24.201 N050.04.06.272 E019.47.24.417 Color_251ACI
N050.04.06.272 E019.47.24.417 N050.04.06.158 E019.47.24.634 Color_251ACI
N050.04.06.158 E019.47.24.634 N050.04.06.069 E019.47.24.867 Color_251ACI
N050.04.06.069 E019.47.24.867 N050.04.05.936 E019.47.25.405 Color_251ACI
N050.04.05.936 E019.47.25.405 N050.04.05.927 E019.47.25.686 Color_251ACI
N050.04.05.927 E019.47.25.686 N050.04.05.892 E019.47.25.951 Color_251ACI
N050.04.05.892 E019.47.25.951 N050.04.05.884 E019.47.26.231 Color_251ACI
N050.04.06.244 E019.47.26.258 N050.04.06.028 E019.47.41.176 Color_251ACI
N050.04.05.764 E019.47.41.255 N050.04.05.884 E019.47.26.231 Color_251ACI
N050.04.24.794 E019.47.35.758 N050.04.25.162 E019.47.35.504 Color_251ACI
N050.04.25.162 E019.47.35.504 N050.04.25.269 E019.47.35.568 Color_251ACI
N050.04.25.269 E019.47.35.568 N050.04.26.127 E019.47.38.514 Color_251ACI
N050.04.26.399 E019.47.39.392 N050.04.27.225 E019.47.42.222 Color_251ACI
N050.04.27.225 E019.47.42.222 N050.04.26.633 E019.47.42.390 Color_251ACI
N050.05.06.424 E019.48.28.589 N050.05.07.375 E019.48.31.780 Color_251ACI
N050.05.07.375 E019.48.31.780 N050.05.07.450 E019.48.31.968 Color_251ACI
N050.05.07.450 E019.48.31.968 N050.05.07.552 E019.48.32.173 Color_251ACI
N050.05.07.552 E019.48.32.173 N050.05.07.712 E019.48.32.269 Color_251ACI
N050.05.07.712 E019.48.32.269 N050.05.07.828 E019.48.32.291 Color_251ACI
N050.05.07.828 E019.48.32.291 N050.05.09.924 E019.48.32.220 Color_251ACI
N050.05.09.924 E019.48.32.220 N050.05.11.606 E019.48.32.090 Color_251ACI
N050.05.11.606 E019.48.32.090 N050.05.12.637 E019.48.31.997 Color_251ACI
N050.05.05.114 E019.48.27.466 N050.05.04.307 E019.48.27.885 Color_251ACI
N050.05.04.307 E019.48.27.885 N050.05.03.484 E019.48.28.247 Color_251ACI
N050.05.03.484 E019.48.28.247 N050.05.02.618 E019.48.28.535 Color_251ACI
N050.05.02.618 E019.48.28.535 N050.05.01.740 E019.48.28.625 Color_251ACI
N050.05.01.740 E019.48.28.625 N050.04.59.088 E019.48.28.599 Color_251ACI
N050.04.59.088 E019.48.28.599 N050.04.56.393 E019.48.28.500 Color_251ACI
N050.04.56.393 E019.48.28.500 N050.04.54.535 E019.48.28.477 Color_251ACI
N050.04.54.535 E019.48.28.477 N050.04.52.640 E019.48.28.479 Color_251ACI
N050.04.52.640 E019.48.28.479 N050.04.50.942 E019.48.28.551 Color_251ACI
N050.04.50.942 E019.48.28.551 N050.04.49.228 E019.48.28.805 Color_251ACI
N050.04.49.228 E019.48.28.805 N050.04.47.796 E019.48.29.038 Color_251ACI
N050.04.47.796 E019.48.29.038 N050.04.46.369 E019.48.29.369 Color_251ACI
N050.04.46.369 E019.48.29.369 N050.04.44.207 E019.48.29.829 Color_251ACI
N050.04.44.207 E019.48.29.829 N050.04.42.052 E019.48.30.388 Color_251ACI
N050.04.42.052 E019.48.30.388 N050.04.40.314 E019.48.30.866 Color_251ACI
N050.04.40.314 E019.48.30.866 N050.04.38.612 E019.48.31.318 Color_251ACI
N050.04.38.612 E019.48.31.318 N050.04.36.082 E019.48.32.032 Color_251ACI
N050.04.36.082 E019.48.32.032 N050.04.33.589 E019.48.32.721 Color_251ACI
N050.04.33.589 E019.48.32.721 N050.04.33.488 E019.48.32.756 Color_251ACI
N050.05.03.764 E019.48.16.272 N050.05.05.086 E019.48.16.116 Color_251ACI
N050.05.03.830 E019.48.16.502 N050.05.05.078 E019.48.16.397 Color_251ACI
N050.05.05.086 E019.48.16.116 N050.05.05.123 E019.48.16.091 Color_251ACI
N050.05.05.123 E019.48.16.091 N050.05.05.160 E019.48.16.065 Color_251ACI
N050.05.05.160 E019.48.16.065 N050.05.05.170 E019.48.16.024 Color_251ACI
N050.05.05.170 E019.48.16.024 N050.05.05.207 E019.48.15.998 Color_251ACI
N050.05.05.207 E019.48.15.998 N050.05.05.254 E019.48.15.931 Color_251ACI
N050.05.05.254 E019.48.15.931 N050.05.05.265 E019.48.15.890 Color_251ACI
N050.05.05.265 E019.48.15.890 N050.05.05.285 E019.48.15.807 Color_251ACI
N050.05.05.078 E019.48.16.397 N050.05.05.141 E019.48.16.387 Color_251ACI
N050.05.05.141 E019.48.16.387 N050.05.05.221 E019.48.16.435 Color_251ACI
N050.05.05.221 E019.48.16.435 N050.05.05.237 E019.48.16.493 Color_251ACI
N050.05.05.237 E019.48.16.493 N050.05.05.264 E019.48.16.509 Color_251ACI
N050.05.05.264 E019.48.16.509 N050.05.05.280 E019.48.16.566 Color_251ACI
N050.05.05.280 E019.48.16.566 N050.05.05.297 E019.48.16.624 Color_251ACI
N050.05.05.297 E019.48.16.624 N050.05.05.313 E019.48.16.681 Color_251ACI
N050.05.05.285 E019.48.15.807 N050.05.05.253 E019.48.15.074 Color_251ACI
N050.05.05.253 E019.48.15.074 N050.05.05.221 E019.48.14.340 Color_251ACI
N050.05.05.221 E019.48.14.340 N050.05.05.083 E019.48.12.924 Color_251ACI
N050.05.05.083 E019.48.12.924 N050.05.04.819 E019.48.11.526 Color_251ACI
N050.05.04.819 E019.48.11.526 N050.05.04.283 E019.48.09.251 Color_251ACI
N050.05.04.283 E019.48.09.251 N050.05.03.737 E019.48.07.017 Color_251ACI
N050.05.03.737 E019.48.07.017 N050.05.03.066 E019.48.04.423 Color_251ACI
N050.05.03.066 E019.48.04.423 N050.05.02.379 E019.48.01.771 Color_251ACI
N050.05.02.379 E019.48.01.771 N050.05.02.159 E019.48.00.686 Color_251ACI
N050.05.02.159 E019.48.00.686 N050.05.01.970 E019.47.59.477 Color_251ACI
N050.05.01.970 E019.47.59.477 N050.05.01.838 E019.47.58.160 Color_251ACI
N050.05.01.838 E019.47.58.160 N050.05.01.797 E019.47.56.849 Color_251ACI
N050.05.01.797 E019.47.56.849 N050.05.01.824 E019.47.56.246 Color_251ACI
N050.05.01.824 E019.47.56.246 N050.05.01.888 E019.47.55.618 Color_251ACI
N050.05.01.888 E019.47.55.618 N050.05.02.020 E019.47.54.840 Color_251ACI
N050.05.02.020 E019.47.54.840 N050.05.02.168 E019.47.54.120 Color_251ACI
N050.05.02.168 E019.47.54.120 N050.05.02.445 E019.47.53.001 Color_251ACI
N050.05.02.445 E019.47.53.001 N050.05.02.766 E019.47.51.956 Color_251ACI
N050.05.04.631 E019.48.25.223 N050.05.04.815 E019.48.25.096 Color_251ACI
N050.05.04.815 E019.48.25.096 N050.05.05.037 E019.48.24.943 Color_251ACI
N050.05.05.037 E019.48.24.943 N050.05.05.215 E019.48.24.717 Color_251ACI
N050.05.05.215 E019.48.24.717 N050.05.05.360 E019.48.24.376 Color_251ACI
N050.05.05.360 E019.48.24.376 N050.05.05.343 E019.48.23.461 Color_251ACI
N050.05.05.343 E019.48.23.461 N050.05.05.352 E019.48.22.562 Color_251ACI
N050.05.05.352 E019.48.22.562 N050.05.05.324 E019.48.20.211 Color_251ACI
N050.05.05.324 E019.48.20.211 N050.05.05.332 E019.48.17.836 Color_251ACI
N050.05.05.332 E019.48.17.836 N050.05.05.323 E019.48.17.258 Color_251ACI
N050.05.05.323 E019.48.17.258 N050.05.05.313 E019.48.16.681 Color_251ACI
N050.04.26.992 E019.45.52.127 N050.04.27.018 E019.45.52.143 Color_251ACI
N050.04.27.018 E019.45.52.143 N050.04.27.034 E019.45.52.201 Color_251ACI
N050.04.27.034 E019.45.52.201 N050.04.27.061 E019.45.52.217 Color_251ACI
N050.04.27.061 E019.45.52.217 N050.04.27.088 E019.45.52.233 Color_251ACI
N050.04.27.088 E019.45.52.233 N050.04.27.114 E019.45.52.249 Color_251ACI
N050.04.27.114 E019.45.52.249 N050.04.27.194 E019.45.52.297 Color_251ACI
N050.04.27.194 E019.45.52.297 N050.04.27.231 E019.45.52.272 Color_251ACI
N050.04.27.054 E019.45.52.737 N050.04.27.091 E019.45.52.711 Color_251ACI
N050.04.27.091 E019.45.52.711 N050.04.27.102 E019.45.52.670 Color_251ACI
N050.04.27.102 E019.45.52.670 N050.04.27.112 E019.45.52.628 Color_251ACI
N050.04.27.112 E019.45.52.628 N050.04.27.138 E019.45.52.644 Color_251ACI
N050.04.27.138 E019.45.52.644 N050.04.27.149 E019.45.52.603 Color_251ACI
N050.04.27.149 E019.45.52.603 N050.04.27.186 E019.45.52.578 Color_251ACI
N050.04.27.186 E019.45.52.578 N050.04.27.196 E019.45.52.536 Color_251ACI
N050.04.27.196 E019.45.52.536 N050.04.27.222 E019.45.52.552 Color_251ACI
N050.04.26.941 E019.45.51.716 N050.04.26.965 E019.45.52.111 Color_251ACI
N050.04.27.054 E019.45.52.737 N050.04.27.073 E019.45.53.033 Color_251ACI
N050.04.27.073 E019.45.53.033 N050.04.27.312 E019.45.53.177 Color_251ACI
N050.04.27.312 E019.45.53.177 N050.04.27.412 E019.45.53.143 Color_251ACI
N050.04.27.412 E019.45.53.143 N050.04.27.441 E019.45.53.398 Color_251ACI
N050.04.27.441 E019.45.53.398 N050.04.27.377 E019.45.53.407 Color_251ACI
N050.04.27.377 E019.45.53.407 N050.04.27.268 E019.45.53.723 Color_251ACI
N050.04.27.268 E019.45.53.723 N050.04.27.227 E019.45.53.888 Color_251ACI
N050.04.27.227 E019.45.53.888 N050.04.27.245 E019.45.54.185 Color_251ACI
N050.04.27.245 E019.45.54.185 N050.04.28.520 E019.46.05.191 Color_251ACI
N050.04.28.520 E019.46.05.191 N050.04.28.675 E019.46.05.427 Color_251ACI
N050.04.26.629 E019.45.52.481 N050.04.26.676 E019.45.52.414 Color_251ACI
N050.04.26.676 E019.45.52.414 N050.04.26.713 E019.45.52.388 Color_251ACI
N050.04.26.713 E019.45.52.388 N050.04.26.723 E019.45.52.347 Color_251ACI
N050.04.26.723 E019.45.52.347 N050.04.26.760 E019.45.52.321 Color_251ACI
N050.04.26.760 E019.45.52.321 N050.04.26.801 E019.45.52.156 Color_251ACI
N050.04.26.801 E019.45.52.156 N050.04.26.795 E019.45.52.057 Color_251ACI
N050.04.26.641 E019.45.52.678 N050.04.26.668 E019.45.52.694 Color_251ACI
N050.04.26.668 E019.45.52.694 N050.04.26.721 E019.45.52.726 Color_251ACI
N050.04.26.721 E019.45.52.726 N050.04.26.758 E019.45.52.701 Color_251ACI
N050.04.26.758 E019.45.52.701 N050.04.26.774 E019.45.52.758 Color_251ACI
N050.04.26.774 E019.45.52.758 N050.04.26.801 E019.45.52.774 Color_251ACI
N050.04.26.801 E019.45.52.774 N050.04.26.854 E019.45.52.806 Color_251ACI
N050.04.26.854 E019.45.52.806 N050.04.26.870 E019.45.52.864 Color_251ACI
N050.04.26.870 E019.45.52.864 N050.04.26.886 E019.45.52.921 Color_251ACI
N050.04.26.639 E019.45.52.439 N050.04.26.576 E019.45.52.449 Color_251ACI
N050.04.26.576 E019.45.52.449 N050.04.26.486 E019.45.52.442 Color_251ACI
N050.04.26.486 E019.45.52.442 N050.04.26.385 E019.45.52.477 Color_251ACI
N050.04.26.385 E019.45.52.477 N050.04.26.332 E019.45.52.445 Color_251ACI
N050.04.26.332 E019.45.52.445 N050.04.26.242 E019.45.52.438 Color_251ACI
N050.04.26.242 E019.45.52.438 N050.04.26.162 E019.45.52.390 Color_251ACI
N050.04.26.162 E019.45.52.390 N050.04.26.072 E019.45.52.384 Color_251ACI
N050.04.26.072 E019.45.52.384 N050.04.26.019 E019.45.52.352 Color_251ACI
N050.04.26.631 E019.45.52.720 N050.04.26.557 E019.45.52.771 Color_251ACI
N050.04.26.557 E019.45.52.771 N050.04.26.467 E019.45.52.764 Color_251ACI
N050.04.26.467 E019.45.52.764 N050.04.26.377 E019.45.52.757 Color_251ACI
N050.04.26.377 E019.45.52.757 N050.04.26.287 E019.45.52.751 Color_251ACI
N050.04.26.287 E019.45.52.751 N050.04.26.197 E019.45.52.744 Color_251ACI
N050.04.26.197 E019.45.52.744 N050.04.26.107 E019.45.52.738 Color_251ACI
N050.04.26.107 E019.45.52.738 N050.04.25.921 E019.45.52.626 Color_251ACI
N050.04.26.019 E019.45.52.352 N050.04.25.317 E019.45.51.977 Color_251ACI
N050.04.25.921 E019.45.52.626 N050.04.25.272 E019.45.52.283 Color_251ACI
N050.04.25.317 E019.45.51.977 N050.04.25.227 E019.45.51.970 Color_251ACI
N050.04.25.227 E019.45.51.970 N050.04.25.148 E019.45.51.922 Color_251ACI
N050.04.25.148 E019.45.51.922 N050.04.25.068 E019.45.51.874 Color_251ACI
N050.04.25.068 E019.45.51.874 N050.04.24.951 E019.45.51.851 Color_251ACI
N050.04.24.951 E019.45.51.851 N050.04.24.861 E019.45.51.845 Color_251ACI
N050.04.24.861 E019.45.51.845 N050.04.24.781 E019.45.51.797 Color_251ACI
N050.04.24.781 E019.45.51.797 N050.04.24.665 E019.45.51.774 Color_251ACI
N050.04.24.665 E019.45.51.774 N050.04.24.575 E019.45.51.768 Color_251ACI
N050.04.19.601 E019.46.24.393 N050.04.19.124 E019.46.24.344 Color_251ACI
N050.04.39.248 E019.45.48.793 N050.04.38.409 E019.45.49.097 Color_251ACI
N050.04.38.409 E019.45.49.097 N050.04.37.543 E019.45.49.385 Color_251ACI
N050.04.37.543 E019.45.49.385 N050.04.36.935 E019.45.49.495 Color_251ACI
N050.04.36.935 E019.45.49.495 N050.04.36.364 E019.45.49.580 Color_251ACI
N050.04.36.364 E019.45.49.580 N050.04.35.639 E019.45.49.667 Color_251ACI
N050.04.35.639 E019.45.49.667 N050.04.34.931 E019.45.49.812 Color_251ACI
N050.04.34.931 E019.45.49.812 N050.04.33.836 E019.45.49.915 Color_251ACI
N050.04.33.836 E019.45.49.915 N050.04.32.767 E019.45.50.034 Color_251ACI
N050.04.32.767 E019.45.50.034 N050.04.32.112 E019.45.50.211 Color_251ACI
N050.04.32.112 E019.45.50.211 N050.04.31.447 E019.45.50.429 Color_251ACI
N050.04.31.447 E019.45.50.429 N050.04.30.992 E019.45.50.536 Color_251ACI
N050.04.30.992 E019.45.50.536 N050.04.30.548 E019.45.50.602 Color_251ACI
N050.04.30.548 E019.45.50.602 N050.04.29.791 E019.45.50.575 Color_251ACI
N050.04.29.791 E019.45.50.575 N050.04.29.044 E019.45.50.506 Color_251ACI
N050.04.29.044 E019.45.50.506 N050.04.28.270 E019.45.50.421 Color_251ACI
N050.04.28.270 E019.45.50.421 N050.04.27.519 E019.45.50.493 Color_251ACI
N050.04.27.519 E019.45.50.493 N050.04.26.901 E019.45.50.644 Color_251ACI
N050.04.26.901 E019.45.50.644 N050.04.26.309 E019.45.50.812 Color_251ACI
N050.04.26.309 E019.45.50.812 N050.04.25.791 E019.45.50.929 Color_251ACI
N050.04.25.791 E019.45.50.929 N050.04.25.310 E019.45.51.020 Color_251ACI
N050.04.26.501 E019.45.51.023 N050.04.26.338 E019.45.51.067 Color_251ACI
N050.04.26.338 E019.45.51.067 N050.04.25.820 E019.45.51.184 Color_251ACI
N050.04.25.820 E019.45.51.184 N050.04.25.302 E019.45.51.301 Color_251ACI
N050.04.30.252 E019.48.12.284 N050.04.30.013 E019.48.12.140 Color_251ACI
N050.04.30.013 E019.48.12.140 N050.04.29.837 E019.48.11.986 Color_251ACI
N050.04.29.837 E019.48.11.986 N050.04.29.698 E019.48.11.807 Color_251ACI
N050.04.29.698 E019.48.11.807 N050.04.29.416 E019.48.11.590 Color_251ACI
N050.04.29.416 E019.48.11.590 N050.04.29.240 E019.48.11.436 Color_251ACI
N050.04.29.240 E019.48.11.436 N050.04.29.038 E019.48.11.267 Color_251ACI
N050.04.29.038 E019.48.11.267 N050.04.28.952 E019.48.11.120 Color_251ACI
N050.04.28.952 E019.48.11.120 N050.04.28.897 E019.48.10.849 Color_251ACI
N050.04.28.897 E019.48.10.849 N050.04.28.895 E019.48.10.609 Color_251ACI
N050.04.28.895 E019.48.10.609 N050.04.28.947 E019.48.10.402 Color_251ACI
N050.04.28.947 E019.48.10.402 N050.04.29.035 E019.48.10.170 Color_251ACI
N050.04.29.035 E019.48.10.170 N050.04.29.139 E019.48.09.995 Color_251ACI
N050.04.23.765 E019.46.23.376 N050.04.23.439 E019.46.24.322 Color_251ACI
N050.04.23.439 E019.46.24.322 N050.04.22.869 E019.46.24.646 Color_251ACI
N050.04.22.869 E019.46.24.646 N050.04.19.818 E019.46.24.381 Color_251ACI
N050.04.19.097 E019.46.24.946 N050.04.22.906 E019.46.25.240 Color_251ACI
N050.04.22.906 E019.46.25.240 N050.04.23.407 E019.46.25.684 Color_251ACI
N050.04.23.407 E019.46.25.684 N050.04.23.625 E019.46.26.530 Color_251ACI
N050.04.22.901 E019.46.50.523 N050.04.22.692 E019.46.50.873 Color_251ACI
N050.04.22.692 E019.46.50.873 N050.04.18.593 E019.46.51.501 Color_251ACI
N050.04.18.593 E019.46.51.501 N050.04.18.373 E019.46.51.035 Color_251ACI
N050.04.18.373 E019.46.51.035 N050.04.19.097 E019.46.24.946 Color_251ACI
N050.04.31.140 E019.47.54.532 N050.04.31.260 E019.47.55.033 Color_251ACI
N050.04.31.260 E019.47.55.033 N050.04.31.385 E019.47.55.394 Color_251ACI
N050.04.31.385 E019.47.55.394 N050.04.31.434 E019.47.55.566 Color_251ACI
N050.04.31.434 E019.47.55.566 N050.04.31.440 E019.47.55.665 Color_251ACI
N050.04.31.440 E019.47.55.665 N050.04.31.446 E019.47.55.764 Color_251ACI
N050.04.25.718 E019.47.36.220 N050.04.26.043 E019.47.37.130 Color_251ACI
N050.04.26.043 E019.47.37.130 N050.04.26.918 E019.47.40.133 Color_251ACI
N050.04.26.918 E019.47.40.133 N050.04.28.030 E019.47.43.659 Color_251ACI
N050.04.28.030 E019.47.43.659 N050.04.28.713 E019.47.45.833 Color_251ACI
N050.04.28.713 E019.47.45.833 N050.04.29.223 E019.47.47.473 Color_251ACI
N050.04.29.223 E019.47.47.473 N050.04.29.739 E019.47.49.213 Color_251ACI
N050.04.29.739 E019.47.49.213 N050.04.30.808 E019.47.52.666 Color_251ACI
N050.04.30.808 E019.47.52.666 N050.04.31.312 E019.47.54.207 Color_251ACI
N050.04.31.312 E019.47.54.207 N050.04.31.606 E019.47.55.241 Color_251ACI
N050.04.31.606 E019.47.55.241 N050.04.31.661 E019.47.55.513 Color_251ACI
N050.04.31.661 E019.47.55.513 N050.04.31.714 E019.47.55.545 Color_251ACI
N050.04.32.447 E019.48.01.462 N050.04.32.421 E019.48.01.446 Color_251ACI
N050.04.32.421 E019.48.01.446 N050.04.32.384 E019.48.01.472 Color_251ACI
N050.04.32.384 E019.48.01.472 N050.04.32.347 E019.48.01.497 Color_251ACI
N050.04.32.347 E019.48.01.497 N050.04.32.337 E019.48.01.538 Color_251ACI
N050.04.32.337 E019.48.01.538 N050.04.32.289 E019.48.01.605 Color_251ACI
N050.04.32.289 E019.48.01.605 N050.04.32.236 E019.48.02.192 Color_251ACI
N050.04.32.236 E019.48.02.192 N050.04.32.099 E019.48.03.729 Color_251ACI
N050.04.32.099 E019.48.03.729 N050.04.32.132 E019.48.03.844 Color_251ACI
N050.04.32.132 E019.48.03.844 N050.04.32.030 E019.48.05.116 Color_251ACI
N050.04.32.030 E019.48.05.116 N050.04.31.993 E019.48.05.141 Color_251ACI
N050.04.31.993 E019.48.05.141 N050.04.31.983 E019.48.05.183 Color_251ACI
N050.04.31.983 E019.48.05.183 N050.04.31.952 E019.48.05.307 Color_251ACI
N050.04.31.952 E019.48.05.307 N050.04.31.958 E019.48.05.406 Color_251ACI
N050.04.31.958 E019.48.05.406 N050.04.31.948 E019.48.05.447 Color_251ACI
N050.04.31.948 E019.48.05.447 N050.04.32.001 E019.48.05.479 Color_251ACI
N050.04.32.001 E019.48.05.479 N050.04.32.034 E019.48.05.594 Color_251ACI
N050.04.32.034 E019.48.05.594 N050.04.32.113 E019.48.05.642 Color_251ACI
N050.04.32.113 E019.48.05.642 N050.04.32.320 E019.48.05.671 Color_251ACI
N050.04.32.320 E019.48.05.671 N050.04.32.295 E019.48.05.895 Color_251ACI
N050.04.32.295 E019.48.05.895 N050.04.31.802 E019.48.05.788 Color_251ACI
N050.04.31.802 E019.48.05.788 N050.04.31.811 E019.48.05.508 Color_251ACI
N050.04.31.811 E019.48.05.508 N050.04.31.424 E019.48.05.465 Color_251ACI
N050.04.31.449 E019.48.05.242 N050.04.31.482 E019.48.04.738 Color_251ACI
N050.04.31.482 E019.48.04.738 N050.04.31.858 E019.48.04.822 Color_251ACI
N050.04.31.858 E019.48.04.822 N050.04.32.169 E019.48.01.723 Color_251ACI
N050.04.32.169 E019.48.01.723 N050.04.32.163 E019.48.01.624 Color_251ACI
N050.04.32.163 E019.48.01.624 N050.04.32.156 E019.48.01.525 Color_251ACI
N050.04.32.156 E019.48.01.525 N050.04.32.150 E019.48.01.426 Color_251ACI
N050.04.32.150 E019.48.01.426 N050.04.32.124 E019.48.01.410 Color_251ACI
N050.04.32.124 E019.48.01.410 N050.04.32.108 E019.48.01.353 Color_251ACI
N050.04.31.357 E019.48.10.663 N050.04.31.212 E019.48.08.290 Color_251ACI
N050.04.31.212 E019.48.08.290 N050.04.31.063 E019.48.08.153 Color_251ACI
N050.04.30.914 E019.48.08.015 N050.04.30.562 E019.48.07.708 Color_251ACI
N050.04.30.562 E019.48.07.708 N050.04.30.583 E019.48.07.625 Color_251ACI
N050.04.30.920 E019.48.08.114 N050.04.30.462 E019.48.07.743 Color_251ACI
N050.04.30.462 E019.48.07.743 N050.04.30.394 E019.48.07.893 Color_251ACI
N050.04.30.394 E019.48.07.893 N050.04.30.474 E019.48.07.941 Color_251ACI
N050.04.30.474 E019.48.07.941 N050.04.30.490 E019.48.07.998 Color_251ACI
N050.04.30.490 E019.48.07.998 N050.04.30.523 E019.48.08.113 Color_251ACI
N050.04.30.523 E019.48.08.113 N050.04.30.539 E019.48.08.171 Color_251ACI
N050.04.30.539 E019.48.08.171 N050.04.30.498 E019.48.08.336 Color_251ACI
N050.04.30.498 E019.48.08.336 N050.04.30.504 E019.48.08.435 Color_251ACI
N050.04.30.504 E019.48.08.435 N050.04.30.436 E019.48.08.585 Color_251ACI
N050.04.27.225 E019.47.42.222 N050.04.27.886 E019.47.44.239 Color_251ACI
N050.04.27.886 E019.47.44.239 N050.04.28.492 E019.47.45.985 Color_251ACI
N050.04.28.492 E019.47.45.985 N050.04.29.002 E019.47.47.626 Color_251ACI
N050.04.29.002 E019.47.47.626 N050.04.29.518 E019.47.49.365 Color_251ACI
N050.04.29.518 E019.47.49.365 N050.04.30.126 E019.47.51.350 Color_251ACI
N050.04.30.234 E019.47.51.653 N050.04.30.587 E019.47.52.818 Color_251ACI
N050.04.30.587 E019.47.52.818 N050.04.30.950 E019.47.53.942 Color_251ACI
N050.04.05.725 E019.47.59.898 N050.04.06.281 E019.48.01.233 Color_251ACI
;rwy_edge_lights N000.00.00.000 E000.00.00.000 N000.00.00.000 E000.00.00.000
N050.04.36.884 E019.46.36.816 N050.04.36.831 E019.46.36.781 Color_252ACI
N050.04.36.831 E019.46.36.781 N050.04.36.767 E019.46.36.801 Color_252ACI
N050.04.36.767 E019.46.36.801 N050.04.36.727 E019.46.36.865 Color_252ACI
N050.04.36.727 E019.46.36.865 N050.04.36.716 E019.46.36.969 Color_252ACI
N050.04.36.716 E019.46.36.969 N050.04.36.743 E019.46.37.055 Color_252ACI
N050.04.36.743 E019.46.37.055 N050.04.36.801 E019.46.37.102 Color_252ACI
N050.04.36.801 E019.46.37.102 N050.04.36.861 E019.46.37.090 Color_252ACI
N050.04.36.861 E019.46.37.090 N050.04.36.910 E019.46.37.021 Color_252ACI
N050.04.36.910 E019.46.37.021 N050.04.36.923 E019.46.36.942 Color_252ACI
N050.04.36.923 E019.46.36.942 N050.04.36.909 E019.46.36.861 Color_252ACI
N050.04.36.909 E019.46.36.861 N050.04.36.884 E019.46.36.816 Color_252ACI
N050.04.37.299 E019.46.39.787 N050.04.37.246 E019.46.39.751 Color_252ACI
N050.04.37.246 E019.46.39.751 N050.04.37.182 E019.46.39.771 Color_252ACI
N050.04.37.182 E019.46.39.771 N050.04.37.142 E019.46.39.835 Color_252ACI
N050.04.37.142 E019.46.39.835 N050.04.37.131 E019.46.39.939 Color_252ACI
N050.04.37.131 E019.46.39.939 N050.04.37.159 E019.46.40.025 Color_252ACI
N050.04.37.159 E019.46.40.025 N050.04.37.216 E019.46.40.072 Color_252ACI
N050.04.37.216 E019.46.40.072 N050.04.37.276 E019.46.40.060 Color_252ACI
N050.04.37.276 E019.46.40.060 N050.04.37.325 E019.46.39.991 Color_252ACI
N050.04.37.325 E019.46.39.991 N050.04.37.338 E019.46.39.912 Color_252ACI
N050.04.37.338 E019.46.39.912 N050.04.37.324 E019.46.39.831 Color_252ACI
N050.04.37.324 E019.46.39.831 N050.04.37.299 E019.46.39.787 Color_252ACI
N050.04.37.705 E019.46.42.742 N050.04.37.651 E019.46.42.707 Color_252ACI
N050.04.37.651 E019.46.42.707 N050.04.37.587 E019.46.42.727 Color_252ACI
N050.04.37.587 E019.46.42.727 N050.04.37.547 E019.46.42.791 Color_252ACI
N050.04.37.547 E019.46.42.791 N050.04.37.536 E019.46.42.895 Color_252ACI
N050.04.37.536 E019.46.42.895 N050.04.37.564 E019.46.42.981 Color_252ACI
N050.04.37.564 E019.46.42.981 N050.04.37.621 E019.46.43.028 Color_252ACI
N050.04.37.621 E019.46.43.028 N050.04.37.681 E019.46.43.016 Color_252ACI
N050.04.37.681 E019.46.43.016 N050.04.37.730 E019.46.42.947 Color_252ACI
N050.04.37.730 E019.46.42.947 N050.04.37.743 E019.46.42.868 Color_252ACI
N050.04.37.743 E019.46.42.868 N050.04.37.729 E019.46.42.787 Color_252ACI
N050.04.37.729 E019.46.42.787 N050.04.37.705 E019.46.42.742 Color_252ACI
N050.04.38.121 E019.46.45.671 N050.04.38.068 E019.46.45.636 Color_252ACI
N050.04.38.068 E019.46.45.636 N050.04.38.004 E019.46.45.656 Color_252ACI
N050.04.38.004 E019.46.45.656 N050.04.37.964 E019.46.45.719 Color_252ACI
N050.04.37.964 E019.46.45.719 N050.04.37.953 E019.46.45.823 Color_252ACI
N050.04.37.953 E019.46.45.823 N050.04.37.980 E019.46.45.909 Color_252ACI
N050.04.37.980 E019.46.45.909 N050.04.38.038 E019.46.45.957 Color_252ACI
N050.04.38.038 E019.46.45.957 N050.04.38.098 E019.46.45.945 Color_252ACI
N050.04.38.098 E019.46.45.945 N050.04.38.146 E019.46.45.876 Color_252ACI
N050.04.38.146 E019.46.45.876 N050.04.38.160 E019.46.45.796 Color_252ACI
N050.04.38.160 E019.46.45.796 N050.04.38.146 E019.46.45.716 Color_252ACI
N050.04.38.146 E019.46.45.716 N050.04.38.121 E019.46.45.671 Color_252ACI
N050.04.38.539 E019.46.48.630 N050.04.38.485 E019.46.48.594 Color_252ACI
N050.04.38.485 E019.46.48.594 N050.04.38.421 E019.46.48.614 Color_252ACI
N050.04.38.421 E019.46.48.614 N050.04.38.381 E019.46.48.678 Color_252ACI
N050.04.38.381 E019.46.48.678 N050.04.38.370 E019.46.48.782 Color_252ACI
N050.04.38.370 E019.46.48.782 N050.04.38.398 E019.46.48.868 Color_252ACI
N050.04.38.398 E019.46.48.868 N050.04.38.455 E019.46.48.915 Color_252ACI
N050.04.38.455 E019.46.48.915 N050.04.38.515 E019.46.48.903 Color_252ACI
N050.04.38.515 E019.46.48.903 N050.04.38.564 E019.46.48.834 Color_252ACI
N050.04.38.564 E019.46.48.834 N050.04.38.577 E019.46.48.755 Color_252ACI
N050.04.38.577 E019.46.48.755 N050.04.38.563 E019.46.48.674 Color_252ACI
N050.04.38.563 E019.46.48.674 N050.04.38.539 E019.46.48.630 Color_252ACI
N050.04.38.949 E019.46.51.596 N050.04.38.895 E019.46.51.560 Color_252ACI
N050.04.38.895 E019.46.51.560 N050.04.38.831 E019.46.51.581 Color_252ACI
N050.04.38.831 E019.46.51.581 N050.04.38.792 E019.46.51.644 Color_252ACI
N050.04.38.792 E019.46.51.644 N050.04.38.780 E019.46.51.748 Color_252ACI
N050.04.38.780 E019.46.51.748 N050.04.38.808 E019.46.51.834 Color_252ACI
N050.04.38.808 E019.46.51.834 N050.04.38.866 E019.46.51.881 Color_252ACI
N050.04.38.866 E019.46.51.881 N050.04.38.926 E019.46.51.870 Color_252ACI
N050.04.38.926 E019.46.51.870 N050.04.38.974 E019.46.51.800 Color_252ACI
N050.04.38.974 E019.46.51.800 N050.04.38.987 E019.46.51.721 Color_252ACI
N050.04.38.987 E019.46.51.721 N050.04.38.973 E019.46.51.640 Color_252ACI
N050.04.38.973 E019.46.51.640 N050.04.38.949 E019.46.51.596 Color_252ACI
N050.04.39.371 E019.46.54.534 N050.04.39.317 E019.46.54.499 Color_252ACI
N050.04.39.317 E019.46.54.499 N050.04.39.253 E019.46.54.519 Color_252ACI
N050.04.39.253 E019.46.54.519 N050.04.39.214 E019.46.54.583 Color_252ACI
N050.04.39.214 E019.46.54.583 N050.04.39.202 E019.46.54.687 Color_252ACI
N050.04.39.202 E019.46.54.687 N050.04.39.230 E019.46.54.773 Color_252ACI
N050.04.39.230 E019.46.54.773 N050.04.39.288 E019.46.54.820 Color_252ACI
N050.04.39.288 E019.46.54.820 N050.04.39.348 E019.46.54.808 Color_252ACI
N050.04.39.348 E019.46.54.808 N050.04.39.396 E019.46.54.739 Color_252ACI
N050.04.39.396 E019.46.54.739 N050.04.39.409 E019.46.54.660 Color_252ACI
N050.04.39.409 E019.46.54.660 N050.04.39.395 E019.46.54.579 Color_252ACI
N050.04.39.395 E019.46.54.579 N050.04.39.371 E019.46.54.534 Color_252ACI
N050.04.39.773 E019.46.57.491 N050.04.39.719 E019.46.57.455 Color_252ACI
N050.04.39.719 E019.46.57.455 N050.04.39.655 E019.46.57.476 Color_252ACI
N050.04.39.655 E019.46.57.476 N050.04.39.615 E019.46.57.539 Color_252ACI
N050.04.39.615 E019.46.57.539 N050.04.39.604 E019.46.57.643 Color_252ACI
N050.04.39.604 E019.46.57.643 N050.04.39.632 E019.46.57.729 Color_252ACI
N050.04.39.632 E019.46.57.729 N050.04.39.690 E019.46.57.777 Color_252ACI
N050.04.39.690 E019.46.57.777 N050.04.39.750 E019.46.57.765 Color_252ACI
N050.04.39.750 E019.46.57.765 N050.04.39.798 E019.46.57.696 Color_252ACI
N050.04.39.798 E019.46.57.696 N050.04.39.811 E019.46.57.616 Color_252ACI
N050.04.39.811 E019.46.57.616 N050.04.39.797 E019.46.57.535 Color_252ACI
N050.04.39.797 E019.46.57.535 N050.04.39.773 E019.46.57.491 Color_252ACI
N050.04.40.181 E019.47.00.463 N050.04.40.127 E019.47.00.428 Color_252ACI
N050.04.40.127 E019.47.00.428 N050.04.40.063 E019.47.00.448 Color_252ACI
N050.04.40.063 E019.47.00.448 N050.04.40.023 E019.47.00.511 Color_252ACI
N050.04.40.023 E019.47.00.511 N050.04.40.012 E019.47.00.615 Color_252ACI
N050.04.40.012 E019.47.00.615 N050.04.40.040 E019.47.00.702 Color_252ACI
N050.04.40.040 E019.47.00.702 N050.04.40.097 E019.47.00.749 Color_252ACI
N050.04.40.097 E019.47.00.749 N050.04.40.157 E019.47.00.737 Color_252ACI
N050.04.40.157 E019.47.00.737 N050.04.40.206 E019.47.00.668 Color_252ACI
N050.04.40.206 E019.47.00.668 N050.04.40.219 E019.47.00.588 Color_252ACI
N050.04.40.219 E019.47.00.588 N050.04.40.205 E019.47.00.508 Color_252ACI
N050.04.40.205 E019.47.00.508 N050.04.40.181 E019.47.00.463 Color_252ACI
N050.04.40.596 E019.47.03.404 N050.04.40.542 E019.47.03.368 Color_252ACI
N050.04.40.542 E019.47.03.368 N050.04.40.478 E019.47.03.389 Color_252ACI
N050.04.40.478 E019.47.03.389 N050.04.40.438 E019.47.03.452 Color_252ACI
N050.04.40.438 E019.47.03.452 N050.04.40.427 E019.47.03.556 Color_252ACI
N050.04.40.427 E019.47.03.556 N050.04.40.455 E019.47.03.642 Color_252ACI
N050.04.40.455 E019.47.03.642 N050.04.40.512 E019.47.03.690 Color_252ACI
N050.04.40.512 E019.47.03.690 N050.04.40.572 E019.47.03.678 Color_252ACI
N050.04.40.572 E019.47.03.678 N050.04.40.621 E019.47.03.609 Color_252ACI
N050.04.40.621 E019.47.03.609 N050.04.40.634 E019.47.03.529 Color_252ACI
N050.04.40.634 E019.47.03.529 N050.04.40.620 E019.47.03.448 Color_252ACI
N050.04.40.620 E019.47.03.448 N050.04.40.596 E019.47.03.404 Color_252ACI
N050.04.41.005 E019.47.06.359 N050.04.40.951 E019.47.06.323 Color_252ACI
N050.04.40.951 E019.47.06.323 N050.04.40.887 E019.47.06.343 Color_252ACI
N050.04.40.887 E019.47.06.343 N050.04.40.847 E019.47.06.407 Color_252ACI
N050.04.40.847 E019.47.06.407 N050.04.40.836 E019.47.06.511 Color_252ACI
N050.04.40.836 E019.47.06.511 N050.04.40.864 E019.47.06.597 Color_252ACI
N050.04.40.864 E019.47.06.597 N050.04.40.921 E019.47.06.644 Color_252ACI
N050.04.40.921 E019.47.06.644 N050.04.40.981 E019.47.06.632 Color_252ACI
N050.04.40.981 E019.47.06.632 N050.04.41.030 E019.47.06.563 Color_252ACI
N050.04.41.030 E019.47.06.563 N050.04.41.043 E019.47.06.484 Color_252ACI
N050.04.41.043 E019.47.06.484 N050.04.41.029 E019.47.06.403 Color_252ACI
N050.04.41.029 E019.47.06.403 N050.04.41.005 E019.47.06.359 Color_252ACI
N050.04.41.418 E019.47.09.318 N050.04.41.364 E019.47.09.282 Color_252ACI
N050.04.41.364 E019.47.09.282 N050.04.41.300 E019.47.09.303 Color_252ACI
N050.04.41.300 E019.47.09.303 N050.04.41.261 E019.47.09.366 Color_252ACI
N050.04.41.261 E019.47.09.366 N050.04.41.249 E019.47.09.470 Color_252ACI
N050.04.41.249 E019.47.09.470 N050.04.41.277 E019.47.09.556 Color_252ACI
N050.04.41.277 E019.47.09.556 N050.04.41.335 E019.47.09.604 Color_252ACI
N050.04.41.335 E019.47.09.604 N050.04.41.395 E019.47.09.592 Color_252ACI
N050.04.41.395 E019.47.09.592 N050.04.41.443 E019.47.09.523 Color_252ACI
N050.04.41.443 E019.47.09.523 N050.04.41.456 E019.47.09.443 Color_252ACI
N050.04.41.456 E019.47.09.443 N050.04.41.442 E019.47.09.363 Color_252ACI
N050.04.41.442 E019.47.09.363 N050.04.41.418 E019.47.09.318 Color_252ACI
N050.04.41.824 E019.47.12.250 N050.04.41.770 E019.47.12.214 Color_252ACI
N050.04.41.770 E019.47.12.214 N050.04.41.706 E019.47.12.235 Color_252ACI
N050.04.41.706 E019.47.12.235 N050.04.41.667 E019.47.12.298 Color_252ACI
N050.04.41.667 E019.47.12.298 N050.04.41.655 E019.47.12.402 Color_252ACI
N050.04.41.655 E019.47.12.402 N050.04.41.683 E019.47.12.488 Color_252ACI
N050.04.41.683 E019.47.12.488 N050.04.41.741 E019.47.12.536 Color_252ACI
N050.04.41.741 E019.47.12.536 N050.04.41.801 E019.47.12.524 Color_252ACI
N050.04.41.801 E019.47.12.524 N050.04.41.849 E019.47.12.455 Color_252ACI
N050.04.41.849 E019.47.12.455 N050.04.41.862 E019.47.12.375 Color_252ACI
N050.04.41.862 E019.47.12.375 N050.04.41.848 E019.47.12.295 Color_252ACI
N050.04.41.848 E019.47.12.295 N050.04.41.824 E019.47.12.250 Color_252ACI
N050.04.42.242 E019.47.15.214 N050.04.42.188 E019.47.15.178 Color_252ACI
N050.04.42.188 E019.47.15.178 N050.04.42.124 E019.47.15.199 Color_252ACI
N050.04.42.124 E019.47.15.199 N050.04.42.084 E019.47.15.262 Color_252ACI
N050.04.42.084 E019.47.15.262 N050.04.42.073 E019.47.15.366 Color_252ACI
N050.04.42.073 E019.47.15.366 N050.04.42.101 E019.47.15.452 Color_252ACI
N050.04.42.101 E019.47.15.452 N050.04.42.159 E019.47.15.500 Color_252ACI
N050.04.42.159 E019.47.15.500 N050.04.42.219 E019.47.15.488 Color_252ACI
N050.04.42.219 E019.47.15.488 N050.04.42.267 E019.47.15.419 Color_252ACI
N050.04.42.267 E019.47.15.419 N050.04.42.280 E019.47.15.339 Color_252ACI
N050.04.42.280 E019.47.15.339 N050.04.42.266 E019.47.15.258 Color_252ACI
N050.04.42.266 E019.47.15.258 N050.04.42.242 E019.47.15.214 Color_252ACI
N050.04.42.662 E019.47.18.141 N050.04.42.609 E019.47.18.106 Color_252ACI
N050.04.42.609 E019.47.18.106 N050.04.42.545 E019.47.18.126 Color_252ACI
N050.04.42.545 E019.47.18.126 N050.04.42.505 E019.47.18.189 Color_252ACI
N050.04.42.505 E019.47.18.189 N050.04.42.494 E019.47.18.294 Color_252ACI
N050.04.42.494 E019.47.18.294 N050.04.42.521 E019.47.18.380 Color_252ACI
N050.04.42.521 E019.47.18.380 N050.04.42.579 E019.47.18.427 Color_252ACI
N050.04.42.579 E019.47.18.427 N050.04.42.639 E019.47.18.415 Color_252ACI
N050.04.42.639 E019.47.18.415 N050.04.42.687 E019.47.18.346 Color_252ACI
N050.04.42.687 E019.47.18.346 N050.04.42.701 E019.47.18.267 Color_252ACI
N050.04.42.701 E019.47.18.267 N050.04.42.687 E019.47.18.186 Color_252ACI
N050.04.42.687 E019.47.18.186 N050.04.42.662 E019.47.18.141 Color_252ACI
N050.04.43.066 E019.47.21.115 N050.04.43.013 E019.47.21.079 Color_252ACI
N050.04.43.013 E019.47.21.079 N050.04.42.949 E019.47.21.100 Color_252ACI
N050.04.42.949 E019.47.21.100 N050.04.42.909 E019.47.21.163 Color_252ACI
N050.04.42.909 E019.47.21.163 N050.04.42.898 E019.47.21.267 Color_252ACI
N050.04.42.898 E019.47.21.267 N050.04.42.926 E019.47.21.353 Color_252ACI
N050.04.42.926 E019.47.21.353 N050.04.42.983 E019.47.21.401 Color_252ACI
N050.04.42.983 E019.47.21.401 N050.04.43.043 E019.47.21.389 Color_252ACI
N050.04.43.043 E019.47.21.389 N050.04.43.092 E019.47.21.320 Color_252ACI
N050.04.43.092 E019.47.21.320 N050.04.43.105 E019.47.21.240 Color_252ACI
N050.04.43.105 E019.47.21.240 N050.04.43.091 E019.47.21.159 Color_252ACI
N050.04.43.091 E019.47.21.159 N050.04.43.066 E019.47.21.115 Color_252ACI
N050.04.43.489 E019.47.24.083 N050.04.43.435 E019.47.24.047 Color_252ACI
N050.04.43.435 E019.47.24.047 N050.04.43.371 E019.47.24.068 Color_252ACI
N050.04.43.371 E019.47.24.068 N050.04.43.331 E019.47.24.131 Color_252ACI
N050.04.43.331 E019.47.24.131 N050.04.43.320 E019.47.24.235 Color_252ACI
N050.04.43.320 E019.47.24.235 N050.04.43.348 E019.47.24.321 Color_252ACI
N050.04.43.348 E019.47.24.321 N050.04.43.405 E019.47.24.369 Color_252ACI
N050.04.43.405 E019.47.24.369 N050.04.43.465 E019.47.24.357 Color_252ACI
N050.04.43.465 E019.47.24.357 N050.04.43.514 E019.47.24.287 Color_252ACI
N050.04.43.514 E019.47.24.287 N050.04.43.527 E019.47.24.208 Color_252ACI
N050.04.43.527 E019.47.24.208 N050.04.43.513 E019.47.24.127 Color_252ACI
N050.04.43.513 E019.47.24.127 N050.04.43.489 E019.47.24.083 Color_252ACI
N050.04.43.892 E019.47.26.998 N050.04.43.839 E019.47.26.962 Color_252ACI
N050.04.43.839 E019.47.26.962 N050.04.43.775 E019.47.26.983 Color_252ACI
N050.04.43.775 E019.47.26.983 N050.04.43.735 E019.47.27.046 Color_252ACI
N050.04.43.735 E019.47.27.046 N050.04.43.724 E019.47.27.150 Color_252ACI
N050.04.43.724 E019.47.27.150 N050.04.43.751 E019.47.27.236 Color_252ACI
N050.04.43.751 E019.47.27.236 N050.04.43.809 E019.47.27.284 Color_252ACI
N050.04.43.809 E019.47.27.284 N050.04.43.869 E019.47.27.272 Color_252ACI
N050.04.43.869 E019.47.27.272 N050.04.43.917 E019.47.27.203 Color_252ACI
N050.04.43.917 E019.47.27.203 N050.04.43.931 E019.47.27.123 Color_252ACI
N050.04.43.931 E019.47.27.123 N050.04.43.917 E019.47.27.042 Color_252ACI
N050.04.43.917 E019.47.27.042 N050.04.43.892 E019.47.26.998 Color_252ACI
N050.04.44.294 E019.47.29.955 N050.04.44.241 E019.47.29.919 Color_252ACI
N050.04.44.241 E019.47.29.919 N050.04.44.177 E019.47.29.940 Color_252ACI
N050.04.44.177 E019.47.29.940 N050.04.44.137 E019.47.30.003 Color_252ACI
N050.04.44.137 E019.47.30.003 N050.04.44.126 E019.47.30.107 Color_252ACI
N050.04.44.126 E019.47.30.107 N050.04.44.153 E019.47.30.193 Color_252ACI
N050.04.44.153 E019.47.30.193 N050.04.44.211 E019.47.30.241 Color_252ACI
N050.04.44.211 E019.47.30.241 N050.04.44.271 E019.47.30.229 Color_252ACI
N050.04.44.271 E019.47.30.229 N050.04.44.319 E019.47.30.160 Color_252ACI
N050.04.44.319 E019.47.30.160 N050.04.44.332 E019.47.30.080 Color_252ACI
N050.04.44.332 E019.47.30.080 N050.04.44.319 E019.47.30.000 Color_252ACI
N050.04.44.319 E019.47.30.000 N050.04.44.294 E019.47.29.955 Color_252ACI
N050.04.44.714 E019.47.32.930 N050.04.44.660 E019.47.32.894 Color_252ACI
N050.04.44.660 E019.47.32.894 N050.04.44.596 E019.47.32.914 Color_252ACI
N050.04.44.596 E019.47.32.914 N050.04.44.556 E019.47.32.978 Color_252ACI
N050.04.44.556 E019.47.32.978 N050.04.44.545 E019.47.33.082 Color_252ACI
N050.04.44.545 E019.47.33.082 N050.04.44.573 E019.47.33.168 Color_252ACI
N050.04.44.573 E019.47.33.168 N050.04.44.630 E019.47.33.215 Color_252ACI
N050.04.44.630 E019.47.33.215 N050.04.44.690 E019.47.33.203 Color_252ACI
N050.04.44.690 E019.47.33.203 N050.04.44.739 E019.47.33.134 Color_252ACI
N050.04.44.739 E019.47.33.134 N050.04.44.752 E019.47.33.055 Color_252ACI
N050.04.44.752 E019.47.33.055 N050.04.44.738 E019.47.32.974 Color_252ACI
N050.04.44.738 E019.47.32.974 N050.04.44.714 E019.47.32.930 Color_252ACI
N050.04.45.124 E019.47.35.866 N050.04.45.070 E019.47.35.831 Color_252ACI
N050.04.45.070 E019.47.35.831 N050.04.45.006 E019.47.35.851 Color_252ACI
N050.04.45.006 E019.47.35.851 N050.04.44.966 E019.47.35.915 Color_252ACI
N050.04.44.966 E019.47.35.915 N050.04.44.955 E019.47.36.019 Color_252ACI
N050.04.44.955 E019.47.36.019 N050.04.44.983 E019.47.36.105 Color_252ACI
N050.04.44.983 E019.47.36.105 N050.04.45.041 E019.47.36.152 Color_252ACI
N050.04.45.041 E019.47.36.152 N050.04.45.101 E019.47.36.140 Color_252ACI
N050.04.45.101 E019.47.36.140 N050.04.45.149 E019.47.36.071 Color_252ACI
N050.04.45.149 E019.47.36.071 N050.04.45.162 E019.47.35.992 Color_252ACI
N050.04.45.162 E019.47.35.992 N050.04.45.148 E019.47.35.911 Color_252ACI
N050.04.45.148 E019.47.35.911 N050.04.45.124 E019.47.35.866 Color_252ACI
N050.04.45.543 E019.47.38.835 N050.04.45.489 E019.47.38.800 Color_252ACI
N050.04.45.489 E019.47.38.800 N050.04.45.425 E019.47.38.820 Color_252ACI
N050.04.45.425 E019.47.38.820 N050.04.45.385 E019.47.38.884 Color_252ACI
N050.04.45.385 E019.47.38.884 N050.04.45.374 E019.47.38.988 Color_252ACI
N050.04.45.374 E019.47.38.988 N050.04.45.402 E019.47.39.074 Color_252ACI
N050.04.45.402 E019.47.39.074 N050.04.45.459 E019.47.39.121 Color_252ACI
N050.04.45.459 E019.47.39.121 N050.04.45.519 E019.47.39.109 Color_252ACI
N050.04.45.519 E019.47.39.109 N050.04.45.568 E019.47.39.040 Color_252ACI
N050.04.45.568 E019.47.39.040 N050.04.45.581 E019.47.38.961 Color_252ACI
N050.04.45.581 E019.47.38.961 N050.04.45.567 E019.47.38.880 Color_252ACI
N050.04.45.567 E019.47.38.880 N050.04.45.543 E019.47.38.835 Color_252ACI
N050.04.45.951 E019.47.41.784 N050.04.45.897 E019.47.41.749 Color_252ACI
N050.04.45.897 E019.47.41.749 N050.04.45.833 E019.47.41.769 Color_252ACI
N050.04.45.833 E019.47.41.769 N050.04.45.793 E019.47.41.833 Color_252ACI
N050.04.45.793 E019.47.41.833 N050.04.45.782 E019.47.41.937 Color_252ACI
N050.04.45.782 E019.47.41.937 N050.04.45.810 E019.47.42.023 Color_252ACI
N050.04.45.810 E019.47.42.023 N050.04.45.867 E019.47.42.070 Color_252ACI
N050.04.45.867 E019.47.42.070 N050.04.45.928 E019.47.42.058 Color_252ACI
N050.04.45.928 E019.47.42.058 N050.04.45.976 E019.47.41.989 Color_252ACI
N050.04.45.976 E019.47.41.989 N050.04.45.989 E019.47.41.910 Color_252ACI
N050.04.45.989 E019.47.41.910 N050.04.45.975 E019.47.41.829 Color_252ACI
N050.04.45.975 E019.47.41.829 N050.04.45.951 E019.47.41.784 Color_252ACI
N050.04.46.370 E019.47.44.730 N050.04.46.316 E019.47.44.695 Color_252ACI
N050.04.46.316 E019.47.44.695 N050.04.46.252 E019.47.44.715 Color_252ACI
N050.04.46.252 E019.47.44.715 N050.04.46.212 E019.47.44.779 Color_252ACI
N050.04.46.212 E019.47.44.779 N050.04.46.201 E019.47.44.883 Color_252ACI
N050.04.46.201 E019.47.44.883 N050.04.46.229 E019.47.44.969 Color_252ACI
N050.04.46.229 E019.47.44.969 N050.04.46.287 E019.47.45.016 Color_252ACI
N050.04.46.287 E019.47.45.016 N050.04.46.347 E019.47.45.004 Color_252ACI
N050.04.46.347 E019.47.45.004 N050.04.46.395 E019.47.44.935 Color_252ACI
N050.04.46.395 E019.47.44.935 N050.04.46.408 E019.47.44.856 Color_252ACI
N050.04.46.408 E019.47.44.856 N050.04.46.394 E019.47.44.775 Color_252ACI
N050.04.46.394 E019.47.44.775 N050.04.46.370 E019.47.44.730 Color_252ACI
N050.04.46.773 E019.47.47.693 N050.04.46.719 E019.47.47.657 Color_252ACI
N050.04.46.719 E019.47.47.657 N050.04.46.655 E019.47.47.678 Color_252ACI
N050.04.46.655 E019.47.47.678 N050.04.46.615 E019.47.47.741 Color_252ACI
N050.04.46.615 E019.47.47.741 N050.04.46.604 E019.47.47.845 Color_252ACI
N050.04.46.604 E019.47.47.845 N050.04.46.632 E019.47.47.931 Color_252ACI
N050.04.46.632 E019.47.47.931 N050.04.46.689 E019.47.47.979 Color_252ACI
N050.04.46.689 E019.47.47.979 N050.04.46.749 E019.47.47.967 Color_252ACI
N050.04.46.749 E019.47.47.967 N050.04.46.798 E019.47.47.898 Color_252ACI
N050.04.46.798 E019.47.47.898 N050.04.46.811 E019.47.47.818 Color_252ACI
N050.04.46.811 E019.47.47.818 N050.04.46.797 E019.47.47.737 Color_252ACI
N050.04.46.797 E019.47.47.737 N050.04.46.773 E019.47.47.693 Color_252ACI
N050.04.47.190 E019.47.50.627 N050.04.47.136 E019.47.50.591 Color_252ACI
N050.04.47.136 E019.47.50.591 N050.04.47.072 E019.47.50.612 Color_252ACI
N050.04.47.072 E019.47.50.612 N050.04.47.033 E019.47.50.675 Color_252ACI
N050.04.47.033 E019.47.50.675 N050.04.47.021 E019.47.50.779 Color_252ACI
N050.04.47.021 E019.47.50.779 N050.04.47.049 E019.47.50.865 Color_252ACI
N050.04.47.049 E019.47.50.865 N050.04.47.107 E019.47.50.913 Color_252ACI
N050.04.47.107 E019.47.50.913 N050.04.47.167 E019.47.50.901 Color_252ACI
N050.04.47.167 E019.47.50.901 N050.04.47.215 E019.47.50.832 Color_252ACI
N050.04.47.215 E019.47.50.832 N050.04.47.228 E019.47.50.752 Color_252ACI
N050.04.47.228 E019.47.50.752 N050.04.47.214 E019.47.50.671 Color_252ACI
N050.04.47.214 E019.47.50.671 N050.04.47.190 E019.47.50.627 Color_252ACI
N050.04.47.612 E019.47.53.595 N050.04.47.559 E019.47.53.559 Color_252ACI
N050.04.47.559 E019.47.53.559 N050.04.47.495 E019.47.53.580 Color_252ACI
N050.04.47.495 E019.47.53.580 N050.04.47.455 E019.47.53.643 Color_252ACI
N050.04.47.455 E019.47.53.643 N050.04.47.444 E019.47.53.747 Color_252ACI
N050.04.47.444 E019.47.53.747 N050.04.47.471 E019.47.53.833 Color_252ACI
N050.04.47.471 E019.47.53.833 N050.04.47.529 E019.47.53.881 Color_252ACI
N050.04.47.529 E019.47.53.881 N050.04.47.589 E019.47.53.869 Color_252ACI
N050.04.47.589 E019.47.53.869 N050.04.47.637 E019.47.53.800 Color_252ACI
N050.04.47.637 E019.47.53.800 N050.04.47.651 E019.47.53.720 Color_252ACI
N050.04.47.651 E019.47.53.720 N050.04.47.637 E019.47.53.639 Color_252ACI
N050.04.47.637 E019.47.53.639 N050.04.47.612 E019.47.53.595 Color_252ACI
N050.04.48.003 E019.47.56.555 N050.04.47.950 E019.47.56.519 Color_252ACI
N050.04.47.950 E019.47.56.519 N050.04.47.886 E019.47.56.540 Color_252ACI
N050.04.47.886 E019.47.56.540 N050.04.47.846 E019.47.56.603 Color_252ACI
N050.04.47.846 E019.47.56.603 N050.04.47.835 E019.47.56.707 Color_252ACI
N050.04.47.835 E019.47.56.707 N050.04.47.862 E019.47.56.793 Color_252ACI
N050.04.47.862 E019.47.56.793 N050.04.47.920 E019.47.56.841 Color_252ACI
N050.04.47.920 E019.47.56.841 N050.04.47.980 E019.47.56.829 Color_252ACI
N050.04.47.980 E019.47.56.829 N050.04.48.028 E019.47.56.760 Color_252ACI
N050.04.48.028 E019.47.56.760 N050.04.48.042 E019.47.56.680 Color_252ACI
N050.04.48.042 E019.47.56.680 N050.04.48.028 E019.47.56.600 Color_252ACI
N050.04.48.028 E019.47.56.600 N050.04.48.003 E019.47.56.555 Color_252ACI
N050.04.48.440 E019.47.59.465 N050.04.48.386 E019.47.59.430 Color_252ACI
N050.04.48.386 E019.47.59.430 N050.04.48.322 E019.47.59.450 Color_252ACI
N050.04.48.322 E019.47.59.450 N050.04.48.282 E019.47.59.514 Color_252ACI
N050.04.48.282 E019.47.59.514 N050.04.48.271 E019.47.59.618 Color_252ACI
N050.04.48.271 E019.47.59.618 N050.04.48.299 E019.47.59.704 Color_252ACI
N050.04.48.299 E019.47.59.704 N050.04.48.356 E019.47.59.751 Color_252ACI
N050.04.48.356 E019.47.59.751 N050.04.48.416 E019.47.59.739 Color_252ACI
N050.04.48.416 E019.47.59.739 N050.04.48.465 E019.47.59.670 Color_252ACI
N050.04.48.465 E019.47.59.670 N050.04.48.478 E019.47.59.591 Color_252ACI
N050.04.48.478 E019.47.59.591 N050.04.48.464 E019.47.59.510 Color_252ACI
N050.04.48.464 E019.47.59.510 N050.04.48.440 E019.47.59.465 Color_252ACI
N050.04.48.834 E019.48.02.440 N050.04.48.781 E019.48.02.404 Color_252ACI
N050.04.48.781 E019.48.02.404 N050.04.48.717 E019.48.02.425 Color_252ACI
N050.04.48.717 E019.48.02.425 N050.04.48.677 E019.48.02.488 Color_252ACI
N050.04.48.677 E019.48.02.488 N050.04.48.666 E019.48.02.592 Color_252ACI
N050.04.48.666 E019.48.02.592 N050.04.48.693 E019.48.02.678 Color_252ACI
N050.04.48.693 E019.48.02.678 N050.04.48.751 E019.48.02.726 Color_252ACI
N050.04.48.751 E019.48.02.726 N050.04.48.811 E019.48.02.714 Color_252ACI
N050.04.48.811 E019.48.02.714 N050.04.48.859 E019.48.02.645 Color_252ACI
N050.04.48.859 E019.48.02.645 N050.04.48.873 E019.48.02.565 Color_252ACI
N050.04.48.873 E019.48.02.565 N050.04.48.859 E019.48.02.484 Color_252ACI
N050.04.48.859 E019.48.02.484 N050.04.48.834 E019.48.02.440 Color_252ACI
N050.04.49.242 E019.48.05.402 N050.04.49.188 E019.48.05.367 Color_252ACI
N050.04.49.188 E019.48.05.367 N050.04.49.124 E019.48.05.387 Color_252ACI
N050.04.49.124 E019.48.05.387 N050.04.49.084 E019.48.05.451 Color_252ACI
N050.04.49.084 E019.48.05.451 N050.04.49.073 E019.48.05.555 Color_252ACI
N050.04.49.073 E019.48.05.555 N050.04.49.101 E019.48.05.641 Color_252ACI
N050.04.49.101 E019.48.05.641 N050.04.49.158 E019.48.05.688 Color_252ACI
N050.04.49.158 E019.48.05.688 N050.04.49.218 E019.48.05.676 Color_252ACI
N050.04.49.218 E019.48.05.676 N050.04.49.267 E019.48.05.607 Color_252ACI
N050.04.49.267 E019.48.05.607 N050.04.49.280 E019.48.05.528 Color_252ACI
N050.04.49.280 E019.48.05.528 N050.04.49.266 E019.48.05.447 Color_252ACI
N050.04.49.266 E019.48.05.447 N050.04.49.242 E019.48.05.402 Color_252ACI
N050.04.49.672 E019.48.08.326 N050.04.49.618 E019.48.08.291 Color_252ACI
N050.04.49.618 E019.48.08.291 N050.04.49.554 E019.48.08.311 Color_252ACI
N050.04.49.554 E019.48.08.311 N050.04.49.515 E019.48.08.375 Color_252ACI
N050.04.49.515 E019.48.08.375 N050.04.49.503 E019.48.08.479 Color_252ACI
N050.04.49.503 E019.48.08.479 N050.04.49.531 E019.48.08.565 Color_252ACI
N050.04.49.531 E019.48.08.565 N050.04.49.589 E019.48.08.612 Color_252ACI
N050.04.49.589 E019.48.08.612 N050.04.49.649 E019.48.08.600 Color_252ACI
N050.04.49.649 E019.48.08.600 N050.04.49.697 E019.48.08.531 Color_252ACI
N050.04.49.697 E019.48.08.531 N050.04.49.710 E019.48.08.452 Color_252ACI
N050.04.49.710 E019.48.08.452 N050.04.49.696 E019.48.08.371 Color_252ACI
N050.04.49.696 E019.48.08.371 N050.04.49.672 E019.48.08.326 Color_252ACI
N050.04.47.126 E019.48.06.133 N050.04.47.072 E019.48.06.098 Color_252ACI
N050.04.47.072 E019.48.06.098 N050.04.47.008 E019.48.06.118 Color_252ACI
N050.04.47.008 E019.48.06.118 N050.04.46.969 E019.48.06.182 Color_252ACI
N050.04.46.969 E019.48.06.182 N050.04.46.957 E019.48.06.286 Color_252ACI
N050.04.46.957 E019.48.06.286 N050.04.46.985 E019.48.06.372 Color_252ACI
N050.04.46.985 E019.48.06.372 N050.04.47.043 E019.48.06.419 Color_252ACI
N050.04.47.043 E019.48.06.419 N050.04.47.103 E019.48.06.407 Color_252ACI
N050.04.47.103 E019.48.06.407 N050.04.47.151 E019.48.06.338 Color_252ACI
N050.04.47.151 E019.48.06.338 N050.04.47.164 E019.48.06.259 Color_252ACI
N050.04.47.164 E019.48.06.259 N050.04.47.150 E019.48.06.178 Color_252ACI
N050.04.47.150 E019.48.06.178 N050.04.47.126 E019.48.06.133 Color_252ACI
N050.04.46.713 E019.48.03.177 N050.04.46.659 E019.48.03.141 Color_252ACI
N050.04.46.659 E019.48.03.141 N050.04.46.595 E019.48.03.161 Color_252ACI
N050.04.46.595 E019.48.03.161 N050.04.46.555 E019.48.03.225 Color_252ACI
N050.04.46.555 E019.48.03.225 N050.04.46.544 E019.48.03.329 Color_252ACI
N050.04.46.544 E019.48.03.329 N050.04.46.572 E019.48.03.415 Color_252ACI
N050.04.46.572 E019.48.03.415 N050.04.46.629 E019.48.03.462 Color_252ACI
N050.04.46.629 E019.48.03.462 N050.04.46.689 E019.48.03.450 Color_252ACI
N050.04.46.689 E019.48.03.450 N050.04.46.738 E019.48.03.381 Color_252ACI
N050.04.46.738 E019.48.03.381 N050.04.46.751 E019.48.03.302 Color_252ACI
N050.04.46.751 E019.48.03.302 N050.04.46.737 E019.48.03.221 Color_252ACI
N050.04.46.737 E019.48.03.221 N050.04.46.713 E019.48.03.177 Color_252ACI
N050.04.46.295 E019.48.00.193 N050.04.46.242 E019.48.00.158 Color_252ACI
N050.04.46.242 E019.48.00.158 N050.04.46.178 E019.48.00.178 Color_252ACI
N050.04.46.178 E019.48.00.178 N050.04.46.138 E019.48.00.242 Color_252ACI
N050.04.46.138 E019.48.00.242 N050.04.46.127 E019.48.00.346 Color_252ACI
N050.04.46.127 E019.48.00.346 N050.04.46.154 E019.48.00.432 Color_252ACI
N050.04.46.154 E019.48.00.432 N050.04.46.212 E019.48.00.479 Color_252ACI
N050.04.46.212 E019.48.00.479 N050.04.46.272 E019.48.00.467 Color_252ACI
N050.04.46.272 E019.48.00.467 N050.04.46.320 E019.48.00.398 Color_252ACI
N050.04.46.320 E019.48.00.398 N050.04.46.333 E019.48.00.319 Color_252ACI
N050.04.46.333 E019.48.00.319 N050.04.46.320 E019.48.00.238 Color_252ACI
N050.04.46.320 E019.48.00.238 N050.04.46.295 E019.48.00.193 Color_252ACI
N050.04.45.880 E019.47.57.266 N050.04.45.826 E019.47.57.230 Color_252ACI
N050.04.45.826 E019.47.57.230 N050.04.45.762 E019.47.57.250 Color_252ACI
N050.04.45.762 E019.47.57.250 N050.04.45.722 E019.47.57.314 Color_252ACI
N050.04.45.722 E019.47.57.314 N050.04.45.711 E019.47.57.418 Color_252ACI
N050.04.45.711 E019.47.57.418 N050.04.45.739 E019.47.57.504 Color_252ACI
N050.04.45.739 E019.47.57.504 N050.04.45.796 E019.47.57.551 Color_252ACI
N050.04.45.796 E019.47.57.551 N050.04.45.856 E019.47.57.540 Color_252ACI
N050.04.45.856 E019.47.57.540 N050.04.45.905 E019.47.57.470 Color_252ACI
N050.04.45.905 E019.47.57.470 N050.04.45.918 E019.47.57.391 Color_252ACI
N050.04.45.918 E019.47.57.391 N050.04.45.904 E019.47.57.310 Color_252ACI
N050.04.45.904 E019.47.57.310 N050.04.45.880 E019.47.57.266 Color_252ACI
N050.04.45.482 E019.47.54.295 N050.04.45.428 E019.47.54.259 Color_252ACI
N050.04.45.428 E019.47.54.259 N050.04.45.364 E019.47.54.280 Color_252ACI
N050.04.45.364 E019.47.54.280 N050.04.45.324 E019.47.54.343 Color_252ACI
N050.04.45.324 E019.47.54.343 N050.04.45.313 E019.47.54.447 Color_252ACI
N050.04.45.313 E019.47.54.447 N050.04.45.341 E019.47.54.533 Color_252ACI
N050.04.45.341 E019.47.54.533 N050.04.45.398 E019.47.54.581 Color_252ACI
N050.04.45.398 E019.47.54.581 N050.04.45.459 E019.47.54.569 Color_252ACI
N050.04.45.459 E019.47.54.569 N050.04.45.507 E019.47.54.500 Color_252ACI
N050.04.45.507 E019.47.54.500 N050.04.45.520 E019.47.54.420 Color_252ACI
N050.04.45.520 E019.47.54.420 N050.04.45.506 E019.47.54.339 Color_252ACI
N050.04.45.506 E019.47.54.339 N050.04.45.482 E019.47.54.295 Color_252ACI
N050.04.45.066 E019.47.51.367 N050.04.45.012 E019.47.51.331 Color_252ACI
N050.04.45.012 E019.47.51.331 N050.04.44.948 E019.47.51.352 Color_252ACI
N050.04.44.948 E019.47.51.352 N050.04.44.908 E019.47.51.415 Color_252ACI
N050.04.44.908 E019.47.51.415 N050.04.44.897 E019.47.51.519 Color_252ACI
N050.04.44.897 E019.47.51.519 N050.04.44.925 E019.47.51.605 Color_252ACI
N050.04.44.925 E019.47.51.605 N050.04.44.983 E019.47.51.652 Color_252ACI
N050.04.44.983 E019.47.51.652 N050.04.45.043 E019.47.51.641 Color_252ACI
N050.04.45.043 E019.47.51.641 N050.04.45.091 E019.47.51.571 Color_252ACI
N050.04.45.091 E019.47.51.571 N050.04.45.104 E019.47.51.492 Color_252ACI
N050.04.45.104 E019.47.51.492 N050.04.45.090 E019.47.51.411 Color_252ACI
N050.04.45.090 E019.47.51.411 N050.04.45.066 E019.47.51.367 Color_252ACI
N050.04.44.646 E019.47.48.401 N050.04.44.593 E019.47.48.366 Color_252ACI
N050.04.44.593 E019.47.48.366 N050.04.44.529 E019.47.48.386 Color_252ACI
N050.04.44.529 E019.47.48.386 N050.04.44.489 E019.47.48.449 Color_252ACI
N050.04.44.489 E019.47.48.449 N050.04.44.478 E019.47.48.553 Color_252ACI
N050.04.44.478 E019.47.48.553 N050.04.44.505 E019.47.48.640 Color_252ACI
N050.04.44.505 E019.47.48.640 N050.04.44.563 E019.47.48.687 Color_252ACI
N050.04.44.563 E019.47.48.687 N050.04.44.623 E019.47.48.675 Color_252ACI
N050.04.44.623 E019.47.48.675 N050.04.44.671 E019.47.48.606 Color_252ACI
N050.04.44.671 E019.47.48.606 N050.04.44.685 E019.47.48.526 Color_252ACI
N050.04.44.685 E019.47.48.526 N050.04.44.671 E019.47.48.446 Color_252ACI
N050.04.44.671 E019.47.48.446 N050.04.44.646 E019.47.48.401 Color_252ACI
N050.04.44.236 E019.47.45.445 N050.04.44.183 E019.47.45.410 Color_252ACI
N050.04.44.183 E019.47.45.410 N050.04.44.119 E019.47.45.430 Color_252ACI
N050.04.44.119 E019.47.45.430 N050.04.44.079 E019.47.45.494 Color_252ACI
N050.04.44.079 E019.47.45.494 N050.04.44.068 E019.47.45.598 Color_252ACI
N050.04.44.068 E019.47.45.598 N050.04.44.096 E019.47.45.684 Color_252ACI
N050.04.44.096 E019.47.45.684 N050.04.44.153 E019.47.45.731 Color_252ACI
N050.04.44.153 E019.47.45.731 N050.04.44.213 E019.47.45.719 Color_252ACI
N050.04.44.213 E019.47.45.719 N050.04.44.261 E019.47.45.650 Color_252ACI
N050.04.44.261 E019.47.45.650 N050.04.44.275 E019.47.45.571 Color_252ACI
N050.04.44.275 E019.47.45.571 N050.04.44.261 E019.47.45.490 Color_252ACI
N050.04.44.261 E019.47.45.490 N050.04.44.236 E019.47.45.445 Color_252ACI
N050.04.43.818 E019.47.42.492 N050.04.43.765 E019.47.42.457 Color_252ACI
N050.04.43.765 E019.47.42.457 N050.04.43.701 E019.47.42.477 Color_252ACI
N050.04.43.701 E019.47.42.477 N050.04.43.661 E019.47.42.540 Color_252ACI
N050.04.43.661 E019.47.42.540 N050.04.43.650 E019.47.42.644 Color_252ACI
N050.04.43.650 E019.47.42.644 N050.04.43.678 E019.47.42.731 Color_252ACI
N050.04.43.678 E019.47.42.731 N050.04.43.735 E019.47.42.778 Color_252ACI
N050.04.43.735 E019.47.42.778 N050.04.43.795 E019.47.42.766 Color_252ACI
N050.04.43.795 E019.47.42.766 N050.04.43.844 E019.47.42.697 Color_252ACI
N050.04.43.844 E019.47.42.697 N050.04.43.857 E019.47.42.617 Color_252ACI
N050.04.43.857 E019.47.42.617 N050.04.43.843 E019.47.42.537 Color_252ACI
N050.04.43.843 E019.47.42.537 N050.04.43.818 E019.47.42.492 Color_252ACI
N050.04.43.413 E019.47.39.573 N050.04.43.360 E019.47.39.537 Color_252ACI
N050.04.43.360 E019.47.39.537 N050.04.43.296 E019.47.39.558 Color_252ACI
N050.04.43.296 E019.47.39.558 N050.04.43.256 E019.47.39.621 Color_252ACI
N050.04.43.256 E019.47.39.621 N050.04.43.245 E019.47.39.725 Color_252ACI
N050.04.43.245 E019.47.39.725 N050.04.43.272 E019.47.39.811 Color_252ACI
N050.04.43.272 E019.47.39.811 N050.04.43.330 E019.47.39.859 Color_252ACI
N050.04.43.330 E019.47.39.859 N050.04.43.390 E019.47.39.847 Color_252ACI
N050.04.43.390 E019.47.39.847 N050.04.43.438 E019.47.39.778 Color_252ACI
N050.04.43.438 E019.47.39.778 N050.04.43.452 E019.47.39.698 Color_252ACI
N050.04.43.452 E019.47.39.698 N050.04.43.438 E019.47.39.617 Color_252ACI
N050.04.43.438 E019.47.39.617 N050.04.43.413 E019.47.39.573 Color_252ACI
N050.04.42.990 E019.47.36.582 N050.04.42.937 E019.47.36.546 Color_252ACI
N050.04.42.937 E019.47.36.546 N050.04.42.873 E019.47.36.567 Color_252ACI
N050.04.42.873 E019.47.36.567 N050.04.42.833 E019.47.36.630 Color_252ACI
N050.04.42.833 E019.47.36.630 N050.04.42.822 E019.47.36.734 Color_252ACI
N050.04.42.822 E019.47.36.734 N050.04.42.849 E019.47.36.820 Color_252ACI
N050.04.42.849 E019.47.36.820 N050.04.42.907 E019.47.36.868 Color_252ACI
N050.04.42.907 E019.47.36.868 N050.04.42.967 E019.47.36.856 Color_252ACI
N050.04.42.967 E019.47.36.856 N050.04.43.015 E019.47.36.787 Color_252ACI
N050.04.43.015 E019.47.36.787 N050.04.43.029 E019.47.36.707 Color_252ACI
N050.04.43.029 E019.47.36.707 N050.04.43.015 E019.47.36.627 Color_252ACI
N050.04.43.015 E019.47.36.627 N050.04.42.990 E019.47.36.582 Color_252ACI
N050.04.42.593 E019.47.33.660 N050.04.42.540 E019.47.33.624 Color_252ACI
N050.04.42.540 E019.47.33.624 N050.04.42.476 E019.47.33.645 Color_252ACI
N050.04.42.476 E019.47.33.645 N050.04.42.436 E019.47.33.708 Color_252ACI
N050.04.42.436 E019.47.33.708 N050.04.42.425 E019.47.33.812 Color_252ACI
N050.04.42.425 E019.47.33.812 N050.04.42.452 E019.47.33.898 Color_252ACI
N050.04.42.452 E019.47.33.898 N050.04.42.510 E019.47.33.946 Color_252ACI
N050.04.42.510 E019.47.33.946 N050.04.42.570 E019.47.33.934 Color_252ACI
N050.04.42.570 E019.47.33.934 N050.04.42.618 E019.47.33.865 Color_252ACI
N050.04.42.618 E019.47.33.865 N050.04.42.631 E019.47.33.785 Color_252ACI
N050.04.42.631 E019.47.33.785 N050.04.42.618 E019.47.33.704 Color_252ACI
N050.04.42.618 E019.47.33.704 N050.04.42.593 E019.47.33.660 Color_252ACI
N050.04.42.167 E019.47.30.703 N050.04.42.113 E019.47.30.668 Color_252ACI
N050.04.42.113 E019.47.30.668 N050.04.42.049 E019.47.30.688 Color_252ACI
N050.04.42.049 E019.47.30.688 N050.04.42.009 E019.47.30.752 Color_252ACI
N050.04.42.009 E019.47.30.752 N050.04.41.998 E019.47.30.856 Color_252ACI
N050.04.41.998 E019.47.30.856 N050.04.42.026 E019.47.30.942 Color_252ACI
N050.04.42.026 E019.47.30.942 N050.04.42.083 E019.47.30.989 Color_252ACI
N050.04.42.083 E019.47.30.989 N050.04.42.143 E019.47.30.977 Color_252ACI
N050.04.42.143 E019.47.30.977 N050.04.42.192 E019.47.30.908 Color_252ACI
N050.04.42.192 E019.47.30.908 N050.04.42.205 E019.47.30.829 Color_252ACI
N050.04.42.205 E019.47.30.829 N050.04.42.191 E019.47.30.748 Color_252ACI
N050.04.42.191 E019.47.30.748 N050.04.42.167 E019.47.30.703 Color_252ACI
N050.04.40.948 E019.47.21.826 N050.04.40.894 E019.47.21.790 Color_252ACI
N050.04.40.894 E019.47.21.790 N050.04.40.830 E019.47.21.810 Color_252ACI
N050.04.40.830 E019.47.21.810 N050.04.40.790 E019.47.21.874 Color_252ACI
N050.04.40.790 E019.47.21.874 N050.04.40.779 E019.47.21.978 Color_252ACI
N050.04.40.779 E019.47.21.978 N050.04.40.807 E019.47.22.064 Color_252ACI
N050.04.40.807 E019.47.22.064 N050.04.40.864 E019.47.22.111 Color_252ACI
N050.04.40.864 E019.47.22.111 N050.04.40.924 E019.47.22.100 Color_252ACI
N050.04.40.924 E019.47.22.100 N050.04.40.973 E019.47.22.030 Color_252ACI
N050.04.40.973 E019.47.22.030 N050.04.40.986 E019.47.21.951 Color_252ACI
N050.04.40.986 E019.47.21.951 N050.04.40.972 E019.47.21.870 Color_252ACI
N050.04.40.972 E019.47.21.870 N050.04.40.948 E019.47.21.826 Color_252ACI
N050.04.40.538 E019.47.18.877 N050.04.40.485 E019.47.18.841 Color_252ACI
N050.04.40.485 E019.47.18.841 N050.04.40.421 E019.47.18.862 Color_252ACI
N050.04.40.421 E019.47.18.862 N050.04.40.381 E019.47.18.925 Color_252ACI
N050.04.40.381 E019.47.18.925 N050.04.40.370 E019.47.19.029 Color_252ACI
N050.04.40.370 E019.47.19.029 N050.04.40.397 E019.47.19.115 Color_252ACI
N050.04.40.397 E019.47.19.115 N050.04.40.455 E019.47.19.163 Color_252ACI
N050.04.40.455 E019.47.19.163 N050.04.40.515 E019.47.19.151 Color_252ACI
N050.04.40.515 E019.47.19.151 N050.04.40.563 E019.47.19.082 Color_252ACI
N050.04.40.563 E019.47.19.082 N050.04.40.577 E019.47.19.002 Color_252ACI
N050.04.40.577 E019.47.19.002 N050.04.40.563 E019.47.18.921 Color_252ACI
N050.04.40.563 E019.47.18.921 N050.04.40.538 E019.47.18.877 Color_252ACI
N050.04.40.116 E019.47.15.919 N050.04.40.062 E019.47.15.883 Color_252ACI
N050.04.40.062 E019.47.15.883 N050.04.39.998 E019.47.15.903 Color_252ACI
N050.04.39.998 E019.47.15.903 N050.04.39.958 E019.47.15.967 Color_252ACI
N050.04.39.958 E019.47.15.967 N050.04.39.947 E019.47.16.071 Color_252ACI
N050.04.39.947 E019.47.16.071 N050.04.39.975 E019.47.16.157 Color_252ACI
N050.04.39.975 E019.47.16.157 N050.04.40.032 E019.47.16.204 Color_252ACI
N050.04.40.032 E019.47.16.204 N050.04.40.092 E019.47.16.192 Color_252ACI
N050.04.40.092 E019.47.16.192 N050.04.40.141 E019.47.16.123 Color_252ACI
N050.04.40.141 E019.47.16.123 N050.04.40.154 E019.47.16.044 Color_252ACI
N050.04.40.154 E019.47.16.044 N050.04.40.140 E019.47.15.963 Color_252ACI
N050.04.40.140 E019.47.15.963 N050.04.40.116 E019.47.15.919 Color_252ACI
N050.04.39.710 E019.47.12.967 N050.04.39.657 E019.47.12.932 Color_252ACI
N050.04.39.657 E019.47.12.932 N050.04.39.593 E019.47.12.952 Color_252ACI
N050.04.39.593 E019.47.12.952 N050.04.39.553 E019.47.13.016 Color_252ACI
N050.04.39.553 E019.47.13.016 N050.04.39.542 E019.47.13.120 Color_252ACI
N050.04.39.542 E019.47.13.120 N050.04.39.569 E019.47.13.206 Color_252ACI
N050.04.39.569 E019.47.13.206 N050.04.39.627 E019.47.13.253 Color_252ACI
N050.04.39.627 E019.47.13.253 N050.04.39.687 E019.47.13.241 Color_252ACI
N050.04.39.687 E019.47.13.241 N050.04.39.735 E019.47.13.172 Color_252ACI
N050.04.39.735 E019.47.13.172 N050.04.39.749 E019.47.13.093 Color_252ACI
N050.04.39.749 E019.47.13.093 N050.04.39.735 E019.47.13.012 Color_252ACI
N050.04.39.735 E019.47.13.012 N050.04.39.710 E019.47.12.967 Color_252ACI
N050.04.39.299 E019.47.10.031 N050.04.39.245 E019.47.09.996 Color_252ACI
N050.04.39.245 E019.47.09.996 N050.04.39.181 E019.47.10.016 Color_252ACI
N050.04.39.181 E019.47.10.016 N050.04.39.141 E019.47.10.080 Color_252ACI
N050.04.39.141 E019.47.10.080 N050.04.39.130 E019.47.10.184 Color_252ACI
N050.04.39.130 E019.47.10.184 N050.04.39.158 E019.47.10.270 Color_252ACI
N050.04.39.158 E019.47.10.270 N050.04.39.216 E019.47.10.317 Color_252ACI
N050.04.39.216 E019.47.10.317 N050.04.39.276 E019.47.10.305 Color_252ACI
N050.04.39.276 E019.47.10.305 N050.04.39.324 E019.47.10.236 Color_252ACI
N050.04.39.324 E019.47.10.236 N050.04.39.337 E019.47.10.157 Color_252ACI
N050.04.39.337 E019.47.10.157 N050.04.39.323 E019.47.10.076 Color_252ACI
N050.04.39.323 E019.47.10.076 N050.04.39.299 E019.47.10.031 Color_252ACI
N050.04.38.885 E019.47.07.077 N050.04.38.831 E019.47.07.041 Color_252ACI
N050.04.38.831 E019.47.07.041 N050.04.38.767 E019.47.07.062 Color_252ACI
N050.04.38.767 E019.47.07.062 N050.04.38.727 E019.47.07.125 Color_252ACI
N050.04.38.727 E019.47.07.125 N050.04.38.716 E019.47.07.229 Color_252ACI
N050.04.38.716 E019.47.07.229 N050.04.38.744 E019.47.07.315 Color_252ACI
N050.04.38.744 E019.47.07.315 N050.04.38.802 E019.47.07.363 Color_252ACI
N050.04.38.802 E019.47.07.363 N050.04.38.862 E019.47.07.351 Color_252ACI
N050.04.38.862 E019.47.07.351 N050.04.38.910 E019.47.07.282 Color_252ACI
N050.04.38.910 E019.47.07.282 N050.04.38.923 E019.47.07.202 Color_252ACI
N050.04.38.923 E019.47.07.202 N050.04.38.909 E019.47.07.121 Color_252ACI
N050.04.38.909 E019.47.07.121 N050.04.38.885 E019.47.07.077 Color_252ACI
N050.04.38.462 E019.47.04.209 N050.04.38.408 E019.47.04.173 Color_252ACI
N050.04.38.408 E019.47.04.173 N050.04.38.344 E019.47.04.194 Color_252ACI
N050.04.38.344 E019.47.04.194 N050.04.38.304 E019.47.04.257 Color_252ACI
N050.04.38.304 E019.47.04.257 N050.04.38.293 E019.47.04.361 Color_252ACI
N050.04.38.293 E019.47.04.361 N050.04.38.321 E019.47.04.447 Color_252ACI
N050.04.38.321 E019.47.04.447 N050.04.38.379 E019.47.04.495 Color_252ACI
N050.04.38.379 E019.47.04.495 N050.04.38.439 E019.47.04.483 Color_252ACI
N050.04.38.439 E019.47.04.483 N050.04.38.487 E019.47.04.414 Color_252ACI
N050.04.38.487 E019.47.04.414 N050.04.38.500 E019.47.04.334 Color_252ACI
N050.04.38.500 E019.47.04.334 N050.04.38.486 E019.47.04.253 Color_252ACI
N050.04.38.486 E019.47.04.253 N050.04.38.462 E019.47.04.209 Color_252ACI
N050.04.38.044 E019.47.01.165 N050.04.37.990 E019.47.01.129 Color_252ACI
N050.04.37.990 E019.47.01.129 N050.04.37.926 E019.47.01.149 Color_252ACI
N050.04.37.926 E019.47.01.149 N050.04.37.886 E019.47.01.213 Color_252ACI
N050.04.37.886 E019.47.01.213 N050.04.37.875 E019.47.01.317 Color_252ACI
N050.04.37.875 E019.47.01.317 N050.04.37.903 E019.47.01.403 Color_252ACI
N050.04.37.903 E019.47.01.403 N050.04.37.961 E019.47.01.450 Color_252ACI
N050.04.37.961 E019.47.01.450 N050.04.38.021 E019.47.01.438 Color_252ACI
N050.04.38.021 E019.47.01.438 N050.04.38.069 E019.47.01.369 Color_252ACI
N050.04.38.069 E019.47.01.369 N050.04.38.082 E019.47.01.290 Color_252ACI
N050.04.38.082 E019.47.01.290 N050.04.38.068 E019.47.01.209 Color_252ACI
N050.04.38.068 E019.47.01.209 N050.04.38.044 E019.47.01.165 Color_252ACI
N050.04.37.646 E019.46.58.204 N050.04.37.592 E019.46.58.169 Color_252ACI
N050.04.37.592 E019.46.58.169 N050.04.37.528 E019.46.58.189 Color_252ACI
N050.04.37.528 E019.46.58.189 N050.04.37.488 E019.46.58.253 Color_252ACI
N050.04.37.488 E019.46.58.253 N050.04.37.477 E019.46.58.357 Color_252ACI
N050.04.37.477 E019.46.58.357 N050.04.37.505 E019.46.58.443 Color_252ACI
N050.04.37.505 E019.46.58.443 N050.04.37.562 E019.46.58.490 Color_252ACI
N050.04.37.562 E019.46.58.490 N050.04.37.622 E019.46.58.478 Color_252ACI
N050.04.37.622 E019.46.58.478 N050.04.37.671 E019.46.58.409 Color_252ACI
N050.04.37.671 E019.46.58.409 N050.04.37.684 E019.46.58.330 Color_252ACI
N050.04.37.684 E019.46.58.330 N050.04.37.670 E019.46.58.249 Color_252ACI
N050.04.37.670 E019.46.58.249 N050.04.37.646 E019.46.58.204 Color_252ACI
N050.04.37.222 E019.46.55.240 N050.04.37.168 E019.46.55.204 Color_252ACI
N050.04.37.168 E019.46.55.204 N050.04.37.104 E019.46.55.225 Color_252ACI
N050.04.37.104 E019.46.55.225 N050.04.37.065 E019.46.55.288 Color_252ACI
N050.04.37.065 E019.46.55.288 N050.04.37.053 E019.46.55.392 Color_252ACI
N050.04.37.053 E019.46.55.392 N050.04.37.081 E019.46.55.478 Color_252ACI
N050.04.37.081 E019.46.55.478 N050.04.37.139 E019.46.55.526 Color_252ACI
N050.04.37.139 E019.46.55.526 N050.04.37.199 E019.46.55.514 Color_252ACI
N050.04.37.199 E019.46.55.514 N050.04.37.247 E019.46.55.445 Color_252ACI
N050.04.37.247 E019.46.55.445 N050.04.37.260 E019.46.55.365 Color_252ACI
N050.04.37.260 E019.46.55.365 N050.04.37.246 E019.46.55.285 Color_252ACI
N050.04.37.246 E019.46.55.285 N050.04.37.222 E019.46.55.240 Color_252ACI
N050.04.35.991 E019.46.46.397 N050.04.35.938 E019.46.46.362 Color_252ACI
N050.04.35.938 E019.46.46.362 N050.04.35.873 E019.46.46.382 Color_252ACI
N050.04.35.873 E019.46.46.382 N050.04.35.834 E019.46.46.446 Color_252ACI
N050.04.35.834 E019.46.46.446 N050.04.35.822 E019.46.46.550 Color_252ACI
N050.04.35.822 E019.46.46.550 N050.04.35.850 E019.46.46.636 Color_252ACI
N050.04.35.850 E019.46.46.636 N050.04.35.908 E019.46.46.683 Color_252ACI
N050.04.35.908 E019.46.46.683 N050.04.35.968 E019.46.46.671 Color_252ACI
N050.04.35.968 E019.46.46.671 N050.04.36.016 E019.46.46.602 Color_252ACI
N050.04.36.016 E019.46.46.602 N050.04.36.029 E019.46.46.523 Color_252ACI
N050.04.36.029 E019.46.46.523 N050.04.36.016 E019.46.46.442 Color_252ACI
N050.04.36.016 E019.46.46.442 N050.04.35.991 E019.46.46.397 Color_252ACI
N050.04.35.585 E019.46.43.466 N050.04.35.531 E019.46.43.430 Color_252ACI
N050.04.35.531 E019.46.43.430 N050.04.35.467 E019.46.43.451 Color_252ACI
N050.04.35.467 E019.46.43.451 N050.04.35.427 E019.46.43.514 Color_252ACI
N050.04.35.427 E019.46.43.514 N050.04.35.416 E019.46.43.618 Color_252ACI
N050.04.35.416 E019.46.43.618 N050.04.35.444 E019.46.43.704 Color_252ACI
N050.04.35.444 E019.46.43.704 N050.04.35.501 E019.46.43.752 Color_252ACI
N050.04.35.501 E019.46.43.752 N050.04.35.561 E019.46.43.740 Color_252ACI
N050.04.35.561 E019.46.43.740 N050.04.35.610 E019.46.43.671 Color_252ACI
N050.04.35.610 E019.46.43.671 N050.04.35.623 E019.46.43.591 Color_252ACI
N050.04.35.623 E019.46.43.591 N050.04.35.609 E019.46.43.511 Color_252ACI
N050.04.35.609 E019.46.43.511 N050.04.35.585 E019.46.43.466 Color_252ACI
N050.04.35.159 E019.46.40.490 N050.04.35.106 E019.46.40.454 Color_252ACI
N050.04.35.106 E019.46.40.454 N050.04.35.042 E019.46.40.474 Color_252ACI
N050.04.35.042 E019.46.40.474 N050.04.35.002 E019.46.40.538 Color_252ACI
N050.04.35.002 E019.46.40.538 N050.04.34.991 E019.46.40.642 Color_252ACI
N050.04.34.991 E019.46.40.642 N050.04.35.018 E019.46.40.728 Color_252ACI
N050.04.35.018 E019.46.40.728 N050.04.35.076 E019.46.40.775 Color_252ACI
N050.04.35.076 E019.46.40.775 N050.04.35.136 E019.46.40.763 Color_252ACI
N050.04.35.136 E019.46.40.763 N050.04.35.184 E019.46.40.694 Color_252ACI
N050.04.35.184 E019.46.40.694 N050.04.35.197 E019.46.40.615 Color_252ACI
N050.04.35.197 E019.46.40.615 N050.04.35.184 E019.46.40.534 Color_252ACI
N050.04.35.184 E019.46.40.534 N050.04.35.159 E019.46.40.490 Color_252ACI
N050.04.34.762 E019.46.37.595 N050.04.34.708 E019.46.37.559 Color_252ACI
N050.04.34.708 E019.46.37.559 N050.04.34.644 E019.46.37.580 Color_252ACI
N050.04.34.644 E019.46.37.580 N050.04.34.604 E019.46.37.643 Color_252ACI
N050.04.34.604 E019.46.37.643 N050.04.34.593 E019.46.37.747 Color_252ACI
N050.04.34.593 E019.46.37.747 N050.04.34.621 E019.46.37.833 Color_252ACI
N050.04.34.621 E019.46.37.833 N050.04.34.678 E019.46.37.881 Color_252ACI
N050.04.34.678 E019.46.37.881 N050.04.34.738 E019.46.37.869 Color_252ACI
N050.04.34.738 E019.46.37.869 N050.04.34.787 E019.46.37.800 Color_252ACI
N050.04.34.787 E019.46.37.800 N050.04.34.800 E019.46.37.720 Color_252ACI
N050.04.34.800 E019.46.37.720 N050.04.34.786 E019.46.37.640 Color_252ACI
N050.04.34.786 E019.46.37.640 N050.04.34.762 E019.46.37.595 Color_252ACI
;rwy_ctr_lights_red N000.00.00.000 E000.00.00.000 N000.00.00.000 E000.00.00.000
N050.04.31.739 E019.46.07.816 N050.04.31.729 E019.46.07.727 Color_14ACI
N050.04.31.729 E019.46.07.727 N050.04.31.683 E019.46.07.655 Color_14ACI
N050.04.31.683 E019.46.07.655 N050.04.31.627 E019.46.07.638 Color_14ACI
N050.04.31.627 E019.46.07.638 N050.04.31.565 E019.46.07.681 Color_14ACI
N050.04.31.565 E019.46.07.681 N050.04.31.534 E019.46.07.764 Color_14ACI
N050.04.31.534 E019.46.07.764 N050.04.31.540 E019.46.07.865 Color_14ACI
N050.04.31.540 E019.46.07.865 N050.04.31.580 E019.46.07.937 Color_14ACI
N050.04.31.580 E019.46.07.937 N050.04.31.643 E019.46.07.962 Color_14ACI
N050.04.31.643 E019.46.07.962 N050.04.31.693 E019.46.07.935 Color_14ACI
N050.04.31.693 E019.46.07.935 N050.04.31.729 E019.46.07.873 Color_14ACI
N050.04.31.729 E019.46.07.873 N050.04.31.739 E019.46.07.816 Color_14ACI
N050.04.31.945 E019.46.09.289 N050.04.31.934 E019.46.09.200 Color_14ACI
N050.04.31.934 E019.46.09.200 N050.04.31.888 E019.46.09.128 Color_14ACI
N050.04.31.888 E019.46.09.128 N050.04.31.832 E019.46.09.111 Color_14ACI
N050.04.31.832 E019.46.09.111 N050.04.31.770 E019.46.09.153 Color_14ACI
N050.04.31.770 E019.46.09.153 N050.04.31.740 E019.46.09.237 Color_14ACI
N050.04.31.740 E019.46.09.237 N050.04.31.746 E019.46.09.338 Color_14ACI
N050.04.31.746 E019.46.09.338 N050.04.31.785 E019.46.09.410 Color_14ACI
N050.04.31.785 E019.46.09.410 N050.04.31.849 E019.46.09.434 Color_14ACI
N050.04.31.849 E019.46.09.434 N050.04.31.899 E019.46.09.408 Color_14ACI
N050.04.31.899 E019.46.09.408 N050.04.31.934 E019.46.09.345 Color_14ACI
N050.04.31.934 E019.46.09.345 N050.04.31.945 E019.46.09.289 Color_14ACI
N050.04.32.150 E019.46.10.762 N050.04.32.140 E019.46.10.672 Color_14ACI
N050.04.32.140 E019.46.10.672 N050.04.32.094 E019.46.10.600 Color_14ACI
N050.04.32.094 E019.46.10.600 N050.04.32.038 E019.46.10.583 Color_14ACI
N050.04.32.038 E019.46.10.583 N050.04.31.976 E019.46.10.626 Color_14ACI
N050.04.31.976 E019.46.10.626 N050.04.31.945 E019.46.10.710 Color_14ACI
N050.04.31.945 E019.46.10.710 N050.04.31.951 E019.46.10.811 Color_14ACI
N050.04.31.951 E019.46.10.811 N050.04.31.991 E019.46.10.882 Color_14ACI
N050.04.31.991 E019.46.10.882 N050.04.32.055 E019.46.10.907 Color_14ACI
N050.04.32.055 E019.46.10.907 N050.04.32.104 E019.46.10.881 Color_14ACI
N050.04.32.104 E019.46.10.881 N050.04.32.140 E019.46.10.818 Color_14ACI
N050.04.32.140 E019.46.10.818 N050.04.32.150 E019.46.10.762 Color_14ACI
N050.04.32.356 E019.46.12.235 N050.04.32.345 E019.46.12.145 Color_14ACI
N050.04.32.345 E019.46.12.145 N050.04.32.299 E019.46.12.073 Color_14ACI
N050.04.32.299 E019.46.12.073 N050.04.32.243 E019.46.12.056 Color_14ACI
N050.04.32.243 E019.46.12.056 N050.04.32.182 E019.46.12.099 Color_14ACI
N050.04.32.182 E019.46.12.099 N050.04.32.151 E019.46.12.182 Color_14ACI
N050.04.32.151 E019.46.12.182 N050.04.32.157 E019.46.12.283 Color_14ACI
N050.04.32.157 E019.46.12.283 N050.04.32.196 E019.46.12.355 Color_14ACI
N050.04.32.196 E019.46.12.355 N050.04.32.260 E019.46.12.380 Color_14ACI
N050.04.32.260 E019.46.12.380 N050.04.32.310 E019.46.12.353 Color_14ACI
N050.04.32.310 E019.46.12.353 N050.04.32.346 E019.46.12.291 Color_14ACI
N050.04.32.346 E019.46.12.291 N050.04.32.356 E019.46.12.235 Color_14ACI
N050.04.32.562 E019.46.13.707 N050.04.32.551 E019.46.13.618 Color_14ACI
N050.04.32.551 E019.46.13.618 N050.04.32.505 E019.46.13.546 Color_14ACI
N050.04.32.505 E019.46.13.546 N050.04.32.449 E019.46.13.529 Color_14ACI
N050.04.32.449 E019.46.13.529 N050.04.32.387 E019.46.13.572 Color_14ACI
N050.04.32.387 E019.46.13.572 N050.04.32.356 E019.46.13.655 Color_14ACI
N050.04.32.356 E019.46.13.655 N050.04.32.363 E019.46.13.756 Color_14ACI
N050.04.32.363 E019.46.13.756 N050.04.32.402 E019.46.13.828 Color_14ACI
N050.04.32.402 E019.46.13.828 N050.04.32.466 E019.46.13.853 Color_14ACI
N050.04.32.466 E019.46.13.853 N050.04.32.515 E019.46.13.826 Color_14ACI
N050.04.32.515 E019.46.13.826 N050.04.32.551 E019.46.13.763 Color_14ACI
N050.04.32.551 E019.46.13.763 N050.04.32.562 E019.46.13.707 Color_14ACI
N050.04.32.767 E019.46.15.180 N050.04.32.757 E019.46.15.091 Color_14ACI
N050.04.32.757 E019.46.15.091 N050.04.32.710 E019.46.15.018 Color_14ACI
N050.04.32.710 E019.46.15.018 N050.04.32.655 E019.46.15.002 Color_14ACI
N050.04.32.655 E019.46.15.002 N050.04.32.593 E019.46.15.044 Color_14ACI
N050.04.32.593 E019.46.15.044 N050.04.32.562 E019.46.15.128 Color_14ACI
N050.04.32.562 E019.46.15.128 N050.04.32.568 E019.46.15.229 Color_14ACI
N050.04.32.568 E019.46.15.229 N050.04.32.608 E019.46.15.300 Color_14ACI
N050.04.32.608 E019.46.15.300 N050.04.32.671 E019.46.15.325 Color_14ACI
N050.04.32.671 E019.46.15.325 N050.04.32.721 E019.46.15.299 Color_14ACI
N050.04.32.721 E019.46.15.299 N050.04.32.757 E019.46.15.236 Color_14ACI
N050.04.32.757 E019.46.15.236 N050.04.32.767 E019.46.15.180 Color_14ACI
N050.04.32.973 E019.46.16.653 N050.04.32.962 E019.46.16.563 Color_14ACI
N050.04.32.962 E019.46.16.563 N050.04.32.916 E019.46.16.491 Color_14ACI
N050.04.32.916 E019.46.16.491 N050.04.32.860 E019.46.16.474 Color_14ACI
N050.04.32.860 E019.46.16.474 N050.04.32.798 E019.46.16.517 Color_14ACI
N050.04.32.798 E019.46.16.517 N050.04.32.767 E019.46.16.601 Color_14ACI
N050.04.32.767 E019.46.16.601 N050.04.32.774 E019.46.16.701 Color_14ACI
N050.04.32.774 E019.46.16.701 N050.04.32.813 E019.46.16.773 Color_14ACI
N050.04.32.813 E019.46.16.773 N050.04.32.877 E019.46.16.798 Color_14ACI
N050.04.32.877 E019.46.16.798 N050.04.32.927 E019.46.16.771 Color_14ACI
N050.04.32.927 E019.46.16.771 N050.04.32.962 E019.46.16.709 Color_14ACI
N050.04.32.962 E019.46.16.709 N050.04.32.973 E019.46.16.653 Color_14ACI
N050.04.33.178 E019.46.18.125 N050.04.33.168 E019.46.18.036 Color_14ACI
N050.04.33.168 E019.46.18.036 N050.04.33.122 E019.46.17.964 Color_14ACI
N050.04.33.122 E019.46.17.964 N050.04.33.066 E019.46.17.947 Color_14ACI
N050.04.33.066 E019.46.17.947 N050.04.33.004 E019.46.17.990 Color_14ACI
N050.04.33.004 E019.46.17.990 N050.04.32.973 E019.46.18.073 Color_14ACI
N050.04.32.973 E019.46.18.073 N050.04.32.979 E019.46.18.174 Color_14ACI
N050.04.32.979 E019.46.18.174 N050.04.33.019 E019.46.18.246 Color_14ACI
N050.04.33.019 E019.46.18.246 N050.04.33.082 E019.46.18.271 Color_14ACI
N050.04.33.082 E019.46.18.271 N050.04.33.132 E019.46.18.244 Color_14ACI
N050.04.33.132 E019.46.18.244 N050.04.33.168 E019.46.18.182 Color_14ACI
N050.04.33.168 E019.46.18.182 N050.04.33.178 E019.46.18.125 Color_14ACI
N050.04.33.384 E019.46.19.598 N050.04.33.373 E019.46.19.509 Color_14ACI
N050.04.33.373 E019.46.19.509 N050.04.33.327 E019.46.19.437 Color_14ACI
N050.04.33.327 E019.46.19.437 N050.04.33.271 E019.46.19.420 Color_14ACI
N050.04.33.271 E019.46.19.420 N050.04.33.209 E019.46.19.462 Color_14ACI
N050.04.33.209 E019.46.19.462 N050.04.33.178 E019.46.19.546 Color_14ACI
N050.04.33.178 E019.46.19.546 N050.04.33.185 E019.46.19.647 Color_14ACI
N050.04.33.185 E019.46.19.647 N050.04.33.224 E019.46.19.718 Color_14ACI
N050.04.33.224 E019.46.19.718 N050.04.33.288 E019.46.19.743 Color_14ACI
N050.04.33.288 E019.46.19.743 N050.04.33.338 E019.46.19.717 Color_14ACI
N050.04.33.338 E019.46.19.717 N050.04.33.373 E019.46.19.654 Color_14ACI
N050.04.33.373 E019.46.19.654 N050.04.33.384 E019.46.19.598 Color_14ACI
N050.04.33.795 E019.46.22.544 N050.04.33.784 E019.46.22.454 Color_14ACI
N050.04.33.784 E019.46.22.454 N050.04.33.738 E019.46.22.382 Color_14ACI
N050.04.33.738 E019.46.22.382 N050.04.33.682 E019.46.22.365 Color_14ACI
N050.04.33.682 E019.46.22.365 N050.04.33.620 E019.46.22.408 Color_14ACI
N050.04.33.620 E019.46.22.408 N050.04.33.590 E019.46.22.491 Color_14ACI
N050.04.33.590 E019.46.22.491 N050.04.33.596 E019.46.22.592 Color_14ACI
N050.04.33.596 E019.46.22.592 N050.04.33.635 E019.46.22.664 Color_14ACI
N050.04.33.635 E019.46.22.664 N050.04.33.699 E019.46.22.689 Color_14ACI
N050.04.33.699 E019.46.22.689 N050.04.33.749 E019.46.22.662 Color_14ACI
N050.04.33.749 E019.46.22.662 N050.04.33.784 E019.46.22.600 Color_14ACI
N050.04.33.784 E019.46.22.600 N050.04.33.795 E019.46.22.544 Color_14ACI
N050.04.34.206 E019.46.25.489 N050.04.34.196 E019.46.25.400 Color_14ACI
N050.04.34.196 E019.46.25.400 N050.04.34.149 E019.46.25.327 Color_14ACI
N050.04.34.149 E019.46.25.327 N050.04.34.093 E019.46.25.311 Color_14ACI
N050.04.34.093 E019.46.25.311 N050.04.34.032 E019.46.25.353 Color_14ACI
N050.04.34.032 E019.46.25.353 N050.04.34.001 E019.46.25.437 Color_14ACI
N050.04.34.001 E019.46.25.437 N050.04.34.007 E019.46.25.538 Color_14ACI
N050.04.34.007 E019.46.25.538 N050.04.34.046 E019.46.25.609 Color_14ACI
N050.04.34.046 E019.46.25.609 N050.04.34.110 E019.46.25.634 Color_14ACI
N050.04.34.110 E019.46.25.634 N050.04.34.160 E019.46.25.608 Color_14ACI
N050.04.34.160 E019.46.25.608 N050.04.34.196 E019.46.25.545 Color_14ACI
N050.04.34.196 E019.46.25.545 N050.04.34.206 E019.46.25.489 Color_14ACI
N050.04.34.617 E019.46.28.434 N050.04.34.607 E019.46.28.345 Color_14ACI
N050.04.34.607 E019.46.28.345 N050.04.34.560 E019.46.28.273 Color_14ACI
N050.04.34.560 E019.46.28.273 N050.04.34.505 E019.46.28.256 Color_14ACI
N050.04.34.505 E019.46.28.256 N050.04.34.443 E019.46.28.299 Color_14ACI
N050.04.34.443 E019.46.28.299 N050.04.34.412 E019.46.28.382 Color_14ACI
N050.04.34.412 E019.46.28.382 N050.04.34.418 E019.46.28.483 Color_14ACI
N050.04.34.418 E019.46.28.483 N050.04.34.458 E019.46.28.555 Color_14ACI
N050.04.34.458 E019.46.28.555 N050.04.34.521 E019.46.28.580 Color_14ACI
N050.04.34.521 E019.46.28.580 N050.04.34.571 E019.46.28.553 Color_14ACI
N050.04.34.571 E019.46.28.553 N050.04.34.607 E019.46.28.490 Color_14ACI
N050.04.34.607 E019.46.28.490 N050.04.34.617 E019.46.28.434 Color_14ACI
N050.04.35.028 E019.46.31.380 N050.04.35.018 E019.46.31.290 Color_14ACI
N050.04.35.018 E019.46.31.290 N050.04.34.972 E019.46.31.218 Color_14ACI
N050.04.34.972 E019.46.31.218 N050.04.34.916 E019.46.31.201 Color_14ACI
N050.04.34.916 E019.46.31.201 N050.04.34.854 E019.46.31.244 Color_14ACI
N050.04.34.854 E019.46.31.244 N050.04.34.823 E019.46.31.328 Color_14ACI
N050.04.34.823 E019.46.31.328 N050.04.34.829 E019.46.31.429 Color_14ACI
N050.04.34.829 E019.46.31.429 N050.04.34.869 E019.46.31.500 Color_14ACI
N050.04.34.869 E019.46.31.500 N050.04.34.932 E019.46.31.525 Color_14ACI
N050.04.34.932 E019.46.31.525 N050.04.34.982 E019.46.31.499 Color_14ACI
N050.04.34.982 E019.46.31.499 N050.04.35.018 E019.46.31.436 Color_14ACI
N050.04.35.018 E019.46.31.436 N050.04.35.028 E019.46.31.380 Color_14ACI
N050.04.35.439 E019.46.34.325 N050.04.35.429 E019.46.34.236 Color_14ACI
N050.04.35.429 E019.46.34.236 N050.04.35.383 E019.46.34.164 Color_14ACI
N050.04.35.383 E019.46.34.164 N050.04.35.327 E019.46.34.147 Color_14ACI
N050.04.35.327 E019.46.34.147 N050.04.35.265 E019.46.34.190 Color_14ACI
N050.04.35.265 E019.46.34.190 N050.04.35.234 E019.46.34.273 Color_14ACI
N050.04.35.234 E019.46.34.273 N050.04.35.240 E019.46.34.374 Color_14ACI
N050.04.35.240 E019.46.34.374 N050.04.35.280 E019.46.34.446 Color_14ACI
N050.04.35.280 E019.46.34.446 N050.04.35.344 E019.46.34.470 Color_14ACI
N050.04.35.344 E019.46.34.470 N050.04.35.393 E019.46.34.444 Color_14ACI
N050.04.35.393 E019.46.34.444 N050.04.35.429 E019.46.34.381 Color_14ACI
N050.04.35.429 E019.46.34.381 N050.04.35.439 E019.46.34.325 Color_14ACI
N050.04.35.851 E019.46.37.271 N050.04.35.840 E019.46.37.181 Color_14ACI
N050.04.35.840 E019.46.37.181 N050.04.35.794 E019.46.37.109 Color_14ACI
N050.04.35.794 E019.46.37.109 N050.04.35.738 E019.46.37.092 Color_14ACI
N050.04.35.738 E019.46.37.092 N050.04.35.676 E019.46.37.135 Color_14ACI
N050.04.35.676 E019.46.37.135 N050.04.35.645 E019.46.37.219 Color_14ACI
N050.04.35.645 E019.46.37.219 N050.04.35.651 E019.46.37.319 Color_14ACI
N050.04.35.651 E019.46.37.319 N050.04.35.691 E019.46.37.391 Color_14ACI
N050.04.35.691 E019.46.37.391 N050.04.35.755 E019.46.37.416 Color_14ACI
N050.04.35.755 E019.46.37.416 N050.04.35.804 E019.46.37.389 Color_14ACI
N050.04.35.804 E019.46.37.389 N050.04.35.840 E019.46.37.327 Color_14ACI
N050.04.35.840 E019.46.37.327 N050.04.35.851 E019.46.37.271 Color_14ACI
N050.04.36.262 E019.46.40.216 N050.04.36.251 E019.46.40.127 Color_14ACI
N050.04.36.251 E019.46.40.127 N050.04.36.205 E019.46.40.054 Color_14ACI
N050.04.36.205 E019.46.40.054 N050.04.36.149 E019.46.40.038 Color_14ACI
N050.04.36.149 E019.46.40.038 N050.04.36.087 E019.46.40.080 Color_14ACI
N050.04.36.087 E019.46.40.080 N050.04.36.056 E019.46.40.164 Color_14ACI
N050.04.36.056 E019.46.40.164 N050.04.36.063 E019.46.40.265 Color_14ACI
N050.04.36.063 E019.46.40.265 N050.04.36.102 E019.46.40.336 Color_14ACI
N050.04.36.102 E019.46.40.336 N050.04.36.166 E019.46.40.361 Color_14ACI
N050.04.36.166 E019.46.40.361 N050.04.36.216 E019.46.40.335 Color_14ACI
N050.04.36.216 E019.46.40.335 N050.04.36.251 E019.46.40.272 Color_14ACI
N050.04.36.251 E019.46.40.272 N050.04.36.262 E019.46.40.216 Color_14ACI
N050.04.36.673 E019.46.43.161 N050.04.36.662 E019.46.43.072 Color_14ACI
N050.04.36.662 E019.46.43.072 N050.04.36.616 E019.46.43.000 Color_14ACI
N050.04.36.616 E019.46.43.000 N050.04.36.560 E019.46.42.983 Color_14ACI
N050.04.36.560 E019.46.42.983 N050.04.36.498 E019.46.43.026 Color_14ACI
N050.04.36.498 E019.46.43.026 N050.04.36.467 E019.46.43.109 Color_14ACI
N050.04.36.467 E019.46.43.109 N050.04.36.474 E019.46.43.210 Color_14ACI
N050.04.36.474 E019.46.43.210 N050.04.36.513 E019.46.43.282 Color_14ACI
N050.04.36.513 E019.46.43.282 N050.04.36.577 E019.46.43.307 Color_14ACI
N050.04.36.577 E019.46.43.307 N050.04.36.627 E019.46.43.280 Color_14ACI
N050.04.36.627 E019.46.43.280 N050.04.36.662 E019.46.43.218 Color_14ACI
N050.04.36.662 E019.46.43.218 N050.04.36.673 E019.46.43.161 Color_14ACI
N050.04.37.084 E019.46.46.107 N050.04.37.073 E019.46.46.017 Color_14ACI
N050.04.37.073 E019.46.46.017 N050.04.37.027 E019.46.45.945 Color_14ACI
N050.04.37.027 E019.46.45.945 N050.04.36.971 E019.46.45.928 Color_14ACI
N050.04.36.971 E019.46.45.928 N050.04.36.909 E019.46.45.971 Color_14ACI
N050.04.36.909 E019.46.45.971 N050.04.36.879 E019.46.46.055 Color_14ACI
N050.04.36.879 E019.46.46.055 N050.04.36.885 E019.46.46.156 Color_14ACI
N050.04.36.885 E019.46.46.156 N050.04.36.924 E019.46.46.227 Color_14ACI
N050.04.36.924 E019.46.46.227 N050.04.36.988 E019.46.46.252 Color_14ACI
N050.04.36.988 E019.46.46.252 N050.04.37.038 E019.46.46.226 Color_14ACI
N050.04.37.038 E019.46.46.226 N050.04.37.073 E019.46.46.163 Color_14ACI
N050.04.37.073 E019.46.46.163 N050.04.37.084 E019.46.46.107 Color_14ACI
N050.04.31.532 E019.46.06.352 N050.04.31.522 E019.46.06.262 Color_14ACI
N050.04.31.522 E019.46.06.262 N050.04.31.476 E019.46.06.190 Color_14ACI
N050.04.31.476 E019.46.06.190 N050.04.31.420 E019.46.06.173 Color_14ACI
N050.04.31.420 E019.46.06.173 N050.04.31.358 E019.46.06.216 Color_14ACI
N050.04.31.358 E019.46.06.216 N050.04.31.327 E019.46.06.300 Color_14ACI
N050.04.31.327 E019.46.06.300 N050.04.31.333 E019.46.06.400 Color_14ACI
N050.04.31.333 E019.46.06.400 N050.04.31.373 E019.46.06.472 Color_14ACI
N050.04.31.373 E019.46.06.472 N050.04.31.437 E019.46.06.497 Color_14ACI
N050.04.31.437 E019.46.06.497 N050.04.31.486 E019.46.06.470 Color_14ACI
N050.04.31.486 E019.46.06.470 N050.04.31.522 E019.46.06.408 Color_14ACI
N050.04.31.522 E019.46.06.408 N050.04.31.532 E019.46.06.352 Color_14ACI
;rwy_end_lgt N000.00.00.000 E000.00.00.000 N000.00.00.000 E000.00.00.000
N050.04.32.061 E019.46.04.316 N050.04.32.007 E019.46.04.281 Color_14ACI
N050.04.32.007 E019.46.04.281 N050.04.31.943 E019.46.04.301 Color_14ACI
N050.04.31.943 E019.46.04.301 N050.04.31.903 E019.46.04.365 Color_14ACI
N050.04.31.903 E019.46.04.365 N050.04.31.892 E019.46.04.469 Color_14ACI
N050.04.31.892 E019.46.04.469 N050.04.31.920 E019.46.04.555 Color_14ACI
N050.04.31.920 E019.46.04.555 N050.04.31.978 E019.46.04.602 Color_14ACI
N050.04.31.978 E019.46.04.602 N050.04.32.038 E019.46.04.590 Color_14ACI
N050.04.32.038 E019.46.04.590 N050.04.32.086 E019.46.04.521 Color_14ACI
N050.04.32.086 E019.46.04.521 N050.04.32.099 E019.46.04.442 Color_14ACI
N050.04.32.099 E019.46.04.442 N050.04.32.085 E019.46.04.361 Color_14ACI
N050.04.32.085 E019.46.04.361 N050.04.32.061 E019.46.04.316 Color_14ACI
N050.04.31.760 E019.46.04.419 N050.04.31.707 E019.46.04.384 Color_14ACI
N050.04.31.707 E019.46.04.384 N050.04.31.642 E019.46.04.404 Color_14ACI
N050.04.31.642 E019.46.04.404 N050.04.31.603 E019.46.04.467 Color_14ACI
N050.04.31.603 E019.46.04.467 N050.04.31.591 E019.46.04.571 Color_14ACI
N050.04.31.591 E019.46.04.571 N050.04.31.619 E019.46.04.657 Color_14ACI
N050.04.31.619 E019.46.04.657 N050.04.31.677 E019.46.04.705 Color_14ACI
N050.04.31.677 E019.46.04.705 N050.04.31.737 E019.46.04.693 Color_14ACI
N050.04.31.737 E019.46.04.693 N050.04.31.785 E019.46.04.624 Color_14ACI
N050.04.31.785 E019.46.04.624 N050.04.31.798 E019.46.04.544 Color_14ACI
N050.04.31.798 E019.46.04.544 N050.04.31.785 E019.46.04.464 Color_14ACI
N050.04.31.785 E019.46.04.464 N050.04.31.760 E019.46.04.419 Color_14ACI
N050.04.31.431 E019.46.04.532 N050.04.31.377 E019.46.04.496 Color_14ACI
N050.04.31.377 E019.46.04.496 N050.04.31.313 E019.46.04.517 Color_14ACI
N050.04.31.313 E019.46.04.517 N050.04.31.274 E019.46.04.580 Color_14ACI
N050.04.31.274 E019.46.04.580 N050.04.31.262 E019.46.04.684 Color_14ACI
N050.04.31.262 E019.46.04.684 N050.04.31.290 E019.46.04.770 Color_14ACI
N050.04.31.290 E019.46.04.770 N050.04.31.348 E019.46.04.817 Color_14ACI
N050.04.31.348 E019.46.04.817 N050.04.31.408 E019.46.04.806 Color_14ACI
N050.04.31.408 E019.46.04.806 N050.04.31.456 E019.46.04.736 Color_14ACI
N050.04.31.456 E019.46.04.736 N050.04.31.469 E019.46.04.657 Color_14ACI
N050.04.31.469 E019.46.04.657 N050.04.31.455 E019.46.04.576 Color_14ACI
N050.04.31.455 E019.46.04.576 N050.04.31.431 E019.46.04.532 Color_14ACI
N050.04.31.117 E019.46.04.627 N050.04.31.064 E019.46.04.592 Color_14ACI
N050.04.31.064 E019.46.04.592 N050.04.31.000 E019.46.04.612 Color_14ACI
N050.04.31.000 E019.46.04.612 N050.04.30.960 E019.46.04.675 Color_14ACI
N050.04.30.960 E019.46.04.675 N050.04.30.949 E019.46.04.779 Color_14ACI
N050.04.30.949 E019.46.04.779 N050.04.30.976 E019.46.04.866 Color_14ACI
N050.04.30.976 E019.46.04.866 N050.04.31.034 E019.46.04.913 Color_14ACI
N050.04.31.034 E019.46.04.913 N050.04.31.094 E019.46.04.901 Color_14ACI
N050.04.31.094 E019.46.04.901 N050.04.31.142 E019.46.04.832 Color_14ACI
N050.04.31.142 E019.46.04.832 N050.04.31.156 E019.46.04.752 Color_14ACI
N050.04.31.156 E019.46.04.752 N050.04.31.142 E019.46.04.672 Color_14ACI
N050.04.31.142 E019.46.04.672 N050.04.31.117 E019.46.04.627 Color_14ACI
N050.04.30.790 E019.46.04.751 N050.04.30.736 E019.46.04.716 Color_14ACI
N050.04.30.736 E019.46.04.716 N050.04.30.672 E019.46.04.736 Color_14ACI
N050.04.30.672 E019.46.04.736 N050.04.30.632 E019.46.04.800 Color_14ACI
N050.04.30.632 E019.46.04.800 N050.04.30.621 E019.46.04.904 Color_14ACI
N050.04.30.621 E019.46.04.904 N050.04.30.649 E019.46.04.990 Color_14ACI
N050.04.30.649 E019.46.04.990 N050.04.30.706 E019.46.05.037 Color_14ACI
N050.04.30.706 E019.46.05.037 N050.04.30.767 E019.46.05.025 Color_14ACI
N050.04.30.767 E019.46.05.025 N050.04.30.815 E019.46.04.956 Color_14ACI
N050.04.30.815 E019.46.04.956 N050.04.30.828 E019.46.04.877 Color_14ACI
N050.04.30.828 E019.46.04.877 N050.04.30.814 E019.46.04.796 Color_14ACI
N050.04.30.814 E019.46.04.796 N050.04.30.790 E019.46.04.751 Color_14ACI
N050.04.30.492 E019.46.04.866 N050.04.30.439 E019.46.04.830 Color_14ACI
N050.04.30.439 E019.46.04.830 N050.04.30.375 E019.46.04.851 Color_14ACI
N050.04.30.375 E019.46.04.851 N050.04.30.335 E019.46.04.914 Color_14ACI
N050.04.30.335 E019.46.04.914 N050.04.30.324 E019.46.05.018 Color_14ACI
N050.04.30.324 E019.46.05.018 N050.04.30.351 E019.46.05.104 Color_14ACI
N050.04.30.351 E019.46.05.104 N050.04.30.409 E019.46.05.152 Color_14ACI
N050.04.30.409 E019.46.05.152 N050.04.30.469 E019.46.05.140 Color_14ACI
N050.04.30.469 E019.46.05.140 N050.04.30.517 E019.46.05.071 Color_14ACI
N050.04.30.517 E019.46.05.071 N050.04.30.531 E019.46.04.991 Color_14ACI
N050.04.30.531 E019.46.04.991 N050.04.30.517 E019.46.04.910 Color_14ACI
N050.04.30.517 E019.46.04.910 N050.04.30.492 E019.46.04.866 Color_14ACI
N050.04.49.625 E019.48.10.086 N050.04.49.571 E019.48.10.051 Color_14ACI
N050.04.49.571 E019.48.10.051 N050.04.49.507 E019.48.10.071 Color_14ACI
N050.04.49.507 E019.48.10.071 N050.04.49.467 E019.48.10.135 Color_14ACI
N050.04.49.467 E019.48.10.135 N050.04.49.456 E019.48.10.239 Color_14ACI
N050.04.49.456 E019.48.10.239 N050.04.49.484 E019.48.10.325 Color_14ACI
N050.04.49.484 E019.48.10.325 N050.04.49.542 E019.48.10.372 Color_14ACI
N050.04.49.542 E019.48.10.372 N050.04.49.602 E019.48.10.360 Color_14ACI
N050.04.49.602 E019.48.10.360 N050.04.49.650 E019.48.10.291 Color_14ACI
N050.04.49.650 E019.48.10.291 N050.04.49.663 E019.48.10.212 Color_14ACI
N050.04.49.663 E019.48.10.212 N050.04.49.649 E019.48.10.131 Color_14ACI
N050.04.49.649 E019.48.10.131 N050.04.49.625 E019.48.10.086 Color_14ACI
N050.04.49.324 E019.48.10.189 N050.04.49.271 E019.48.10.153 Color_14ACI
N050.04.49.271 E019.48.10.153 N050.04.49.207 E019.48.10.174 Color_14ACI
N050.04.49.207 E019.48.10.174 N050.04.49.167 E019.48.10.237 Color_14ACI
N050.04.49.167 E019.48.10.237 N050.04.49.156 E019.48.10.341 Color_14ACI
N050.04.49.156 E019.48.10.341 N050.04.49.183 E019.48.10.427 Color_14ACI
N050.04.49.183 E019.48.10.427 N050.04.49.241 E019.48.10.475 Color_14ACI
N050.04.49.241 E019.48.10.475 N050.04.49.301 E019.48.10.463 Color_14ACI
N050.04.49.301 E019.48.10.463 N050.04.49.349 E019.48.10.394 Color_14ACI
N050.04.49.349 E019.48.10.394 N050.04.49.363 E019.48.10.314 Color_14ACI
N050.04.49.363 E019.48.10.314 N050.04.49.349 E019.48.10.234 Color_14ACI
N050.04.49.349 E019.48.10.234 N050.04.49.324 E019.48.10.189 Color_14ACI
N050.04.48.995 E019.48.10.302 N050.04.48.942 E019.48.10.266 Color_14ACI
N050.04.48.942 E019.48.10.266 N050.04.48.878 E019.48.10.286 Color_14ACI
N050.04.48.878 E019.48.10.286 N050.04.48.838 E019.48.10.350 Color_14ACI
N050.04.48.838 E019.48.10.350 N050.04.48.827 E019.48.10.454 Color_14ACI
N050.04.48.827 E019.48.10.454 N050.04.48.854 E019.48.10.540 Color_14ACI
N050.04.48.854 E019.48.10.540 N050.04.48.912 E019.48.10.587 Color_14ACI
N050.04.48.912 E019.48.10.587 N050.04.48.972 E019.48.10.575 Color_14ACI
N050.04.48.972 E019.48.10.575 N050.04.49.020 E019.48.10.506 Color_14ACI
N050.04.49.020 E019.48.10.506 N050.04.49.034 E019.48.10.427 Color_14ACI
N050.04.49.034 E019.48.10.427 N050.04.49.020 E019.48.10.346 Color_14ACI
N050.04.49.020 E019.48.10.346 N050.04.48.995 E019.48.10.302 Color_14ACI
N050.04.48.682 E019.48.10.397 N050.04.48.628 E019.48.10.362 Color_14ACI
N050.04.48.628 E019.48.10.362 N050.04.48.564 E019.48.10.382 Color_14ACI
N050.04.48.564 E019.48.10.382 N050.04.48.524 E019.48.10.445 Color_14ACI
N050.04.48.524 E019.48.10.445 N050.04.48.513 E019.48.10.549 Color_14ACI
N050.04.48.513 E019.48.10.549 N050.04.48.541 E019.48.10.636 Color_14ACI
N050.04.48.541 E019.48.10.636 N050.04.48.598 E019.48.10.683 Color_14ACI
N050.04.48.598 E019.48.10.683 N050.04.48.658 E019.48.10.671 Color_14ACI
N050.04.48.658 E019.48.10.671 N050.04.48.707 E019.48.10.602 Color_14ACI
N050.04.48.707 E019.48.10.602 N050.04.48.720 E019.48.10.522 Color_14ACI
N050.04.48.720 E019.48.10.522 N050.04.48.706 E019.48.10.442 Color_14ACI
N050.04.48.706 E019.48.10.442 N050.04.48.682 E019.48.10.397 Color_14ACI
N050.04.48.354 E019.48.10.521 N050.04.48.300 E019.48.10.486 Color_14ACI
N050.04.48.300 E019.48.10.486 N050.04.48.236 E019.48.10.506 Color_14ACI
N050.04.48.236 E019.48.10.506 N050.04.48.197 E019.48.10.570 Color_14ACI
N050.04.48.197 E019.48.10.570 N050.04.48.185 E019.48.10.674 Color_14ACI
N050.04.48.185 E019.48.10.674 N050.04.48.213 E019.48.10.760 Color_14ACI
N050.04.48.213 E019.48.10.760 N050.04.48.271 E019.48.10.807 Color_14ACI
N050.04.48.271 E019.48.10.807 N050.04.48.331 E019.48.10.795 Color_14ACI
N050.04.48.331 E019.48.10.795 N050.04.48.379 E019.48.10.726 Color_14ACI
N050.04.48.379 E019.48.10.726 N050.04.48.392 E019.48.10.647 Color_14ACI
N050.04.48.392 E019.48.10.647 N050.04.48.378 E019.48.10.566 Color_14ACI
N050.04.48.378 E019.48.10.566 N050.04.48.354 E019.48.10.521 Color_14ACI
N050.04.48.057 E019.48.10.636 N050.04.48.003 E019.48.10.600 Color_14ACI
N050.04.48.003 E019.48.10.600 N050.04.47.939 E019.48.10.621 Color_14ACI
N050.04.47.939 E019.48.10.621 N050.04.47.899 E019.48.10.684 Color_14ACI
N050.04.47.899 E019.48.10.684 N050.04.47.888 E019.48.10.788 Color_14ACI
N050.04.47.888 E019.48.10.788 N050.04.47.916 E019.48.10.874 Color_14ACI
N050.04.47.916 E019.48.10.874 N050.04.47.973 E019.48.10.922 Color_14ACI
N050.04.47.973 E019.48.10.922 N050.04.48.033 E019.48.10.910 Color_14ACI
N050.04.48.033 E019.48.10.910 N050.04.48.082 E019.48.10.841 Color_14ACI
N050.04.48.082 E019.48.10.841 N050.04.48.095 E019.48.10.761 Color_14ACI
N050.04.48.095 E019.48.10.761 N050.04.48.081 E019.48.10.680 Color_14ACI
N050.04.48.081 E019.48.10.680 N050.04.48.057 E019.48.10.636 Color_14ACI
;rwy_beg_lgt N000.00.00.000 E000.00.00.000 N000.00.00.000 E000.00.00.000
N050.04.47.949 E019.47.58.079 N050.04.47.896 E019.47.58.043 Color_96ACI
N050.04.47.896 E019.47.58.043 N050.04.47.832 E019.47.58.064 Color_96ACI
N050.04.47.832 E019.47.58.064 N050.04.47.792 E019.47.58.127 Color_96ACI
N050.04.47.792 E019.47.58.127 N050.04.47.781 E019.47.58.231 Color_96ACI
N050.04.47.781 E019.47.58.231 N050.04.47.808 E019.47.58.317 Color_96ACI
N050.04.47.808 E019.47.58.317 N050.04.47.866 E019.47.58.365 Color_96ACI
N050.04.47.866 E019.47.58.365 N050.04.47.926 E019.47.58.353 Color_96ACI
N050.04.47.926 E019.47.58.353 N050.04.47.974 E019.47.58.284 Color_96ACI
N050.04.47.974 E019.47.58.284 N050.04.47.988 E019.47.58.204 Color_96ACI
N050.04.47.988 E019.47.58.204 N050.04.47.974 E019.47.58.123 Color_96ACI
N050.04.47.974 E019.47.58.123 N050.04.47.949 E019.47.58.079 Color_96ACI
N050.04.47.649 E019.47.58.181 N050.04.47.595 E019.47.58.146 Color_96ACI
N050.04.47.595 E019.47.58.146 N050.04.47.531 E019.47.58.166 Color_96ACI
N050.04.47.531 E019.47.58.166 N050.04.47.491 E019.47.58.230 Color_96ACI
N050.04.47.491 E019.47.58.230 N050.04.47.480 E019.47.58.334 Color_96ACI
N050.04.47.480 E019.47.58.334 N050.04.47.508 E019.47.58.420 Color_96ACI
N050.04.47.508 E019.47.58.420 N050.04.47.565 E019.47.58.467 Color_96ACI
N050.04.47.565 E019.47.58.467 N050.04.47.625 E019.47.58.455 Color_96ACI
N050.04.47.625 E019.47.58.455 N050.04.47.674 E019.47.58.386 Color_96ACI
N050.04.47.674 E019.47.58.386 N050.04.47.687 E019.47.58.307 Color_96ACI
N050.04.47.687 E019.47.58.307 N050.04.47.673 E019.47.58.226 Color_96ACI
N050.04.47.673 E019.47.58.226 N050.04.47.649 E019.47.58.181 Color_96ACI
N050.04.47.320 E019.47.58.294 N050.04.47.266 E019.47.58.258 Color_96ACI
N050.04.47.266 E019.47.58.258 N050.04.47.202 E019.47.58.279 Color_96ACI
N050.04.47.202 E019.47.58.279 N050.04.47.162 E019.47.58.342 Color_96ACI
N050.04.47.162 E019.47.58.342 N050.04.47.151 E019.47.58.446 Color_96ACI
N050.04.47.151 E019.47.58.446 N050.04.47.179 E019.47.58.532 Color_96ACI
N050.04.47.179 E019.47.58.532 N050.04.47.236 E019.47.58.580 Color_96ACI
N050.04.47.236 E019.47.58.580 N050.04.47.296 E019.47.58.568 Color_96ACI
N050.04.47.296 E019.47.58.568 N050.04.47.345 E019.47.58.499 Color_96ACI
N050.04.47.345 E019.47.58.499 N050.04.47.358 E019.47.58.419 Color_96ACI
N050.04.47.358 E019.47.58.419 N050.04.47.344 E019.47.58.339 Color_96ACI
N050.04.47.344 E019.47.58.339 N050.04.47.320 E019.47.58.294 Color_96ACI
N050.04.47.006 E019.47.58.389 N050.04.46.952 E019.47.58.354 Color_96ACI
N050.04.46.952 E019.47.58.354 N050.04.46.888 E019.47.58.374 Color_96ACI
N050.04.46.888 E019.47.58.374 N050.04.46.848 E019.47.58.438 Color_96ACI
N050.04.46.848 E019.47.58.438 N050.04.46.837 E019.47.58.542 Color_96ACI
N050.04.46.837 E019.47.58.542 N050.04.46.865 E019.47.58.628 Color_96ACI
N050.04.46.865 E019.47.58.628 N050.04.46.922 E019.47.58.675 Color_96ACI
N050.04.46.922 E019.47.58.675 N050.04.46.983 E019.47.58.663 Color_96ACI
N050.04.46.983 E019.47.58.663 N050.04.47.031 E019.47.58.594 Color_96ACI
N050.04.47.031 E019.47.58.594 N050.04.47.044 E019.47.58.515 Color_96ACI
N050.04.47.044 E019.47.58.515 N050.04.47.030 E019.47.58.434 Color_96ACI
N050.04.47.030 E019.47.58.434 N050.04.47.006 E019.47.58.389 Color_96ACI
N050.04.46.678 E019.47.58.514 N050.04.46.625 E019.47.58.478 Color_96ACI
N050.04.46.625 E019.47.58.478 N050.04.46.561 E019.47.58.499 Color_96ACI
N050.04.46.561 E019.47.58.499 N050.04.46.521 E019.47.58.562 Color_96ACI
N050.04.46.521 E019.47.58.562 N050.04.46.510 E019.47.58.666 Color_96ACI
N050.04.46.510 E019.47.58.666 N050.04.46.538 E019.47.58.752 Color_96ACI
N050.04.46.538 E019.47.58.752 N050.04.46.595 E019.47.58.800 Color_96ACI
N050.04.46.595 E019.47.58.800 N050.04.46.655 E019.47.58.788 Color_96ACI
N050.04.46.655 E019.47.58.788 N050.04.46.704 E019.47.58.719 Color_96ACI
N050.04.46.704 E019.47.58.719 N050.04.46.717 E019.47.58.639 Color_96ACI
N050.04.46.717 E019.47.58.639 N050.04.46.703 E019.47.58.558 Color_96ACI
N050.04.46.703 E019.47.58.558 N050.04.46.678 E019.47.58.514 Color_96ACI
N050.04.46.381 E019.47.58.628 N050.04.46.327 E019.47.58.593 Color_96ACI
N050.04.46.327 E019.47.58.593 N050.04.46.263 E019.47.58.613 Color_96ACI
N050.04.46.263 E019.47.58.613 N050.04.46.223 E019.47.58.677 Color_96ACI
N050.04.46.223 E019.47.58.677 N050.04.46.212 E019.47.58.781 Color_96ACI
N050.04.46.212 E019.47.58.781 N050.04.46.240 E019.47.58.867 Color_96ACI
N050.04.46.240 E019.47.58.867 N050.04.46.298 E019.47.58.914 Color_96ACI
N050.04.46.298 E019.47.58.914 N050.04.46.358 E019.47.58.902 Color_96ACI
N050.04.46.358 E019.47.58.902 N050.04.46.406 E019.47.58.833 Color_96ACI
N050.04.46.406 E019.47.58.833 N050.04.46.419 E019.47.58.754 Color_96ACI
N050.04.46.419 E019.47.58.754 N050.04.46.405 E019.47.58.673 Color_96ACI
N050.04.46.405 E019.47.58.673 N050.04.46.381 E019.47.58.628 Color_96ACI
N050.04.48.214 E019.47.58.008 N050.04.48.160 E019.47.57.972 Color_96ACI
N050.04.48.160 E019.47.57.972 N050.04.48.096 E019.47.57.993 Color_96ACI
N050.04.48.096 E019.47.57.993 N050.04.48.056 E019.47.58.056 Color_96ACI
N050.04.48.056 E019.47.58.056 N050.04.48.045 E019.47.58.160 Color_96ACI
N050.04.48.045 E019.47.58.160 N050.04.48.073 E019.47.58.246 Color_96ACI
N050.04.48.073 E019.47.58.246 N050.04.48.131 E019.47.58.294 Color_96ACI
N050.04.48.131 E019.47.58.294 N050.04.48.191 E019.47.58.282 Color_96ACI
N050.04.48.191 E019.47.58.282 N050.04.48.239 E019.47.58.212 Color_96ACI
N050.04.48.239 E019.47.58.212 N050.04.48.252 E019.47.58.133 Color_96ACI
N050.04.48.252 E019.47.58.133 N050.04.48.238 E019.47.58.052 Color_96ACI
N050.04.48.238 E019.47.58.052 N050.04.48.214 E019.47.58.008 Color_96ACI
N050.04.48.487 E019.47.57.900 N050.04.48.433 E019.47.57.864 Color_96ACI
N050.04.48.433 E019.47.57.864 N050.04.48.369 E019.47.57.885 Color_96ACI
N050.04.48.369 E019.47.57.885 N050.04.48.330 E019.47.57.948 Color_96ACI
N050.04.48.330 E019.47.57.948 N050.04.48.318 E019.47.58.052 Color_96ACI
N050.04.48.318 E019.47.58.052 N050.04.48.346 E019.47.58.138 Color_96ACI
N050.04.48.346 E019.47.58.138 N050.04.48.404 E019.47.58.186 Color_96ACI
N050.04.48.404 E019.47.58.186 N050.04.48.464 E019.47.58.174 Color_96ACI
N050.04.48.464 E019.47.58.174 N050.04.48.512 E019.47.58.105 Color_96ACI
N050.04.48.512 E019.47.58.105 N050.04.48.525 E019.47.58.025 Color_96ACI
N050.04.48.525 E019.47.58.025 N050.04.48.511 E019.47.57.944 Color_96ACI
N050.04.48.511 E019.47.57.944 N050.04.48.487 E019.47.57.900 Color_96ACI
N050.04.48.782 E019.47.57.808 N050.04.48.728 E019.47.57.773 Color_96ACI
N050.04.48.728 E019.47.57.773 N050.04.48.664 E019.47.57.793 Color_96ACI
N050.04.48.664 E019.47.57.793 N050.04.48.625 E019.47.57.857 Color_96ACI
N050.04.48.625 E019.47.57.857 N050.04.48.613 E019.47.57.961 Color_96ACI
N050.04.48.613 E019.47.57.961 N050.04.48.641 E019.47.58.047 Color_96ACI
N050.04.48.641 E019.47.58.047 N050.04.48.699 E019.47.58.094 Color_96ACI
N050.04.48.699 E019.47.58.094 N050.04.48.759 E019.47.58.082 Color_96ACI
N050.04.48.759 E019.47.58.082 N050.04.48.807 E019.47.58.013 Color_96ACI
N050.04.48.807 E019.47.58.013 N050.04.48.820 E019.47.57.934 Color_96ACI
N050.04.48.820 E019.47.57.934 N050.04.48.806 E019.47.57.853 Color_96ACI
N050.04.48.806 E019.47.57.853 N050.04.48.782 E019.47.57.808 Color_96ACI
N050.04.49.064 E019.47.57.709 N050.04.49.010 E019.47.57.674 Color_96ACI
N050.04.49.010 E019.47.57.674 N050.04.48.946 E019.47.57.694 Color_96ACI
N050.04.48.946 E019.47.57.694 N050.04.48.907 E019.47.57.758 Color_96ACI
N050.04.48.907 E019.47.57.758 N050.04.48.895 E019.47.57.862 Color_96ACI
N050.04.48.895 E019.47.57.862 N050.04.48.923 E019.47.57.948 Color_96ACI
N050.04.48.923 E019.47.57.948 N050.04.48.981 E019.47.57.995 Color_96ACI
N050.04.48.981 E019.47.57.995 N050.04.49.041 E019.47.57.983 Color_96ACI
N050.04.49.041 E019.47.57.983 N050.04.49.089 E019.47.57.914 Color_96ACI
N050.04.49.089 E019.47.57.914 N050.04.49.102 E019.47.57.835 Color_96ACI
N050.04.49.102 E019.47.57.835 N050.04.49.088 E019.47.57.754 Color_96ACI
N050.04.49.088 E019.47.57.754 N050.04.49.064 E019.47.57.709 Color_96ACI
N050.04.46.089 E019.47.58.732 N050.04.46.036 E019.47.58.697 Color_96ACI
N050.04.46.036 E019.47.58.697 N050.04.45.972 E019.47.58.717 Color_96ACI
N050.04.45.972 E019.47.58.717 N050.04.45.932 E019.47.58.780 Color_96ACI
N050.04.45.932 E019.47.58.780 N050.04.45.921 E019.47.58.884 Color_96ACI
N050.04.45.921 E019.47.58.884 N050.04.45.949 E019.47.58.971 Color_96ACI
N050.04.45.949 E019.47.58.971 N050.04.46.006 E019.47.59.018 Color_96ACI
N050.04.46.006 E019.47.59.018 N050.04.46.066 E019.47.59.006 Color_96ACI
N050.04.46.066 E019.47.59.006 N050.04.46.115 E019.47.58.937 Color_96ACI
N050.04.46.115 E019.47.58.937 N050.04.46.128 E019.47.58.857 Color_96ACI
N050.04.46.128 E019.47.58.857 N050.04.46.114 E019.47.58.777 Color_96ACI
N050.04.46.114 E019.47.58.777 N050.04.46.089 E019.47.58.732 Color_96ACI
N050.04.45.803 E019.47.58.838 N050.04.45.749 E019.47.58.802 Color_96ACI
N050.04.45.749 E019.47.58.802 N050.04.45.685 E019.47.58.823 Color_96ACI
N050.04.45.685 E019.47.58.823 N050.04.45.645 E019.47.58.886 Color_96ACI
N050.04.45.645 E019.47.58.886 N050.04.45.634 E019.47.58.990 Color_96ACI
N050.04.45.634 E019.47.58.990 N050.04.45.662 E019.47.59.076 Color_96ACI
N050.04.45.662 E019.47.59.076 N050.04.45.719 E019.47.59.124 Color_96ACI
N050.04.45.719 E019.47.59.124 N050.04.45.779 E019.47.59.112 Color_96ACI
N050.04.45.779 E019.47.59.112 N050.04.45.828 E019.47.59.043 Color_96ACI
N050.04.45.828 E019.47.59.043 N050.04.45.841 E019.47.58.963 Color_96ACI
N050.04.45.841 E019.47.58.963 N050.04.45.827 E019.47.58.882 Color_96ACI
N050.04.45.827 E019.47.58.882 N050.04.45.803 E019.47.58.838 Color_96ACI
N050.04.45.533 E019.47.58.945 N050.04.45.479 E019.47.58.909 Color_96ACI
N050.04.45.479 E019.47.58.909 N050.04.45.415 E019.47.58.930 Color_96ACI
N050.04.45.415 E019.47.58.930 N050.04.45.375 E019.47.58.993 Color_96ACI
N050.04.45.375 E019.47.58.993 N050.04.45.364 E019.47.59.097 Color_96ACI
N050.04.45.364 E019.47.59.097 N050.04.45.392 E019.47.59.183 Color_96ACI
N050.04.45.392 E019.47.59.183 N050.04.45.449 E019.47.59.231 Color_96ACI
N050.04.45.449 E019.47.59.231 N050.04.45.509 E019.47.59.219 Color_96ACI
N050.04.45.509 E019.47.59.219 N050.04.45.558 E019.47.59.150 Color_96ACI
N050.04.45.558 E019.47.59.150 N050.04.45.571 E019.47.59.070 Color_96ACI
N050.04.45.571 E019.47.59.070 N050.04.45.557 E019.47.58.990 Color_96ACI
N050.04.45.557 E019.47.58.990 N050.04.45.533 E019.47.58.945 Color_96ACI
N050.04.45.259 E019.47.59.039 N050.04.45.205 E019.47.59.004 Color_96ACI
N050.04.45.205 E019.47.59.004 N050.04.45.141 E019.47.59.024 Color_96ACI
N050.04.45.141 E019.47.59.024 N050.04.45.101 E019.47.59.087 Color_96ACI
N050.04.45.101 E019.47.59.087 N050.04.45.090 E019.47.59.191 Color_96ACI
N050.04.45.090 E019.47.59.191 N050.04.45.118 E019.47.59.277 Color_96ACI
N050.04.45.118 E019.47.59.277 N050.04.45.175 E019.47.59.325 Color_96ACI
N050.04.45.175 E019.47.59.325 N050.04.45.235 E019.47.59.313 Color_96ACI
N050.04.45.235 E019.47.59.313 N050.04.45.284 E019.47.59.244 Color_96ACI
N050.04.45.284 E019.47.59.244 N050.04.45.297 E019.47.59.164 Color_96ACI
N050.04.45.297 E019.47.59.164 N050.04.45.283 E019.47.59.084 Color_96ACI
N050.04.45.283 E019.47.59.084 N050.04.45.259 E019.47.59.039 Color_96ACI
;rwy_edg_Y N000.00.00.000 E000.00.00.000 N000.00.00.000 E000.00.00.000
N050.04.32.763 E019.46.07.311 N050.04.32.709 E019.46.07.276 Color_45ACI
N050.04.32.709 E019.46.07.276 N050.04.32.645 E019.46.07.296 Color_45ACI
N050.04.32.645 E019.46.07.296 N050.04.32.605 E019.46.07.360 Color_45ACI
N050.04.32.605 E019.46.07.360 N050.04.32.594 E019.46.07.464 Color_45ACI
N050.04.32.594 E019.46.07.464 N050.04.32.622 E019.46.07.550 Color_45ACI
N050.04.32.622 E019.46.07.550 N050.04.32.680 E019.46.07.597 Color_45ACI
N050.04.32.680 E019.46.07.597 N050.04.32.740 E019.46.07.585 Color_45ACI
N050.04.32.740 E019.46.07.585 N050.04.32.788 E019.46.07.516 Color_45ACI
N050.04.32.788 E019.46.07.516 N050.04.32.801 E019.46.07.437 Color_45ACI
N050.04.32.801 E019.46.07.437 N050.04.32.787 E019.46.07.356 Color_45ACI
N050.04.32.787 E019.46.07.356 N050.04.32.763 E019.46.07.311 Color_45ACI
N050.04.33.188 E019.46.10.280 N050.04.33.134 E019.46.10.244 Color_45ACI
N050.04.33.134 E019.46.10.244 N050.04.33.070 E019.46.10.264 Color_45ACI
N050.04.33.070 E019.46.10.264 N050.04.33.030 E019.46.10.328 Color_45ACI
N050.04.33.030 E019.46.10.328 N050.04.33.019 E019.46.10.432 Color_45ACI
N050.04.33.019 E019.46.10.432 N050.04.33.047 E019.46.10.518 Color_45ACI
N050.04.33.047 E019.46.10.518 N050.04.33.104 E019.46.10.565 Color_45ACI
N050.04.33.104 E019.46.10.565 N050.04.33.165 E019.46.10.553 Color_45ACI
N050.04.33.165 E019.46.10.553 N050.04.33.213 E019.46.10.484 Color_45ACI
N050.04.33.213 E019.46.10.484 N050.04.33.226 E019.46.10.405 Color_45ACI
N050.04.33.226 E019.46.10.405 N050.04.33.212 E019.46.10.324 Color_45ACI
N050.04.33.212 E019.46.10.324 N050.04.33.188 E019.46.10.280 Color_45ACI
N050.04.33.591 E019.46.13.198 N050.04.33.537 E019.46.13.162 Color_45ACI
N050.04.33.537 E019.46.13.162 N050.04.33.473 E019.46.13.183 Color_45ACI
N050.04.33.473 E019.46.13.183 N050.04.33.434 E019.46.13.246 Color_45ACI
N050.04.33.434 E019.46.13.246 N050.04.33.422 E019.46.13.350 Color_45ACI
N050.04.33.422 E019.46.13.350 N050.04.33.450 E019.46.13.436 Color_45ACI
N050.04.33.450 E019.46.13.436 N050.04.33.508 E019.46.13.484 Color_45ACI
N050.04.33.508 E019.46.13.484 N050.04.33.568 E019.46.13.472 Color_45ACI
N050.04.33.568 E019.46.13.472 N050.04.33.616 E019.46.13.403 Color_45ACI
N050.04.33.616 E019.46.13.403 N050.04.33.629 E019.46.13.323 Color_45ACI
N050.04.33.629 E019.46.13.323 N050.04.33.615 E019.46.13.242 Color_45ACI
N050.04.33.615 E019.46.13.242 N050.04.33.591 E019.46.13.198 Color_45ACI
N050.04.34.017 E019.46.16.223 N050.04.33.964 E019.46.16.187 Color_45ACI
N050.04.33.964 E019.46.16.187 N050.04.33.900 E019.46.16.208 Color_45ACI
N050.04.33.900 E019.46.16.208 N050.04.33.860 E019.46.16.271 Color_45ACI
N050.04.33.860 E019.46.16.271 N050.04.33.849 E019.46.16.375 Color_45ACI
N050.04.33.849 E019.46.16.375 N050.04.33.876 E019.46.16.461 Color_45ACI
N050.04.33.876 E019.46.16.461 N050.04.33.934 E019.46.16.509 Color_45ACI
N050.04.33.934 E019.46.16.509 N050.04.33.994 E019.46.16.497 Color_45ACI
N050.04.33.994 E019.46.16.497 N050.04.34.042 E019.46.16.428 Color_45ACI
N050.04.34.042 E019.46.16.428 N050.04.34.056 E019.46.16.348 Color_45ACI
N050.04.34.056 E019.46.16.348 N050.04.34.042 E019.46.16.268 Color_45ACI
N050.04.34.042 E019.46.16.268 N050.04.34.017 E019.46.16.223 Color_45ACI
N050.04.34.433 E019.46.19.199 N050.04.34.380 E019.46.19.163 Color_45ACI
N050.04.34.380 E019.46.19.163 N050.04.34.316 E019.46.19.183 Color_45ACI
N050.04.34.316 E019.46.19.183 N050.04.34.276 E019.46.19.247 Color_45ACI
N050.04.34.276 E019.46.19.247 N050.04.34.265 E019.46.19.351 Color_45ACI
N050.04.34.265 E019.46.19.351 N050.04.34.292 E019.46.19.437 Color_45ACI
N050.04.34.292 E019.46.19.437 N050.04.34.350 E019.46.19.484 Color_45ACI
N050.04.34.350 E019.46.19.484 N050.04.34.410 E019.46.19.472 Color_45ACI
N050.04.34.410 E019.46.19.472 N050.04.34.458 E019.46.19.403 Color_45ACI
N050.04.34.458 E019.46.19.403 N050.04.34.471 E019.46.19.324 Color_45ACI
N050.04.34.471 E019.46.19.324 N050.04.34.458 E019.46.19.243 Color_45ACI
N050.04.34.458 E019.46.19.243 N050.04.34.433 E019.46.19.199 Color_45ACI
N050.04.34.836 E019.46.22.138 N050.04.34.783 E019.46.22.102 Color_45ACI
N050.04.34.783 E019.46.22.102 N050.04.34.719 E019.46.22.123 Color_45ACI
N050.04.34.719 E019.46.22.123 N050.04.34.679 E019.46.22.186 Color_45ACI
N050.04.34.679 E019.46.22.186 N050.04.34.668 E019.46.22.290 Color_45ACI
N050.04.34.668 E019.46.22.290 N050.04.34.696 E019.46.22.376 Color_45ACI
N050.04.34.696 E019.46.22.376 N050.04.34.753 E019.46.22.424 Color_45ACI
N050.04.34.753 E019.46.22.424 N050.04.34.813 E019.46.22.412 Color_45ACI
N050.04.34.813 E019.46.22.412 N050.04.34.862 E019.46.22.342 Color_45ACI
N050.04.34.862 E019.46.22.342 N050.04.34.875 E019.46.22.263 Color_45ACI
N050.04.34.875 E019.46.22.263 N050.04.34.861 E019.46.22.182 Color_45ACI
N050.04.34.861 E019.46.22.182 N050.04.34.836 E019.46.22.138 Color_45ACI
N050.04.35.266 E019.46.25.080 N050.04.35.213 E019.46.25.044 Color_45ACI
N050.04.35.213 E019.46.25.044 N050.04.35.149 E019.46.25.065 Color_45ACI
N050.04.35.149 E019.46.25.065 N050.04.35.109 E019.46.25.128 Color_45ACI
N050.04.35.109 E019.46.25.128 N050.04.35.098 E019.46.25.232 Color_45ACI
N050.04.35.098 E019.46.25.232 N050.04.35.126 E019.46.25.318 Color_45ACI
N050.04.35.126 E019.46.25.318 N050.04.35.183 E019.46.25.365 Color_45ACI
N050.04.35.183 E019.46.25.365 N050.04.35.243 E019.46.25.354 Color_45ACI
N050.04.35.243 E019.46.25.354 N050.04.35.292 E019.46.25.284 Color_45ACI
N050.04.35.292 E019.46.25.284 N050.04.35.305 E019.46.25.205 Color_45ACI
N050.04.35.305 E019.46.25.205 N050.04.35.291 E019.46.25.124 Color_45ACI
N050.04.35.291 E019.46.25.124 N050.04.35.266 E019.46.25.080 Color_45ACI
N050.04.35.682 E019.46.28.027 N050.04.35.628 E019.46.27.991 Color_45ACI
N050.04.35.628 E019.46.27.991 N050.04.35.564 E019.46.28.011 Color_45ACI
N050.04.35.564 E019.46.28.011 N050.04.35.524 E019.46.28.075 Color_45ACI
N050.04.35.524 E019.46.28.075 N050.04.35.513 E019.46.28.179 Color_45ACI
N050.04.35.513 E019.46.28.179 N050.04.35.541 E019.46.28.265 Color_45ACI
N050.04.35.541 E019.46.28.265 N050.04.35.599 E019.46.28.312 Color_45ACI
N050.04.35.599 E019.46.28.312 N050.04.35.659 E019.46.28.300 Color_45ACI
N050.04.35.659 E019.46.28.300 N050.04.35.707 E019.46.28.231 Color_45ACI
N050.04.35.707 E019.46.28.231 N050.04.35.720 E019.46.28.152 Color_45ACI
N050.04.35.720 E019.46.28.152 N050.04.35.706 E019.46.28.071 Color_45ACI
N050.04.35.706 E019.46.28.071 N050.04.35.682 E019.46.28.027 Color_45ACI
N050.04.36.065 E019.46.30.925 N050.04.36.011 E019.46.30.890 Color_45ACI
N050.04.36.011 E019.46.30.890 N050.04.35.947 E019.46.30.910 Color_45ACI
N050.04.35.947 E019.46.30.910 N050.04.35.907 E019.46.30.974 Color_45ACI
N050.04.35.907 E019.46.30.974 N050.04.35.896 E019.46.31.078 Color_45ACI
N050.04.35.896 E019.46.31.078 N050.04.35.924 E019.46.31.164 Color_45ACI
N050.04.35.924 E019.46.31.164 N050.04.35.982 E019.46.31.211 Color_45ACI
N050.04.35.982 E019.46.31.211 N050.04.36.042 E019.46.31.199 Color_45ACI
N050.04.36.042 E019.46.31.199 N050.04.36.090 E019.46.31.130 Color_45ACI
N050.04.36.090 E019.46.31.130 N050.04.36.103 E019.46.31.051 Color_45ACI
N050.04.36.103 E019.46.31.051 N050.04.36.089 E019.46.30.970 Color_45ACI
N050.04.36.089 E019.46.30.970 N050.04.36.065 E019.46.30.925 Color_45ACI
N050.04.36.498 E019.46.33.890 N050.04.36.444 E019.46.33.854 Color_45ACI
N050.04.36.444 E019.46.33.854 N050.04.36.380 E019.46.33.874 Color_45ACI
N050.04.36.380 E019.46.33.874 N050.04.36.340 E019.46.33.938 Color_45ACI
N050.04.36.340 E019.46.33.938 N050.04.36.329 E019.46.34.042 Color_45ACI
N050.04.36.329 E019.46.34.042 N050.04.36.357 E019.46.34.128 Color_45ACI
N050.04.36.357 E019.46.34.128 N050.04.36.414 E019.46.34.175 Color_45ACI
N050.04.36.414 E019.46.34.175 N050.04.36.475 E019.46.34.163 Color_45ACI
N050.04.36.475 E019.46.34.163 N050.04.36.523 E019.46.34.094 Color_45ACI
N050.04.36.523 E019.46.34.094 N050.04.36.536 E019.46.34.015 Color_45ACI
N050.04.36.536 E019.46.34.015 N050.04.36.522 E019.46.33.934 Color_45ACI
N050.04.36.522 E019.46.33.934 N050.04.36.498 E019.46.33.890 Color_45ACI
N050.04.34.343 E019.46.34.603 N050.04.34.289 E019.46.34.568 Color_45ACI
N050.04.34.289 E019.46.34.568 N050.04.34.225 E019.46.34.588 Color_45ACI
N050.04.34.225 E019.46.34.588 N050.04.34.185 E019.46.34.652 Color_45ACI
N050.04.34.185 E019.46.34.652 N050.04.34.174 E019.46.34.756 Color_45ACI
N050.04.34.174 E019.46.34.756 N050.04.34.202 E019.46.34.842 Color_45ACI
N050.04.34.202 E019.46.34.842 N050.04.34.259 E019.46.34.889 Color_45ACI
N050.04.34.259 E019.46.34.889 N050.04.34.319 E019.46.34.877 Color_45ACI
N050.04.34.319 E019.46.34.877 N050.04.34.368 E019.46.34.808 Color_45ACI
N050.04.34.368 E019.46.34.808 N050.04.34.381 E019.46.34.729 Color_45ACI
N050.04.34.381 E019.46.34.729 N050.04.34.367 E019.46.34.648 Color_45ACI
N050.04.34.367 E019.46.34.648 N050.04.34.343 E019.46.34.603 Color_45ACI
N050.04.33.922 E019.46.31.632 N050.04.33.868 E019.46.31.596 Color_45ACI
N050.04.33.868 E019.46.31.596 N050.04.33.804 E019.46.31.617 Color_45ACI
N050.04.33.804 E019.46.31.617 N050.04.33.765 E019.46.31.680 Color_45ACI
N050.04.33.765 E019.46.31.680 N050.04.33.753 E019.46.31.784 Color_45ACI
N050.04.33.753 E019.46.31.784 N050.04.33.781 E019.46.31.870 Color_45ACI
N050.04.33.781 E019.46.31.870 N050.04.33.839 E019.46.31.918 Color_45ACI
N050.04.33.839 E019.46.31.918 N050.04.33.899 E019.46.31.906 Color_45ACI
N050.04.33.899 E019.46.31.906 N050.04.33.947 E019.46.31.837 Color_45ACI
N050.04.33.947 E019.46.31.837 N050.04.33.960 E019.46.31.757 Color_45ACI
N050.04.33.960 E019.46.31.757 N050.04.33.946 E019.46.31.676 Color_45ACI
N050.04.33.946 E019.46.31.676 N050.04.33.922 E019.46.31.632 Color_45ACI
N050.04.33.527 E019.46.28.722 N050.04.33.473 E019.46.28.687 Color_45ACI
N050.04.33.473 E019.46.28.687 N050.04.33.409 E019.46.28.707 Color_45ACI
N050.04.33.409 E019.46.28.707 N050.04.33.369 E019.46.28.771 Color_45ACI
N050.04.33.369 E019.46.28.771 N050.04.33.358 E019.46.28.875 Color_45ACI
N050.04.33.358 E019.46.28.875 N050.04.33.386 E019.46.28.961 Color_45ACI
N050.04.33.386 E019.46.28.961 N050.04.33.443 E019.46.29.008 Color_45ACI
N050.04.33.443 E019.46.29.008 N050.04.33.503 E019.46.28.996 Color_45ACI
N050.04.33.503 E019.46.28.996 N050.04.33.552 E019.46.28.927 Color_45ACI
N050.04.33.552 E019.46.28.927 N050.04.33.565 E019.46.28.848 Color_45ACI
N050.04.33.565 E019.46.28.848 N050.04.33.551 E019.46.28.767 Color_45ACI
N050.04.33.551 E019.46.28.767 N050.04.33.527 E019.46.28.722 Color_45ACI
N050.04.33.115 E019.46.25.787 N050.04.33.061 E019.46.25.751 Color_45ACI
N050.04.33.061 E019.46.25.751 N050.04.32.997 E019.46.25.771 Color_45ACI
N050.04.32.997 E019.46.25.771 N050.04.32.958 E019.46.25.835 Color_45ACI
N050.04.32.958 E019.46.25.835 N050.04.32.946 E019.46.25.939 Color_45ACI
N050.04.32.946 E019.46.25.939 N050.04.32.974 E019.46.26.025 Color_45ACI
N050.04.32.974 E019.46.26.025 N050.04.33.032 E019.46.26.072 Color_45ACI
N050.04.33.032 E019.46.26.072 N050.04.33.092 E019.46.26.060 Color_45ACI
N050.04.33.092 E019.46.26.060 N050.04.33.140 E019.46.25.991 Color_45ACI
N050.04.33.140 E019.46.25.991 N050.04.33.153 E019.46.25.912 Color_45ACI
N050.04.33.153 E019.46.25.912 N050.04.33.139 E019.46.25.831 Color_45ACI
N050.04.33.139 E019.46.25.831 N050.04.33.115 E019.46.25.787 Color_45ACI
N050.04.32.704 E019.46.22.792 N050.04.32.650 E019.46.22.757 Color_45ACI
N050.04.32.650 E019.46.22.757 N050.04.32.586 E019.46.22.777 Color_45ACI
N050.04.32.586 E019.46.22.777 N050.04.32.547 E019.46.22.841 Color_45ACI
N050.04.32.547 E019.46.22.841 N050.04.32.535 E019.46.22.945 Color_45ACI
N050.04.32.535 E019.46.22.945 N050.04.32.563 E019.46.23.031 Color_45ACI
N050.04.32.563 E019.46.23.031 N050.04.32.621 E019.46.23.078 Color_45ACI
N050.04.32.621 E019.46.23.078 N050.04.32.681 E019.46.23.066 Color_45ACI
N050.04.32.681 E019.46.23.066 N050.04.32.729 E019.46.22.997 Color_45ACI
N050.04.32.729 E019.46.22.997 N050.04.32.742 E019.46.22.918 Color_45ACI
N050.04.32.742 E019.46.22.918 N050.04.32.728 E019.46.22.837 Color_45ACI
N050.04.32.728 E019.46.22.837 N050.04.32.704 E019.46.22.792 Color_45ACI
N050.04.31.865 E019.46.16.984 N050.04.31.811 E019.46.16.949 Color_45ACI
N050.04.31.811 E019.46.16.949 N050.04.31.747 E019.46.16.969 Color_45ACI
N050.04.31.747 E019.46.16.969 N050.04.31.707 E019.46.17.033 Color_45ACI
N050.04.31.707 E019.46.17.033 N050.04.31.696 E019.46.17.137 Color_45ACI
N050.04.31.696 E019.46.17.137 N050.04.31.724 E019.46.17.223 Color_45ACI
N050.04.31.724 E019.46.17.223 N050.04.31.781 E019.46.17.270 Color_45ACI
N050.04.31.781 E019.46.17.270 N050.04.31.841 E019.46.17.258 Color_45ACI
N050.04.31.841 E019.46.17.258 N050.04.31.890 E019.46.17.189 Color_45ACI
N050.04.31.890 E019.46.17.189 N050.04.31.903 E019.46.17.110 Color_45ACI
N050.04.31.903 E019.46.17.110 N050.04.31.889 E019.46.17.029 Color_45ACI
N050.04.31.889 E019.46.17.029 N050.04.31.865 E019.46.16.984 Color_45ACI
N050.04.31.440 E019.46.13.923 N050.04.31.387 E019.46.13.888 Color_45ACI
N050.04.31.387 E019.46.13.888 N050.04.31.323 E019.46.13.908 Color_45ACI
N050.04.31.323 E019.46.13.908 N050.04.31.283 E019.46.13.972 Color_45ACI
N050.04.31.283 E019.46.13.972 N050.04.31.272 E019.46.14.076 Color_45ACI
N050.04.31.272 E019.46.14.076 N050.04.31.299 E019.46.14.162 Color_45ACI
N050.04.31.299 E019.46.14.162 N050.04.31.357 E019.46.14.209 Color_45ACI
N050.04.31.357 E019.46.14.209 N050.04.31.417 E019.46.14.197 Color_45ACI
N050.04.31.417 E019.46.14.197 N050.04.31.465 E019.46.14.128 Color_45ACI
N050.04.31.465 E019.46.14.128 N050.04.31.479 E019.46.14.049 Color_45ACI
N050.04.31.479 E019.46.14.049 N050.04.31.465 E019.46.13.968 Color_45ACI
N050.04.31.465 E019.46.13.968 N050.04.31.440 E019.46.13.923 Color_45ACI
N050.04.31.035 E019.46.10.972 N050.04.30.981 E019.46.10.936 Color_45ACI
N050.04.30.981 E019.46.10.936 N050.04.30.917 E019.46.10.957 Color_45ACI
N050.04.30.917 E019.46.10.957 N050.04.30.877 E019.46.11.020 Color_45ACI
N050.04.30.877 E019.46.11.020 N050.04.30.866 E019.46.11.124 Color_45ACI
N050.04.30.866 E019.46.11.124 N050.04.30.894 E019.46.11.210 Color_45ACI
N050.04.30.894 E019.46.11.210 N050.04.30.952 E019.46.11.258 Color_45ACI
N050.04.30.952 E019.46.11.258 N050.04.31.012 E019.46.11.246 Color_45ACI
N050.04.31.012 E019.46.11.246 N050.04.31.060 E019.46.11.176 Color_45ACI
N050.04.31.060 E019.46.11.176 N050.04.31.073 E019.46.11.097 Color_45ACI
N050.04.31.073 E019.46.11.097 N050.04.31.059 E019.46.11.016 Color_45ACI
N050.04.31.059 E019.46.11.016 N050.04.31.035 E019.46.10.972 Color_45ACI
;rwy_markings N000.00.00.000 E000.00.00.000 N000.00.00.000 E000.00.00.000
N050.04.45.957 E019.47.57.037 N050.04.46.164 E019.47.58.543 Color_252ACI
N050.04.46.217 E019.47.56.949 N050.04.46.427 E019.47.58.454 Color_252ACI
N050.04.46.456 E019.47.56.868 N050.04.46.666 E019.47.58.373 Color_252ACI
N050.04.46.719 E019.47.56.779 N050.04.46.929 E019.47.58.284 Color_252ACI
N050.04.46.977 E019.47.56.692 N050.04.47.187 E019.47.58.197 Color_252ACI
N050.04.47.221 E019.47.56.609 N050.04.47.431 E019.47.58.114 Color_252ACI
N050.04.47.484 E019.47.56.520 N050.04.47.694 E019.47.58.025 Color_252ACI
N050.04.47.711 E019.47.56.443 N050.04.47.921 E019.47.57.948 Color_252ACI
N050.04.33.052 E019.46.20.063 N050.04.33.215 E019.46.21.188 Color_252ACI
N050.04.32.915 E019.46.20.123 N050.04.33.074 E019.46.21.256 Color_252ACI
N050.04.32.752 E019.46.20.160 N050.04.32.910 E019.46.21.286 Color_252ACI
N050.04.32.028 E019.46.12.732 N050.04.32.185 E019.46.13.826 Color_252ACI
N050.04.31.901 E019.46.12.751 N050.04.32.058 E019.46.13.845 Color_252ACI
N050.04.31.774 E019.46.12.769 N050.04.31.931 E019.46.13.864 Color_252ACI
N050.04.46.451 E019.47.56.132 N050.04.46.445 E019.47.56.033 Color_252ACI
N050.04.46.445 E019.47.56.033 N050.04.46.466 E019.47.55.951 Color_252ACI
N050.04.46.466 E019.47.55.951 N050.04.46.503 E019.47.55.925 Color_252ACI
N050.04.46.503 E019.47.55.925 N050.04.46.503 E019.47.55.925 Color_252ACI
N050.04.46.503 E019.47.55.925 N050.04.46.540 E019.47.55.900 Color_252ACI
N050.04.46.540 E019.47.55.900 N050.04.46.593 E019.47.55.932 Color_252ACI
N050.04.46.593 E019.47.55.932 N050.04.46.609 E019.47.55.989 Color_252ACI
N050.04.46.609 E019.47.55.989 N050.04.46.625 E019.47.56.047 Color_252ACI
N050.04.46.625 E019.47.56.047 N050.04.46.615 E019.47.56.088 Color_252ACI
N050.04.46.615 E019.47.56.088 N050.04.46.615 E019.47.56.088 Color_252ACI
N050.04.46.615 E019.47.56.088 N050.04.46.547 E019.47.56.238 Color_252ACI
N050.04.46.547 E019.47.56.238 N050.04.46.377 E019.47.56.776 Color_252ACI
N050.04.46.377 E019.47.56.776 N050.04.46.814 E019.47.56.628 Color_252ACI
N050.04.46.814 E019.47.56.628 N050.04.46.793 E019.47.56.481 Color_252ACI
N050.04.46.793 E019.47.56.481 N050.04.46.569 E019.47.56.548 Color_252ACI
N050.04.46.569 E019.47.56.548 N050.04.46.605 E019.47.56.431 Color_252ACI
N050.04.46.605 E019.47.56.431 N050.04.46.605 E019.47.56.431 Color_252ACI
N050.04.46.605 E019.47.56.431 N050.04.46.654 E019.47.56.302 Color_252ACI
N050.04.46.654 E019.47.56.302 N050.04.46.732 E019.47.56.111 Color_252ACI
N050.04.46.732 E019.47.56.111 N050.04.46.736 E019.47.55.970 Color_252ACI
N050.04.46.736 E019.47.55.970 N050.04.46.720 E019.47.55.913 Color_252ACI
N050.04.46.720 E019.47.55.913 N050.04.46.704 E019.47.55.881 Color_252ACI
N050.04.46.704 E019.47.55.881 N050.04.46.704 E019.47.55.881 Color_252ACI
N050.04.46.704 E019.47.55.881 N050.04.46.677 E019.47.55.839 Color_252ACI
N050.04.46.677 E019.47.55.839 N050.04.46.624 E019.47.55.807 Color_252ACI
N050.04.46.624 E019.47.55.807 N050.04.46.597 E019.47.55.791 Color_252ACI
N050.04.46.597 E019.47.55.791 N050.04.46.570 E019.47.55.775 Color_252ACI
N050.04.46.570 E019.47.55.775 N050.04.46.507 E019.47.55.785 Color_252ACI
N050.04.46.507 E019.47.55.785 N050.04.46.470 E019.47.55.810 Color_252ACI
N050.04.46.470 E019.47.55.810 N050.04.46.433 E019.47.55.836 Color_252ACI
N050.04.46.433 E019.47.55.836 N050.04.46.396 E019.47.55.861 Color_252ACI
N050.04.46.396 E019.47.55.861 N050.04.46.349 E019.47.55.928 Color_252ACI
N050.04.46.349 E019.47.55.928 N050.04.46.339 E019.47.55.969 Color_252ACI
N050.04.46.339 E019.47.55.969 N050.04.46.351 E019.47.56.167 Color_252ACI
N050.04.46.351 E019.47.56.167 N050.04.46.451 E019.47.56.132 Color_252ACI
N050.04.46.931 E019.47.55.821 N050.04.47.158 E019.47.55.748 Color_252ACI
N050.04.47.158 E019.47.55.748 N050.04.47.135 E019.47.55.592 Color_252ACI
N050.04.47.135 E019.47.55.592 N050.04.46.834 E019.47.55.696 Color_252ACI
N050.04.46.834 E019.47.55.696 N050.04.46.865 E019.47.56.191 Color_252ACI
N050.04.46.865 E019.47.56.191 N050.04.46.965 E019.47.56.156 Color_252ACI
N050.04.46.965 E019.47.56.156 N050.04.46.975 E019.47.56.114 Color_252ACI
N050.04.46.975 E019.47.56.114 N050.04.47.012 E019.47.56.089 Color_252ACI
N050.04.47.012 E019.47.56.089 N050.04.47.012 E019.47.56.089 Color_252ACI
N050.04.47.012 E019.47.56.089 N050.04.47.012 E019.47.56.089 Color_252ACI
N050.04.47.012 E019.47.56.089 N050.04.47.076 E019.47.56.080 Color_252ACI
N050.04.47.076 E019.47.56.080 N050.04.47.102 E019.47.56.096 Color_252ACI
N050.04.47.102 E019.47.56.096 N050.04.47.118 E019.47.56.153 Color_252ACI
N050.04.47.118 E019.47.56.153 N050.04.47.135 E019.47.56.210 Color_252ACI
N050.04.47.135 E019.47.56.210 N050.04.47.151 E019.47.56.268 Color_252ACI
N050.04.47.151 E019.47.56.268 N050.04.47.120 E019.47.56.392 Color_252ACI
N050.04.47.120 E019.47.56.392 N050.04.47.083 E019.47.56.418 Color_252ACI
N050.04.47.083 E019.47.56.418 N050.04.47.057 E019.47.56.413 Color_252ACI
N050.04.47.057 E019.47.56.413 N050.04.47.033 E019.47.56.406 Color_252ACI
N050.04.47.033 E019.47.56.406 N050.04.47.004 E019.47.56.370 Color_252ACI
N050.04.47.004 E019.47.56.370 N050.04.47.004 E019.47.56.370 Color_252ACI
N050.04.47.004 E019.47.56.370 N050.04.46.993 E019.47.56.332 Color_252ACI
N050.04.46.993 E019.47.56.332 N050.04.46.872 E019.47.56.368 Color_252ACI
N050.04.46.872 E019.47.56.368 N050.04.46.893 E019.47.56.446 Color_252ACI
N050.04.46.893 E019.47.56.446 N050.04.46.893 E019.47.56.446 Color_252ACI
N050.04.46.893 E019.47.56.446 N050.04.46.963 E019.47.56.535 Color_252ACI
N050.04.46.963 E019.47.56.535 N050.04.46.989 E019.47.56.551 Color_252ACI
N050.04.46.989 E019.47.56.551 N050.04.47.087 E019.47.56.535 Color_252ACI
N050.04.47.087 E019.47.56.535 N050.04.47.125 E019.47.56.527 Color_252ACI
N050.04.47.125 E019.47.56.527 N050.04.47.190 E019.47.56.482 Color_252ACI
N050.04.47.190 E019.47.56.482 N050.04.47.233 E019.47.56.356 Color_252ACI
N050.04.47.233 E019.47.56.356 N050.04.47.251 E019.47.56.233 Color_252ACI
N050.04.47.251 E019.47.56.233 N050.04.47.251 E019.47.56.233 Color_252ACI
N050.04.47.251 E019.47.56.233 N050.04.47.245 E019.47.56.134 Color_252ACI
N050.04.47.245 E019.47.56.134 N050.04.47.229 E019.47.56.077 Color_252ACI
N050.04.47.229 E019.47.56.077 N050.04.47.213 E019.47.56.019 Color_252ACI
N050.04.47.213 E019.47.56.019 N050.04.47.186 E019.47.56.003 Color_252ACI
N050.04.47.186 E019.47.56.003 N050.04.47.106 E019.47.55.955 Color_252ACI
N050.04.47.106 E019.47.55.955 N050.04.47.016 E019.47.55.949 Color_252ACI
N050.04.47.016 E019.47.55.949 N050.04.47.016 E019.47.55.949 Color_252ACI
N050.04.47.016 E019.47.55.949 N050.04.46.979 E019.47.55.974 Color_252ACI
N050.04.46.979 E019.47.55.974 N050.04.46.979 E019.47.55.974 Color_252ACI
N050.04.46.979 E019.47.55.974 N050.04.46.943 E019.47.56.000 Color_252ACI
N050.04.46.943 E019.47.56.000 N050.04.46.932 E019.47.56.041 Color_252ACI
N050.04.46.932 E019.47.56.041 N050.04.46.931 E019.47.55.821 Color_252ACI
N050.04.31.989 E019.46.07.065 N050.04.31.972 E019.46.06.929 Color_252ACI
N050.04.31.972 E019.46.06.929 N050.04.31.972 E019.46.06.929 Color_252ACI
N050.04.31.972 E019.46.06.929 N050.04.31.916 E019.46.06.718 Color_252ACI
N050.04.31.916 E019.46.06.718 N050.04.31.844 E019.46.06.604 Color_252ACI
N050.04.31.844 E019.46.06.604 N050.04.31.755 E019.46.06.585 Color_252ACI
N050.04.31.755 E019.46.06.585 N050.04.31.697 E019.46.06.602 Color_252ACI
N050.04.31.697 E019.46.06.602 N050.04.31.619 E019.46.06.673 Color_252ACI
N050.04.31.619 E019.46.06.673 N050.04.31.578 E019.46.06.824 Color_252ACI
N050.04.31.578 E019.46.06.824 N050.04.31.577 E019.46.07.045 Color_252ACI
N050.04.31.577 E019.46.07.045 N050.04.31.595 E019.46.07.185 Color_252ACI
N050.04.31.595 E019.46.07.185 N050.04.31.650 E019.46.07.391 Color_252ACI
N050.04.31.650 E019.46.07.391 N050.04.31.650 E019.46.07.391 Color_252ACI
N050.04.31.650 E019.46.07.391 N050.04.31.723 E019.46.07.506 Color_252ACI
N050.04.31.723 E019.46.07.506 N050.04.31.812 E019.46.07.524 Color_252ACI
N050.04.31.812 E019.46.07.524 N050.04.31.812 E019.46.07.524 Color_252ACI
N050.04.31.812 E019.46.07.524 N050.04.31.869 E019.46.07.506 Color_252ACI
N050.04.31.869 E019.46.07.506 N050.04.31.951 E019.46.07.439 Color_252ACI
N050.04.31.951 E019.46.07.439 N050.04.31.987 E019.46.07.289 Color_252ACI
N050.04.31.987 E019.46.07.289 N050.04.31.989 E019.46.07.065 Color_252ACI
N050.04.31.874 E019.46.07.068 N050.04.31.874 E019.46.07.068 Color_252ACI
N050.04.31.874 E019.46.07.068 N050.04.31.891 E019.46.07.125 Color_252ACI
N050.04.31.891 E019.46.07.125 N050.04.31.897 E019.46.07.224 Color_252ACI
N050.04.31.897 E019.46.07.224 N050.04.31.886 E019.46.07.265 Color_252ACI
N050.04.31.886 E019.46.07.265 N050.04.31.866 E019.46.07.348 Color_252ACI
N050.04.31.866 E019.46.07.348 N050.04.31.829 E019.46.07.374 Color_252ACI
N050.04.31.829 E019.46.07.374 N050.04.31.776 E019.46.07.342 Color_252ACI
N050.04.31.776 E019.46.07.342 N050.04.31.749 E019.46.07.326 Color_252ACI
N050.04.31.749 E019.46.07.326 N050.04.31.733 E019.46.07.268 Color_252ACI
N050.04.31.733 E019.46.07.268 N050.04.31.733 E019.46.07.268 Color_252ACI
N050.04.31.733 E019.46.07.268 N050.04.31.717 E019.46.07.211 Color_252ACI
N050.04.31.717 E019.46.07.211 N050.04.31.694 E019.46.07.054 Color_252ACI
N050.04.31.694 E019.46.07.054 N050.04.31.688 E019.46.06.955 Color_252ACI
N050.04.31.688 E019.46.06.955 N050.04.31.688 E019.46.06.955 Color_252ACI
N050.04.31.688 E019.46.06.955 N050.04.31.682 E019.46.06.857 Color_252ACI
N050.04.31.682 E019.46.06.857 N050.04.31.703 E019.46.06.774 Color_252ACI
N050.04.31.703 E019.46.06.774 N050.04.31.740 E019.46.06.748 Color_252ACI
N050.04.31.740 E019.46.06.748 N050.04.31.740 E019.46.06.748 Color_252ACI
N050.04.31.740 E019.46.06.748 N050.04.31.784 E019.46.06.733 Color_252ACI
N050.04.31.784 E019.46.06.733 N050.04.31.784 E019.46.06.733 Color_252ACI
N050.04.31.784 E019.46.06.733 N050.04.31.817 E019.46.06.775 Color_252ACI
N050.04.31.817 E019.46.06.775 N050.04.31.852 E019.46.06.911 Color_252ACI
N050.04.31.852 E019.46.06.911 N050.04.31.868 E019.46.06.969 Color_252ACI
N050.04.31.868 E019.46.06.969 N050.04.31.868 E019.46.06.969 Color_252ACI
N050.04.31.868 E019.46.06.969 N050.04.31.874 E019.46.07.068 Color_252ACI
N050.04.31.171 E019.46.07.720 N050.04.31.561 E019.46.07.593 Color_252ACI
N050.04.31.561 E019.46.07.593 N050.04.31.538 E019.46.07.437 Color_252ACI
N050.04.31.538 E019.46.07.437 N050.04.31.274 E019.46.07.527 Color_252ACI
N050.04.31.274 E019.46.07.527 N050.04.31.305 E019.46.07.299 Color_252ACI
N050.04.31.305 E019.46.07.299 N050.04.31.305 E019.46.07.299 Color_252ACI
N050.04.31.305 E019.46.07.299 N050.04.31.369 E019.46.06.763 Color_252ACI
N050.04.31.369 E019.46.06.763 N050.04.31.269 E019.46.06.798 Color_252ACI
N050.04.31.269 E019.46.06.798 N050.04.31.156 E019.46.07.568 Color_252ACI
N050.04.31.156 E019.46.07.568 N050.04.31.171 E019.46.07.720 Color_252ACI
N050.04.48.075 E019.48.05.729 N050.04.48.274 E019.48.07.515 Color_252ACI
N050.04.44.315 E019.47.40.836 N050.04.44.009 E019.47.40.940 Color_252ACI
N050.04.44.009 E019.47.40.940 N050.04.44.315 E019.47.43.126 Color_252ACI
N050.04.44.315 E019.47.43.126 N050.04.44.620 E019.47.43.023 Color_252ACI
N050.04.44.620 E019.47.43.023 N050.04.44.315 E019.47.40.836 Color_252ACI
N050.04.41.452 E019.47.20.402 N050.04.41.609 E019.47.21.496 Color_252ACI
N050.04.37.177 E019.46.49.585 N050.04.37.331 E019.46.50.684 Color_252ACI
N050.04.36.147 E019.46.42.212 N050.04.36.302 E019.46.43.309 Color_252ACI
N050.04.35.119 E019.46.34.829 N050.04.35.271 E019.46.35.921 Color_252ACI
N050.04.34.943 E019.46.34.868 N050.04.35.100 E019.46.35.990 Color_252ACI
N050.04.46.107 E019.47.49.417 N050.04.46.258 E019.47.50.503 Color_252ACI
N050.04.46.271 E019.47.49.363 N050.04.46.423 E019.47.50.447 Color_252ACI
N050.04.44.881 E019.47.40.644 N050.04.45.202 E019.47.40.535 Color_252ACI
N050.04.45.202 E019.47.40.535 N050.04.45.507 E019.47.42.722 Color_252ACI
N050.04.45.507 E019.47.42.722 N050.04.45.186 E019.47.42.831 Color_252ACI
N050.04.45.186 E019.47.42.831 N050.04.44.881 E019.47.40.644 Color_252ACI
N050.04.42.028 E019.47.20.177 N050.04.42.174 E019.47.21.312 Color_252ACI
N050.04.37.738 E019.46.49.356 N050.04.37.896 E019.46.50.488 Color_252ACI
N050.04.36.772 E019.46.41.999 N050.04.36.929 E019.46.43.125 Color_252ACI
N050.04.35.685 E019.46.34.640 N050.04.35.837 E019.46.35.728 Color_252ACI
N050.04.35.836 E019.46.34.596 N050.04.35.992 E019.46.35.690 Color_252ACI
N050.04.33.624 E019.46.19.870 N050.04.33.774 E019.46.20.974 Color_252ACI
N050.04.33.773 E019.46.19.778 N050.04.33.924 E019.46.20.890 Color_252ACI
N050.04.33.947 E019.46.19.767 N050.04.34.104 E019.46.20.893 Color_252ACI
N050.04.32.919 E019.46.12.400 N050.04.33.071 E019.46.13.488 Color_252ACI
N050.04.32.745 E019.46.12.457 N050.04.32.900 E019.46.13.565 Color_252ACI
N050.04.32.597 E019.46.12.506 N050.04.32.752 E019.46.13.616 Color_252ACI
N050.04.46.428 E019.47.49.309 N050.04.46.579 E019.47.50.395 Color_252ACI
N050.04.45.385 E019.47.49.663 N050.04.45.536 E019.47.50.748 Color_252ACI
N050.04.45.236 E019.47.49.714 N050.04.45.387 E019.47.50.799 Color_252ACI
N050.04.45.541 E019.47.49.610 N050.04.45.693 E019.47.50.695 Color_252ACI
N050.04.31.989 E019.46.07.065 N050.04.31.972 E019.46.06.929 Color_252ACI
N050.04.31.972 E019.46.06.929 N050.04.31.972 E019.46.06.929 Color_252ACI
N050.04.31.972 E019.46.06.929 N050.04.31.916 E019.46.06.718 Color_252ACI
N050.04.31.916 E019.46.06.718 N050.04.31.844 E019.46.06.604 Color_252ACI
N050.04.31.844 E019.46.06.604 N050.04.31.755 E019.46.06.585 Color_252ACI
N050.04.31.755 E019.46.06.585 N050.04.31.697 E019.46.06.602 Color_252ACI
N050.04.31.697 E019.46.06.602 N050.04.31.619 E019.46.06.673 Color_252ACI
N050.04.31.619 E019.46.06.673 N050.04.31.578 E019.46.06.824 Color_252ACI
N050.04.31.578 E019.46.06.824 N050.04.31.577 E019.46.07.045 Color_252ACI
N050.04.31.577 E019.46.07.045 N050.04.31.595 E019.46.07.185 Color_252ACI
N050.04.31.595 E019.46.07.185 N050.04.31.650 E019.46.07.391 Color_252ACI
N050.04.31.650 E019.46.07.391 N050.04.31.650 E019.46.07.391 Color_252ACI
N050.04.31.650 E019.46.07.391 N050.04.31.723 E019.46.07.506 Color_252ACI
N050.04.31.723 E019.46.07.506 N050.04.31.812 E019.46.07.524 Color_252ACI
N050.04.31.812 E019.46.07.524 N050.04.31.812 E019.46.07.524 Color_252ACI
N050.04.31.812 E019.46.07.524 N050.04.31.869 E019.46.07.506 Color_252ACI
N050.04.31.869 E019.46.07.506 N050.04.31.951 E019.46.07.439 Color_252ACI
N050.04.31.951 E019.46.07.439 N050.04.31.987 E019.46.07.289 Color_252ACI
N050.04.31.987 E019.46.07.289 N050.04.31.989 E019.46.07.065 Color_252ACI
N050.04.31.989 E019.46.07.065 N050.04.31.972 E019.46.06.929 Color_252ACI
N050.04.31.972 E019.46.06.929 N050.04.31.972 E019.46.06.929 Color_252ACI
N050.04.31.972 E019.46.06.929 N050.04.31.916 E019.46.06.718 Color_252ACI
N050.04.31.916 E019.46.06.718 N050.04.31.844 E019.46.06.604 Color_252ACI
N050.04.31.844 E019.46.06.604 N050.04.31.755 E019.46.06.585 Color_252ACI
N050.04.31.755 E019.46.06.585 N050.04.31.697 E019.46.06.602 Color_252ACI
N050.04.31.697 E019.46.06.602 N050.04.31.619 E019.46.06.673 Color_252ACI
N050.04.31.619 E019.46.06.673 N050.04.31.578 E019.46.06.824 Color_252ACI
N050.04.31.578 E019.46.06.824 N050.04.31.577 E019.46.07.045 Color_252ACI
N050.04.31.577 E019.46.07.045 N050.04.31.595 E019.46.07.185 Color_252ACI
N050.04.31.595 E019.46.07.185 N050.04.31.650 E019.46.07.391 Color_252ACI
N050.04.31.650 E019.46.07.391 N050.04.31.650 E019.46.07.391 Color_252ACI
N050.04.31.650 E019.46.07.391 N050.04.31.723 E019.46.07.506 Color_252ACI
N050.04.31.723 E019.46.07.506 N050.04.31.812 E019.46.07.524 Color_252ACI
N050.04.31.812 E019.46.07.524 N050.04.31.812 E019.46.07.524 Color_252ACI
N050.04.31.812 E019.46.07.524 N050.04.31.869 E019.46.07.506 Color_252ACI
N050.04.31.869 E019.46.07.506 N050.04.31.951 E019.46.07.439 Color_252ACI
N050.04.31.951 E019.46.07.439 N050.04.31.987 E019.46.07.289 Color_252ACI
N050.04.31.987 E019.46.07.289 N050.04.31.989 E019.46.07.065 Color_252ACI
N050.04.30.383 E019.46.05.397 N050.04.30.590 E019.46.06.903 Color_252ACI
N050.04.30.643 E019.46.05.309 N050.04.30.853 E019.46.06.814 Color_252ACI
N050.04.30.883 E019.46.05.228 N050.04.31.093 E019.46.06.733 Color_252ACI
N050.04.31.145 E019.46.05.139 N050.04.31.355 E019.46.06.644 Color_252ACI
N050.04.31.403 E019.46.05.052 N050.04.31.613 E019.46.06.557 Color_252ACI
N050.04.31.647 E019.46.04.969 N050.04.31.857 E019.46.06.474 Color_252ACI
N050.04.31.910 E019.46.04.880 N050.04.32.120 E019.46.06.385 Color_252ACI
N050.04.32.137 E019.46.04.803 N050.04.32.347 E019.46.06.308 Color_252ACI
N050.04.33.774 E019.46.25.177 N050.04.33.468 E019.46.25.281 Color_252ACI
N050.04.33.468 E019.46.25.281 N050.04.33.774 E019.46.27.467 Color_252ACI
N050.04.33.774 E019.46.27.467 N050.04.34.079 E019.46.27.364 Color_252ACI
N050.04.34.079 E019.46.27.364 N050.04.33.774 E019.46.25.177 Color_252ACI
N050.04.34.340 E019.46.24.985 N050.04.34.661 E019.46.24.876 Color_252ACI
N050.04.34.661 E019.46.24.876 N050.04.34.966 E019.46.27.063 Color_252ACI
N050.04.34.966 E019.46.27.063 N050.04.34.645 E019.46.27.172 Color_252ACI
N050.04.34.645 E019.46.27.172 N050.04.34.340 E019.46.24.985 Color_252ACI
N050.04.40.432 E019.47.13.062 N050.04.40.588 E019.47.14.156 Color_252ACI
N050.04.41.007 E019.47.12.837 N050.04.41.153 E019.47.13.973 Color_252ACI
N050.04.44.067 E019.47.34.801 N050.04.44.218 E019.47.35.887 Color_252ACI
N050.04.44.231 E019.47.34.746 N050.04.44.382 E019.47.35.831 Color_252ACI
N050.04.43.345 E019.47.35.046 N050.04.43.496 E019.47.36.131 Color_252ACI
N050.04.43.501 E019.47.34.994 N050.04.43.652 E019.47.36.078 Color_252ACI
N050.04.43.046 E019.47.27.493 N050.04.43.197 E019.47.28.579 Color_252ACI
N050.04.43.210 E019.47.27.438 N050.04.43.361 E019.47.28.523 Color_252ACI
N050.04.42.323 E019.47.27.739 N050.04.42.475 E019.47.28.823 Color_252ACI
N050.04.42.480 E019.47.27.686 N050.04.42.631 E019.47.28.770 Color_252ACI
N050.04.48.419 E019.48.08.052 N050.04.48.282 E019.48.07.085 Color_252ACI
N050.04.48.325 E019.48.07.048 N050.04.48.220 E019.48.06.630 Color_252ACI
N050.04.48.220 E019.48.06.630 N050.04.48.233 E019.48.07.073 Color_252ACI
N050.04.48.069 E019.48.05.594 N050.04.47.932 E019.48.04.628 Color_252ACI
N050.04.47.975 E019.48.04.590 N050.04.47.870 E019.48.04.172 Color_252ACI
N050.04.47.870 E019.48.04.172 N050.04.47.883 E019.48.04.615 Color_252ACI
N050.04.47.729 E019.48.03.148 N050.04.47.592 E019.48.02.181 Color_252ACI
N050.04.47.635 E019.48.02.144 N050.04.47.530 E019.48.01.725 Color_252ACI
N050.04.47.530 E019.48.01.725 N050.04.47.543 E019.48.02.168 Color_252ACI
N050.04.47.385 E019.48.00.672 N050.04.47.249 E019.47.59.705 Color_252ACI
N050.04.47.292 E019.47.59.668 N050.04.47.187 E019.47.59.249 Color_252ACI
N050.04.47.187 E019.47.59.249 N050.04.47.199 E019.47.59.692 Color_252ACI


LOTNISKA_EPBC N000.00.00.000 E000.00.00.000 N000.00.00.000 E000.00.00.000
N052.16.02.693 E020.53.49.680 N052.16.02.219 E020.53.52.903 Color_251ACI
N052.16.02.219 E020.53.52.903 N052.15.57.651 E020.54.25.759 Color_251ACI
N052.15.57.651 E020.54.25.759 N052.15.56.998 E020.54.26.584 Color_251ACI
N052.15.56.998 E020.54.26.584 N052.15.41.873 E020.54.38.861 Color_251ACI
N052.15.41.873 E020.54.38.861 N052.15.40.922 E020.54.39.548 Color_251ACI
N052.15.40.922 E020.54.39.548 N052.15.39.436 E020.54.40.759 Color_251ACI
N052.15.39.436 E020.54.40.759 N052.15.39.249 E020.54.40.749 Color_251ACI
N052.15.39.249 E020.54.40.749 N052.15.39.100 E020.54.40.680 Color_251ACI
N052.15.39.100 E020.54.40.680 N052.15.38.990 E020.54.40.552 Color_251ACI
N052.15.38.990 E020.54.40.552 N052.15.38.636 E020.54.39.431 Color_251ACI
N052.15.38.636 E020.54.39.431 N052.15.38.142 E020.54.37.812 Color_251ACI
N052.15.38.142 E020.54.37.812 N052.15.35.817 E020.54.39.777 Color_251ACI
N052.15.35.817 E020.54.39.777 N052.15.35.961 E020.54.40.091 Color_251ACI
N052.15.35.961 E020.54.40.091 N052.15.35.312 E020.54.40.670 Color_251ACI
N052.15.35.312 E020.54.40.670 N052.15.35.738 E020.54.41.917 Color_251ACI
N052.15.35.738 E020.54.41.917 N052.15.36.271 E020.54.41.516 Color_251ACI
N052.15.36.271 E020.54.41.516 N052.15.36.627 E020.54.42.515 Color_251ACI
N052.15.36.627 E020.54.42.515 N052.15.36.499 E020.54.43.305 Color_251ACI
N052.15.36.499 E020.54.43.305 N052.15.36.384 E020.54.43.421 Color_251ACI
N052.15.36.384 E020.54.43.421 N052.15.32.689 E020.54.46.418 Color_251ACI
N052.15.32.689 E020.54.46.418 N052.15.32.466 E020.54.46.285 Color_251ACI
N052.15.32.466 E020.54.46.285 N052.15.31.323 E020.54.47.206 Color_251ACI
N052.15.31.323 E020.54.47.206 N052.15.30.870 E020.54.47.367 Color_251ACI
N052.15.30.870 E020.54.47.367 N052.15.27.429 E020.54.42.963 Color_251ACI
N052.15.27.429 E020.54.42.963 N052.15.27.322 E020.54.42.651 Color_251ACI
N052.15.27.322 E020.54.42.651 N052.15.27.292 E020.54.42.281 Color_251ACI
N052.15.27.292 E020.54.42.281 N052.15.27.336 E020.54.41.916 Color_251ACI
N052.15.27.336 E020.54.41.916 N052.15.28.124 E020.54.39.934 Color_251ACI
N052.15.28.124 E020.54.39.934 N052.15.28.321 E020.54.39.454 Color_251ACI
N052.15.28.321 E020.54.39.454 N052.15.27.113 E020.54.37.922 Color_251ACI
N052.15.27.113 E020.54.37.922 N052.15.26.746 E020.54.37.474 Color_251ACI
N052.15.26.746 E020.54.37.474 N052.15.26.552 E020.54.37.832 Color_251ACI
N052.15.26.552 E020.54.37.832 N052.15.25.651 E020.54.39.808 Color_251ACI
N052.15.25.651 E020.54.39.808 N052.15.25.613 E020.54.39.867 Color_251ACI
N052.15.25.613 E020.54.39.867 N052.15.25.497 E020.54.40.045 Color_251ACI
N052.15.25.497 E020.54.40.045 N052.15.25.458 E020.54.40.104 Color_251ACI
N052.15.25.458 E020.54.40.104 N052.15.25.269 E020.54.40.156 Color_251ACI
N052.15.25.269 E020.54.40.156 N052.15.25.083 E020.54.40.085 Color_251ACI
N052.15.25.083 E020.54.40.085 N052.15.23.508 E020.54.38.105 Color_251ACI
N052.15.23.508 E020.54.38.105 N052.15.23.437 E020.54.37.917 Color_251ACI
N052.15.23.437 E020.54.37.917 N052.15.23.329 E020.54.37.666 Color_251ACI
N052.15.23.329 E020.54.37.666 N052.15.23.296 E020.54.37.420 Color_251ACI
N052.15.23.296 E020.54.37.420 N052.15.23.301 E020.54.37.175 Color_251ACI
N052.15.23.301 E020.54.37.175 N052.15.23.386 E020.54.36.689 Color_251ACI
N052.15.23.386 E020.54.36.689 N052.15.24.363 E020.54.34.594 Color_251ACI
N052.15.24.363 E020.54.34.594 N052.15.24.143 E020.54.34.338 Color_251ACI
N052.15.24.143 E020.54.34.338 N052.15.24.262 E020.54.34.038 Color_251ACI
N052.15.24.262 E020.54.34.038 N052.15.23.127 E020.54.32.570 Color_251ACI
N052.15.23.127 E020.54.32.570 N052.15.21.800 E020.54.35.260 Color_251ACI
N052.15.21.800 E020.54.35.260 N052.15.21.053 E020.54.35.099 Color_251ACI
N052.15.21.053 E020.54.35.099 N052.15.19.993 E020.54.33.635 Color_251ACI
N052.15.19.993 E020.54.33.635 N052.15.19.602 E020.54.34.473 Color_251ACI
N052.15.19.602 E020.54.34.473 N052.15.31.144 E020.54.48.729 Color_251ACI
N052.15.31.144 E020.54.48.729 N052.15.37.848 E020.54.43.374 Color_251ACI
N052.15.37.848 E020.54.43.374 N052.15.56.406 E020.54.28.086 Color_251ACI
N052.15.56.406 E020.54.28.086 N052.15.57.171 E020.54.29.289 Color_251ACI
N052.15.57.171 E020.54.29.289 N052.15.53.610 E020.54.54.598 Color_251ACI
N052.15.53.610 E020.54.54.598 N052.15.54.765 E020.54.54.964 Color_251ACI
N052.15.54.765 E020.54.54.964 N052.15.54.414 E020.54.57.642 Color_251ACI
N052.15.54.414 E020.54.57.642 N052.15.54.971 E020.54.57.916 Color_251ACI
N052.15.54.971 E020.54.57.916 N052.15.55.280 E020.54.57.442 Color_251ACI
N052.15.55.280 E020.54.57.442 N052.15.58.967 E020.54.58.795 Color_251ACI
N052.15.58.967 E020.54.58.795 N052.16.00.503 E020.54.56.913 Color_251ACI
N052.16.00.503 E020.54.56.913 N052.16.02.031 E020.54.57.420 Color_251ACI
N052.16.02.031 E020.54.57.420 N052.16.02.247 E020.54.55.960 Color_251ACI
N052.16.02.247 E020.54.55.960 N052.16.01.714 E020.54.56.362 Color_251ACI
N052.16.01.714 E020.54.56.362 N052.15.54.342 E020.54.53.594 Color_251ACI
N052.15.54.342 E020.54.53.594 N052.15.58.105 E020.54.27.498 Color_251ACI
N052.15.58.105 E020.54.27.498 N052.15.58.503 E020.54.26.293 Color_251ACI
N052.15.58.503 E020.54.26.293 N052.16.06.923 E020.54.19.432 Color_251ACI
N052.16.06.923 E020.54.19.432 N052.16.07.335 E020.54.19.454 Color_251ACI
N052.16.07.335 E020.54.19.454 N052.16.07.555 E020.54.17.749 Color_251ACI
N052.16.07.555 E020.54.17.749 N052.15.58.487 E020.54.25.189 Color_251ACI
N052.15.58.487 E020.54.25.189 N052.16.03.071 E020.53.51.476 Color_251ACI
N052.16.03.071 E020.53.51.476 N052.16.03.797 E020.53.50.778 Color_251ACI
N052.16.03.797 E020.53.50.778 N052.16.10.761 E020.53.53.341 Color_251ACI
N052.16.10.761 E020.53.53.341 N052.16.10.901 E020.53.53.838 Color_251ACI
N052.16.10.901 E020.53.53.838 N052.16.11.118 E020.53.52.317 Color_251ACI
N052.16.11.118 E020.53.52.317 N052.16.08.662 E020.53.51.333 Color_251ACI
N052.16.08.662 E020.53.51.333 N052.16.03.262 E020.53.49.341 Color_251ACI
N052.16.03.262 E020.53.49.341 N052.16.02.693 E020.53.49.680 Color_251ACI
N052.15.55.086 E020.54.26.547 N052.15.55.046 E020.54.26.668 Color_251ACI
N052.16.13.910 E020.53.53.379 N052.16.13.477 E020.53.56.421 Color_251ACI
N052.16.13.477 E020.53.56.421 N052.16.14.932 E020.53.54.841 Color_251ACI
N052.16.14.932 E020.53.54.841 N052.16.21.632 E020.53.57.390 Color_251ACI
N052.16.21.632 E020.53.57.390 N052.16.22.076 E020.53.53.798 Color_251ACI
N052.16.22.076 E020.53.53.798 N052.16.21.590 E020.53.53.712 Color_251ACI
N052.16.21.590 E020.53.53.712 N052.16.21.283 E020.53.54.125 Color_251ACI
N052.16.21.283 E020.53.54.125 N052.16.17.486 E020.53.52.643 Color_251ACI
N052.16.17.486 E020.53.52.643 N052.16.13.910 E020.53.53.379 Color_251ACI
N052.15.59.202 E020.54.56.356 N052.16.00.206 E020.54.56.775 Color_251ACI
N052.16.00.206 E020.54.56.775 N052.15.58.978 E020.54.58.244 Color_251ACI
N052.15.58.978 E020.54.58.244 N052.15.59.202 E020.54.56.356 Color_251ACI
N052.15.24.953 E020.54.25.371 N052.15.25.133 E020.54.25.748 Color_251ACI
N052.15.25.133 E020.54.25.748 N052.15.25.163 E020.54.26.179 Color_251ACI
N052.15.25.163 E020.54.26.179 N052.15.25.150 E020.54.26.852 Color_251ACI
N052.15.25.150 E020.54.26.852 N052.15.25.106 E020.54.27.156 Color_251ACI
N052.15.25.106 E020.54.27.156 N052.15.25.063 E020.54.27.460 Color_251ACI
N052.15.25.063 E020.54.27.460 N052.15.24.983 E020.54.27.702 Color_251ACI
N052.15.24.983 E020.54.27.702 N052.15.24.867 E020.54.27.879 Color_251ACI
N052.15.24.867 E020.54.27.879 N052.15.24.637 E020.54.28.174 Color_251ACI
N052.15.24.637 E020.54.28.174 N052.15.24.447 E020.54.28.287 Color_251ACI
N052.15.24.447 E020.54.28.287 N052.15.24.219 E020.54.28.459 Color_251ACI
N052.15.24.219 E020.54.28.459 N052.15.24.069 E020.54.28.451 Color_251ACI
N052.15.24.069 E020.54.28.451 N052.15.23.844 E020.54.28.440 Color_251ACI
N052.15.23.844 E020.54.28.440 N052.15.23.584 E020.54.28.304 Color_251ACI
N052.15.23.584 E020.54.28.304 N052.15.21.090 E020.54.25.357 Color_251ACI
N052.15.21.090 E020.54.25.357 N052.15.20.945 E020.54.25.105 Color_251ACI
N052.15.20.945 E020.54.25.105 N052.15.20.839 E020.54.24.732 Color_251ACI
N052.15.20.839 E020.54.24.732 N052.15.20.809 E020.54.24.362 Color_251ACI
N052.15.20.809 E020.54.24.362 N052.15.20.817 E020.54.23.934 Color_251ACI
N052.15.20.817 E020.54.23.934 N052.15.20.862 E020.54.23.569 Color_251ACI
N052.15.20.862 E020.54.23.569 N052.15.20.944 E020.54.23.205 Color_251ACI
N052.15.20.944 E020.54.23.205 N052.15.21.023 E020.54.22.964 Color_251ACI
N052.15.21.023 E020.54.22.964 N052.15.21.180 E020.54.22.604 Color_251ACI
N052.15.21.180 E020.54.22.604 N052.15.21.334 E020.54.22.428 Color_251ACI
N052.15.21.334 E020.54.22.428 N052.15.21.487 E020.54.22.252 Color_251ACI
N052.15.21.487 E020.54.22.252 N052.15.21.601 E020.54.22.197 Color_251ACI
N052.15.21.601 E020.54.22.197 N052.15.21.752 E020.54.22.143 Color_251ACI
N052.15.21.752 E020.54.22.143 N052.15.21.865 E020.54.22.088 Color_251ACI
N052.15.21.865 E020.54.22.088 N052.15.21.979 E020.54.22.033 Color_251ACI
N052.15.21.979 E020.54.22.033 N052.15.22.166 E020.54.22.042 Color_251ACI
N052.15.22.166 E020.54.22.042 N052.15.22.279 E020.54.22.048 Color_251ACI
N052.15.22.279 E020.54.22.048 N052.15.22.427 E020.54.22.117 Color_251ACI
N052.15.22.427 E020.54.22.117 N052.15.24.953 E020.54.25.371 Color_251ACI
N052.15.51.593 E020.55.09.815 N052.15.50.243 E020.55.19.550 Color_251ACI
N052.15.52.100 E020.55.08.799 N052.15.50.581 E020.55.19.567 Color_251ACI
N052.16.12.435 E020.55.20.013 N052.16.14.071 E020.55.20.771 Color_251ACI
N052.16.14.970 E020.55.20.817 N052.16.14.970 E020.55.20.817 Color_251ACI
N052.16.14.970 E020.55.20.817 N052.16.15.822 E020.55.17.429 Color_251ACI
N052.16.15.822 E020.55.17.429 N052.16.16.143 E020.55.16.342 Color_251ACI
N052.16.16.143 E020.55.16.342 N052.16.16.422 E020.55.15.499 Color_251ACI
N052.16.16.422 E020.55.15.499 N052.16.18.509 E020.55.10.275 Color_251ACI
N052.16.18.509 E020.55.10.275 N052.16.20.078 E020.55.06.678 Color_251ACI
N052.16.20.078 E020.55.06.678 N052.16.21.943 E020.55.03.281 Color_251ACI
N052.16.21.943 E020.55.03.281 N052.16.22.745 E020.55.02.525 Color_251ACI
N052.16.22.745 E020.55.02.525 N052.16.23.089 E020.55.02.175 Color_251ACI
N052.16.23.089 E020.55.02.175 N052.16.23.656 E020.55.01.959 Color_251ACI
N052.16.23.656 E020.55.01.959 N052.16.23.957 E020.55.01.913 Color_251ACI
N052.16.23.957 E020.55.01.913 N052.16.24.145 E020.55.01.862 Color_251ACI
N052.16.24.145 E020.55.01.862 N052.16.24.259 E020.55.01.806 Color_251ACI
N052.16.15.195 E020.55.20.828 N052.16.15.764 E020.55.18.529 Color_251ACI
N052.16.15.764 E020.55.18.529 N052.16.16.368 E020.55.16.354 Color_251ACI
N052.16.16.368 E020.55.16.354 N052.16.17.316 E020.55.13.829 Color_251ACI
N052.16.17.316 E020.55.13.829 N052.16.18.301 E020.55.11.367 Color_251ACI
N052.16.18.301 E020.55.11.367 N052.16.20.107 E020.55.07.109 Color_251ACI
N052.16.20.107 E020.55.07.109 N052.16.21.971 E020.55.03.773 Color_251ACI
N052.16.21.971 E020.55.03.773 N052.16.22.509 E020.55.03.126 Color_251ACI
N052.16.22.509 E020.55.03.126 N052.16.23.044 E020.55.02.602 Color_251ACI
N052.16.23.044 E020.55.02.602 N052.16.23.422 E020.55.02.437 Color_251ACI
N052.16.23.422 E020.55.02.437 N052.16.23.875 E020.55.02.277 Color_251ACI
N052.16.23.875 E020.55.02.277 N052.16.24.063 E020.55.02.225 Color_251ACI
N052.16.18.537 E020.54.53.179 N052.16.14.049 E020.55.12.130 Color_251ACI
N052.16.14.049 E020.55.12.130 N052.16.12.048 E020.55.20.667 Color_251ACI
N052.16.12.392 E020.55.20.317 N052.16.12.272 E020.55.20.679 Color_251ACI
N052.16.12.392 E020.55.20.317 N052.16.13.359 E020.55.20.734 Color_251ACI
N052.16.03.262 E020.53.49.341 N052.16.03.957 E020.53.44.413 Color_251ACI
N052.16.03.957 E020.53.44.413 N052.16.09.275 E020.53.46.708 Color_251ACI
N052.16.09.275 E020.53.46.708 N052.16.08.624 E020.53.51.331 Color_251ACI
N052.15.59.282 E020.53.51.588 N052.15.57.859 E020.53.51.454 Color_251ACI
N052.15.57.859 E020.53.51.454 N052.15.57.916 E020.53.48.516 Color_251ACI
N052.15.57.916 E020.53.48.516 N052.15.59.227 E020.53.48.583 Color_251ACI
N052.15.59.227 E020.53.48.583 N052.15.59.655 E020.53.49.708 Color_251ACI
N052.15.59.655 E020.53.49.708 N052.16.00.211 E020.53.50.043 Color_251ACI
N052.16.01.338 E020.53.51.939 N052.16.01.122 E020.53.51.437 Color_251ACI
N052.16.01.122 E020.53.51.437 N052.15.59.708 E020.53.50.875 Color_251ACI
N052.15.59.708 E020.53.50.875 N052.15.59.282 E020.53.51.588 Color_251ACI
N052.16.08.490 E020.53.52.489 N052.16.08.056 E020.53.55.531 Color_251ACI
N052.16.08.056 E020.53.55.531 N052.16.03.848 E020.53.54.028 Color_251ACI
N052.16.03.848 E020.53.54.028 N052.16.02.882 E020.54.01.332 Color_251ACI
N052.16.02.882 E020.54.01.332 N052.16.01.765 E020.54.00.907 Color_251ACI
N052.16.26.294 E020.55.01.237 N052.16.26.476 E020.55.01.552 Color_251ACI
N052.16.26.476 E020.55.01.552 N052.16.28.702 E020.55.06.691 Color_251ACI
N052.16.28.702 E020.55.06.691 N052.16.29.816 E020.55.09.199 Color_251ACI
N052.16.25.961 E020.55.01.036 N052.16.29.804 E020.55.09.812 Color_251ACI
N052.15.43.951 E020.53.29.662 N052.15.43.712 E020.53.30.385 Color_251ACI
N052.15.43.712 E020.53.30.385 N052.15.43.080 E020.53.32.068 Color_251ACI
N052.15.43.080 E020.53.32.068 N052.15.43.411 E020.53.34.353 Color_251ACI
N052.15.43.411 E020.53.34.353 N052.15.45.119 E020.53.48.902 Color_251ACI
N052.15.45.119 E020.53.48.902 N052.15.46.053 E020.53.54.955 Color_251ACI
N052.16.18.619 E020.54.52.816 N052.16.19.887 E020.54.47.304 Color_251ACI
N052.16.19.887 E020.54.47.304 N052.16.28.661 E020.54.10.190 Color_251ACI
N052.16.28.661 E020.54.10.190 N052.16.29.620 E020.54.09.075 Color_251ACI
N052.16.29.620 E020.54.09.075 N052.16.30.618 E020.54.07.839 Color_251ACI
N052.16.30.618 E020.54.07.839 N052.16.31.001 E020.54.07.430 Color_251ACI
N052.16.30.531 E020.54.08.509 N052.16.30.991 E020.54.07.981 Color_251ACI
N052.15.15.640 E020.53.52.662 N052.15.31.461 E020.53.51.144 Color_251ACI
N052.15.31.461 E020.53.51.144 N052.15.32.738 E020.53.51.086 Color_251ACI
N052.15.32.738 E020.53.51.086 N052.15.33.337 E020.53.51.117 Color_251ACI
N052.15.33.337 E020.53.51.117 N052.15.36.339 E020.53.45.204 Color_251ACI
N052.15.36.339 E020.53.45.204 N052.15.42.436 E020.53.32.403 Color_251ACI
N052.15.42.436 E020.53.32.403 N052.15.43.534 E020.53.29.886 Color_251ACI
N052.15.43.534 E020.53.29.886 N052.15.43.614 E020.53.29.644 Color_251ACI
N052.15.58.573 E020.54.14.838 N052.15.58.260 E020.54.17.457 Color_251ACI
N052.15.58.260 E020.54.17.457 N052.15.58.017 E020.54.18.425 Color_251ACI
N052.15.58.017 E020.54.18.425 N052.15.56.902 E020.54.21.799 Color_251ACI
N052.15.56.902 E020.54.21.799 N052.15.55.189 E020.54.27.043 Color_251ACI
N052.15.55.189 E020.54.27.043 N052.15.54.916 E020.54.27.580 Color_251ACI
N052.15.54.916 E020.54.27.580 N052.15.54.604 E020.54.28.177 Color_251ACI
N052.15.54.604 E020.54.28.177 N052.15.54.335 E020.54.28.531 Color_251ACI
N052.15.54.335 E020.54.28.531 N052.15.54.067 E020.54.28.824 Color_251ACI
N052.15.54.067 E020.54.28.824 N052.15.53.611 E020.54.29.107 Color_251ACI
N052.15.53.611 E020.54.29.107 N052.15.53.157 E020.54.29.328 Color_251ACI
N052.15.53.157 E020.54.29.328 N052.15.52.894 E020.54.29.376 Color_251ACI
N052.15.52.894 E020.54.29.376 N052.15.52.071 E020.54.29.273 Color_251ACI
N052.15.52.416 E020.54.28.862 N052.15.52.827 E020.54.28.944 Color_251ACI
N052.15.52.827 E020.54.28.944 N052.15.53.090 E020.54.28.896 Color_251ACI
N052.15.53.090 E020.54.28.896 N052.15.53.506 E020.54.28.734 Color_251ACI
N052.15.53.506 E020.54.28.734 N052.15.53.771 E020.54.28.625 Color_251ACI
N052.15.53.771 E020.54.28.625 N052.15.53.962 E020.54.28.451 Color_251ACI
N052.15.53.962 E020.54.28.451 N052.15.54.191 E020.54.28.217 Color_251ACI
N052.15.54.191 E020.54.28.217 N052.15.54.423 E020.54.27.861 Color_251ACI
N052.15.54.423 E020.54.27.861 N052.15.54.966 E020.54.26.909 Color_251ACI
N052.15.54.966 E020.54.26.909 N052.15.55.084 E020.54.26.608 Color_251ACI
N052.15.53.908 E020.54.54.675 N052.15.51.766 E020.55.08.598 Color_251ACI
N052.15.51.766 E020.55.08.598 N052.15.51.678 E020.55.09.268 Color_251ACI
N052.15.51.593 E020.55.09.815 N052.15.51.148 E020.55.09.547 Color_251ACI
N052.15.51.148 E020.55.09.547 N052.15.48.725 E020.55.08.749 Color_251ACI
N052.15.51.678 E020.55.09.268 N052.15.50.819 E020.55.09.101 Color_251ACI
N052.15.50.819 E020.55.09.101 N052.15.50.037 E020.55.08.816 Color_251ACI
N052.15.50.037 E020.55.08.816 N052.15.49.220 E020.55.08.406 Color_251ACI
N052.15.49.220 E020.55.08.406 N052.15.48.771 E020.55.08.322 Color_251ACI
N052.16.01.087 E020.53.45.430 N052.16.00.827 E020.53.45.294 Color_251ACI
N052.16.00.827 E020.53.45.294 N052.16.00.256 E020.53.49.677 Color_251ACI
N052.16.00.256 E020.53.49.677 N052.16.01.484 E020.53.50.169 Color_251ACI
N052.16.01.484 E020.53.50.169 N052.16.01.439 E020.53.50.534 Color_251ACI
N052.16.01.439 E020.53.50.534 N052.16.00.211 E020.53.50.043 Color_251ACI
N052.16.02.264 E020.53.52.538 N052.16.01.867 E020.53.51.721 Color_251ACI
N052.16.01.867 E020.53.51.721 N052.16.01.602 E020.53.51.830 Color_251ACI
N052.16.01.602 E020.53.51.830 N052.15.58.573 E020.54.14.838 Color_251ACI
N052.16.02.693 E020.53.49.680 N052.16.01.739 E020.53.50.550 Color_251ACI
N052.16.01.739 E020.53.50.550 N052.16.02.221 E020.53.46.959 Color_251ACI
N052.16.20.099 E020.54.34.324 N052.16.20.508 E020.54.32.568 Color_251ACI
N052.16.21.062 E020.54.34.925 N052.16.20.099 E020.54.34.324 Color_251ACI
N052.16.21.472 E020.54.33.108 N052.16.21.062 E020.54.34.925 Color_251ACI
N052.16.20.508 E020.54.32.568 N052.16.21.435 E020.54.33.106 Color_251ACI
N052.16.21.736 E020.54.27.177 N052.16.21.069 E020.54.26.775 Color_251ACI
N052.16.20.714 E020.54.31.598 N052.16.21.736 E020.54.27.177 Color_251ACI
N052.16.20.046 E020.54.31.196 N052.16.20.714 E020.54.31.598 Color_251ACI
N052.16.21.069 E020.54.26.775 N052.16.20.046 E020.54.31.196 Color_251ACI
N052.16.18.687 E020.54.29.717 N052.16.20.168 E020.54.30.712 Color_251ACI
N052.16.18.075 E020.54.32.321 N052.16.18.687 E020.54.29.717 Color_251ACI
N052.16.19.559 E020.54.33.132 N052.16.18.075 E020.54.32.321 Color_251ACI
N052.16.20.168 E020.54.30.712 N052.16.19.559 E020.54.33.132 Color_251ACI
N052.16.18.654 E020.54.37.314 N052.16.16.808 E020.54.45.615 Color_251ACI
N052.16.19.284 E020.54.37.714 N052.16.18.654 E020.54.37.314 Color_251ACI
N052.16.17.401 E020.54.45.951 N052.16.19.284 E020.54.37.714 Color_251ACI
N052.16.16.808 E020.54.45.615 N052.16.17.401 E020.54.45.951 Color_251ACI
N052.16.22.376 E020.54.36.831 N052.16.21.375 E020.54.36.228 Color_251ACI
N052.16.21.375 E020.54.36.228 N052.16.21.186 E020.54.36.280 Color_251ACI
N052.16.21.186 E020.54.36.280 N052.16.21.107 E020.54.36.521 Color_251ACI
N052.16.21.107 E020.54.36.521 N052.16.20.805 E020.54.38.589 Color_251ACI
N052.16.20.805 E020.54.38.589 N052.16.20.409 E020.54.41.632 Color_251ACI
N052.16.20.409 E020.54.41.632 N052.16.20.279 E020.54.42.545 Color_251ACI
N052.16.20.279 E020.54.42.545 N052.16.20.073 E020.54.43.515 Color_251ACI
N052.16.20.073 E020.54.43.515 N052.16.19.294 E020.54.46.968 Color_251ACI
N052.16.19.294 E020.54.46.968 N052.16.18.721 E020.54.49.451 Color_251ACI
N052.16.18.721 E020.54.49.451 N052.16.18.069 E020.54.52.175 Color_251ACI
N052.16.18.069 E020.54.52.175 N052.16.18.064 E020.54.52.420 Color_251ACI
N052.16.18.064 E020.54.52.420 N052.16.18.174 E020.54.52.548 Color_251ACI
N052.16.18.174 E020.54.52.548 N052.16.18.619 E020.54.52.816 Color_251ACI
N052.16.22.419 E020.54.36.527 N052.16.21.456 E020.54.35.926 Color_251ACI
N052.16.21.456 E020.54.35.926 N052.16.21.385 E020.54.35.677 Color_251ACI
N052.16.21.385 E020.54.35.677 N052.16.21.351 E020.54.35.491 Color_251ACI
N052.16.21.351 E020.54.35.491 N052.16.21.471 E020.54.35.130 Color_251ACI
N052.16.21.471 E020.54.35.130 N052.16.24.534 E020.54.22.051 Color_251ACI
N052.16.24.534 E020.54.22.051 N052.16.24.312 E020.54.21.917 Color_251ACI
N052.16.24.312 E020.54.21.917 N052.16.21.325 E020.54.34.938 Color_251ACI
N052.16.21.325 E020.54.34.938 N052.16.21.204 E020.54.35.361 Color_251ACI
N052.16.21.204 E020.54.35.361 N052.16.21.127 E020.54.35.480 Color_251ACI
N052.16.21.127 E020.54.35.480 N052.16.21.051 E020.54.35.537 Color_251ACI
N052.16.21.051 E020.54.35.537 N052.16.20.938 E020.54.35.531 Color_251ACI
N052.16.20.938 E020.54.35.531 N052.16.20.085 E020.54.35.059 Color_251ACI
N052.16.20.085 E020.54.35.059 N052.16.19.900 E020.54.34.927 Color_251ACI
N052.16.19.900 E020.54.34.927 N052.16.19.826 E020.54.34.862 Color_251ACI
N052.16.19.826 E020.54.34.862 N052.16.19.754 E020.54.34.735 Color_251ACI
N052.16.19.754 E020.54.34.735 N052.16.19.717 E020.54.34.672 Color_251ACI
N052.16.19.717 E020.54.34.672 N052.16.19.718 E020.54.34.611 Color_251ACI
N052.16.19.718 E020.54.34.611 N052.16.19.720 E020.54.34.550 Color_251ACI
N052.16.19.720 E020.54.34.550 N052.16.19.759 E020.54.34.429 Color_251ACI
N052.16.19.759 E020.54.34.429 N052.16.19.798 E020.54.34.370 Color_251ACI
N052.16.19.798 E020.54.34.370 N052.16.19.837 E020.54.34.311 Color_251ACI
N052.16.19.837 E020.54.34.311 N052.16.19.912 E020.54.34.315 Color_251ACI
N052.16.19.912 E020.54.34.315 N052.16.19.987 E020.54.34.318 Color_251ACI
N052.16.19.987 E020.54.34.318 N052.16.20.099 E020.54.34.324 Color_251ACI
N052.16.20.508 E020.54.32.568 N052.16.20.714 E020.54.31.598 Color_251ACI
N052.16.21.736 E020.54.27.177 N052.16.23.002 E020.54.21.788 Color_251ACI
N052.16.23.003 E020.54.21.727 N052.16.22.409 E020.54.21.390 Color_251ACI
N052.16.22.409 E020.54.21.390 N052.16.21.069 E020.54.26.775 Color_251ACI
N052.16.18.075 E020.54.32.321 N052.16.17.668 E020.54.32.055 Color_251ACI
N052.16.17.668 E020.54.32.055 N052.16.17.546 E020.54.32.539 Color_251ACI
N052.16.17.546 E020.54.32.539 N052.16.19.102 E020.54.33.538 Color_251ACI
N052.16.19.102 E020.54.33.538 N052.16.19.212 E020.54.33.666 Color_251ACI
N052.16.19.212 E020.54.33.666 N052.16.19.246 E020.54.33.852 Color_251ACI
N052.16.19.246 E020.54.33.852 N052.16.19.244 E020.54.33.913 Color_251ACI
N052.16.19.244 E020.54.33.913 N052.16.19.200 E020.54.34.278 Color_251ACI
N052.16.19.200 E020.54.34.278 N052.16.18.906 E020.54.35.918 Color_251ACI
N052.16.18.906 E020.54.35.918 N052.16.19.464 E020.54.36.130 Color_251ACI
N052.16.17.216 E020.54.45.819 N052.16.17.063 E020.54.45.995 Color_251ACI
N052.16.17.063 E020.54.45.995 N052.16.17.060 E020.54.46.118 Color_251ACI
N052.16.17.060 E020.54.46.118 N052.16.17.018 E020.54.46.361 Color_251ACI
N052.16.17.018 E020.54.46.361 N052.16.16.969 E020.54.46.971 Color_251ACI
N052.16.16.969 E020.54.46.971 N052.16.17.001 E020.54.47.279 Color_251ACI
N052.16.17.001 E020.54.47.279 N052.16.17.072 E020.54.47.467 Color_251ACI
N052.16.17.072 E020.54.47.467 N052.16.17.404 E020.54.47.729 Color_251ACI
N052.16.17.790 E020.54.41.314 N052.16.15.822 E020.54.40.294 Color_251ACI
N052.16.15.822 E020.54.40.294 N052.16.15.739 E020.54.40.719 Color_251ACI
N052.16.15.739 E020.54.40.719 N052.16.17.708 E020.54.41.678 Color_251ACI
N052.16.16.808 E020.54.45.615 N052.16.16.734 E020.54.47.510 Color_251ACI
N052.16.16.734 E020.54.47.510 N052.16.16.428 E020.54.47.801 Color_251ACI
N052.16.16.428 E020.54.47.801 N052.16.15.057 E020.54.46.934 Color_251ACI
N052.16.15.057 E020.54.46.934 N052.16.15.023 E020.54.46.749 Color_251ACI
N052.16.15.023 E020.54.46.749 N052.16.14.957 E020.54.46.316 Color_251ACI
N052.16.14.957 E020.54.46.316 N052.16.14.323 E020.54.46.100 Color_251ACI
N052.16.14.323 E020.54.46.100 N052.16.14.156 E020.54.47.011 Color_251ACI
N052.16.14.156 E020.54.47.011 N052.16.14.863 E020.54.47.292 Color_251ACI
N052.16.14.863 E020.54.47.292 N052.16.15.088 E020.54.47.304 Color_251ACI
N052.16.15.088 E020.54.47.304 N052.16.16.421 E020.54.48.169 Color_251ACI
N052.16.16.421 E020.54.48.169 N052.16.14.584 E020.54.55.979 Color_251ACI
N052.16.14.584 E020.54.55.979 N052.16.14.542 E020.54.56.222 Color_251ACI
N052.16.14.542 E020.54.56.222 N052.16.14.538 E020.54.56.406 Color_251ACI
N052.16.14.538 E020.54.56.406 N052.16.14.498 E020.54.56.526 Color_251ACI
N052.16.14.498 E020.54.56.526 N052.16.14.532 E020.54.56.712 Color_251ACI
N052.16.14.532 E020.54.56.712 N052.16.14.530 E020.54.56.834 Color_251ACI
N052.16.14.530 E020.54.56.834 N052.16.14.601 E020.54.57.022 Color_251ACI
N052.16.14.601 E020.54.57.022 N052.16.14.674 E020.54.57.148 Color_251ACI
N052.16.14.674 E020.54.57.148 N052.16.14.783 E020.54.57.338 Color_251ACI
N052.16.14.783 E020.54.57.338 N052.16.14.892 E020.54.57.527 Color_251ACI
N052.16.14.892 E020.54.57.527 N052.16.15.077 E020.54.57.659 Color_251ACI
N052.16.15.077 E020.54.57.659 N052.16.15.299 E020.54.57.793 Color_251ACI
N052.16.15.299 E020.54.57.793 N052.16.15.706 E020.54.58.059 Color_251ACI
N052.16.15.706 E020.54.58.059 N052.16.16.042 E020.54.58.138 Color_251ACI
N052.16.16.042 E020.54.58.138 N052.16.16.305 E020.54.58.151 Color_251ACI
N052.16.16.305 E020.54.58.151 N052.16.16.493 E020.54.58.099 Color_251ACI
N052.16.16.493 E020.54.58.099 N052.16.16.722 E020.54.57.866 Color_251ACI
N052.15.58.378 E020.54.13.296 N052.15.58.189 E020.54.13.347 Color_251ACI
N052.15.58.189 E020.54.13.347 N052.15.58.152 E020.54.13.346 Color_251ACI
N052.15.58.152 E020.54.13.346 N052.15.57.518 E020.54.13.129 Color_251ACI
N052.15.57.518 E020.54.13.129 N052.15.56.487 E020.54.12.157 Color_251ACI
N052.15.56.487 E020.54.12.157 N052.15.56.084 E020.54.11.646 Color_251ACI
N052.15.46.053 E020.53.54.955 N052.15.46.412 E020.53.55.831 Color_251ACI
N052.15.46.412 E020.53.55.831 N052.15.50.310 E020.54.01.791 Color_251ACI
N052.15.50.310 E020.54.01.791 N052.15.53.662 E020.54.06.926 Color_251ACI
N052.15.53.662 E020.54.06.926 N052.15.56.682 E020.54.11.738 Color_251ACI
N052.15.56.682 E020.54.11.738 N052.15.57.679 E020.54.12.586 Color_251ACI
N052.15.57.679 E020.54.12.586 N052.15.58.200 E020.54.12.796 Color_251ACI
N052.15.58.200 E020.54.12.796 N052.15.58.465 E020.54.12.626 Color_251ACI
N052.16.20.144 E020.54.47.624 N052.16.15.295 E020.55.07.781 Color_251ACI
N052.16.15.295 E020.55.07.781 N052.16.12.435 E020.55.20.013 Color_251ACI
N052.16.18.537 E020.54.53.179 N052.16.18.019 E020.54.52.846 Color_251ACI
N052.16.18.019 E020.54.52.846 N052.16.17.908 E020.54.52.779 Color_251ACI
N052.16.17.908 E020.54.52.779 N052.16.17.830 E020.54.52.898 Color_251ACI
N052.16.17.830 E020.54.52.898 N052.16.17.786 E020.54.53.263 Color_251ACI
N052.16.20.144 E020.54.47.624 N052.16.22.871 E020.54.54.014 Color_251ACI
N052.16.22.871 E020.54.54.014 N052.16.25.817 E020.55.00.722 Color_251ACI
N052.16.25.923 E020.55.01.034 N052.16.25.768 E020.55.01.332 Color_251ACI
N052.16.25.768 E020.55.01.332 N052.16.25.577 E020.55.01.506 Color_251ACI
N052.16.25.577 E020.55.01.506 N052.16.25.390 E020.55.01.497 Color_251ACI
N052.16.25.390 E020.55.01.497 N052.16.25.130 E020.55.01.361 Color_251ACI
N052.16.25.130 E020.55.01.361 N052.16.24.980 E020.55.01.353 Color_251ACI
N052.16.24.980 E020.55.01.353 N052.16.24.789 E020.55.01.527 Color_251ACI
N052.16.24.789 E020.55.01.527 N052.16.24.709 E020.55.01.768 Color_251ACI
N052.16.24.709 E020.55.01.768 N052.16.24.630 E020.55.02.009 Color_251ACI
N052.16.24.630 E020.55.02.009 N052.16.24.514 E020.55.02.187 Color_251ACI
N052.16.24.514 E020.55.02.187 N052.16.24.288 E020.55.02.237 Color_251ACI
N052.16.24.288 E020.55.02.237 N052.16.24.063 E020.55.02.225 Color_251ACI
N052.16.24.259 E020.55.01.806 N052.16.24.410 E020.55.01.753 Color_251ACI
N052.16.24.410 E020.55.01.753 N052.16.24.568 E020.55.01.332 Color_251ACI
N052.16.24.568 E020.55.01.332 N052.16.24.836 E020.55.01.039 Color_251ACI
N052.16.24.836 E020.55.01.039 N052.16.25.062 E020.55.00.990 Color_251ACI
N052.16.25.062 E020.55.00.990 N052.16.25.398 E020.55.01.068 Color_251ACI
N052.16.25.398 E020.55.01.068 N052.16.25.546 E020.55.01.137 Color_251ACI
N052.16.25.546 E020.55.01.137 N052.16.25.700 E020.55.00.961 Color_251ACI
N052.16.25.700 E020.55.00.961 N052.16.25.779 E020.55.00.720 Color_251ACI
N052.16.26.294 E020.55.01.237 N052.16.20.266 E020.54.47.140 Color_251ACI
N052.16.29.612 E020.54.09.504 N052.16.28.920 E020.54.10.387 Color_251ACI
N052.16.28.920 E020.54.10.387 N052.16.28.560 E020.54.11.533 Color_251ACI
N052.16.28.560 E020.54.11.533 N052.16.24.555 E020.54.28.792 Color_251ACI
N052.16.24.555 E020.54.28.792 N052.16.20.266 E020.54.47.140 Color_251ACI
N052.16.16.722 E020.54.57.866 N052.16.16.926 E020.54.57.019 Color_251ACI
N052.16.16.926 E020.54.57.019 N052.16.17.787 E020.54.53.202 Color_251ACI
N052.16.16.047 E020.54.57.893 N052.16.16.272 E020.54.57.904 Color_251ACI
N052.16.16.272 E020.54.57.904 N052.16.16.423 E020.54.57.851 Color_251ACI
N052.16.16.423 E020.54.57.851 N052.16.16.576 E020.54.57.675 Color_251ACI
N052.16.16.576 E020.54.57.675 N052.16.16.738 E020.54.57.070 Color_251ACI
N052.16.16.738 E020.54.57.070 N052.16.17.682 E020.54.52.829 Color_251ACI
N052.16.17.682 E020.54.52.829 N052.16.17.685 E020.54.52.645 Color_251ACI
N052.16.17.685 E020.54.52.645 N052.16.17.687 E020.54.52.523 Color_251ACI
N052.16.17.687 E020.54.52.523 N052.16.17.651 E020.54.52.460 Color_251ACI
N052.16.17.651 E020.54.52.460 N052.16.16.019 E020.54.51.518 Color_251ACI
N052.16.16.019 E020.54.51.518 N052.16.15.165 E020.54.55.029 Color_251ACI
N052.16.15.165 E020.54.55.029 N052.16.15.423 E020.54.55.226 Color_251ACI
N052.16.15.423 E020.54.55.226 N052.16.15.178 E020.54.56.255 Color_251ACI
N052.16.15.178 E020.54.56.255 N052.16.14.956 E020.54.56.121 Color_251ACI
N052.16.14.956 E020.54.56.121 N052.16.14.919 E020.54.56.119 Color_251ACI
N052.16.14.919 E020.54.56.119 N052.16.14.880 E020.54.56.178 Color_251ACI
N052.16.14.880 E020.54.56.178 N052.16.14.879 E020.54.56.240 Color_251ACI
N052.16.14.879 E020.54.56.240 N052.16.14.839 E020.54.56.360 Color_251ACI
N052.16.14.839 E020.54.56.360 N052.16.14.799 E020.54.56.481 Color_251ACI
N052.16.14.799 E020.54.56.481 N052.16.14.797 E020.54.56.603 Color_251ACI
N052.16.14.797 E020.54.56.603 N052.16.14.794 E020.54.56.725 Color_251ACI
N052.16.14.794 E020.54.56.725 N052.16.14.828 E020.54.56.911 Color_251ACI
N052.16.14.828 E020.54.56.911 N052.16.14.900 E020.54.57.099 Color_251ACI
N052.16.14.900 E020.54.57.099 N052.16.15.010 E020.54.57.227 Color_251ACI
N052.16.15.010 E020.54.57.227 N052.16.15.119 E020.54.57.416 Color_251ACI
N052.16.15.119 E020.54.57.416 N052.16.15.266 E020.54.57.546 Color_251ACI
N052.16.15.266 E020.54.57.546 N052.16.15.415 E020.54.57.615 Color_251ACI
N052.16.15.415 E020.54.57.615 N052.16.15.600 E020.54.57.747 Color_251ACI
N052.16.15.600 E020.54.57.747 N052.16.15.823 E020.54.57.820 Color_251ACI
N052.16.15.823 E020.54.57.820 N052.16.16.010 E020.54.57.891 Color_251ACI
N052.16.16.010 E020.54.57.891 N052.16.16.084 E020.54.57.895 Color_251ACI
N052.16.16.788 E020.54.50.516 N052.16.16.270 E020.54.50.183 Color_251ACI
N052.16.16.270 E020.54.50.183 N052.16.16.025 E020.54.51.212 Color_251ACI
N052.16.16.025 E020.54.51.212 N052.16.17.656 E020.54.52.215 Color_251ACI
N052.16.17.656 E020.54.52.215 N052.16.17.768 E020.54.52.221 Color_251ACI
N052.16.17.768 E020.54.52.221 N052.16.17.847 E020.54.52.041 Color_251ACI
N052.16.17.847 E020.54.52.041 N052.16.17.967 E020.54.51.618 Color_251ACI
N052.16.17.967 E020.54.51.618 N052.16.18.013 E020.54.51.191 Color_251ACI
N052.16.18.013 E020.54.51.191 N052.16.18.014 E020.54.51.130 Color_251ACI
N052.16.18.014 E020.54.51.130 N052.16.17.754 E020.54.50.994 Color_251ACI
N052.16.18.798 E020.54.45.471 N052.16.19.317 E020.54.45.743 Color_251ACI
N052.16.19.317 E020.54.45.743 N052.16.19.353 E020.54.45.868 Color_251ACI
N052.16.19.353 E020.54.45.868 N052.16.19.350 E020.54.45.990 Color_251ACI
N052.16.19.350 E020.54.45.990 N052.16.18.170 E020.54.50.832 Color_251ACI
N052.16.18.170 E020.54.50.832 N052.16.18.095 E020.54.50.828 Color_251ACI
N052.16.18.095 E020.54.50.828 N052.16.17.798 E020.54.50.690 Color_251ACI
N052.16.19.994 E020.54.39.773 N052.16.20.403 E020.54.39.977 Color_251ACI
N052.16.20.403 E020.54.39.977 N052.16.20.933 E020.54.35.776 Color_251ACI
N052.16.20.933 E020.54.35.776 N052.16.19.931 E020.54.35.235 Color_251ACI
N052.16.19.931 E020.54.35.235 N052.16.19.858 E020.54.35.170 Color_251ACI
N052.16.19.858 E020.54.35.170 N052.16.19.783 E020.54.35.166 Color_251ACI
N052.16.19.783 E020.54.35.166 N052.16.19.708 E020.54.35.162 Color_251ACI
N052.16.19.708 E020.54.35.162 N052.16.19.633 E020.54.35.158 Color_251ACI
N052.16.19.633 E020.54.35.158 N052.16.19.594 E020.54.35.218 Color_251ACI
N052.16.19.594 E020.54.35.218 N052.16.19.557 E020.54.35.216 Color_251ACI
N052.16.19.557 E020.54.35.216 N052.16.19.517 E020.54.35.336 Color_251ACI
N052.16.19.517 E020.54.35.336 N052.16.19.516 E020.54.35.397 Color_251ACI
N052.16.19.516 E020.54.35.397 N052.16.19.515 E020.54.35.459 Color_251ACI
N052.16.19.515 E020.54.35.459 N052.16.19.551 E020.54.35.522 Color_251ACI
N052.16.19.551 E020.54.35.522 N052.16.19.550 E020.54.35.583 Color_251ACI
N052.16.19.550 E020.54.35.583 N052.16.19.587 E020.54.35.585 Color_251ACI
N052.16.19.912 E020.54.40.136 N052.16.20.321 E020.54.40.341 Color_251ACI
N052.16.20.321 E020.54.40.341 N052.16.20.354 E020.54.40.588 Color_251ACI
N052.16.20.354 E020.54.40.588 N052.16.20.350 E020.54.40.771 Color_251ACI
N052.16.20.350 E020.54.40.771 N052.16.20.182 E020.54.41.743 Color_251ACI
N052.16.20.182 E020.54.41.743 N052.16.19.554 E020.54.45.143 Color_251ACI
N052.16.19.554 E020.54.45.143 N052.16.19.514 E020.54.45.263 Color_251ACI
N052.16.19.514 E020.54.45.263 N052.16.19.324 E020.54.45.376 Color_251ACI
N052.16.19.324 E020.54.45.376 N052.16.18.841 E020.54.45.167 Color_251ACI
N052.15.58.039 E020.54.17.262 N052.15.57.875 E020.54.17.989 Color_251ACI
N052.15.57.875 E020.54.17.989 N052.15.57.557 E020.54.18.953 Color_251ACI
N052.15.57.557 E020.54.18.953 N052.15.57.115 E020.54.20.462 Color_251ACI
N052.15.57.115 E020.54.20.462 N052.15.55.084 E020.54.26.608 Color_251ACI
N052.15.24.032 E020.54.22.567 N052.15.25.282 E020.54.19.934 Color_251ACI
N052.15.25.282 E020.54.19.934 N052.15.25.287 E020.54.19.690 Color_251ACI
N052.15.25.287 E020.54.19.690 N052.15.25.176 E020.54.19.623 Color_251ACI
N052.15.25.176 E020.54.19.623 N052.15.24.801 E020.54.19.603 Color_251ACI
N052.15.24.801 E020.54.19.603 N052.15.23.526 E020.54.19.599 Color_251ACI
N052.15.23.526 E020.54.19.599 N052.15.22.562 E020.54.20.959 Color_251ACI
N052.15.24.032 E020.54.22.567 N052.15.24.027 E020.54.22.812 Color_251ACI
N052.15.24.027 E020.54.22.812 N052.15.26.886 E020.54.26.267 Color_251ACI
N052.15.26.886 E020.54.26.267 N052.15.26.961 E020.54.26.271 Color_251ACI
N052.15.26.961 E020.54.26.271 N052.15.27.351 E020.54.25.494 Color_251ACI
N052.15.26.292 E020.54.25.991 N052.15.24.174 E020.54.30.785 Color_251ACI
N052.15.24.174 E020.54.30.785 N052.15.23.991 E020.54.30.531 Color_251ACI
N052.15.23.991 E020.54.30.531 N052.15.26.145 E020.54.25.800 Color_251ACI
N052.15.26.145 E020.54.25.800 N052.15.20.060 E020.54.18.441 Color_251ACI
N052.15.20.060 E020.54.18.441 N052.15.19.905 E020.54.18.679 Color_251ACI
N052.15.19.905 E020.54.18.679 N052.15.18.477 E020.54.24.672 Color_251ACI
N052.15.18.477 E020.54.24.672 N052.15.16.751 E020.54.30.589 Color_251ACI
N052.15.16.751 E020.54.30.589 N052.15.13.424 E020.54.37.772 Color_251ACI
N052.15.20.259 E020.54.17.839 N052.15.20.289 E020.54.18.208 Color_251ACI
N052.15.20.289 E020.54.18.208 N052.15.22.562 E020.54.20.959 Color_251ACI
N052.15.16.631 E020.54.28.990 N052.15.16.665 E020.54.29.175 Color_251ACI
N052.15.16.665 E020.54.29.175 N052.15.16.740 E020.54.29.179 Color_251ACI
N052.15.16.740 E020.54.29.179 N052.15.16.815 E020.54.29.183 Color_251ACI
N052.15.16.815 E020.54.29.183 N052.15.18.376 E020.54.24.054 Color_251ACI
N052.15.18.376 E020.54.24.054 N052.15.19.357 E020.54.19.876 Color_251ACI
N052.15.16.631 E020.54.28.990 N052.15.16.947 E020.54.24.287 Color_251ACI
N052.15.16.947 E020.54.24.287 N052.15.19.247 E020.54.19.748 Color_251ACI
N052.15.19.247 E020.54.19.748 N052.15.19.356 E020.54.19.937 Color_251ACI
N052.15.20.259 E020.54.17.839 N052.15.33.396 E020.53.51.978 Color_251ACI
N052.15.33.396 E020.53.51.978 N052.15.34.556 E020.53.52.099 Color_251ACI
N052.15.34.556 E020.53.52.099 N052.15.36.167 E020.53.52.181 Color_251ACI
N052.15.36.167 E020.53.52.181 N052.15.37.028 E020.53.52.287 Color_251ACI
N052.15.37.028 E020.53.52.287 N052.15.37.440 E020.53.52.308 Color_251ACI
N052.15.37.440 E020.53.52.308 N052.15.39.309 E020.53.52.649 Color_251ACI
N052.15.39.309 E020.53.52.649 N052.15.40.543 E020.53.52.834 Color_251ACI
N052.15.40.543 E020.53.52.834 N052.15.41.966 E020.53.52.968 Color_251ACI
N052.15.41.966 E020.53.52.968 N052.15.43.869 E020.53.53.495 Color_251ACI
N052.15.43.869 E020.53.53.495 N052.15.44.051 E020.53.53.749 Color_251ACI
N052.15.44.051 E020.53.53.749 N052.15.45.347 E020.53.54.612 Color_251ACI
N052.15.45.347 E020.53.54.612 N052.15.48.074 E020.53.59.103 Color_251ACI
N052.15.48.074 E020.53.59.103 N052.15.56.084 E020.54.11.646 Color_251ACI
N052.15.45.418 E020.53.52.900 N052.15.44.787 E020.53.48.640 Color_251ACI
N052.15.44.787 E020.53.48.640 N052.15.43.041 E020.53.34.088 Color_251ACI
N052.15.43.041 E020.53.34.088 N052.15.42.810 E020.53.32.422 Color_251ACI
N052.15.42.810 E020.53.32.422 N052.15.36.401 E020.53.45.882 Color_251ACI
N052.15.36.401 E020.53.45.882 N052.15.33.667 E020.53.51.502 Color_251ACI
N052.15.33.667 E020.53.51.502 N052.15.33.926 E020.53.51.699 Color_251ACI
N052.15.33.926 E020.53.51.699 N052.15.35.537 E020.53.51.781 Color_251ACI
N052.15.35.537 E020.53.51.781 N052.15.36.399 E020.53.51.825 Color_251ACI
N052.15.36.399 E020.53.51.825 N052.15.36.811 E020.53.51.847 Color_251ACI
N052.15.36.811 E020.53.51.847 N052.15.38.679 E020.53.52.249 Color_251ACI
N052.15.38.679 E020.53.52.249 N052.15.39.951 E020.53.52.436 Color_251ACI
N052.15.39.951 E020.53.52.436 N052.15.41.336 E020.53.52.569 Color_251ACI
N052.15.41.336 E020.53.52.569 N052.15.42.458 E020.53.52.749 Color_251ACI
N052.15.42.458 E020.53.52.749 N052.15.43.952 E020.53.53.070 Color_251ACI
N052.15.43.952 E020.53.53.070 N052.15.44.986 E020.53.53.920 Color_251ACI
N052.15.44.986 E020.53.53.920 N052.15.45.097 E020.53.53.987 Color_251ACI
N052.15.45.097 E020.53.53.987 N052.15.45.249 E020.53.53.872 Color_251ACI
N052.15.45.249 E020.53.53.872 N052.15.45.365 E020.53.53.694 Color_251ACI
N052.15.45.365 E020.53.53.694 N052.15.45.448 E020.53.53.269 Color_251ACI
N052.15.45.448 E020.53.53.269 N052.15.45.419 E020.53.52.839 Color_251ACI
N052.15.15.626 E020.53.53.396 N052.15.31.334 E020.53.51.934 Color_251ACI
N052.15.31.334 E020.53.51.934 N052.15.32.573 E020.53.51.875 Color_251ACI
N052.15.32.573 E020.53.51.875 N052.15.32.597 E020.53.52.550 Color_251ACI
N052.15.32.597 E020.53.52.550 N052.15.16.613 E020.54.24.086 Color_251ACI
N052.15.16.613 E020.54.24.086 N052.15.16.310 E020.54.30.076 Color_251ACI
N052.15.16.310 E020.54.30.076 N052.15.13.458 E020.54.35.997 Color_251ACI
N052.15.21.473 E020.54.21.026 N052.15.21.950 E020.54.21.602 Color_251ACI
N052.15.21.950 E020.54.21.602 N052.15.21.685 E020.54.21.711 Color_251ACI
N052.15.21.685 E020.54.21.711 N052.15.21.420 E020.54.21.820 Color_251ACI
N052.15.21.420 E020.54.21.820 N052.15.21.115 E020.54.22.111 Color_251ACI
N052.15.21.115 E020.54.22.111 N052.15.20.999 E020.54.22.289 Color_251ACI
N052.15.20.999 E020.54.22.289 N052.15.20.843 E020.54.22.587 Color_251ACI
N052.15.20.843 E020.54.22.587 N052.15.20.725 E020.54.22.887 Color_251ACI
N052.15.20.725 E020.54.22.887 N052.15.20.682 E020.54.23.130 Color_251ACI
N052.15.20.682 E020.54.23.130 N052.15.20.602 E020.54.23.433 Color_251ACI
N052.15.20.602 E020.54.23.433 N052.15.20.556 E020.54.23.859 Color_251ACI
N052.15.20.556 E020.54.23.859 N052.15.20.543 E020.54.24.533 Color_251ACI
N052.15.20.543 E020.54.24.533 N052.15.20.608 E020.54.25.026 Color_251ACI
N052.15.20.608 E020.54.25.026 N052.15.20.678 E020.54.25.336 Color_251ACI
N052.15.20.678 E020.54.25.336 N052.15.20.823 E020.54.25.589 Color_251ACI
N052.15.20.823 E020.54.25.589 N052.15.20.968 E020.54.25.841 Color_251ACI
N052.15.20.968 E020.54.25.841 N052.15.23.168 E020.54.28.466 Color_251ACI
N052.15.23.168 E020.54.28.466 N052.15.23.426 E020.54.28.725 Color_251ACI
N052.15.23.426 E020.54.28.725 N052.15.23.761 E020.54.28.864 Color_251ACI
N052.15.23.761 E020.54.28.864 N052.15.24.061 E020.54.28.880 Color_251ACI
N052.15.24.061 E020.54.28.880 N052.15.24.363 E020.54.28.773 Color_251ACI
N052.15.24.363 E020.54.28.773 N052.15.24.552 E020.54.28.660 Color_251ACI
N052.15.24.552 E020.54.28.660 N052.15.24.780 E020.54.28.549 Color_251ACI
N052.15.24.780 E020.54.28.549 N052.15.24.972 E020.54.28.314 Color_251ACI
N052.15.24.972 E020.54.28.314 N052.15.25.126 E020.54.28.076 Color_251ACI
N052.15.25.126 E020.54.28.076 N052.15.25.247 E020.54.27.654 Color_251ACI
N052.15.25.247 E020.54.27.654 N052.15.25.366 E020.54.27.292 Color_251ACI
N052.15.25.366 E020.54.27.292 N052.15.25.448 E020.54.26.929 Color_251ACI
N052.15.25.448 E020.54.26.929 N052.15.25.454 E020.54.26.623 Color_251ACI
N052.15.25.454 E020.54.26.623 N052.15.25.426 E020.54.26.131 Color_251ACI
N052.15.25.426 E020.54.26.131 N052.15.25.395 E020.54.25.823 Color_251ACI
N052.15.25.395 E020.54.25.823 N052.15.25.219 E020.54.25.201 Color_251ACI
N052.15.25.219 E020.54.25.201 N052.15.25.036 E020.54.24.947 Color_251ACI
N052.15.25.036 E020.54.24.947 N052.15.21.595 E020.54.20.542 Color_251ACI
N052.15.21.595 E020.54.20.542 N052.15.21.437 E020.54.20.963 Color_251ACI
N052.15.21.437 E020.54.20.963 N052.15.21.473 E020.54.21.026 Color_251ACI
N052.15.52.440 E020.55.08.633 N052.15.52.100 E020.55.08.799 Color_251ACI
N052.16.00.523 E020.53.49.446 N052.16.00.824 E020.53.47.439 Color_251ACI
N052.16.00.824 E020.53.47.439 N052.16.01.827 E020.53.47.919 Color_251ACI
N052.16.01.827 E020.53.47.919 N052.16.01.565 E020.53.49.867 Color_251ACI
N052.16.02.221 E020.53.46.959 N052.16.01.998 E020.53.46.825 Color_251ACI
N052.15.50.585 E020.54.28.523 N052.15.48.080 E020.54.28.088 Color_251ACI
N052.15.52.416 E020.54.28.862 N052.15.50.585 E020.54.28.523 Color_251ACI
N052.16.01.338 E020.53.51.939 N052.15.58.039 E020.54.17.262 Color_251ACI
N052.15.52.440 E020.55.08.633 N052.15.54.429 E020.54.54.886 Color_251ACI
N052.15.44.475 E020.54.28.332 N052.15.45.876 E020.54.27.669 Color_251ACI
N052.15.45.876 E020.54.27.669 N052.15.46.960 E020.54.27.847 Color_251ACI
N052.15.46.960 E020.54.27.847 N052.15.48.080 E020.54.28.088 Color_251ACI
N052.16.29.612 E020.54.09.504 N052.16.30.531 E020.54.08.509 Color_251ACI
N052.16.00.868 E020.53.47.074 N052.16.01.087 E020.53.45.430 Color_251ACI
N052.16.01.872 E020.53.47.554 N052.16.00.868 E020.53.47.074 Color_251ACI
N052.16.01.961 E020.53.46.823 N052.16.01.872 E020.53.47.554 Color_251ACI
N052.15.51.593 E020.55.09.815 N052.15.50.243 E020.55.19.550 Color_251ACI
N052.15.52.100 E020.55.08.799 N052.15.50.581 E020.55.19.567 Color_251ACI
N052.16.12.435 E020.55.20.013 N052.16.14.071 E020.55.20.771 Color_251ACI
N052.16.14.970 E020.55.20.817 N052.16.14.970 E020.55.20.817 Color_251ACI
N052.16.14.970 E020.55.20.817 N052.16.15.822 E020.55.17.429 Color_251ACI
N052.16.15.822 E020.55.17.429 N052.16.16.143 E020.55.16.342 Color_251ACI
N052.16.16.143 E020.55.16.342 N052.16.16.422 E020.55.15.499 Color_251ACI
N052.16.16.422 E020.55.15.499 N052.16.18.509 E020.55.10.275 Color_251ACI
N052.16.18.509 E020.55.10.275 N052.16.20.078 E020.55.06.678 Color_251ACI
N052.16.20.078 E020.55.06.678 N052.16.21.943 E020.55.03.281 Color_251ACI
N052.16.21.943 E020.55.03.281 N052.16.22.745 E020.55.02.525 Color_251ACI
N052.16.22.745 E020.55.02.525 N052.16.23.089 E020.55.02.175 Color_251ACI
N052.16.23.089 E020.55.02.175 N052.16.23.656 E020.55.01.959 Color_251ACI
N052.16.23.656 E020.55.01.959 N052.16.23.957 E020.55.01.913 Color_251ACI
N052.16.23.957 E020.55.01.913 N052.16.24.145 E020.55.01.862 Color_251ACI
N052.16.24.145 E020.55.01.862 N052.16.24.259 E020.55.01.806 Color_251ACI
N052.16.23.422 E020.55.02.437 N052.16.23.875 E020.55.02.277 Color_251ACI
N052.16.23.875 E020.55.02.277 N052.16.24.063 E020.55.02.225 Color_251ACI
N052.16.15.195 E020.55.20.828 N052.16.15.764 E020.55.18.529 Color_251ACI
N052.16.15.764 E020.55.18.529 N052.16.16.368 E020.55.16.354 Color_251ACI
N052.16.16.368 E020.55.16.354 N052.16.17.316 E020.55.13.829 Color_251ACI
N052.16.17.316 E020.55.13.829 N052.16.18.301 E020.55.11.367 Color_251ACI
N052.16.18.301 E020.55.11.367 N052.16.20.107 E020.55.07.109 Color_251ACI
N052.16.20.107 E020.55.07.109 N052.16.21.971 E020.55.03.773 Color_251ACI
N052.16.21.971 E020.55.03.773 N052.16.22.509 E020.55.03.126 Color_251ACI
N052.16.22.509 E020.55.03.126 N052.16.23.044 E020.55.02.602 Color_251ACI
N052.16.23.044 E020.55.02.602 N052.16.23.422 E020.55.02.437 Color_251ACI
N052.16.18.537 E020.54.53.179 N052.16.14.049 E020.55.12.130 Color_251ACI
N052.16.14.049 E020.55.12.130 N052.16.12.048 E020.55.20.667 Color_251ACI
N052.16.12.392 E020.55.20.317 N052.16.12.272 E020.55.20.679 Color_251ACI
N052.16.12.392 E020.55.20.317 N052.16.13.359 E020.55.20.734 Color_251ACI
N052.16.03.262 E020.53.49.341 N052.16.03.957 E020.53.44.413 Color_251ACI
N052.16.03.957 E020.53.44.413 N052.16.09.275 E020.53.46.708 Color_251ACI
N052.16.09.275 E020.53.46.708 N052.16.08.624 E020.53.51.331 Color_251ACI
N052.16.01.338 E020.53.51.939 N052.16.01.122 E020.53.51.437 Color_251ACI
N052.16.01.122 E020.53.51.437 N052.15.59.708 E020.53.50.875 Color_251ACI
N052.15.59.708 E020.53.50.875 N052.15.59.282 E020.53.51.588 Color_251ACI
N052.15.59.282 E020.53.51.588 N052.15.57.859 E020.53.51.454 Color_251ACI
N052.15.57.859 E020.53.51.454 N052.15.57.916 E020.53.48.516 Color_251ACI
N052.15.57.916 E020.53.48.516 N052.15.59.227 E020.53.48.583 Color_251ACI
N052.15.59.227 E020.53.48.583 N052.15.59.655 E020.53.49.708 Color_251ACI
N052.15.59.655 E020.53.49.708 N052.16.00.211 E020.53.50.043 Color_251ACI
N052.16.08.490 E020.53.52.489 N052.16.08.056 E020.53.55.531 Color_251ACI
N052.16.08.056 E020.53.55.531 N052.16.03.848 E020.53.54.028 Color_251ACI
N052.16.03.848 E020.53.54.028 N052.16.02.882 E020.54.01.332 Color_251ACI
N052.16.02.882 E020.54.01.332 N052.16.01.765 E020.54.00.907 Color_251ACI
N052.16.26.294 E020.55.01.237 N052.16.26.476 E020.55.01.552 Color_251ACI
N052.16.26.476 E020.55.01.552 N052.16.28.702 E020.55.06.691 Color_251ACI
N052.16.28.702 E020.55.06.691 N052.16.29.816 E020.55.09.199 Color_251ACI
N052.16.25.961 E020.55.01.036 N052.16.29.804 E020.55.09.812 Color_251ACI
N052.15.43.951 E020.53.29.662 N052.15.43.712 E020.53.30.385 Color_251ACI
N052.15.43.712 E020.53.30.385 N052.15.43.080 E020.53.32.068 Color_251ACI
N052.15.43.080 E020.53.32.068 N052.15.43.411 E020.53.34.353 Color_251ACI
N052.15.43.411 E020.53.34.353 N052.15.45.119 E020.53.48.902 Color_251ACI
N052.15.45.119 E020.53.48.902 N052.15.46.053 E020.53.54.955 Color_251ACI
N052.16.18.619 E020.54.52.816 N052.16.19.887 E020.54.47.304 Color_251ACI
N052.16.19.887 E020.54.47.304 N052.16.28.661 E020.54.10.190 Color_251ACI
N052.16.28.661 E020.54.10.190 N052.16.29.620 E020.54.09.075 Color_251ACI
N052.16.29.620 E020.54.09.075 N052.16.30.618 E020.54.07.839 Color_251ACI
N052.16.30.618 E020.54.07.839 N052.16.31.001 E020.54.07.430 Color_251ACI
N052.16.30.531 E020.54.08.509 N052.16.30.991 E020.54.07.981 Color_251ACI
N052.15.15.640 E020.53.52.662 N052.15.31.461 E020.53.51.144 Color_251ACI
N052.15.31.461 E020.53.51.144 N052.15.32.738 E020.53.51.086 Color_251ACI
N052.15.32.738 E020.53.51.086 N052.15.33.337 E020.53.51.117 Color_251ACI
N052.15.33.337 E020.53.51.117 N052.15.36.339 E020.53.45.204 Color_251ACI
N052.15.36.339 E020.53.45.204 N052.15.42.436 E020.53.32.403 Color_251ACI
N052.15.42.436 E020.53.32.403 N052.15.43.534 E020.53.29.886 Color_251ACI
N052.15.43.534 E020.53.29.886 N052.15.43.614 E020.53.29.644 Color_251ACI
N052.15.58.573 E020.54.14.838 N052.15.58.260 E020.54.17.457 Color_251ACI
N052.15.58.260 E020.54.17.457 N052.15.58.017 E020.54.18.425 Color_251ACI
N052.15.58.017 E020.54.18.425 N052.15.56.902 E020.54.21.799 Color_251ACI
N052.15.56.902 E020.54.21.799 N052.15.55.189 E020.54.27.043 Color_251ACI
N052.15.55.189 E020.54.27.043 N052.15.54.916 E020.54.27.580 Color_251ACI
N052.15.54.916 E020.54.27.580 N052.15.54.604 E020.54.28.177 Color_251ACI
N052.15.54.604 E020.54.28.177 N052.15.54.335 E020.54.28.531 Color_251ACI
N052.15.54.335 E020.54.28.531 N052.15.54.067 E020.54.28.824 Color_251ACI
N052.15.54.067 E020.54.28.824 N052.15.53.611 E020.54.29.107 Color_251ACI
N052.15.53.611 E020.54.29.107 N052.15.53.157 E020.54.29.328 Color_251ACI
N052.15.53.157 E020.54.29.328 N052.15.52.894 E020.54.29.376 Color_251ACI
N052.15.52.894 E020.54.29.376 N052.15.52.071 E020.54.29.273 Color_251ACI
N052.15.52.416 E020.54.28.862 N052.15.52.827 E020.54.28.944 Color_251ACI
N052.15.52.827 E020.54.28.944 N052.15.53.090 E020.54.28.896 Color_251ACI
N052.15.53.090 E020.54.28.896 N052.15.53.506 E020.54.28.734 Color_251ACI
N052.15.53.506 E020.54.28.734 N052.15.53.771 E020.54.28.625 Color_251ACI
N052.15.53.771 E020.54.28.625 N052.15.53.962 E020.54.28.451 Color_251ACI
N052.15.53.962 E020.54.28.451 N052.15.54.191 E020.54.28.217 Color_251ACI
N052.15.54.191 E020.54.28.217 N052.15.54.423 E020.54.27.861 Color_251ACI
N052.15.54.423 E020.54.27.861 N052.15.54.966 E020.54.26.909 Color_251ACI
N052.15.54.966 E020.54.26.909 N052.15.55.084 E020.54.26.608 Color_251ACI
N052.15.53.908 E020.54.54.675 N052.15.51.766 E020.55.08.598 Color_251ACI
N052.15.51.766 E020.55.08.598 N052.15.51.678 E020.55.09.268 Color_251ACI
N052.15.51.593 E020.55.09.815 N052.15.51.148 E020.55.09.547 Color_251ACI
N052.15.51.148 E020.55.09.547 N052.15.48.725 E020.55.08.749 Color_251ACI
N052.15.51.678 E020.55.09.268 N052.15.50.819 E020.55.09.101 Color_251ACI
N052.15.50.819 E020.55.09.101 N052.15.50.037 E020.55.08.816 Color_251ACI
N052.15.50.037 E020.55.08.816 N052.15.49.220 E020.55.08.406 Color_251ACI
N052.15.49.220 E020.55.08.406 N052.15.48.771 E020.55.08.322 Color_251ACI
N052.16.01.087 E020.53.45.430 N052.16.00.827 E020.53.45.294 Color_251ACI
N052.16.00.827 E020.53.45.294 N052.16.00.256 E020.53.49.677 Color_251ACI
N052.16.00.256 E020.53.49.677 N052.16.01.484 E020.53.50.169 Color_251ACI
N052.16.01.484 E020.53.50.169 N052.16.01.439 E020.53.50.534 Color_251ACI
N052.16.01.439 E020.53.50.534 N052.16.00.211 E020.53.50.043 Color_251ACI
N052.16.02.264 E020.53.52.538 N052.16.01.867 E020.53.51.721 Color_251ACI
N052.16.01.867 E020.53.51.721 N052.16.01.602 E020.53.51.830 Color_251ACI
N052.16.01.602 E020.53.51.830 N052.15.58.573 E020.54.14.838 Color_251ACI
N052.16.02.693 E020.53.49.680 N052.16.01.739 E020.53.50.550 Color_251ACI
N052.16.01.739 E020.53.50.550 N052.16.02.221 E020.53.46.959 Color_251ACI
N052.16.20.099 E020.54.34.324 N052.16.20.508 E020.54.32.568 Color_251ACI
N052.16.21.062 E020.54.34.925 N052.16.20.099 E020.54.34.324 Color_251ACI
N052.16.21.472 E020.54.33.108 N052.16.21.062 E020.54.34.925 Color_251ACI
N052.16.20.508 E020.54.32.568 N052.16.21.435 E020.54.33.106 Color_251ACI
N052.16.21.736 E020.54.27.177 N052.16.21.069 E020.54.26.775 Color_251ACI
N052.16.20.714 E020.54.31.598 N052.16.21.736 E020.54.27.177 Color_251ACI
N052.16.20.046 E020.54.31.196 N052.16.20.714 E020.54.31.598 Color_251ACI
N052.16.21.069 E020.54.26.775 N052.16.20.046 E020.54.31.196 Color_251ACI
N052.16.18.687 E020.54.29.717 N052.16.20.168 E020.54.30.712 Color_251ACI
N052.16.18.075 E020.54.32.321 N052.16.18.687 E020.54.29.717 Color_251ACI
N052.16.19.559 E020.54.33.132 N052.16.18.075 E020.54.32.321 Color_251ACI
N052.16.20.168 E020.54.30.712 N052.16.19.559 E020.54.33.132 Color_251ACI
N052.16.18.654 E020.54.37.314 N052.16.16.808 E020.54.45.615 Color_251ACI
N052.16.19.284 E020.54.37.714 N052.16.18.654 E020.54.37.314 Color_251ACI
N052.16.17.401 E020.54.45.951 N052.16.19.284 E020.54.37.714 Color_251ACI
N052.16.16.808 E020.54.45.615 N052.16.17.401 E020.54.45.951 Color_251ACI
N052.15.47.427 E020.54.28.912 N052.15.47.433 E020.54.28.606 Color_251ACI
N052.15.47.433 E020.54.28.606 N052.15.45.904 E020.54.28.160 Color_251ACI
N052.16.22.376 E020.54.36.831 N052.16.21.375 E020.54.36.228 Color_251ACI
N052.16.21.375 E020.54.36.228 N052.16.21.186 E020.54.36.280 Color_251ACI
N052.16.21.186 E020.54.36.280 N052.16.21.107 E020.54.36.521 Color_251ACI
N052.16.21.107 E020.54.36.521 N052.16.20.805 E020.54.38.589 Color_251ACI
N052.16.20.805 E020.54.38.589 N052.16.20.409 E020.54.41.632 Color_251ACI
N052.16.20.409 E020.54.41.632 N052.16.20.279 E020.54.42.545 Color_251ACI
N052.16.20.279 E020.54.42.545 N052.16.20.073 E020.54.43.515 Color_251ACI
N052.16.20.073 E020.54.43.515 N052.16.19.294 E020.54.46.968 Color_251ACI
N052.16.19.294 E020.54.46.968 N052.16.18.721 E020.54.49.451 Color_251ACI
N052.16.18.721 E020.54.49.451 N052.16.18.069 E020.54.52.175 Color_251ACI
N052.16.18.069 E020.54.52.175 N052.16.18.064 E020.54.52.420 Color_251ACI
N052.16.18.064 E020.54.52.420 N052.16.18.174 E020.54.52.548 Color_251ACI
N052.16.18.174 E020.54.52.548 N052.16.18.619 E020.54.52.816 Color_251ACI
N052.16.22.419 E020.54.36.527 N052.16.21.456 E020.54.35.926 Color_251ACI
N052.16.21.456 E020.54.35.926 N052.16.21.385 E020.54.35.677 Color_251ACI
N052.16.21.385 E020.54.35.677 N052.16.21.351 E020.54.35.491 Color_251ACI
N052.16.21.351 E020.54.35.491 N052.16.21.471 E020.54.35.130 Color_251ACI
N052.16.21.471 E020.54.35.130 N052.16.24.534 E020.54.22.051 Color_251ACI
N052.16.24.534 E020.54.22.051 N052.16.24.312 E020.54.21.917 Color_251ACI
N052.16.24.312 E020.54.21.917 N052.16.21.325 E020.54.34.938 Color_251ACI
N052.16.21.325 E020.54.34.938 N052.16.21.204 E020.54.35.361 Color_251ACI
N052.16.21.204 E020.54.35.361 N052.16.21.127 E020.54.35.480 Color_251ACI
N052.16.21.127 E020.54.35.480 N052.16.21.051 E020.54.35.537 Color_251ACI
N052.16.21.051 E020.54.35.537 N052.16.20.938 E020.54.35.531 Color_251ACI
N052.16.20.938 E020.54.35.531 N052.16.20.085 E020.54.35.059 Color_251ACI
N052.16.20.085 E020.54.35.059 N052.16.19.900 E020.54.34.927 Color_251ACI
N052.16.19.900 E020.54.34.927 N052.16.19.826 E020.54.34.862 Color_251ACI
N052.16.19.826 E020.54.34.862 N052.16.19.754 E020.54.34.735 Color_251ACI
N052.16.19.754 E020.54.34.735 N052.16.19.717 E020.54.34.672 Color_251ACI
N052.16.19.717 E020.54.34.672 N052.16.19.718 E020.54.34.611 Color_251ACI
N052.16.19.718 E020.54.34.611 N052.16.19.720 E020.54.34.550 Color_251ACI
N052.16.19.720 E020.54.34.550 N052.16.19.759 E020.54.34.429 Color_251ACI
N052.16.19.759 E020.54.34.429 N052.16.19.798 E020.54.34.370 Color_251ACI
N052.16.19.798 E020.54.34.370 N052.16.19.837 E020.54.34.311 Color_251ACI
N052.16.19.837 E020.54.34.311 N052.16.19.912 E020.54.34.315 Color_251ACI
N052.16.19.912 E020.54.34.315 N052.16.19.987 E020.54.34.318 Color_251ACI
N052.16.19.987 E020.54.34.318 N052.16.20.099 E020.54.34.324 Color_251ACI
N052.16.20.508 E020.54.32.568 N052.16.20.714 E020.54.31.598 Color_251ACI
N052.16.21.736 E020.54.27.177 N052.16.23.002 E020.54.21.788 Color_251ACI
N052.16.23.003 E020.54.21.727 N052.16.22.409 E020.54.21.390 Color_251ACI
N052.16.22.409 E020.54.21.390 N052.16.21.069 E020.54.26.775 Color_251ACI
N052.16.18.075 E020.54.32.321 N052.16.17.668 E020.54.32.055 Color_251ACI
N052.16.17.668 E020.54.32.055 N052.16.17.546 E020.54.32.539 Color_251ACI
N052.16.17.546 E020.54.32.539 N052.16.19.102 E020.54.33.538 Color_251ACI
N052.16.19.102 E020.54.33.538 N052.16.19.212 E020.54.33.666 Color_251ACI
N052.16.19.212 E020.54.33.666 N052.16.19.246 E020.54.33.852 Color_251ACI
N052.16.19.246 E020.54.33.852 N052.16.19.244 E020.54.33.913 Color_251ACI
N052.16.19.244 E020.54.33.913 N052.16.19.200 E020.54.34.278 Color_251ACI
N052.16.19.200 E020.54.34.278 N052.16.18.906 E020.54.35.918 Color_251ACI
N052.16.18.906 E020.54.35.918 N052.16.19.464 E020.54.36.130 Color_251ACI
N052.16.17.216 E020.54.45.819 N052.16.17.063 E020.54.45.995 Color_251ACI
N052.16.17.063 E020.54.45.995 N052.16.17.060 E020.54.46.118 Color_251ACI
N052.16.17.060 E020.54.46.118 N052.16.17.018 E020.54.46.361 Color_251ACI
N052.16.17.018 E020.54.46.361 N052.16.16.969 E020.54.46.971 Color_251ACI
N052.16.16.969 E020.54.46.971 N052.16.17.001 E020.54.47.279 Color_251ACI
N052.16.17.001 E020.54.47.279 N052.16.17.072 E020.54.47.467 Color_251ACI
N052.16.17.072 E020.54.47.467 N052.16.17.404 E020.54.47.729 Color_251ACI
N052.16.17.790 E020.54.41.314 N052.16.15.822 E020.54.40.294 Color_251ACI
N052.16.15.822 E020.54.40.294 N052.16.15.739 E020.54.40.719 Color_251ACI
N052.16.15.739 E020.54.40.719 N052.16.17.708 E020.54.41.678 Color_251ACI
N052.16.16.808 E020.54.45.615 N052.16.16.734 E020.54.47.510 Color_251ACI
N052.16.16.734 E020.54.47.510 N052.16.16.428 E020.54.47.801 Color_251ACI
N052.16.16.428 E020.54.47.801 N052.16.15.057 E020.54.46.934 Color_251ACI
N052.16.15.057 E020.54.46.934 N052.16.15.023 E020.54.46.749 Color_251ACI
N052.16.15.023 E020.54.46.749 N052.16.14.957 E020.54.46.316 Color_251ACI
N052.16.14.957 E020.54.46.316 N052.16.14.323 E020.54.46.100 Color_251ACI
N052.16.14.323 E020.54.46.100 N052.16.14.156 E020.54.47.011 Color_251ACI
N052.16.14.156 E020.54.47.011 N052.16.14.863 E020.54.47.292 Color_251ACI
N052.16.14.863 E020.54.47.292 N052.16.15.088 E020.54.47.304 Color_251ACI
N052.16.15.088 E020.54.47.304 N052.16.16.421 E020.54.48.169 Color_251ACI
N052.16.16.421 E020.54.48.169 N052.16.14.584 E020.54.55.979 Color_251ACI
N052.16.14.584 E020.54.55.979 N052.16.14.542 E020.54.56.222 Color_251ACI
N052.16.14.542 E020.54.56.222 N052.16.14.538 E020.54.56.406 Color_251ACI
N052.16.14.538 E020.54.56.406 N052.16.14.498 E020.54.56.526 Color_251ACI
N052.16.14.498 E020.54.56.526 N052.16.14.532 E020.54.56.712 Color_251ACI
N052.16.14.532 E020.54.56.712 N052.16.14.530 E020.54.56.834 Color_251ACI
N052.16.14.530 E020.54.56.834 N052.16.14.601 E020.54.57.022 Color_251ACI
N052.16.14.601 E020.54.57.022 N052.16.14.674 E020.54.57.148 Color_251ACI
N052.16.14.674 E020.54.57.148 N052.16.14.783 E020.54.57.338 Color_251ACI
N052.16.14.783 E020.54.57.338 N052.16.14.892 E020.54.57.527 Color_251ACI
N052.16.14.892 E020.54.57.527 N052.16.15.077 E020.54.57.659 Color_251ACI
N052.16.15.077 E020.54.57.659 N052.16.15.299 E020.54.57.793 Color_251ACI
N052.16.15.299 E020.54.57.793 N052.16.15.706 E020.54.58.059 Color_251ACI
N052.16.15.706 E020.54.58.059 N052.16.16.042 E020.54.58.138 Color_251ACI
N052.16.16.042 E020.54.58.138 N052.16.16.305 E020.54.58.151 Color_251ACI
N052.16.16.305 E020.54.58.151 N052.16.16.493 E020.54.58.099 Color_251ACI
N052.16.16.493 E020.54.58.099 N052.16.16.722 E020.54.57.866 Color_251ACI
N052.15.58.378 E020.54.13.296 N052.15.58.189 E020.54.13.347 Color_251ACI
N052.15.58.189 E020.54.13.347 N052.15.58.152 E020.54.13.346 Color_251ACI
N052.15.58.152 E020.54.13.346 N052.15.57.518 E020.54.13.129 Color_251ACI
N052.15.57.518 E020.54.13.129 N052.15.56.487 E020.54.12.157 Color_251ACI
N052.15.56.487 E020.54.12.157 N052.15.56.084 E020.54.11.646 Color_251ACI
N052.15.46.053 E020.53.54.955 N052.15.46.412 E020.53.55.831 Color_251ACI
N052.15.46.412 E020.53.55.831 N052.15.50.310 E020.54.01.791 Color_251ACI
N052.15.50.310 E020.54.01.791 N052.15.53.662 E020.54.06.926 Color_251ACI
N052.15.53.662 E020.54.06.926 N052.15.56.682 E020.54.11.738 Color_251ACI
N052.15.56.682 E020.54.11.738 N052.15.57.679 E020.54.12.586 Color_251ACI
N052.15.57.679 E020.54.12.586 N052.15.58.200 E020.54.12.796 Color_251ACI
N052.15.58.200 E020.54.12.796 N052.15.58.465 E020.54.12.626 Color_251ACI
N052.16.20.144 E020.54.47.624 N052.16.15.295 E020.55.07.781 Color_251ACI
N052.16.15.295 E020.55.07.781 N052.16.12.435 E020.55.20.013 Color_251ACI
N052.16.18.537 E020.54.53.179 N052.16.18.019 E020.54.52.846 Color_251ACI
N052.16.18.019 E020.54.52.846 N052.16.17.908 E020.54.52.779 Color_251ACI
N052.16.17.908 E020.54.52.779 N052.16.17.830 E020.54.52.898 Color_251ACI
N052.16.17.830 E020.54.52.898 N052.16.17.786 E020.54.53.263 Color_251ACI
N052.16.20.144 E020.54.47.624 N052.16.22.871 E020.54.54.014 Color_251ACI
N052.16.22.871 E020.54.54.014 N052.16.25.817 E020.55.00.722 Color_251ACI
N052.16.25.923 E020.55.01.034 N052.16.25.768 E020.55.01.332 Color_251ACI
N052.16.25.768 E020.55.01.332 N052.16.25.577 E020.55.01.506 Color_251ACI
N052.16.25.577 E020.55.01.506 N052.16.25.390 E020.55.01.497 Color_251ACI
N052.16.25.390 E020.55.01.497 N052.16.25.130 E020.55.01.361 Color_251ACI
N052.16.25.130 E020.55.01.361 N052.16.24.980 E020.55.01.353 Color_251ACI
N052.16.24.980 E020.55.01.353 N052.16.24.789 E020.55.01.527 Color_251ACI
N052.16.24.789 E020.55.01.527 N052.16.24.709 E020.55.01.768 Color_251ACI
N052.16.24.709 E020.55.01.768 N052.16.24.630 E020.55.02.009 Color_251ACI
N052.16.24.630 E020.55.02.009 N052.16.24.514 E020.55.02.187 Color_251ACI
N052.16.24.514 E020.55.02.187 N052.16.24.288 E020.55.02.237 Color_251ACI
N052.16.24.288 E020.55.02.237 N052.16.24.063 E020.55.02.225 Color_251ACI
N052.16.24.259 E020.55.01.806 N052.16.24.410 E020.55.01.753 Color_251ACI
N052.16.24.410 E020.55.01.753 N052.16.24.568 E020.55.01.332 Color_251ACI
N052.16.24.568 E020.55.01.332 N052.16.24.836 E020.55.01.039 Color_251ACI
N052.16.24.836 E020.55.01.039 N052.16.25.062 E020.55.00.990 Color_251ACI
N052.16.25.062 E020.55.00.990 N052.16.25.398 E020.55.01.068 Color_251ACI
N052.16.25.398 E020.55.01.068 N052.16.25.546 E020.55.01.137 Color_251ACI
N052.16.25.546 E020.55.01.137 N052.16.25.700 E020.55.00.961 Color_251ACI
N052.16.25.700 E020.55.00.961 N052.16.25.779 E020.55.00.720 Color_251ACI
N052.16.26.294 E020.55.01.237 N052.16.20.266 E020.54.47.140 Color_251ACI
N052.16.29.612 E020.54.09.504 N052.16.28.920 E020.54.10.387 Color_251ACI
N052.16.28.920 E020.54.10.387 N052.16.28.560 E020.54.11.533 Color_251ACI
N052.16.28.560 E020.54.11.533 N052.16.24.555 E020.54.28.792 Color_251ACI
N052.16.24.555 E020.54.28.792 N052.16.20.266 E020.54.47.140 Color_251ACI
N052.16.16.722 E020.54.57.866 N052.16.16.926 E020.54.57.019 Color_251ACI
N052.16.16.926 E020.54.57.019 N052.16.17.787 E020.54.53.202 Color_251ACI
N052.16.16.047 E020.54.57.893 N052.16.16.272 E020.54.57.904 Color_251ACI
N052.16.16.272 E020.54.57.904 N052.16.16.423 E020.54.57.851 Color_251ACI
N052.16.16.423 E020.54.57.851 N052.16.16.576 E020.54.57.675 Color_251ACI
N052.16.16.576 E020.54.57.675 N052.16.16.738 E020.54.57.070 Color_251ACI
N052.16.16.738 E020.54.57.070 N052.16.17.682 E020.54.52.829 Color_251ACI
N052.16.17.682 E020.54.52.829 N052.16.17.685 E020.54.52.645 Color_251ACI
N052.16.17.685 E020.54.52.645 N052.16.17.687 E020.54.52.523 Color_251ACI
N052.16.17.687 E020.54.52.523 N052.16.17.651 E020.54.52.460 Color_251ACI
N052.16.17.651 E020.54.52.460 N052.16.16.019 E020.54.51.518 Color_251ACI
N052.16.16.019 E020.54.51.518 N052.16.15.165 E020.54.55.029 Color_251ACI
N052.16.15.165 E020.54.55.029 N052.16.15.423 E020.54.55.226 Color_251ACI
N052.16.15.423 E020.54.55.226 N052.16.15.178 E020.54.56.255 Color_251ACI
N052.16.15.178 E020.54.56.255 N052.16.14.956 E020.54.56.121 Color_251ACI
N052.16.14.956 E020.54.56.121 N052.16.14.919 E020.54.56.119 Color_251ACI
N052.16.14.919 E020.54.56.119 N052.16.14.880 E020.54.56.178 Color_251ACI
N052.16.14.880 E020.54.56.178 N052.16.14.879 E020.54.56.240 Color_251ACI
N052.16.14.879 E020.54.56.240 N052.16.14.839 E020.54.56.360 Color_251ACI
N052.16.14.839 E020.54.56.360 N052.16.14.799 E020.54.56.481 Color_251ACI
N052.16.14.799 E020.54.56.481 N052.16.14.797 E020.54.56.603 Color_251ACI
N052.16.14.797 E020.54.56.603 N052.16.14.794 E020.54.56.725 Color_251ACI
N052.16.14.794 E020.54.56.725 N052.16.14.828 E020.54.56.911 Color_251ACI
N052.16.14.828 E020.54.56.911 N052.16.14.900 E020.54.57.099 Color_251ACI
N052.16.14.900 E020.54.57.099 N052.16.15.010 E020.54.57.227 Color_251ACI
N052.16.15.010 E020.54.57.227 N052.16.15.119 E020.54.57.416 Color_251ACI
N052.16.15.119 E020.54.57.416 N052.16.15.266 E020.54.57.546 Color_251ACI
N052.16.15.266 E020.54.57.546 N052.16.15.415 E020.54.57.615 Color_251ACI
N052.16.15.415 E020.54.57.615 N052.16.15.600 E020.54.57.747 Color_251ACI
N052.16.15.600 E020.54.57.747 N052.16.15.823 E020.54.57.820 Color_251ACI
N052.16.15.823 E020.54.57.820 N052.16.16.010 E020.54.57.891 Color_251ACI
N052.16.16.010 E020.54.57.891 N052.16.16.084 E020.54.57.895 Color_251ACI
N052.16.16.788 E020.54.50.516 N052.16.16.270 E020.54.50.183 Color_251ACI
N052.16.16.270 E020.54.50.183 N052.16.16.025 E020.54.51.212 Color_251ACI
N052.16.16.025 E020.54.51.212 N052.16.17.656 E020.54.52.215 Color_251ACI
N052.16.17.656 E020.54.52.215 N052.16.17.768 E020.54.52.221 Color_251ACI
N052.16.17.768 E020.54.52.221 N052.16.17.847 E020.54.52.041 Color_251ACI
N052.16.17.847 E020.54.52.041 N052.16.17.967 E020.54.51.618 Color_251ACI
N052.16.17.967 E020.54.51.618 N052.16.18.013 E020.54.51.191 Color_251ACI
N052.16.18.013 E020.54.51.191 N052.16.18.014 E020.54.51.130 Color_251ACI
N052.16.18.014 E020.54.51.130 N052.16.17.754 E020.54.50.994 Color_251ACI
N052.16.18.798 E020.54.45.471 N052.16.19.317 E020.54.45.743 Color_251ACI
N052.16.19.317 E020.54.45.743 N052.16.19.353 E020.54.45.868 Color_251ACI
N052.16.19.353 E020.54.45.868 N052.16.19.350 E020.54.45.990 Color_251ACI
N052.16.19.350 E020.54.45.990 N052.16.18.170 E020.54.50.832 Color_251ACI
N052.16.18.170 E020.54.50.832 N052.16.18.095 E020.54.50.828 Color_251ACI
N052.16.18.095 E020.54.50.828 N052.16.17.798 E020.54.50.690 Color_251ACI
N052.16.19.994 E020.54.39.773 N052.16.20.403 E020.54.39.977 Color_251ACI
N052.16.20.403 E020.54.39.977 N052.16.20.933 E020.54.35.776 Color_251ACI
N052.16.20.933 E020.54.35.776 N052.16.19.931 E020.54.35.235 Color_251ACI
N052.16.19.931 E020.54.35.235 N052.16.19.858 E020.54.35.170 Color_251ACI
N052.16.19.858 E020.54.35.170 N052.16.19.783 E020.54.35.166 Color_251ACI
N052.16.19.783 E020.54.35.166 N052.16.19.708 E020.54.35.162 Color_251ACI
N052.16.19.708 E020.54.35.162 N052.16.19.633 E020.54.35.158 Color_251ACI
N052.16.19.633 E020.54.35.158 N052.16.19.594 E020.54.35.218 Color_251ACI
N052.16.19.594 E020.54.35.218 N052.16.19.557 E020.54.35.216 Color_251ACI
N052.16.19.557 E020.54.35.216 N052.16.19.517 E020.54.35.336 Color_251ACI
N052.16.19.517 E020.54.35.336 N052.16.19.516 E020.54.35.397 Color_251ACI
N052.16.19.516 E020.54.35.397 N052.16.19.515 E020.54.35.459 Color_251ACI
N052.16.19.515 E020.54.35.459 N052.16.19.551 E020.54.35.522 Color_251ACI
N052.16.19.551 E020.54.35.522 N052.16.19.550 E020.54.35.583 Color_251ACI
N052.16.19.550 E020.54.35.583 N052.16.19.587 E020.54.35.585 Color_251ACI
N052.16.19.912 E020.54.40.136 N052.16.20.321 E020.54.40.341 Color_251ACI
N052.16.20.321 E020.54.40.341 N052.16.20.354 E020.54.40.588 Color_251ACI
N052.16.20.354 E020.54.40.588 N052.16.20.350 E020.54.40.771 Color_251ACI
N052.16.20.350 E020.54.40.771 N052.16.20.182 E020.54.41.743 Color_251ACI
N052.16.20.182 E020.54.41.743 N052.16.19.554 E020.54.45.143 Color_251ACI
N052.16.19.554 E020.54.45.143 N052.16.19.514 E020.54.45.263 Color_251ACI
N052.16.19.514 E020.54.45.263 N052.16.19.324 E020.54.45.376 Color_251ACI
N052.16.19.324 E020.54.45.376 N052.16.18.841 E020.54.45.167 Color_251ACI
N052.15.58.039 E020.54.17.262 N052.15.57.875 E020.54.17.989 Color_251ACI
N052.15.57.875 E020.54.17.989 N052.15.57.557 E020.54.18.953 Color_251ACI
N052.15.57.557 E020.54.18.953 N052.15.57.115 E020.54.20.462 Color_251ACI
N052.15.57.115 E020.54.20.462 N052.15.55.084 E020.54.26.608 Color_251ACI
N052.15.24.032 E020.54.22.567 N052.15.25.282 E020.54.19.934 Color_251ACI
N052.15.25.282 E020.54.19.934 N052.15.25.287 E020.54.19.690 Color_251ACI
N052.15.25.287 E020.54.19.690 N052.15.25.176 E020.54.19.623 Color_251ACI
N052.15.25.176 E020.54.19.623 N052.15.24.801 E020.54.19.603 Color_251ACI
N052.15.24.801 E020.54.19.603 N052.15.23.526 E020.54.19.599 Color_251ACI
N052.15.23.526 E020.54.19.599 N052.15.22.562 E020.54.20.959 Color_251ACI
N052.15.24.032 E020.54.22.567 N052.15.24.027 E020.54.22.812 Color_251ACI
N052.15.24.027 E020.54.22.812 N052.15.26.886 E020.54.26.267 Color_251ACI
N052.15.26.886 E020.54.26.267 N052.15.26.961 E020.54.26.271 Color_251ACI
N052.15.26.961 E020.54.26.271 N052.15.27.351 E020.54.25.494 Color_251ACI
N052.15.26.292 E020.54.25.991 N052.15.24.174 E020.54.30.785 Color_251ACI
N052.15.24.174 E020.54.30.785 N052.15.23.991 E020.54.30.531 Color_251ACI
N052.15.23.991 E020.54.30.531 N052.15.26.145 E020.54.25.800 Color_251ACI
N052.15.26.145 E020.54.25.800 N052.15.20.060 E020.54.18.441 Color_251ACI
N052.15.20.060 E020.54.18.441 N052.15.19.905 E020.54.18.679 Color_251ACI
N052.15.19.905 E020.54.18.679 N052.15.18.477 E020.54.24.672 Color_251ACI
N052.15.18.477 E020.54.24.672 N052.15.16.751 E020.54.30.589 Color_251ACI
N052.15.16.751 E020.54.30.589 N052.15.13.424 E020.54.37.772 Color_251ACI
N052.15.20.259 E020.54.17.839 N052.15.20.289 E020.54.18.208 Color_251ACI
N052.15.20.289 E020.54.18.208 N052.15.22.562 E020.54.20.959 Color_251ACI
N052.15.16.631 E020.54.28.990 N052.15.16.665 E020.54.29.175 Color_251ACI
N052.15.16.665 E020.54.29.175 N052.15.16.740 E020.54.29.179 Color_251ACI
N052.15.16.740 E020.54.29.179 N052.15.16.815 E020.54.29.183 Color_251ACI
N052.15.16.815 E020.54.29.183 N052.15.18.376 E020.54.24.054 Color_251ACI
N052.15.18.376 E020.54.24.054 N052.15.19.357 E020.54.19.876 Color_251ACI
N052.15.16.631 E020.54.28.990 N052.15.16.947 E020.54.24.287 Color_251ACI
N052.15.16.947 E020.54.24.287 N052.15.19.247 E020.54.19.748 Color_251ACI
N052.15.19.247 E020.54.19.748 N052.15.19.356 E020.54.19.937 Color_251ACI
N052.15.20.259 E020.54.17.839 N052.15.33.396 E020.53.51.978 Color_251ACI
N052.15.33.396 E020.53.51.978 N052.15.34.556 E020.53.52.099 Color_251ACI
N052.15.34.556 E020.53.52.099 N052.15.36.167 E020.53.52.181 Color_251ACI
N052.15.36.167 E020.53.52.181 N052.15.37.028 E020.53.52.287 Color_251ACI
N052.15.37.028 E020.53.52.287 N052.15.37.440 E020.53.52.308 Color_251ACI
N052.15.37.440 E020.53.52.308 N052.15.39.309 E020.53.52.649 Color_251ACI
N052.15.39.309 E020.53.52.649 N052.15.40.543 E020.53.52.834 Color_251ACI
N052.15.40.543 E020.53.52.834 N052.15.41.966 E020.53.52.968 Color_251ACI
N052.15.41.966 E020.53.52.968 N052.15.43.869 E020.53.53.495 Color_251ACI
N052.15.43.869 E020.53.53.495 N052.15.44.051 E020.53.53.749 Color_251ACI
N052.15.44.051 E020.53.53.749 N052.15.45.347 E020.53.54.612 Color_251ACI
N052.15.45.347 E020.53.54.612 N052.15.48.074 E020.53.59.103 Color_251ACI
N052.15.48.074 E020.53.59.103 N052.15.56.084 E020.54.11.646 Color_251ACI
N052.15.45.418 E020.53.52.900 N052.15.44.787 E020.53.48.640 Color_251ACI
N052.15.44.787 E020.53.48.640 N052.15.43.041 E020.53.34.088 Color_251ACI
N052.15.43.041 E020.53.34.088 N052.15.42.810 E020.53.32.422 Color_251ACI
N052.15.42.810 E020.53.32.422 N052.15.36.401 E020.53.45.882 Color_251ACI
N052.15.36.401 E020.53.45.882 N052.15.33.667 E020.53.51.502 Color_251ACI
N052.15.33.667 E020.53.51.502 N052.15.33.926 E020.53.51.699 Color_251ACI
N052.15.33.926 E020.53.51.699 N052.15.35.537 E020.53.51.781 Color_251ACI
N052.15.35.537 E020.53.51.781 N052.15.36.399 E020.53.51.825 Color_251ACI
N052.15.36.399 E020.53.51.825 N052.15.36.811 E020.53.51.847 Color_251ACI
N052.15.36.811 E020.53.51.847 N052.15.38.679 E020.53.52.249 Color_251ACI
N052.15.38.679 E020.53.52.249 N052.15.39.951 E020.53.52.436 Color_251ACI
N052.15.39.951 E020.53.52.436 N052.15.41.336 E020.53.52.569 Color_251ACI
N052.15.41.336 E020.53.52.569 N052.15.42.458 E020.53.52.749 Color_251ACI
N052.15.42.458 E020.53.52.749 N052.15.43.952 E020.53.53.070 Color_251ACI
N052.15.43.952 E020.53.53.070 N052.15.44.986 E020.53.53.920 Color_251ACI
N052.15.44.986 E020.53.53.920 N052.15.45.097 E020.53.53.987 Color_251ACI
N052.15.45.097 E020.53.53.987 N052.15.45.249 E020.53.53.872 Color_251ACI
N052.15.45.249 E020.53.53.872 N052.15.45.365 E020.53.53.694 Color_251ACI
N052.15.45.365 E020.53.53.694 N052.15.45.448 E020.53.53.269 Color_251ACI
N052.15.45.448 E020.53.53.269 N052.15.45.419 E020.53.52.839 Color_251ACI
N052.15.15.626 E020.53.53.396 N052.15.31.334 E020.53.51.934 Color_251ACI
N052.15.31.334 E020.53.51.934 N052.15.32.573 E020.53.51.875 Color_251ACI
N052.15.32.573 E020.53.51.875 N052.15.32.597 E020.53.52.550 Color_251ACI
N052.15.32.597 E020.53.52.550 N052.15.16.613 E020.54.24.086 Color_251ACI
N052.15.16.613 E020.54.24.086 N052.15.16.310 E020.54.30.076 Color_251ACI
N052.15.16.310 E020.54.30.076 N052.15.13.458 E020.54.35.997 Color_251ACI
N052.15.21.473 E020.54.21.026 N052.15.21.950 E020.54.21.602 Color_251ACI
N052.15.21.950 E020.54.21.602 N052.15.21.685 E020.54.21.711 Color_251ACI
N052.15.21.685 E020.54.21.711 N052.15.21.420 E020.54.21.820 Color_251ACI
N052.15.21.420 E020.54.21.820 N052.15.21.115 E020.54.22.111 Color_251ACI
N052.15.21.115 E020.54.22.111 N052.15.20.999 E020.54.22.289 Color_251ACI
N052.15.20.999 E020.54.22.289 N052.15.20.843 E020.54.22.587 Color_251ACI
N052.15.20.843 E020.54.22.587 N052.15.20.725 E020.54.22.887 Color_251ACI
N052.15.20.725 E020.54.22.887 N052.15.20.682 E020.54.23.130 Color_251ACI
N052.15.20.682 E020.54.23.130 N052.15.20.602 E020.54.23.433 Color_251ACI
N052.15.20.602 E020.54.23.433 N052.15.20.556 E020.54.23.859 Color_251ACI
N052.15.20.556 E020.54.23.859 N052.15.20.543 E020.54.24.533 Color_251ACI
N052.15.20.543 E020.54.24.533 N052.15.20.608 E020.54.25.026 Color_251ACI
N052.15.20.608 E020.54.25.026 N052.15.20.678 E020.54.25.336 Color_251ACI
N052.15.20.678 E020.54.25.336 N052.15.20.823 E020.54.25.589 Color_251ACI
N052.15.20.823 E020.54.25.589 N052.15.20.968 E020.54.25.841 Color_251ACI
N052.15.20.968 E020.54.25.841 N052.15.23.168 E020.54.28.466 Color_251ACI
N052.15.23.168 E020.54.28.466 N052.15.23.426 E020.54.28.725 Color_251ACI
N052.15.23.426 E020.54.28.725 N052.15.23.761 E020.54.28.864 Color_251ACI
N052.15.23.761 E020.54.28.864 N052.15.24.061 E020.54.28.880 Color_251ACI
N052.15.24.061 E020.54.28.880 N052.15.24.363 E020.54.28.773 Color_251ACI
N052.15.24.363 E020.54.28.773 N052.15.24.552 E020.54.28.660 Color_251ACI
N052.15.24.552 E020.54.28.660 N052.15.24.780 E020.54.28.549 Color_251ACI
N052.15.24.780 E020.54.28.549 N052.15.24.972 E020.54.28.314 Color_251ACI
N052.15.24.972 E020.54.28.314 N052.15.25.126 E020.54.28.076 Color_251ACI
N052.15.25.126 E020.54.28.076 N052.15.25.247 E020.54.27.654 Color_251ACI
N052.15.25.247 E020.54.27.654 N052.15.25.366 E020.54.27.292 Color_251ACI
N052.15.25.366 E020.54.27.292 N052.15.25.448 E020.54.26.929 Color_251ACI
N052.15.25.448 E020.54.26.929 N052.15.25.454 E020.54.26.623 Color_251ACI
N052.15.25.454 E020.54.26.623 N052.15.25.426 E020.54.26.131 Color_251ACI
N052.15.25.426 E020.54.26.131 N052.15.25.395 E020.54.25.823 Color_251ACI
N052.15.25.395 E020.54.25.823 N052.15.25.219 E020.54.25.201 Color_251ACI
N052.15.25.219 E020.54.25.201 N052.15.25.036 E020.54.24.947 Color_251ACI
N052.15.25.036 E020.54.24.947 N052.15.21.595 E020.54.20.542 Color_251ACI
N052.15.21.595 E020.54.20.542 N052.15.21.437 E020.54.20.963 Color_251ACI
N052.15.21.437 E020.54.20.963 N052.15.21.473 E020.54.21.026 Color_251ACI
N052.15.52.440 E020.55.08.633 N052.15.52.100 E020.55.08.799 Color_251ACI
N052.16.00.523 E020.53.49.446 N052.16.00.824 E020.53.47.439 Color_251ACI
N052.16.00.824 E020.53.47.439 N052.16.01.827 E020.53.47.919 Color_251ACI
N052.16.01.827 E020.53.47.919 N052.16.01.565 E020.53.49.867 Color_251ACI
N052.16.02.221 E020.53.46.959 N052.16.01.998 E020.53.46.825 Color_251ACI
N052.15.50.585 E020.54.28.523 N052.15.48.080 E020.54.28.088 Color_251ACI
N052.15.52.416 E020.54.28.862 N052.15.50.585 E020.54.28.523 Color_251ACI
N052.16.01.338 E020.53.51.939 N052.15.58.039 E020.54.17.262 Color_251ACI
N052.15.52.440 E020.55.08.633 N052.15.54.429 E020.54.54.886 Color_251ACI
N052.15.44.475 E020.54.28.332 N052.15.45.876 E020.54.27.669 Color_251ACI
N052.15.45.876 E020.54.27.669 N052.15.46.960 E020.54.27.847 Color_251ACI
N052.15.46.960 E020.54.27.847 N052.15.48.080 E020.54.28.088 Color_251ACI
N052.16.29.612 E020.54.09.504 N052.16.30.531 E020.54.08.509 Color_251ACI
N052.16.00.868 E020.53.47.074 N052.16.01.087 E020.53.45.430 Color_251ACI
N052.16.01.872 E020.53.47.554 N052.16.00.868 E020.53.47.074 Color_251ACI
N052.16.01.961 E020.53.46.823 N052.16.01.872 E020.53.47.554 Color_251ACI
N052.16.00.181 E020.53.53.595 N052.16.00.516 E020.53.53.735 Color_251ACI
N052.16.00.516 E020.53.53.735 N052.16.00.431 E020.53.54.221 Color_251ACI
N052.16.00.431 E020.53.54.221 N052.16.00.133 E020.53.54.144 Color_251ACI
N052.16.00.583 E020.53.54.106 N052.16.00.919 E020.53.54.185 Color_251ACI
N052.16.00.919 E020.53.54.185 N052.16.00.834 E020.53.54.732 Color_251ACI
N052.16.00.834 E020.53.54.732 N052.16.00.535 E020.53.54.655 Color_251ACI
N052.15.59.755 E020.53.44.504 N052.16.00.091 E020.53.44.583 Color_251ACI
N052.16.00.091 E020.53.44.583 N052.16.00.006 E020.53.45.130 Color_251ACI
N052.16.00.006 E020.53.45.130 N052.15.59.708 E020.53.44.992 Color_251ACI
N052.16.21.222 E020.54.38.304 N052.16.21.437 E020.54.36.905 Color_251ACI
N052.16.21.437 E020.54.36.905 N052.16.21.660 E020.54.36.978 Color_251ACI
N052.16.21.660 E020.54.36.978 N052.16.21.446 E020.54.38.376 Color_251ACI
N052.16.15.199 E020.54.59.075 N052.16.14.197 E020.54.58.533 Color_251ACI
N052.16.14.197 E020.54.58.533 N052.16.14.154 E020.54.58.837 Color_251ACI
N052.16.14.154 E020.54.58.837 N052.16.15.119 E020.54.59.377 Color_251ACI
N052.16.16.944 E020.54.54.139 N052.16.15.869 E020.54.53.472 Color_251ACI
N052.16.15.869 E020.54.53.472 N052.16.15.745 E020.54.54.078 Color_251ACI
N052.16.15.745 E020.54.54.078 N052.16.16.821 E020.54.54.685 Color_251ACI
N052.16.02.499 E020.53.46.115 N052.16.02.872 E020.53.46.257 Color_251ACI
N052.16.02.872 E020.53.46.257 N052.16.02.740 E020.53.47.231 Color_251ACI
N052.16.02.740 E020.53.47.231 N052.16.02.368 E020.53.47.089 Color_251ACI
N052.16.01.693 E020.53.45.155 N052.16.02.176 E020.53.45.364 Color_251ACI
N052.16.02.176 E020.53.45.364 N052.16.01.914 E020.53.47.311 Color_251ACI
N052.16.01.914 E020.53.47.311 N052.16.01.393 E020.53.47.100 Color_251ACI
N052.16.00.353 E020.53.44.596 N052.16.00.652 E020.53.44.673 Color_251ACI
N052.16.00.652 E020.53.44.673 N052.16.00.604 E020.53.45.222 Color_251ACI
N052.16.00.604 E020.53.45.222 N052.16.00.268 E020.53.45.143 Color_251ACI
N052.16.13.667 E020.54.58.812 N052.16.12.722 E020.55.03.115 Color_251ACI
N052.16.12.722 E020.55.03.115 N052.16.12.462 E020.55.02.979 Color_251ACI
N052.16.12.462 E020.55.02.979 N052.16.13.445 E020.54.58.679 Color_251ACI
N052.16.14.539 E020.55.00.267 N052.16.13.542 E020.55.01.441 Color_251ACI
N052.16.13.542 E020.55.01.441 N052.16.13.434 E020.55.01.190 Color_251ACI
N052.16.13.434 E020.55.01.190 N052.16.14.395 E020.54.59.953 Color_251ACI
N052.16.14.204 E020.55.00.127 N052.16.13.436 E020.55.01.068 Color_251ACI
N052.16.13.436 E020.55.01.068 N052.16.13.327 E020.55.00.879 Color_251ACI
N052.16.13.327 E020.55.00.879 N052.16.14.097 E020.54.59.876 Color_251ACI
N052.16.15.001 E020.54.59.616 N052.16.13.888 E020.54.59.008 Color_251ACI
N052.16.13.888 E020.54.59.008 N052.16.13.807 E020.54.59.310 Color_251ACI
N052.16.13.807 E020.54.59.310 N052.16.14.957 E020.54.59.982 Color_251ACI
N052.16.15.964 E020.54.58.317 N052.16.14.926 E020.54.57.713 Color_251ACI
N052.16.14.926 E020.54.57.713 N052.16.14.801 E020.54.58.319 Color_251ACI
N052.16.14.801 E020.54.58.319 N052.16.15.840 E020.54.58.924 Color_251ACI
N052.16.16.539 E020.54.55.712 N052.16.16.205 E020.54.55.511 Color_251ACI
N052.16.16.205 E020.54.55.511 N052.16.15.836 E020.54.57.147 Color_251ACI
N052.16.15.836 E020.54.57.147 N052.16.16.170 E020.54.57.347 Color_251ACI
N052.16.17.312 E020.54.52.565 N052.16.16.348 E020.54.51.964 Color_251ACI
N052.16.16.348 E020.54.51.964 N052.16.16.187 E020.54.52.569 Color_251ACI
N052.16.16.187 E020.54.52.569 N052.16.17.188 E020.54.53.171 Color_251ACI
N052.16.17.404 E020.54.47.729 N052.16.16.750 E020.54.50.575 Color_251ACI
N052.16.16.750 E020.54.50.575 N052.16.17.714 E020.54.51.115 Color_251ACI
N052.16.17.714 E020.54.51.115 N052.16.18.368 E020.54.48.330 Color_251ACI
N052.16.18.093 E020.54.43.107 N052.16.17.437 E020.54.46.015 Color_251ACI
N052.16.17.437 E020.54.46.015 N052.16.18.512 E020.54.46.682 Color_251ACI
N052.16.18.512 E020.54.46.682 N052.16.19.168 E020.54.43.775 Color_251ACI
N052.16.18.664 E020.54.40.685 N052.16.19.284 E020.54.37.714 Color_251ACI
N052.16.19.284 E020.54.37.714 N052.16.20.285 E020.54.38.317 Color_251ACI
N052.16.20.285 E020.54.38.317 N052.16.19.667 E020.54.41.227 Color_251ACI
N052.16.19.588 E020.54.35.524 N052.16.20.627 E020.54.36.128 Color_251ACI
N052.16.20.627 E020.54.36.128 N052.16.20.504 E020.54.36.674 Color_251ACI
N052.16.20.504 E020.54.36.674 N052.16.19.465 E020.54.36.069 Color_251ACI
N052.16.21.160 E020.54.29.844 N052.16.22.126 E020.54.30.322 Color_251ACI
N052.16.22.126 E020.54.30.322 N052.16.21.715 E020.54.32.201 Color_251ACI
N052.16.21.715 E020.54.32.201 N052.16.20.787 E020.54.31.663 Color_251ACI
N052.16.21.772 E020.54.27.240 N052.16.22.663 E020.54.27.715 Color_251ACI
N052.16.22.663 E020.54.27.715 N052.16.22.292 E020.54.29.473 Color_251ACI
N052.16.22.292 E020.54.29.473 N052.16.21.401 E020.54.28.998 Color_251ACI
N052.16.22.423 E020.54.24.577 N052.16.23.313 E020.54.25.113 Color_251ACI
N052.16.23.313 E020.54.25.113 N052.16.22.903 E020.54.26.931 Color_251ACI
N052.16.22.903 E020.54.26.931 N052.16.22.013 E020.54.26.395 Color_251ACI
N052.16.23.113 E020.54.21.855 N052.16.23.965 E020.54.22.389 Color_251ACI
N052.16.23.965 E020.54.22.389 N052.16.23.555 E020.54.24.206 Color_251ACI
N052.16.23.555 E020.54.24.206 N052.16.22.667 E020.54.23.609 Color_251ACI
;buildings N000.00.00.000 E000.00.00.000 N000.00.00.000 E000.00.00.000
N052.16.00.353 E020.53.44.596 N052.16.00.652 E020.53.44.673 Color_16ACI
N052.16.00.652 E020.53.44.673 N052.16.00.604 E020.53.45.222 Color_16ACI
N052.16.00.604 E020.53.45.222 N052.16.00.268 E020.53.45.143 Color_16ACI
N052.16.00.268 E020.53.45.143 N052.16.00.353 E020.53.44.596 Color_16ACI
N052.16.01.693 E020.53.45.155 N052.16.02.176 E020.53.45.364 Color_16ACI
N052.16.02.176 E020.53.45.364 N052.16.01.914 E020.53.47.311 Color_16ACI
N052.16.01.914 E020.53.47.311 N052.16.01.393 E020.53.47.100 Color_16ACI
N052.16.01.393 E020.53.47.100 N052.16.01.693 E020.53.45.155 Color_16ACI
N052.16.02.499 E020.53.46.115 N052.16.02.872 E020.53.46.257 Color_16ACI
N052.16.02.872 E020.53.46.257 N052.16.02.740 E020.53.47.231 Color_16ACI
N052.16.02.740 E020.53.47.231 N052.16.02.368 E020.53.47.089 Color_16ACI
N052.16.02.368 E020.53.47.089 N052.16.02.499 E020.53.46.115 Color_16ACI
N052.15.59.755 E020.53.44.504 N052.16.00.091 E020.53.44.583 Color_16ACI
N052.16.00.091 E020.53.44.583 N052.16.00.006 E020.53.45.130 Color_16ACI
N052.16.00.006 E020.53.45.130 N052.15.59.708 E020.53.44.992 Color_16ACI
N052.15.59.708 E020.53.44.992 N052.15.59.755 E020.53.44.504 Color_16ACI
N052.16.00.583 E020.53.54.106 N052.16.00.919 E020.53.54.185 Color_16ACI
N052.16.00.919 E020.53.54.185 N052.16.00.834 E020.53.54.732 Color_16ACI
N052.16.00.834 E020.53.54.732 N052.16.00.535 E020.53.54.655 Color_16ACI
N052.16.00.535 E020.53.54.655 N052.16.00.583 E020.53.54.106 Color_16ACI
N052.16.00.181 E020.53.53.595 N052.16.00.516 E020.53.53.735 Color_16ACI
N052.16.00.516 E020.53.53.735 N052.16.00.431 E020.53.54.221 Color_16ACI
N052.16.00.431 E020.53.54.221 N052.16.00.133 E020.53.54.144 Color_16ACI
N052.16.00.133 E020.53.54.144 N052.16.00.181 E020.53.53.595 Color_16ACI
N052.16.23.113 E020.54.21.855 N052.16.23.965 E020.54.22.389 Color_16ACI
N052.16.23.965 E020.54.22.389 N052.16.23.555 E020.54.24.206 Color_16ACI
N052.16.23.555 E020.54.24.206 N052.16.22.667 E020.54.23.609 Color_16ACI
N052.16.22.667 E020.54.23.609 N052.16.23.113 E020.54.21.855 Color_16ACI
N052.16.22.423 E020.54.24.577 N052.16.23.313 E020.54.25.113 Color_16ACI
N052.16.23.313 E020.54.25.113 N052.16.22.903 E020.54.26.931 Color_16ACI
N052.16.22.903 E020.54.26.931 N052.16.22.013 E020.54.26.395 Color_16ACI
N052.16.22.013 E020.54.26.395 N052.16.22.423 E020.54.24.577 Color_16ACI
N052.16.21.772 E020.54.27.240 N052.16.22.663 E020.54.27.715 Color_16ACI
N052.16.22.663 E020.54.27.715 N052.16.22.292 E020.54.29.473 Color_16ACI
N052.16.22.292 E020.54.29.473 N052.16.21.401 E020.54.28.998 Color_16ACI
N052.16.21.401 E020.54.28.998 N052.16.21.772 E020.54.27.240 Color_16ACI
N052.16.21.160 E020.54.29.844 N052.16.22.126 E020.54.30.322 Color_16ACI
N052.16.22.126 E020.54.30.322 N052.16.21.715 E020.54.32.201 Color_16ACI
N052.16.21.715 E020.54.32.201 N052.16.20.787 E020.54.31.663 Color_16ACI
N052.16.20.787 E020.54.31.663 N052.16.21.160 E020.54.29.844 Color_16ACI
N052.16.19.588 E020.54.35.524 N052.16.20.627 E020.54.36.128 Color_16ACI
N052.16.20.627 E020.54.36.128 N052.16.20.504 E020.54.36.674 Color_16ACI
N052.16.20.504 E020.54.36.674 N052.16.19.465 E020.54.36.069 Color_16ACI
N052.16.19.465 E020.54.36.069 N052.16.19.588 E020.54.35.524 Color_16ACI
N052.16.18.664 E020.54.40.685 N052.16.19.284 E020.54.37.714 Color_16ACI
N052.16.19.284 E020.54.37.714 N052.16.20.285 E020.54.38.317 Color_16ACI
N052.16.20.285 E020.54.38.317 N052.16.19.667 E020.54.41.227 Color_16ACI
N052.16.19.667 E020.54.41.227 N052.16.18.664 E020.54.40.685 Color_16ACI
N052.16.18.093 E020.54.43.107 N052.16.17.437 E020.54.46.015 Color_16ACI
N052.16.17.437 E020.54.46.015 N052.16.18.512 E020.54.46.682 Color_16ACI
N052.16.18.512 E020.54.46.682 N052.16.19.168 E020.54.43.775 Color_16ACI
N052.16.19.168 E020.54.43.775 N052.16.18.093 E020.54.43.107 Color_16ACI
N052.16.17.404 E020.54.47.729 N052.16.16.750 E020.54.50.575 Color_16ACI
N052.16.16.750 E020.54.50.575 N052.16.17.714 E020.54.51.115 Color_16ACI
N052.16.17.714 E020.54.51.115 N052.16.18.368 E020.54.48.330 Color_16ACI
N052.16.18.368 E020.54.48.330 N052.16.17.404 E020.54.47.729 Color_16ACI
N052.16.17.312 E020.54.52.565 N052.16.16.348 E020.54.51.964 Color_16ACI
N052.16.16.348 E020.54.51.964 N052.16.16.187 E020.54.52.569 Color_16ACI
N052.16.16.187 E020.54.52.569 N052.16.17.188 E020.54.53.171 Color_16ACI
N052.16.17.188 E020.54.53.171 N052.16.17.312 E020.54.52.565 Color_16ACI
N052.16.16.539 E020.54.55.712 N052.16.16.205 E020.54.55.511 Color_16ACI
N052.16.16.205 E020.54.55.511 N052.16.15.836 E020.54.57.147 Color_16ACI
N052.16.15.836 E020.54.57.147 N052.16.16.170 E020.54.57.347 Color_16ACI
N052.16.16.170 E020.54.57.347 N052.16.16.539 E020.54.55.712 Color_16ACI
N052.16.15.964 E020.54.58.317 N052.16.14.926 E020.54.57.713 Color_16ACI
N052.16.14.926 E020.54.57.713 N052.16.14.801 E020.54.58.319 Color_16ACI
N052.16.14.801 E020.54.58.319 N052.16.15.840 E020.54.58.924 Color_16ACI
N052.16.15.840 E020.54.58.924 N052.16.15.964 E020.54.58.317 Color_16ACI
N052.16.15.001 E020.54.59.616 N052.16.13.888 E020.54.59.008 Color_16ACI
N052.16.13.888 E020.54.59.008 N052.16.13.807 E020.54.59.310 Color_16ACI
N052.16.13.807 E020.54.59.310 N052.16.14.957 E020.54.59.982 Color_16ACI
N052.16.14.957 E020.54.59.982 N052.16.15.001 E020.54.59.616 Color_16ACI
N052.16.14.204 E020.55.00.127 N052.16.13.436 E020.55.01.068 Color_16ACI
N052.16.13.436 E020.55.01.068 N052.16.13.327 E020.55.00.879 Color_16ACI
N052.16.13.327 E020.55.00.879 N052.16.14.097 E020.54.59.876 Color_16ACI
N052.16.14.097 E020.54.59.876 N052.16.14.204 E020.55.00.127 Color_16ACI
N052.16.14.539 E020.55.00.267 N052.16.13.542 E020.55.01.441 Color_16ACI
N052.16.13.542 E020.55.01.441 N052.16.13.434 E020.55.01.190 Color_16ACI
N052.16.13.434 E020.55.01.190 N052.16.14.395 E020.54.59.953 Color_16ACI
N052.16.14.395 E020.54.59.953 N052.16.14.539 E020.55.00.267 Color_16ACI
N052.16.13.667 E020.54.58.812 N052.16.12.722 E020.55.03.115 Color_16ACI
N052.16.12.722 E020.55.03.115 N052.16.12.462 E020.55.02.979 Color_16ACI
N052.16.12.462 E020.55.02.979 N052.16.13.445 E020.54.58.679 Color_16ACI
N052.16.13.445 E020.54.58.679 N052.16.13.667 E020.54.58.812 Color_16ACI
N052.16.16.944 E020.54.54.139 N052.16.15.869 E020.54.53.472 Color_16ACI
N052.16.15.869 E020.54.53.472 N052.16.15.745 E020.54.54.078 Color_16ACI
N052.16.15.745 E020.54.54.078 N052.16.16.821 E020.54.54.685 Color_16ACI
N052.16.16.821 E020.54.54.685 N052.16.16.944 E020.54.54.139 Color_16ACI
N052.16.15.199 E020.54.59.075 N052.16.14.197 E020.54.58.533 Color_16ACI
N052.16.14.197 E020.54.58.533 N052.16.14.154 E020.54.58.837 Color_16ACI
N052.16.14.154 E020.54.58.837 N052.16.15.119 E020.54.59.377 Color_16ACI
N052.16.15.119 E020.54.59.377 N052.16.15.199 E020.54.59.075 Color_16ACI
N052.16.21.222 E020.54.38.304 N052.16.21.437 E020.54.36.905 Color_16ACI
N052.16.21.437 E020.54.36.905 N052.16.21.660 E020.54.36.978 Color_16ACI
N052.16.21.660 E020.54.36.978 N052.16.21.446 E020.54.38.376 Color_16ACI
N052.16.21.446 E020.54.38.376 N052.16.21.222 E020.54.38.304 Color_16ACI
N052.15.28.036 E020.54.24.978 N052.15.27.683 E020.54.25.818 Color_16ACI
N052.15.27.683 E020.54.25.818 N052.15.26.509 E020.54.24.409 Color_16ACI
N052.15.26.509 E020.54.24.409 N052.15.26.782 E020.54.23.872 Color_16ACI
N052.15.26.782 E020.54.23.872 N052.15.27.588 E020.54.24.894 Color_16ACI
N052.15.27.588 E020.54.24.894 N052.15.27.745 E020.54.24.534 Color_16ACI
N052.15.27.745 E020.54.24.534 N052.15.28.036 E020.54.24.978 Color_16ACI
N052.15.27.848 E020.54.15.225 N052.15.27.873 E020.54.15.900 Color_16ACI
N052.15.27.873 E020.54.15.900 N052.15.27.460 E020.54.15.940 Color_16ACI
N052.15.27.460 E020.54.15.940 N052.15.27.435 E020.54.15.265 Color_16ACI
N052.15.27.435 E020.54.15.265 N052.15.27.848 E020.54.15.225 Color_16ACI
N052.15.32.585 E020.54.14.671 N052.15.32.546 E020.54.16.691 Color_16ACI
N052.15.32.546 E020.54.16.691 N052.15.31.797 E020.54.16.653 Color_16ACI
N052.15.31.797 E020.54.16.653 N052.15.31.836 E020.54.14.632 Color_16ACI
N052.15.31.836 E020.54.14.632 N052.15.32.585 E020.54.14.671 Color_16ACI
N052.15.32.398 E020.54.12.700 N052.15.32.380 E020.54.13.619 Color_16ACI
N052.15.32.380 E020.54.13.619 N052.15.30.132 E020.54.13.503 Color_16ACI
N052.15.30.132 E020.54.13.503 N052.15.30.113 E020.54.12.522 Color_16ACI
N052.15.30.113 E020.54.12.522 N052.15.32.398 E020.54.12.700 Color_16ACI
N052.15.32.337 E020.54.19.806 N052.15.32.319 E020.54.20.724 Color_16ACI
N052.15.32.319 E020.54.20.724 N052.15.30.033 E020.54.20.607 Color_16ACI
N052.15.30.033 E020.54.20.607 N052.15.30.051 E020.54.19.688 Color_16ACI
N052.15.30.051 E020.54.19.688 N052.15.32.337 E020.54.19.806 Color_16ACI
N052.15.31.664 E020.54.21.609 N052.15.31.642 E020.54.22.773 Color_16ACI
N052.15.31.642 E020.54.22.773 N052.15.30.744 E020.54.22.665 Color_16ACI
N052.15.30.744 E020.54.22.665 N052.15.30.756 E020.54.22.053 Color_16ACI
N052.15.30.756 E020.54.22.053 N052.15.31.205 E020.54.22.076 Color_16ACI
N052.15.31.205 E020.54.22.076 N052.15.31.252 E020.54.21.588 Color_16ACI
N052.15.31.252 E020.54.21.588 N052.15.31.664 E020.54.21.609 Color_16ACI
N052.15.33.665 E020.54.34.642 N052.15.33.632 E020.54.36.356 Color_16ACI
N052.15.33.632 E020.54.36.356 N052.15.33.034 E020.54.36.264 Color_16ACI
N052.15.33.034 E020.54.36.264 N052.15.33.066 E020.54.34.550 Color_16ACI
N052.15.33.066 E020.54.34.550 N052.15.33.665 E020.54.34.642 Color_16ACI
N052.15.32.073 E020.54.37.440 N052.15.31.775 E020.54.37.364 Color_16ACI
N052.15.31.775 E020.54.37.364 N052.15.31.642 E020.54.38.399 Color_16ACI
N052.15.31.642 E020.54.38.399 N052.15.31.941 E020.54.38.475 Color_16ACI
N052.15.31.941 E020.54.38.475 N052.15.32.073 E020.54.37.440 Color_16ACI
N052.15.32.491 E020.54.29.373 N052.15.32.290 E020.54.31.998 Color_16ACI
N052.15.32.290 E020.54.31.998 N052.15.31.917 E020.54.31.917 Color_16ACI
N052.15.31.917 E020.54.31.917 N052.15.32.080 E020.54.29.291 Color_16ACI
N052.15.32.080 E020.54.29.291 N052.15.32.491 E020.54.29.373 Color_16ACI
N052.15.31.837 E020.54.28.236 N052.15.31.564 E020.54.28.774 Color_16ACI
N052.15.31.564 E020.54.28.774 N052.15.31.050 E020.54.28.196 Color_16ACI
N052.15.31.050 E020.54.28.196 N052.15.30.308 E020.54.29.751 Color_16ACI
N052.15.30.308 E020.54.29.751 N052.15.29.941 E020.54.29.304 Color_16ACI
N052.15.29.941 E020.54.29.304 N052.15.30.684 E020.54.27.748 Color_16ACI
N052.15.30.684 E020.54.27.748 N052.15.29.331 E020.54.25.902 Color_16ACI
N052.15.29.331 E020.54.25.902 N052.15.28.591 E020.54.27.335 Color_16ACI
N052.15.28.591 E020.54.27.335 N052.15.28.300 E020.54.26.891 Color_16ACI
N052.15.28.300 E020.54.26.891 N052.15.29.428 E020.54.24.804 Color_16ACI
N052.15.29.428 E020.54.24.804 N052.15.31.837 E020.54.28.236 Color_16ACI
N052.15.34.802 E020.54.14.478 N052.15.34.722 E020.54.16.680 Color_16ACI
N052.15.34.722 E020.54.16.680 N052.15.34.385 E020.54.16.663 Color_16ACI
N052.15.34.385 E020.54.16.663 N052.15.34.377 E020.54.17.091 Color_16ACI
N052.15.34.377 E020.54.17.091 N052.15.33.891 E020.54.17.005 Color_16ACI
N052.15.33.891 E020.54.17.005 N052.15.34.029 E020.54.13.703 Color_16ACI
N052.15.34.029 E020.54.13.703 N052.15.34.515 E020.54.13.789 Color_16ACI
N052.15.34.515 E020.54.13.789 N052.15.34.502 E020.54.14.463 Color_16ACI
N052.15.34.502 E020.54.14.463 N052.15.34.802 E020.54.14.478 Color_16ACI
N052.15.37.530 E020.54.22.829 N052.15.37.477 E020.54.23.623 Color_16ACI
N052.15.37.477 E020.54.23.623 N052.15.34.747 E020.54.23.177 Color_16ACI
N052.15.34.747 E020.54.23.177 N052.15.34.800 E020.54.22.383 Color_16ACI
N052.15.34.800 E020.54.22.383 N052.15.37.530 E020.54.22.829 Color_16ACI
N052.15.37.695 E020.54.20.080 N052.15.37.683 E020.54.20.692 Color_16ACI
N052.15.37.683 E020.54.20.692 N052.15.35.738 E020.54.20.409 Color_16ACI
N052.15.35.738 E020.54.20.409 N052.15.35.784 E020.54.19.982 Color_16ACI
N052.15.35.784 E020.54.19.982 N052.15.35.336 E020.54.19.898 Color_16ACI
N052.15.35.336 E020.54.19.898 N052.15.35.293 E020.54.20.141 Color_16ACI
N052.15.35.293 E020.54.20.141 N052.15.34.170 E020.54.20.022 Color_16ACI
N052.15.34.170 E020.54.20.022 N052.15.34.221 E020.54.19.351 Color_16ACI
N052.15.34.221 E020.54.19.351 N052.15.35.305 E020.54.19.529 Color_16ACI
N052.15.35.305 E020.54.19.529 N052.15.35.351 E020.54.19.102 Color_16ACI
N052.15.35.351 E020.54.19.102 N052.15.35.799 E020.54.19.186 Color_16ACI
N052.15.35.799 E020.54.19.186 N052.15.35.789 E020.54.19.737 Color_16ACI
N052.15.35.789 E020.54.19.737 N052.15.37.696 E020.54.20.019 Color_16ACI
N052.15.37.696 E020.54.20.019 N052.15.37.695 E020.54.20.080 Color_16ACI
N052.15.37.630 E020.54.25.408 N052.15.37.575 E020.54.26.324 Color_16ACI
N052.15.37.575 E020.54.26.324 N052.15.35.330 E020.54.26.025 Color_16ACI
N052.15.35.330 E020.54.26.025 N052.15.35.386 E020.54.25.109 Color_16ACI
N052.15.35.386 E020.54.25.109 N052.15.37.630 E020.54.25.408 Color_16ACI
N052.15.40.099 E020.54.23.819 N052.15.39.912 E020.54.25.709 Color_16ACI
N052.15.39.912 E020.54.25.709 N052.15.39.539 E020.54.25.628 Color_16ACI
N052.15.39.539 E020.54.25.628 N052.15.39.725 E020.54.23.738 Color_16ACI
N052.15.39.725 E020.54.23.738 N052.15.40.099 E020.54.23.819 Color_16ACI
N052.15.39.695 E020.54.19.447 N052.15.39.422 E020.54.19.985 Color_16ACI
N052.15.39.422 E020.54.19.985 N052.15.40.115 E020.54.21.001 Color_16ACI
N052.15.40.115 E020.54.21.001 N052.15.40.388 E020.54.20.463 Color_16ACI
N052.15.40.388 E020.54.20.463 N052.15.39.695 E020.54.19.447 Color_16ACI
N052.15.41.304 E020.54.23.574 N052.15.40.913 E020.54.22.451 Color_16ACI
N052.15.40.913 E020.54.22.451 N052.15.40.607 E020.54.22.742 Color_16ACI
N052.15.40.607 E020.54.22.742 N052.15.40.998 E020.54.23.865 Color_16ACI
N052.15.40.998 E020.54.23.865 N052.15.41.304 E020.54.23.574 Color_16ACI
N052.15.42.229 E020.54.28.095 N052.15.42.407 E020.54.28.594 Color_16ACI
N052.15.42.407 E020.54.28.594 N052.15.41.452 E020.54.29.525 Color_16ACI
N052.15.41.452 E020.54.29.525 N052.15.41.275 E020.54.28.965 Color_16ACI
N052.15.41.275 E020.54.28.965 N052.15.42.229 E020.54.28.095 Color_16ACI
N052.15.38.141 E020.54.37.874 N052.15.35.817 E020.54.39.777 Color_16ACI
N052.15.35.817 E020.54.39.777 N052.15.35.215 E020.54.37.908 Color_16ACI
N052.15.35.215 E020.54.37.908 N052.15.37.578 E020.54.35.945 Color_16ACI
N052.15.37.578 E020.54.35.945 N052.15.38.141 E020.54.37.874 Color_16ACI
N052.15.30.905 E020.54.24.022 N052.15.30.781 E020.54.24.628 Color_16ACI
N052.15.30.781 E020.54.24.628 N052.15.29.965 E020.54.24.157 Color_16ACI
N052.15.29.965 E020.54.24.157 N052.15.30.088 E020.54.23.612 Color_16ACI
N052.15.30.088 E020.54.23.612 N052.15.30.905 E020.54.24.022 Color_16ACI
N052.15.29.144 E020.54.21.971 N052.15.29.181 E020.54.20.073 Color_16ACI
N052.15.29.181 E020.54.20.073 N052.15.29.705 E020.54.20.100 Color_16ACI
N052.15.29.705 E020.54.20.100 N052.15.29.684 E020.54.21.202 Color_16ACI
N052.15.29.684 E020.54.21.202 N052.15.29.497 E020.54.21.192 Color_16ACI
N052.15.29.497 E020.54.21.192 N052.15.29.482 E020.54.21.988 Color_16ACI
N052.15.29.482 E020.54.21.988 N052.15.29.144 E020.54.21.971 Color_16ACI
N052.15.32.621 E020.54.44.086 N052.15.32.532 E020.54.44.817 Color_16ACI
N052.15.32.532 E020.54.44.817 N052.15.31.673 E020.54.44.589 Color_16ACI
N052.15.31.673 E020.54.44.589 N052.15.31.761 E020.54.43.920 Color_16ACI
N052.15.31.761 E020.54.43.920 N052.15.32.621 E020.54.44.086 Color_16ACI
N052.15.31.577 E020.54.39.866 N052.15.31.358 E020.54.41.509 Color_16ACI
N052.15.31.358 E020.54.41.509 N052.15.31.098 E020.54.41.373 Color_16ACI
N052.15.31.098 E020.54.41.373 N052.15.31.317 E020.54.39.730 Color_16ACI
N052.15.31.317 E020.54.39.730 N052.15.31.577 E020.54.39.866 Color_16ACI
N052.15.27.858 E020.54.34.283 N052.15.27.663 E020.54.34.641 Color_16ACI
N052.15.27.663 E020.54.34.641 N052.15.28.285 E020.54.35.469 Color_16ACI
N052.15.28.285 E020.54.35.469 N052.15.28.480 E020.54.35.111 Color_16ACI
N052.15.28.480 E020.54.35.111 N052.15.27.858 E020.54.34.283 Color_16ACI
N052.15.29.616 E020.54.38.417 N052.15.27.125 E020.54.35.348 Color_16ACI
N052.15.27.125 E020.54.35.348 N052.15.26.929 E020.54.35.767 Color_16ACI
N052.15.26.929 E020.54.35.767 N052.15.27.258 E020.54.36.213 Color_16ACI
N052.15.27.258 E020.54.36.213 N052.15.26.711 E020.54.37.349 Color_16ACI
N052.15.26.711 E020.54.37.349 N052.15.26.271 E020.54.36.837 Color_16ACI
N052.15.26.271 E020.54.36.837 N052.15.26.037 E020.54.37.315 Color_16ACI
N052.15.26.037 E020.54.37.315 N052.15.26.513 E020.54.37.891 Color_16ACI
N052.15.26.513 E020.54.37.891 N052.15.26.746 E020.54.37.474 Color_16ACI
N052.15.26.746 E020.54.37.474 N052.15.28.321 E020.54.39.454 Color_16ACI
N052.15.28.321 E020.54.39.454 N052.15.28.126 E020.54.39.873 Color_16ACI
N052.15.28.126 E020.54.39.873 N052.15.28.676 E020.54.40.514 Color_16ACI
N052.15.28.676 E020.54.40.514 N052.15.28.872 E020.54.40.095 Color_16ACI
N052.15.28.872 E020.54.40.095 N052.15.28.396 E020.54.39.458 Color_16ACI
N052.15.28.396 E020.54.39.458 N052.15.28.942 E020.54.38.383 Color_16ACI
N052.15.28.942 E020.54.38.383 N052.15.29.381 E020.54.38.957 Color_16ACI
N052.15.29.381 E020.54.38.957 N052.15.29.616 E020.54.38.417 Color_16ACI
N052.15.47.069 E020.54.29.997 N052.15.46.497 E020.54.30.458 Color_16ACI
N052.15.46.497 E020.54.30.458 N052.15.46.322 E020.54.29.836 Color_16ACI
N052.15.46.322 E020.54.29.836 N052.15.46.929 E020.54.29.438 Color_16ACI
N052.15.46.929 E020.54.29.438 N052.15.47.069 E020.54.29.997 Color_16ACI
N052.15.46.560 E020.54.31.074 N052.15.46.256 E020.54.31.304 Color_16ACI
N052.15.46.256 E020.54.31.304 N052.15.46.647 E020.54.32.427 Color_16ACI
N052.15.46.647 E020.54.32.427 N052.15.46.914 E020.54.32.195 Color_16ACI
N052.15.46.914 E020.54.32.195 N052.15.46.560 E020.54.31.074 Color_16ACI
N052.15.49.194 E020.54.30.657 N052.15.48.889 E020.54.30.887 Color_16ACI
N052.15.48.889 E020.54.30.887 N052.15.49.173 E020.54.31.759 Color_16ACI
N052.15.49.173 E020.54.31.759 N052.15.49.477 E020.54.31.530 Color_16ACI
N052.15.49.477 E020.54.31.530 N052.15.49.194 E020.54.30.657 Color_16ACI
N052.15.48.629 E020.54.30.751 N052.15.48.419 E020.54.30.005 Color_16ACI
N052.15.48.419 E020.54.30.005 N052.15.48.113 E020.54.30.296 Color_16ACI
N052.15.48.113 E020.54.30.296 N052.15.48.362 E020.54.30.982 Color_16ACI
N052.15.48.362 E020.54.30.982 N052.15.48.629 E020.54.30.751 Color_16ACI
N052.15.47.737 E020.54.30.338 N052.15.48.018 E020.54.31.333 Color_16ACI
N052.15.48.018 E020.54.31.333 N052.15.47.789 E020.54.31.566 Color_16ACI
N052.15.47.789 E020.54.31.566 N052.15.47.470 E020.54.30.569 Color_16ACI
N052.15.47.470 E020.54.30.569 N052.15.47.737 E020.54.30.338 Color_16ACI
N052.15.48.921 E020.54.31.195 N052.15.49.063 E020.54.31.631 Color_16ACI
N052.15.49.063 E020.54.31.631 N052.15.48.072 E020.54.32.438 Color_16ACI
N052.15.48.072 E020.54.32.438 N052.15.47.930 E020.54.32.002 Color_16ACI
N052.15.47.930 E020.54.32.002 N052.15.48.921 E020.54.31.195 Color_16ACI
N052.15.44.316 E020.54.30.775 N052.15.44.724 E020.54.32.941 Color_16ACI
N052.15.44.724 E020.54.32.941 N052.15.45.066 E020.54.32.713 Color_16ACI
N052.15.45.066 E020.54.32.713 N052.15.44.619 E020.54.30.607 Color_16ACI
N052.15.44.619 E020.54.30.607 N052.15.44.316 E020.54.30.775 Color_16ACI
N052.15.41.963 E020.54.34.148 N052.15.42.528 E020.54.36.015 Color_16ACI
N052.15.42.528 E020.54.36.015 N052.15.42.298 E020.54.36.248 Color_16ACI
N052.15.42.298 E020.54.36.248 N052.15.41.696 E020.54.34.379 Color_16ACI
N052.15.41.696 E020.54.34.379 N052.15.41.963 E020.54.34.148 Color_16ACI
N052.15.40.805 E020.54.33.904 N052.15.40.653 E020.54.34.019 Color_16ACI
N052.15.40.844 E020.54.33.845 N052.15.40.805 E020.54.33.904 Color_16ACI
N052.15.40.920 E020.54.33.788 N052.15.40.844 E020.54.33.845 Color_16ACI
N052.15.40.425 E020.54.32.230 N052.15.40.920 E020.54.33.788 Color_16ACI
N052.15.39.928 E020.54.32.695 N052.15.40.425 E020.54.32.230 Color_16ACI
N052.15.40.387 E020.54.34.189 N052.15.39.928 E020.54.32.695 Color_16ACI
N052.15.40.616 E020.54.34.017 N052.15.40.387 E020.54.34.189 Color_16ACI
N052.15.35.018 E020.54.26.683 N052.15.35.269 E020.54.27.248 Color_16ACI
N052.15.35.269 E020.54.27.248 N052.15.35.077 E020.54.27.483 Color_16ACI
N052.15.35.077 E020.54.27.483 N052.15.34.826 E020.54.26.919 Color_16ACI
N052.15.34.826 E020.54.26.919 N052.15.35.018 E020.54.26.683 Color_16ACI
N052.15.34.787 E020.54.26.978 N052.15.34.535 E020.54.26.414 Color_16ACI
N052.15.34.535 E020.54.26.414 N052.15.33.922 E020.54.27.118 Color_16ACI
N052.15.33.922 E020.54.27.118 N052.15.34.172 E020.54.27.743 Color_16ACI
N052.15.34.172 E020.54.27.743 N052.15.34.787 E020.54.26.978 Color_16ACI
N052.15.34.331 E020.54.11.635 N052.15.34.314 E020.54.12.553 Color_16ACI
N052.15.34.314 E020.54.12.553 N052.15.33.939 E020.54.12.534 Color_16ACI
N052.15.33.939 E020.54.12.534 N052.15.33.919 E020.54.11.614 Color_16ACI
N052.15.33.919 E020.54.11.614 N052.15.34.331 E020.54.11.635 Color_16ACI
N052.15.35.422 E020.54.15.368 N052.15.35.442 E020.54.16.288 Color_16ACI
N052.15.35.442 E020.54.16.288 N052.15.35.143 E020.54.16.273 Color_16ACI
N052.15.35.143 E020.54.16.273 N052.15.35.160 E020.54.15.354 Color_16ACI
N052.15.35.160 E020.54.15.354 N052.15.35.422 E020.54.15.368 Color_16ACI
N052.15.40.502 E020.54.30.151 N052.15.39.584 E020.54.31.084 Color_16ACI
N052.15.39.584 E020.54.31.084 N052.15.39.370 E020.54.30.522 Color_16ACI
N052.15.39.370 E020.54.30.522 N052.15.40.251 E020.54.29.587 Color_16ACI
N052.15.40.251 E020.54.29.587 N052.15.40.502 E020.54.30.151 Color_16ACI
N052.15.38.593 E020.54.26.070 N052.15.38.583 E020.54.26.560 Color_16ACI
N052.15.38.583 E020.54.26.560 N052.15.38.059 E020.54.26.533 Color_16ACI
N052.15.38.059 E020.54.26.533 N052.15.38.068 E020.54.26.043 Color_16ACI
N052.15.38.068 E020.54.26.043 N052.15.38.593 E020.54.26.070 Color_16ACI
N052.15.45.067 E020.54.26.831 N052.15.45.132 E020.54.27.324 Color_16ACI
N052.15.45.132 E020.54.27.324 N052.15.43.885 E020.54.27.812 Color_16ACI
N052.15.43.885 E020.54.27.812 N052.15.43.857 E020.54.27.320 Color_16ACI
N052.15.43.857 E020.54.27.320 N052.15.45.067 E020.54.26.831 Color_16ACI
N052.15.29.820 E020.54.39.531 N052.15.29.647 E020.54.40.748 Color_16ACI
N052.15.29.647 E020.54.40.748 N052.15.29.870 E020.54.40.820 Color_16ACI
N052.15.29.870 E020.54.40.820 N052.15.30.080 E020.54.39.667 Color_16ACI
N052.15.30.080 E020.54.39.667 N052.15.29.820 E020.54.39.531 Color_16ACI
N052.15.37.009 E020.54.34.323 N052.15.37.329 E020.54.35.258 Color_16ACI
N052.15.37.329 E020.54.35.258 N052.15.37.100 E020.54.35.430 Color_16ACI
N052.15.37.100 E020.54.35.430 N052.15.36.781 E020.54.34.495 Color_16ACI
N052.15.36.781 E020.54.34.495 N052.15.37.009 E020.54.34.323 Color_16ACI
N052.15.50.863 E020.54.29.640 N052.15.50.855 E020.54.30.068 Color_16ACI
N052.15.50.855 E020.54.30.068 N052.15.49.546 E020.54.29.879 Color_16ACI
N052.15.49.546 E020.54.29.879 N052.15.49.592 E020.54.29.452 Color_16ACI
N052.15.49.592 E020.54.29.452 N052.15.50.863 E020.54.29.640 Color_16ACI
N052.15.47.569 E020.54.29.349 N052.15.47.390 E020.54.28.910 Color_16ACI
N052.15.47.390 E020.54.28.910 N052.15.47.200 E020.54.29.023 Color_16ACI
N052.15.47.200 E020.54.29.023 N052.15.47.340 E020.54.29.521 Color_16ACI
N052.15.47.340 E020.54.29.521 N052.15.47.569 E020.54.29.349 Color_16ACI
N052.15.38.598 E020.54.33.608 N052.15.39.585 E020.54.36.906 Color_16ACI
N052.15.39.585 E020.54.36.906 N052.15.39.166 E020.54.37.252 Color_16ACI
N052.15.39.166 E020.54.37.252 N052.15.38.218 E020.54.33.894 Color_16ACI
N052.15.38.218 E020.54.33.894 N052.15.38.598 E020.54.33.608 Color_16ACI
N052.15.23.743 E020.54.31.744 N052.15.23.311 E020.54.32.763 Color_16ACI
N052.15.23.311 E020.54.32.763 N052.15.24.299 E020.54.34.039 Color_16ACI
N052.15.24.299 E020.54.34.039 N052.15.24.144 E020.54.34.277 Color_16ACI
N052.15.24.144 E020.54.34.277 N052.15.24.400 E020.54.34.657 Color_16ACI
N052.15.24.400 E020.54.34.657 N052.15.24.673 E020.54.34.120 Color_16ACI
N052.15.24.673 E020.54.34.120 N052.15.25.025 E020.54.33.341 Color_16ACI
N052.15.25.025 E020.54.33.341 N052.15.23.743 E020.54.31.744 Color_16ACI
N052.15.26.655 E020.54.16.818 N052.15.24.394 E020.54.17.377 Color_16ACI
N052.15.24.394 E020.54.17.377 N052.15.24.202 E020.54.15.651 Color_16ACI
N052.15.24.202 E020.54.15.651 N052.15.25.483 E020.54.15.349 Color_16ACI
N052.15.25.483 E020.54.15.349 N052.15.25.577 E020.54.16.334 Color_16ACI
N052.15.25.577 E020.54.16.334 N052.15.26.105 E020.54.16.177 Color_16ACI
N052.15.26.105 E020.54.16.177 N052.15.25.920 E020.54.14.084 Color_16ACI
N052.15.25.920 E020.54.14.084 N052.15.26.372 E020.54.13.985 Color_16ACI
N052.15.26.372 E020.54.13.985 N052.15.26.655 E020.54.16.818 Color_16ACI
N052.15.25.655 E020.54.23.998 N052.15.24.261 E020.54.22.333 Color_16ACI
N052.15.24.261 E020.54.22.333 N052.15.25.278 E020.54.20.179 Color_16ACI
N052.15.25.278 E020.54.20.179 N052.15.25.717 E020.54.20.753 Color_16ACI
N052.15.25.717 E020.54.20.753 N052.15.25.520 E020.54.21.233 Color_16ACI
N052.15.25.520 E020.54.21.233 N052.15.25.299 E020.54.21.038 Color_16ACI
N052.15.25.299 E020.54.21.038 N052.15.24.790 E020.54.22.115 Color_16ACI
N052.15.24.790 E020.54.22.115 N052.15.25.927 E020.54.23.460 Color_16ACI
N052.15.25.927 E020.54.23.460 N052.15.25.655 E020.54.23.998 Color_16ACI
N052.15.29.344 E020.54.17.446 N052.15.29.291 E020.54.18.240 Color_16ACI
N052.15.29.291 E020.54.18.240 N052.15.27.461 E020.54.17.840 Color_16ACI
N052.15.27.461 E020.54.17.840 N052.15.27.550 E020.54.17.109 Color_16ACI
N052.15.27.550 E020.54.17.109 N052.15.29.344 E020.54.17.446 Color_16ACI
N052.15.40.912 E020.54.26.373 N052.15.39.900 E020.54.28.282 Color_16ACI
N052.15.39.900 E020.54.28.282 N052.15.39.644 E020.54.27.962 Color_16ACI
N052.15.39.644 E020.54.27.962 N052.15.40.693 E020.54.26.055 Color_16ACI
N052.15.40.693 E020.54.26.055 N052.15.40.912 E020.54.26.373 Color_16ACI
N052.15.26.828 E020.54.35.149 N052.15.26.670 E020.54.35.570 Color_16ACI
N052.15.26.670 E020.54.35.570 N052.15.26.414 E020.54.35.251 Color_16ACI
N052.15.26.414 E020.54.35.251 N052.15.26.099 E020.54.36.031 Color_16ACI
N052.15.26.099 E020.54.36.031 N052.15.25.695 E020.54.35.582 Color_16ACI
N052.15.25.695 E020.54.35.582 N052.15.26.243 E020.54.34.384 Color_16ACI
N052.15.26.243 E020.54.34.384 N052.15.26.828 E020.54.35.149 Color_16ACI
N052.15.32.450 E020.54.17.789 N052.15.32.434 E020.54.18.646 Color_16ACI
N052.15.32.434 E020.54.18.646 N052.15.30.153 E020.54.18.284 Color_16ACI
N052.15.30.153 E020.54.18.284 N052.15.30.167 E020.54.17.550 Color_16ACI
N052.15.30.167 E020.54.17.550 N052.15.32.450 E020.54.17.789 Color_16ACI
N052.15.36.152 E020.54.14.486 N052.15.35.996 E020.54.14.784 Color_16ACI
N052.15.35.996 E020.54.14.784 N052.15.38.586 E020.54.18.594 Color_16ACI
N052.15.38.586 E020.54.18.594 N052.15.38.779 E020.54.18.297 Color_16ACI
N052.15.38.779 E020.54.18.297 N052.15.36.152 E020.54.14.486 Color_16ACI
;grass_rwy N000.00.00.000 E000.00.00.000 N000.00.00.000 E000.00.00.000
N052.16.17.626 E020.54.08.828 N052.16.10.577 E020.54.59.573 Color_96ACI
N052.16.15.317 E020.54.07.975 N052.16.17.626 E020.54.08.828 Color_96ACI
N052.16.15.317 E020.54.07.975 N052.16.12.971 E020.54.07.119 Color_96ACI
N052.16.12.971 E020.54.07.119 N052.16.05.923 E020.54.57.864 Color_96ACI
N052.16.05.923 E020.54.57.864 N052.16.08.231 E020.54.58.718 Color_96ACI
N052.16.08.231 E020.54.58.718 N052.16.10.577 E020.54.59.573 Color_96ACI
N052.16.10.577 E020.54.59.573 N052.16.17.626 E020.54.08.828 Color_96ACI
N052.16.17.626 E020.54.08.828 N052.16.15.317 E020.54.07.975 Color_96ACI
;linia_energ N000.00.00.000 E000.00.00.000 N000.00.00.000 E000.00.00.000
N052.15.42.864 E020.54.24.328 N052.15.42.435 E020.54.25.225 Color_196ACI
N052.15.59.285 E020.53.59.248 N052.15.59.286 E020.53.59.187 Color_196ACI
N052.15.59.286 E020.53.59.187 N052.15.57.811 E020.53.53.964 Color_196ACI
N052.15.57.811 E020.53.53.964 N052.15.55.764 E020.53.47.302 Color_196ACI
N052.15.55.764 E020.53.47.302 N052.15.53.904 E020.53.40.650 Color_196ACI
N052.15.53.904 E020.53.40.650 N052.15.52.636 E020.53.36.357 Color_196ACI
N052.15.52.636 E020.53.36.357 N052.15.51.856 E020.53.33.989 Color_196ACI
N052.15.51.856 E020.53.33.989 N052.15.51.390 E020.53.32.862 Color_196ACI
N052.15.51.390 E020.53.32.862 N052.15.50.662 E020.53.31.721 Color_196ACI
N052.15.50.662 E020.53.31.721 N052.15.49.571 E020.53.29.950 Color_196ACI
N052.15.35.788 E020.54.13.916 N052.15.35.321 E020.54.14.811 Color_196ACI
N052.15.39.325 E020.54.19.183 N052.15.38.859 E020.54.20.017 Color_196ACI
N052.15.47.115 E020.54.25.649 N052.15.47.205 E020.54.26.818 Color_196ACI
N052.15.50.721 E020.54.21.421 N052.15.51.232 E020.54.22.183 Color_196ACI
N052.15.53.944 E020.54.15.704 N052.15.54.454 E020.54.16.465 Color_196ACI
N052.15.56.982 E020.54.09.793 N052.15.57.569 E020.54.10.497 Color_196ACI
N052.15.59.133 E020.54.03.224 N052.15.59.803 E020.54.03.503 Color_196ACI
N052.15.59.248 E020.53.59.185 N052.15.59.383 E020.53.59.989 Color_196ACI
N052.15.59.383 E020.53.59.989 N052.15.59.544 E020.54.01.345 Color_196ACI
N052.15.59.544 E020.54.01.345 N052.15.59.509 E020.54.03.182 Color_196ACI
N052.15.59.509 E020.54.03.182 N052.15.59.212 E020.54.05.005 Color_196ACI
N052.15.59.212 E020.54.05.005 N052.15.58.492 E020.54.07.358 Color_196ACI
N052.15.58.492 E020.54.07.358 N052.15.57.666 E020.54.09.338 Color_196ACI
N052.15.57.666 E020.54.09.338 N052.15.56.257 E020.54.12.391 Color_196ACI
N052.15.56.257 E020.54.12.391 N052.15.51.557 E020.54.20.851 Color_196ACI
N052.15.51.557 E020.54.20.851 N052.15.50.161 E020.54.23.231 Color_196ACI
N052.15.50.161 E020.54.23.231 N052.15.49.387 E020.54.24.478 Color_196ACI
N052.15.49.387 E020.54.24.478 N052.15.48.470 E020.54.25.350 Color_196ACI
N052.15.48.470 E020.54.25.350 N052.15.47.179 E020.54.26.203 Color_196ACI
N052.15.47.179 E020.54.26.203 N052.15.45.786 E020.54.26.500 Color_196ACI
N052.15.45.786 E020.54.26.500 N052.15.44.217 E020.54.26.174 Color_196ACI
N052.15.44.217 E020.54.26.174 N052.15.43.217 E020.54.25.510 Color_196ACI
N052.15.43.217 E020.54.25.510 N052.15.42.045 E020.54.24.041 Color_196ACI
N052.15.42.045 E020.54.24.041 N052.15.33.658 E020.54.11.539 Color_196ACI
N052.15.52.879 E020.53.35.389 N052.15.52.040 E020.53.36.143 Color_196ACI
N052.15.53.126 E020.53.36.198 N052.15.52.252 E020.53.36.828 Color_196ACI
N052.15.55.903 E020.53.45.900 N052.15.55.028 E020.53.46.529 Color_196ACI
N052.15.56.114 E020.53.46.646 N052.15.55.239 E020.53.47.275 Color_196ACI
N052.15.59.004 E020.53.56.292 N052.15.58.129 E020.53.56.922 Color_196ACI
N052.15.59.215 E020.53.57.039 N052.15.58.340 E020.53.57.668 Color_196ACI
;rwy N000.00.00.000 E000.00.00.000 N000.00.00.000 E000.00.00.000
N052.16.13.910 E020.53.53.379 N052.16.11.118 E020.53.52.317 Color_46ACI
N052.16.11.118 E020.53.52.317 N052.16.01.901 E020.54.58.332 Color_46ACI
N052.16.01.901 E020.54.58.332 N052.16.04.695 E020.54.59.333 Color_46ACI
N052.16.04.695 E020.54.59.333 N052.16.13.910 E020.53.53.379 Color_46ACI
N052.16.04.695 E020.54.59.333 N052.16.01.820 E020.55.20.143 Color_46ACI
N052.16.01.901 E020.54.58.332 N052.15.58.898 E020.55.19.994 Color_46ACI


[REGIONS]
; - Bialystok
URBAN region_URBAN N053.07.56.392 E023.04.06.128
N053.07.56.809 E023.04.06.488
N053.07.58.854 E023.04.05.257
N053.08.03.592 E023.04.02.266
N053.08.43.433 E023.04.12.248
N053.08.47.332 E023.04.12.353
N053.08.52.408 E023.04.13.523
N053.08.54.701 E023.04.13.897
N053.08.56.465 E023.04.14.261
N053.09.02.887 E023.04.16.111
N053.09.05.008 E023.04.14.419
N053.09.06.649 E023.04.14.851
N053.09.07.682 E023.04.18.041
N053.09.18.270 E023.04.20.053
N053.09.20.084 E023.04.20.701
N053.09.21.697 E023.04.22.066
N053.09.19.850 E023.04.31.966
N053.09.22.388 E023.04.29.687
N053.09.28.094 E023.04.25.133
N053.09.34.754 E023.04.20.258
N053.09.36.346 E023.04.14.383
N053.09.39.355 E023.04.16.648
N053.09.40.759 E023.04.16.986
N053.09.42.451 E023.04.19.236
N053.09.44.165 E023.04.20.258
N053.09.46.890 E023.04.22.408
N053.09.46.192 E023.04.25.853
N053.09.49.565 E023.04.27.851
N053.09.48.035 E023.04.33.704
N053.10.00.995 E023.04.39.137
N053.10.01.481 E023.04.36.890
N053.10.06.254 E023.04.38.021
N053.10.02.856 E023.05.12.883
N053.09.40.828 E023.05.58.427
N053.09.21.179 E023.06.25.423
N053.09.23.832 E023.07.04.469
N053.09.24.181 E023.08.20.562
N053.09.34.294 E023.09.09.806
N053.09.14.764 E023.10.07.622
N053.10.06.971 E023.11.16.976
N053.10.09.890 E023.11.51.648
N053.10.04.559 E023.11.50.572
N053.10.03.036 E023.12.30.827
N053.09.42.649 E023.12.58.036
N053.09.14.033 E023.12.11.027
N053.09.10.433 E023.12.37.800
N053.09.16.679 E023.12.54.187
N053.09.11.819 E023.13.16.860
N053.08.33.443 E023.13.02.860
N053.08.23.507 E023.12.50.623
N053.08.04.999 E023.12.59.040
N053.07.24.287 E023.13.20.010
N053.06.55.843 E023.13.16.190
N053.06.52.024 E023.12.47.462
N053.06.24.782 E023.12.35.417
N053.06.17.564 E023.12.02.585
N053.06.24.610 E023.11.52.278
N053.06.13.241 E023.10.52.828
N053.06.36.623 E023.10.27.916
N053.05.51.410 E023.07.46.160
N053.05.52.663 E023.07.41.920
N053.06.03.661 E023.07.29.960
N053.06.09.511 E023.07.22.224
N053.06.17.453 E023.07.11.208
N053.06.18.284 E023.07.09.451
N053.06.17.647 E023.07.06.751
N053.06.17.154 E023.07.03.860
N053.06.17.150 E023.07.02.089
N053.06.24.530 E023.06.52.340
N053.06.34.124 E023.05.50.582
N053.06.49.982 E023.05.07.224
N053.06.44.618 E023.04.46.880
N053.07.07.752 E023.04.34.295
N053.07.09.815 E023.04.32.228
N053.07.11.255 E023.04.29.881
N053.07.15.820 E023.04.27.077
N053.07.19.513 E023.04.25.043
N053.07.20.838 E023.04.24.996
N053.07.23.333 E023.04.23.686
N053.07.30.842 E023.04.18.541
N053.07.31.908 E023.04.23.624
N053.07.32.880 E023.04.23.077
N053.07.33.143 E023.04.24.643
N053.07.38.086 E023.04.21.270
N053.07.37.412 E023.04.18.620
N053.07.37.999 E023.04.18.221
N053.07.36.725 E023.04.06.949
N053.07.39.166 E023.04.02.582
N053.07.41.106 E023.04.01.794
N053.07.43.568 E023.04.13.501
N053.07.43.878 E023.04.12.922
N053.07.44.425 E023.04.11.071
N053.07.45.527 E023.04.08.357
N053.07.48.220 E023.04.07.835
N053.07.48.407 E023.04.06.089
N053.07.49.058 E023.04.05.783
N053.07.51.902 E023.04.05.020
N053.07.52.345 E023.04.04.688
N053.07.52.907 E023.04.02.453
; - Bydgoszcz
URBAN region_URBAN N053.09.20.322 E017.55.04.703
N053.09.20.196 E017.55.06.334
N053.09.19.339 E017.55.03.490
N053.09.14.285 E017.55.08.256
N053.09.13.075 E017.55.05.005
N053.09.10.793 E017.55.05.905
N053.09.11.196 E017.55.09.253
N053.09.10.969 E017.55.09.361
N053.09.10.901 E017.55.09.343
N053.09.10.912 E017.55.09.386
N053.09.08.456 E017.55.10.535
N053.09.09.011 E017.55.12.680
N053.09.03.449 E017.55.14.653
N053.09.02.596 E017.55.08.515
N053.09.00.432 E017.55.11.424
N053.08.58.614 E017.55.12.518
N053.08.54.863 E017.55.14.279
N053.08.52.552 E017.55.13.555
N053.08.51.630 E017.55.13.742
N053.08.48.095 E017.55.26.598
N053.08.27.233 E017.55.36.494
N053.08.27.899 E017.56.29.382
N053.08.30.066 E017.56.30.534
N053.08.25.004 E017.56.48.340
N053.08.25.642 E017.56.47.947
N053.08.24.817 E017.56.50.935
N053.08.44.948 E017.56.38.447
N053.08.50.179 E017.56.41.230
N053.08.52.076 E017.56.48.372
N053.09.01.382 E017.57.28.076
N053.09.05.270 E017.57.28.800
N053.09.27.684 E017.57.15.217
N053.09.33.152 E017.57.13.280
N053.09.58.468 E017.57.05.677
N053.09.58.324 E017.57.03.514
N053.10.00.160 E017.57.02.963
N053.10.00.185 E017.57.03.218
N053.10.00.808 E017.57.03.269
N053.10.01.031 E017.57.05.198
N053.10.04.926 E017.57.03.870
N053.10.08.306 E017.57.00.727
N053.11.18.370 E017.57.28.033
N053.11.46.172 E017.57.58.939
N053.11.37.828 E017.58.32.653
N053.11.36.719 E017.58.30.990
N053.11.36.676 E017.58.29.608
N053.11.35.927 E017.58.26.674
N053.11.35.848 E017.58.24.632
N053.11.34.426 E017.58.21.878
N053.11.28.392 E017.58.15.737
N053.11.27.550 E017.58.15.359
N053.11.22.481 E017.58.14.196
N053.11.20.602 E017.58.14.412
N053.11.19.259 E017.58.13.703
N053.11.18.542 E017.58.09.797
N053.11.16.332 E017.58.08.566
N053.11.13.258 E017.58.05.567
N053.11.11.796 E017.58.06.064
N053.11.10.817 E017.58.06.100
N053.11.09.586 E017.58.05.254
N053.11.07.120 E017.58.05.462
N053.11.04.909 E017.58.04.048
N053.11.00.006 E017.58.03.122
N053.10.58.577 E017.58.02.968
N053.10.56.806 E017.58.05.178
N053.10.55.405 E017.58.05.585
N053.10.54.667 E017.58.05.628
N053.10.39.907 E017.57.47.783
N053.10.40.181 E017.58.06.251
N053.10.39.547 E017.58.06.269
N053.10.32.765 E017.58.08.364
N053.10.24.251 E017.58.12.169
N053.10.14.506 E017.58.13.696
N053.10.08.998 E017.58.14.128
N053.10.05.311 E017.58.16.144
N053.10.04.908 E017.58.19.409
N053.10.04.242 E017.58.19.567
N053.10.03.443 E017.58.31.166
N053.09.54.011 E017.58.34.100
N053.09.36.634 E017.58.35.436
N053.09.15.473 E017.58.23.887
N053.09.03.726 E017.58.50.952
N053.08.41.442 E017.59.05.024
N053.08.29.724 E017.59.27.276
N053.08.31.438 E018.00.02.556
N053.08.27.132 E018.00.37.552
N053.09.15.505 E018.01.10.517
N053.10.29.082 E018.02.50.971
N053.10.27.682 E018.02.54.092
N053.10.21.371 E018.03.07.438
N053.10.28.823 E018.03.17.726
N053.10.28.740 E018.03.18.504
N053.10.23.387 E018.03.42.890
N053.10.23.412 E018.03.45.133
N053.10.23.304 E018.03.49.136
N053.10.21.986 E018.03.49.381
N053.10.04.300 E018.03.32.339
N053.09.29.549 E018.03.27.954
N053.09.18.684 E018.02.22.481
N053.08.48.653 E018.01.50.855
N053.08.20.933 E018.02.58.384
N053.07.59.329 E018.05.40.171
N053.08.05.197 E018.06.04.097
N053.08.22.560 E018.06.02.308
N053.08.51.756 E018.07.18.779
N053.09.28.422 E018.07.19.992
N053.09.23.836 E018.08.36.848
N053.09.58.673 E018.09.11.711
N053.10.35.195 E018.09.48.539
N053.10.34.950 E018.09.51.883
N053.10.35.594 E018.09.52.200
N053.10.19.189 E018.10.41.153
N053.09.36.742 E018.10.43.144
N053.09.31.961 E018.10.59.189
N053.09.01.080 E018.10.57.868
N053.08.32.870 E018.09.34.942
N053.08.15.288 E018.08.21.538
N053.07.12.338 E018.07.07.028
N053.06.00.774 E018.06.15.044
N053.06.09.378 E018.05.50.982
N053.06.26.701 E018.05.38.004
N053.06.40.928 E018.04.29.111
N053.06.44.683 E018.04.00.296
N053.05.51.522 E018.03.33.754
N053.05.39.754 E018.02.42.763
N053.05.52.084 E018.01.48.284
N053.05.41.352 E018.01.10.866
N053.05.40.812 E018.00.50.195
N053.05.39.671 E018.00.50.036
N053.05.41.950 E018.00.31.486
N053.05.43.670 E018.00.32.098
N053.05.43.861 E018.00.29.833
N053.05.46.363 E018.00.30.168
N053.05.46.442 E018.00.29.034
N053.06.02.358 E018.00.25.056
N053.06.05.188 E018.00.09.036
N053.05.47.926 E018.00.04.306
N053.05.47.911 E017.59.59.798
N053.05.48.293 E017.59.36.204
N053.05.49.718 E017.59.16.505
N053.05.53.124 E017.58.32.920
N053.05.54.175 E017.58.17.274
N053.05.48.034 E017.58.15.164
N053.05.49.121 E017.57.48.593
N053.05.44.675 E017.57.35.402
N053.05.49.088 E017.57.25.571
N053.05.52.184 E017.57.11.473
N053.06.00.500 E017.56.59.406
N053.06.40.579 E017.57.03.031
N053.06.49.151 E017.57.22.374
N053.06.59.818 E017.57.04.086
N053.07.07.316 E017.57.05.821
N053.07.08.562 E017.56.57.710
N053.07.08.101 E017.56.46.608
N053.07.09.055 E017.56.37.640
N053.07.11.507 E017.56.36.535
N053.07.26.141 E017.56.33.493
N053.07.30.040 E017.56.34.458
N053.07.33.359 E017.56.31.996
N053.07.37.337 E017.56.26.408
N053.07.37.308 E017.56.26.189
N053.07.37.844 E017.56.25.397
N053.07.37.668 E017.56.22.420
N053.07.36.023 E017.56.14.827
N053.07.34.900 E017.56.10.525
N053.07.34.745 E017.56.10.414
N053.07.40.944 E017.55.24.967
N053.07.56.298 E017.54.47.174
N053.07.56.172 E017.54.46.184
N053.08.13.056 E017.54.43.420
N053.08.32.464 E017.54.24.462
N053.09.15.833 E017.54.34.686
N053.09.26.258 E017.55.08.490
; - Gdansk
URBAN region_URBAN N054.25.24.017 E018.33.47.405
N054.25.25.352 E018.33.49.342
N054.25.26.083 E018.33.57.114
N054.25.25.774 E018.34.03.335
N054.25.24.406 E018.34.18.667
N054.25.29.579 E018.34.37.358
N054.25.28.477 E018.34.39.086
N054.25.32.578 E018.34.56.784
N054.25.32.585 E018.35.00.168
N054.25.40.829 E018.35.14.341
N054.25.02.716 E018.36.00.918
N054.24.14.760 E018.37.22.123
N054.24.43.931 E018.37.44.818
N054.24.41.756 E018.37.51.427
N054.24.37.447 E018.38.06.148
N054.24.34.232 E018.38.18.661
N054.24.32.357 E018.38.27.654
N054.24.25.096 E018.39.00.079
N054.24.06.304 E018.40.47.885
N054.23.37.136 E018.40.34.655
N054.23.17.916 E018.39.21.784
N054.22.48.634 E018.38.22.470
N054.22.04.940 E018.38.26.689
N054.21.19.274 E018.40.18.455
N054.21.42.862 E018.40.43.234
N054.21.39.586 E018.41.21.664
N054.21.49.882 E018.43.05.293
N054.21.02.837 E018.43.13.289
N054.20.44.707 E018.41.35.513
N054.20.38.980 E018.40.37.974
N054.19.50.614 E018.39.21.593
N054.19.11.410 E018.39.27.673
N054.18.55.602 E018.38.39.851
N054.17.38.224 E018.38.17.513
N054.16.46.132 E018.38.29.998
N054.16.46.398 E018.38.20.918
N054.16.41.837 E018.38.22.121
N054.16.41.030 E018.38.00.769
N054.18.20.653 E018.37.21.522
N054.17.58.060 E018.36.16.535
N054.17.59.647 E018.36.15.545
N054.18.02.275 E018.36.17.532
N054.18.13.241 E018.36.07.092
N054.18.29.380 E018.35.57.055
N054.18.44.165 E018.37.13.634
N054.19.34.644 E018.37.32.354
N054.19.35.713 E018.37.13.159
N054.18.53.989 E018.35.41.467
N054.18.48.276 E018.35.05.075
N054.19.22.883 E018.34.22.519
N054.19.35.292 E018.34.49.253
N054.19.14.099 E018.35.22.085
N054.20.02.602 E018.37.10.992
N054.20.12.696 E018.37.14.736
N054.20.11.386 E018.36.07.574
N054.19.51.118 E018.35.35.149
N054.19.46.409 E018.34.20.352
N054.19.29.359 E018.33.05.699
N054.19.51.654 E018.32.30.912
N054.20.05.284 E018.33.26.417
N054.20.12.347 E018.35.13.823
N054.20.30.347 E018.35.38.598
N054.20.59.464 E018.35.30.631
N054.21.16.254 E018.35.24.702
N054.21.54.518 E018.36.21.942
N054.22.14.718 E018.36.31.356
N054.22.39.097 E018.34.58.904
N054.22.52.414 E018.34.16.500
N054.24.02.837 E018.33.21.946
N054.24.19.620 E018.33.14.076
N054.24.49.900 E018.33.21.442
N054.25.13.332 E018.33.19.958
N054.25.11.611 E018.33.25.913
N054.25.24.866 E018.33.34.488
N054.25.25.255 E018.33.36.716
N054.25.24.370 E018.33.39.542
; - Gorzów_Wielkopolski
URBAN region_URBAN N052.43.42.784 E015.10.31.228
N052.43.42.740 E015.10.53.418
N052.43.35.000 E015.11.06.072
N052.43.54.102 E015.12.38.074
N052.44.18.308 E015.11.52.188
N052.44.48.131 E015.12.28.768
N052.44.39.408 E015.12.49.349
N052.44.41.294 E015.13.08.382
N052.44.56.720 E015.13.10.031
N052.45.01.476 E015.13.40.181
N052.45.26.510 E015.13.57.734
N052.45.29.329 E015.14.29.472
N052.45.05.209 E015.14.32.532
N052.45.08.946 E015.15.23.303
N052.45.57.974 E015.16.23.826
N052.45.42.498 E015.16.41.196
N052.45.03.082 E015.15.53.406
N052.44.07.951 E015.16.51.784
N052.43.59.642 E015.17.48.858
N052.43.55.942 E015.17.48.332
N052.43.52.280 E015.17.47.000
N052.43.49.843 E015.17.45.802
N052.43.49.562 E015.17.45.827
N052.43.52.252 E015.17.20.731
N052.43.51.301 E015.17.20.220
N052.43.53.598 E015.16.59.128
N052.43.51.100 E015.16.58.436
N052.43.49.958 E015.16.57.907
N052.43.57.461 E015.16.05.754
N052.43.42.197 E015.15.00.684
N052.43.18.941 E015.15.44.950
N052.43.15.024 E015.16.07.115
N052.43.22.667 E015.16.34.100
N052.42.51.761 E015.16.49.782
N052.42.20.801 E015.17.24.464
N052.42.08.359 E015.16.49.541
N052.42.51.865 E015.16.11.752
N052.42.36.511 E015.15.41.566
N052.42.11.408 E015.15.52.528
N052.41.13.625 E015.15.20.556
N052.41.24.320 E015.14.45.769
N052.42.17.273 E015.15.22.457
N052.42.29.822 E015.15.17.766
N052.42.26.039 E015.14.47.645
N052.43.08.558 E015.14.12.980
N052.42.56.081 E015.13.47.568
N052.43.11.550 E015.13.31.789
N052.43.05.808 E015.13.11.165
N052.43.28.034 E015.12.52.236
; - Katowice
URBAN region_URBAN N050.13.46.855 E018.55.12.155
N050.13.46.474 E018.55.17.476
N050.13.45.977 E018.55.20.330
N050.13.43.698 E018.55.27.779
N050.13.43.428 E018.55.29.158
N050.13.43.493 E018.55.30.778
N050.13.45.329 E018.55.46.290
N050.13.45.995 E018.55.49.829
N050.13.46.265 E018.55.54.998
N050.13.46.463 E018.55.56.100
N050.13.47.338 E018.55.58.609
N050.13.48.914 E018.56.01.568
N050.13.49.181 E018.56.02.702
N050.13.49.480 E018.56.04.495
N050.13.49.897 E018.56.06.097
N050.13.50.909 E018.56.08.070
N050.13.51.172 E018.56.08.750
N050.13.51.175 E018.56.09.730
N050.13.51.049 E018.56.10.507
N050.13.50.743 E018.56.15.691
N050.13.51.341 E018.56.18.794
N050.13.52.302 E018.56.22.870
N050.13.52.878 E018.56.25.584
N050.13.53.188 E018.56.27.524
N050.13.53.155 E018.56.28.493
N050.13.53.198 E018.56.33.104
N050.13.53.476 E018.56.35.974
N050.13.53.850 E018.56.39.343
N050.13.54.998 E018.56.45.125
N050.13.55.963 E018.56.53.653
N050.13.55.405 E018.56.54.175
N050.14.07.699 E018.57.11.678
N050.14.23.078 E018.57.28.040
N050.14.39.556 E018.57.43.326
N050.14.58.250 E018.58.18.235
N050.15.19.886 E018.57.33.826
N050.15.18.850 E018.57.24.361
N050.15.23.580 E018.57.23.188
N050.15.27.400 E018.57.21.514
N050.15.29.239 E018.57.19.998
N050.15.30.445 E018.57.19.732
N050.15.31.957 E018.57.19.836
N050.15.34.358 E018.57.18.878
N050.15.36.173 E018.57.17.698
N050.15.39.215 E018.57.16.607
N050.15.41.612 E018.57.15.880
N050.15.42.898 E018.57.15.336
N050.15.44.658 E018.57.14.152
N050.15.46.058 E018.57.13.702
N050.15.46.116 E018.57.15.696
N050.15.49.684 E018.57.16.787
N050.15.53.370 E018.57.19.418
N050.15.55.591 E018.57.20.236
N050.15.56.412 E018.57.20.236
N050.15.58.633 E018.57.19.508
N050.16.01.499 E018.57.18.785
N050.16.02.964 E018.57.18.785
N050.16.04.602 E018.57.19.782
N050.16.06.006 E018.57.20.963
N050.16.07.349 E018.57.21.780
N050.16.08.285 E018.57.22.961
N050.16.09.923 E018.57.23.778
N050.16.12.907 E018.57.26.503
N050.16.14.545 E018.57.27.684
N050.16.16.302 E018.57.28.411
N050.16.19.812 E018.57.28.318
N050.16.20.896 E018.57.27.832
N050.16.22.048 E018.57.27.464
N050.16.22.958 E018.57.27.673
N050.16.23.873 E018.57.28.148
N050.16.24.413 E018.57.28.674
N050.16.23.941 E018.57.30.301
N050.16.24.586 E018.57.31.036
N050.16.24.820 E018.57.31.720
N050.16.24.956 E018.57.32.400
N050.16.26.443 E018.57.33.138
N050.16.25.601 E018.57.37.498
N050.16.25.565 E018.57.38.653
N050.16.25.770 E018.57.39.492
N050.16.26.040 E018.57.40.122
N050.16.29.424 E018.57.40.144
N050.16.33.348 E018.57.40.702
N050.16.35.818 E018.57.40.543
N050.16.42.820 E018.57.40.702
N050.16.46.204 E018.57.39.287
N050.16.48.166 E018.57.38.394
N050.16.48.133 E018.57.39.391
N050.16.48.979 E018.57.43.067
N050.16.52.262 E018.57.43.121
N050.16.53.447 E018.57.43.488
N050.16.54.257 E018.57.43.333
N050.16.54.494 E018.57.43.070
N050.16.54.664 E018.57.44.802
N050.16.54.934 E018.57.45.065
N050.16.56.287 E018.57.45.277
N050.16.57.234 E018.57.45.940
N050.16.57.943 E018.57.46.512
N050.17.00.751 E018.57.48.096
N050.17.03.674 E018.57.50.476
N050.17.05.233 E018.57.51.887
N050.17.05.914 E018.57.52.679
N050.17.07.361 E018.57.54.662
N050.17.09.348 E018.57.56.027
N050.17.10.622 E018.57.56.732
N050.17.11.933 E018.57.57.661
N050.17.12.725 E018.57.58.759
N050.17.13.150 E018.58.00.739
N050.17.13.236 E018.58.03.112
N050.17.13.207 E018.58.04.080
N050.17.13.754 E018.58.05.995
N050.17.13.895 E018.58.07.795
N050.17.13.837 E018.58.09.818
N050.17.13.686 E018.58.10.618
N050.17.13.222 E018.58.11.453
N050.17.12.541 E018.58.11.928
N050.17.11.861 E018.58.11.932
N050.17.11.015 E018.58.12.155
N050.17.08.282 E018.58.16.298
N050.17.05.507 E018.58.20.647
N050.17.04.121 E018.58.22.670
N050.17.03.300 E018.58.24.557
N050.17.03.120 E018.58.25.100
N050.17.02.987 E018.58.25.939
N050.17.02.976 E018.58.27.437
N050.17.02.720 E018.58.28.236
N050.17.02.231 E018.58.28.906
N050.17.01.835 E018.58.29.298
N050.16.59.812 E018.58.29.492
N050.16.59.423 E018.58.29.885
N050.16.56.514 E018.58.34.068
N050.16.49.220 E018.58.45.718
N050.16.47.147 E018.58.48.821
N050.16.41.952 E018.58.57.104
N050.16.36.703 E018.59.05.136
N050.16.36.142 E018.59.06.871
N050.16.35.573 E018.59.07.966
N050.16.34.482 E018.59.09.629
N050.16.33.982 E018.59.09.820
N050.16.33.384 E018.59.10.201
N050.16.19.938 E018.59.31.945
N050.16.21.630 E018.59.34.570
N050.16.34.104 E018.59.54.575
N050.16.39.302 E019.00.05.418
N050.16.53.378 E019.00.29.686
N050.17.43.912 E019.00.15.980
N050.17.44.196 E019.00.16.754
N050.17.44.340 E019.00.16.207
N050.17.44.405 E019.00.16.794
N050.17.42.032 E019.00.26.338
N050.17.36.906 E019.00.47.909
N050.17.35.290 E019.00.53.968
N050.17.34.800 E019.00.54.378
N050.17.34.991 E019.00.55.163
N050.17.32.770 E019.01.02.744
N050.17.30.548 E019.01.07.122
N050.17.30.088 E019.01.07.194
N050.17.28.878 E019.01.06.096
N050.17.26.848 E019.01.03.860
N050.17.25.094 E019.01.04.609
N050.17.24.947 E019.01.06.748
N050.17.24.659 E019.01.07.367
N050.17.21.358 E019.01.09.757
N050.17.20.004 E019.01.11.309
N050.17.18.935 E019.01.15.845
N050.17.18.103 E019.01.17.224
N050.17.16.840 E019.01.18.106
N050.17.14.132 E019.01.23.480
N050.17.13.524 E019.01.25.748
N050.17.13.610 E019.01.27.440
N050.17.13.578 E019.01.29.532
N050.17.12.080 E019.01.32.599
N050.17.11.645 E019.01.34.468
N050.17.11.612 E019.01.36.869
N050.17.12.473 E019.01.37.409
N050.17.12.901 E019.01.38.302
N050.17.13.186 E019.01.39.461
N050.17.12.926 E019.01.41.329
N050.17.10.453 E019.01.44.076
N050.17.09.445 E019.01.46.297
N050.17.07.948 E019.01.48.875
N050.17.07.346 E019.01.49.670
N050.17.05.824 E019.01.50.999
N050.17.01.633 E019.01.49.912
N050.17.02.915 E019.01.55.661
N050.17.02.666 E019.01.55.754
N050.16.56.860 E019.01.57.054
N050.16.56.572 E019.01.56.741
N050.16.55.225 E019.01.56.158
N050.16.53.990 E019.01.56.150
N050.16.52.414 E019.01.56.946
N050.16.49.541 E019.01.58.220
N050.16.46.985 E019.01.59.902
N050.16.45.577 E019.02.00.960
N050.16.43.964 E019.02.03.044
N050.16.42.467 E019.02.06.378
N050.16.41.488 E019.02.09.042
N050.16.41.106 E019.02.13.492
N050.16.41.106 E019.02.14.561
N050.16.42.539 E019.02.15.367
N050.16.42.103 E019.02.17.725
N050.16.41.873 E019.02.18.524
N050.16.35.620 E019.02.48.052
N050.16.33.683 E019.02.55.522
N050.16.32.588 E019.02.59.474
N050.16.32.387 E019.02.59.834
N050.16.39.292 E019.03.05.080
N050.16.42.578 E019.02.55.522
N050.16.52.810 E019.03.03.233
N050.16.50.412 E019.03.11.232
N050.16.57.803 E019.03.17.194
N050.16.57.734 E019.03.20.016
N050.17.00.236 E019.03.22.442
N050.17.02.288 E019.03.26.474
N050.17.06.014 E019.03.28.386
N050.17.06.731 E019.03.28.728
N050.17.11.292 E019.03.30.442
N050.17.12.754 E019.03.30.539
N050.17.13.844 E019.03.30.812
N050.17.15.104 E019.03.31.309
N050.17.16.195 E019.03.32.162
N050.17.16.796 E019.03.32.789
N050.17.18.895 E019.03.30.841
N050.17.20.015 E019.03.30.359
N050.17.20.987 E019.03.30.762
N050.17.21.905 E019.03.32.148
N050.17.22.819 E019.03.32.821
N050.17.23.737 E019.03.33.228
N050.17.25.087 E019.03.33.102
N050.17.25.422 E019.03.33.491
N050.17.25.775 E019.03.33.595
N050.17.26.668 E019.03.33.199
N050.17.28.734 E019.03.28.480
N050.17.30.808 E019.03.26.860
N050.17.31.384 E019.03.26.176
N050.17.31.960 E019.03.25.200
N050.17.34.912 E019.03.25.538
N050.17.35.599 E019.03.25.819
N050.17.36.326 E019.03.26.402
N050.17.38.548 E019.03.28.526
N050.17.39.278 E019.03.28.926
N050.17.39.905 E019.03.29.743
N050.17.40.060 E019.03.30.276
N050.17.41.071 E019.03.31.147
N050.17.41.352 E019.03.32.069
N050.17.41.741 E019.03.32.717
N050.17.41.906 E019.03.33.329
N050.17.41.975 E019.03.33.991
N050.17.27.722 E019.04.14.210
N050.16.49.318 E019.04.21.540
N050.16.50.146 E019.05.07.220
N050.16.00.296 E019.06.41.810
N050.16.00.059 E019.07.18.138
N050.16.02.467 E019.07.17.760
N050.16.00.584 E019.07.22.217
N050.15.56.747 E019.07.16.882
N050.15.54.745 E019.07.15.200
N050.15.50.792 E019.07.10.416
N050.15.49.331 E019.07.08.551
N050.15.47.588 E019.07.07.054
N050.15.43.823 E019.07.04.314
N050.15.42.786 E019.07.04.022
N050.15.39.136 E019.07.04.030
N050.15.35.932 E019.07.03.810
N050.15.35.392 E019.07.03.007
N050.15.33.509 E019.07.02.204
N050.15.24.336 E019.06.59.036
N050.15.26.939 E019.06.53.406
N050.15.28.451 E019.06.49.208
N050.15.17.431 E019.06.45.979
N050.15.08.503 E019.06.43.441
N050.15.08.471 E019.06.41.148
N050.15.04.583 E019.06.40.104
N050.15.03.748 E019.06.38.610
N050.15.02.459 E019.06.38.257
N050.15.01.595 E019.06.38.362
N050.15.00.054 E019.06.37.764
N050.14.59.381 E019.06.35.521
N050.14.59.478 E019.06.31.036
N050.14.58.279 E019.06.29.794
N050.14.57.476 E019.06.28.670
N050.14.56.558 E019.06.26.773
N050.14.55.450 E019.06.23.512
N050.14.55.028 E019.06.21.496
N050.14.55.522 E019.06.17.816
N050.14.55.064 E019.06.17.222
N050.14.54.604 E019.06.14.317
N050.14.52.811 E019.06.14.378
N050.14.51.932 E019.06.14.026
N050.14.51.475 E019.06.13.136
N050.14.51.281 E019.06.09.457
N050.14.49.067 E019.06.08.986
N050.14.48.872 E019.06.08.633
N050.14.48.412 E019.06.07.207
N050.14.47.422 E019.06.05.609
N050.14.46.428 E019.06.04.482
N050.14.44.020 E019.06.02.707
N050.14.42.454 E019.06.04.907
N050.14.37.856 E019.06.09.295
N050.14.36.510 E019.06.10.760
N050.14.36.092 E019.06.10.764
N050.14.35.315 E019.06.08.302
N050.14.34.984 E019.06.07.016
N050.14.34.523 E019.06.07.265
N050.14.33.526 E019.06.02.761
N050.14.28.331 E019.06.02.974
N050.14.26.725 E019.06.03.629
N050.14.25.044 E019.06.04.698
N050.14.24.166 E019.06.05.530
N050.14.23.518 E019.06.04.288
N050.14.22.106 E019.06.05.890
N050.14.20.328 E019.06.08.712
N050.14.15.637 E019.06.05.922
N050.14.04.175 E019.05.53.963
N050.12.38.030 E019.05.08.027
N050.13.26.249 E019.01.54.361
N050.13.05.959 E019.00.19.408
N050.12.49.558 E019.00.19.465
N050.12.15.516 E019.03.44.518
N050.11.20.641 E019.03.15.653
N050.10.24.643 E019.01.55.686
N050.10.32.434 E019.01.17.630
N050.10.32.567 E019.01.17.580
N050.10.32.509 E019.01.17.252
N050.10.41.048 E019.00.35.554
N050.10.13.559 E018.59.24.079
N050.09.59.652 E018.56.50.622
N050.10.00.163 E018.56.51.112
N050.10.00.635 E018.56.51.756
N050.10.01.520 E018.56.54.236
N050.10.03.536 E018.56.51.576
N050.10.05.434 E018.56.49.556
N050.10.06.733 E018.56.48.916
N050.10.07.327 E018.56.48.826
N050.10.09.516 E018.56.49.931
N050.10.11.813 E018.56.51.637
N050.10.12.713 E018.56.50.356
N050.10.14.128 E018.56.48.865
N050.10.15.406 E018.56.47.965
N050.10.16.511 E018.56.46.151
N050.10.17.756 E018.56.43.854
N050.10.27.685 E018.56.38.724
N050.10.26.789 E018.56.37.810
N050.10.28.229 E018.56.37.741
N050.10.28.762 E018.56.36.913
N050.10.29.417 E018.56.32.690
N050.10.29.420 E018.56.29.839
N050.10.24.449 E018.56.27.629
N050.10.22.868 E018.56.27.276
N050.10.22.768 E018.56.22.207
N050.10.26.440 E018.56.20.371
N050.10.29.334 E018.56.21.401
N050.10.30.090 E018.56.22.538
N050.10.30.050 E018.56.18.564
N050.10.37.038 E018.56.15.068
N050.10.36.239 E018.56.09.913
N050.10.36.790 E018.56.08.995
N050.10.37.261 E018.56.09.168
N050.10.37.571 E018.56.09.064
N050.10.37.812 E018.56.08.905
N050.10.38.363 E018.56.06.378
N050.10.39.770 E018.56.04.031
N050.10.44.231 E018.56.05.096
N050.10.52.226 E018.56.11.641
N050.10.52.716 E018.56.01.860
N050.10.54.552 E018.55.59.959
N050.10.56.680 E018.56.10.568
N050.11.05.356 E018.56.06.457
N050.11.04.592 E018.56.04.657
N050.11.09.013 E018.56.00.431
N050.11.10.374 E018.56.00.337
N050.11.14.024 E018.56.00.373
N050.11.16.458 E018.55.56.856
N050.11.17.048 E018.55.56.561
N050.11.18.164 E018.55.55.772
N050.11.19.090 E018.55.59.142
N050.11.21.397 E018.56.00.157
N050.11.22.513 E018.56.01.176
N050.11.21.973 E018.56.05.212
N050.11.23.050 E018.56.05.201
N050.11.24.054 E018.56.04.783
N050.11.28.234 E018.56.03.448
N050.11.28.860 E018.56.08.678
N050.11.28.946 E018.56.11.278
N050.11.29.753 E018.56.10.892
N050.11.30.700 E018.56.10.550
N050.11.31.808 E018.56.09.568
N050.11.32.730 E018.56.09.078
N050.11.35.268 E018.56.08.833
N050.11.37.043 E018.56.09.182
N050.11.41.100 E018.56.08.840
N050.11.41.924 E018.56.08.891
N050.11.42.464 E018.56.08.549
N050.11.38.242 E018.55.49.660
N050.11.46.230 E018.55.44.483
N050.11.49.686 E018.55.51.118
N050.11.49.880 E018.55.50.862
N050.11.51.720 E018.55.54.070
N050.12.22.313 E018.56.37.392
N050.12.59.638 E018.56.51.724
N050.13.19.294 E018.55.41.707
N050.13.42.308 E018.55.24.996
N050.13.44.231 E018.55.25.082
N050.13.46.794 E018.55.05.405
; - Kielce
URBAN region_URBAN N050.53.53.531 E020.33.01.040
N050.54.14.260 E020.33.35.557
N050.54.20.376 E020.33.59.515
N050.54.21.895 E020.34.07.190
N050.54.27.288 E020.34.35.936
N050.54.36.688 E020.35.20.321
N050.54.38.567 E020.35.26.394
N050.54.37.210 E020.36.07.578
N050.54.05.443 E020.36.24.620
N050.54.19.105 E020.36.36.893
N050.54.44.086 E020.36.35.251
N050.54.44.150 E020.36.56.689
N050.54.42.354 E020.37.00.124
N050.54.32.839 E020.36.57.971
N050.54.12.920 E020.37.00.916
N050.54.14.216 E020.38.02.490
N050.54.24.656 E020.38.11.065
N050.54.24.505 E020.38.20.274
N050.54.23.933 E020.38.20.141
N050.54.22.000 E020.38.31.034
N050.54.20.880 E020.38.42.252
N050.54.17.118 E020.39.03.560
N050.54.12.737 E020.39.36.086
N050.54.15.973 E020.39.37.930
N050.54.16.394 E020.39.38.048
N050.54.15.998 E020.39.41.069
N050.54.23.144 E020.39.42.422
N050.54.23.033 E020.39.49.165
N050.54.32.011 E020.40.15.384
N050.54.44.474 E020.40.29.734
N050.54.44.914 E020.40.36.055
N050.54.46.573 E020.40.36.948
N050.54.44.748 E020.40.48.252
N050.54.38.556 E020.40.58.256
N050.54.38.383 E020.40.58.120
N050.54.40.594 E020.40.53.227
N050.54.33.660 E020.40.53.594
N050.54.22.878 E020.40.57.842
N050.54.19.487 E020.40.57.828
N050.54.15.185 E020.40.56.777
N050.54.10.886 E020.40.54.372
N050.54.09.461 E020.41.00.089
N050.54.02.837 E020.40.59.981
N050.53.46.763 E020.40.43.964
N050.53.46.504 E020.40.43.907
N050.53.44.639 E020.40.36.692
N050.53.37.504 E020.40.38.096
N050.53.34.364 E020.40.37.765
N050.53.34.339 E020.40.39.936
N050.53.27.856 E020.40.39.648
N050.53.16.400 E020.40.37.045
N050.53.00.046 E020.39.44.600
N050.52.48.083 E020.39.44.849
N050.52.37.110 E020.40.10.204
N050.52.37.304 E020.40.35.328
N050.52.33.503 E020.40.35.731
N050.52.25.748 E020.40.32.516
N050.52.11.791 E020.40.34.280
N050.52.06.226 E020.40.35.526
N050.52.05.218 E020.40.35.663
N050.51.59.771 E020.40.29.813
N050.51.53.442 E020.40.36.224
N050.51.53.413 E020.40.37.222
N050.51.48.222 E020.40.37.906
N050.51.47.808 E020.41.08.851
N050.51.47.718 E020.41.18.827
N050.51.01.908 E020.41.17.459
N050.51.02.538 E020.41.07.429
N050.51.03.247 E020.41.06.493
N050.51.06.394 E020.40.58.879
N050.51.08.521 E020.40.57.302
N050.51.08.831 E020.40.09.217
N050.51.06.433 E020.40.08.674
N050.51.32.591 E020.38.39.847
N050.51.25.362 E020.38.33.720
N050.50.53.876 E020.39.27.122
N050.50.26.783 E020.39.30.197
N050.50.21.779 E020.39.02.678
N050.50.23.118 E020.38.30.008
N050.50.35.678 E020.38.04.636
N050.50.13.106 E020.37.34.986
N050.49.49.292 E020.37.49.307
N050.49.39.025 E020.38.02.076
N050.49.30.461 E020.38.28.615
N050.49.22.055 E020.38.28.792
N050.49.23.117 E020.38.16.008
N050.49.15.474 E020.38.15.356
N050.49.08.184 E020.38.14.942
N050.49.08.173 E020.38.15.050
N050.49.00.440 E020.38.13.164
N050.48.58.777 E020.38.32.708
N050.48.55.339 E020.38.31.934
N050.49.02.132 E020.37.37.765
N050.48.36.594 E020.37.35.800
N050.48.41.890 E020.37.00.556
N050.49.20.190 E020.37.02.237
N050.49.14.952 E020.36.07.135
N050.49.11.363 E020.34.51.384
N050.49.30.662 E020.33.44.510
N050.49.43.097 E020.33.46.181
N050.49.27.570 E020.34.58.836
N050.49.36.962 E020.36.22.655
N050.49.43.338 E020.37.04.249
N050.50.23.352 E020.37.19.700
N050.50.35.750 E020.36.35.489
N050.51.20.527 E020.36.48.330
N050.51.20.279 E020.36.18.191
N050.51.31.453 E020.36.19.199
N050.51.14.231 E020.33.48.877
N050.50.03.282 E020.32.22.625
N050.50.34.148 E020.31.55.538
N050.50.56.512 E020.31.58.778
N050.51.26.014 E020.31.56.831
N050.52.09.023 E020.31.49.537
N050.52.11.680 E020.32.19.630
N050.50.59.230 E020.32.35.131
N050.51.46.076 E020.33.41.872
N050.51.54.904 E020.35.22.160
N050.52.31.606 E020.35.22.600
N050.52.46.466 E020.33.15.358
N050.52.50.268 E020.32.53.909
N050.53.07.879 E020.33.01.040
N050.53.05.179 E020.33.57.654
N050.53.43.591 E020.34.11.863
N050.53.50.500 E020.33.40.280
N050.53.37.529 E020.33.16.697
; - Kraków
URBAN region_URBAN N050.01.13.570 E019.49.07.489
N050.01.13.771 E019.49.12.601
N050.01.17.933 E019.49.24.305
N050.01.21.443 E019.49.31.516
N050.01.20.388 E019.49.32.909
N050.01.20.186 E019.49.34.766
N050.01.20.636 E019.49.36.548
N050.01.22.044 E019.49.38.179
N050.01.24.049 E019.49.38.723
N050.01.24.463 E019.49.38.086
N050.01.24.550 E019.49.38.395
N050.01.24.708 E019.49.38.204
N050.01.26.357 E019.49.40.822
N050.01.27.282 E019.49.41.596
N050.01.44.026 E019.50.19.518
N050.02.00.121 E019.51.07.726
N050.02.30.656 E019.52.15.913
N050.02.12.026 E019.53.14.903
N050.02.19.946 E019.53.55.954
N050.02.43.458 E019.54.23.134
N050.02.57.898 E019.54.43.124
N050.03.11.084 E019.53.42.630
N050.03.40.964 E019.51.57.197
N050.03.46.015 E019.50.42.439
N050.03.11.711 E019.49.51.125
N050.03.16.492 E019.49.15.899
N050.03.48.229 E019.49.41.758
N050.04.32.884 E019.49.42.380
N050.04.38.255 E019.49.57.994
N050.04.27.127 E019.50.27.496
N050.04.38.874 E019.50.43.195
N050.04.56.410 E019.50.09.550
N050.05.09.175 E019.50.08.318
N050.05.25.462 E019.50.26.916
N050.05.17.988 E019.50.55.064
N050.05.02.933 E019.52.06.884
N050.05.26.599 E019.52.11.478
N050.05.49.279 E019.52.27.358
N050.06.18.414 E019.52.32.034
N050.06.42.732 E019.53.14.806
N050.06.56.092 E019.54.00.238
N050.06.11.041 E019.54.56.066
N050.05.49.960 E019.55.12.684
N050.05.58.560 E019.56.23.474
N050.06.44.140 E019.56.22.808
N050.06.43.880 E019.56.58.142
N050.06.10.987 E019.57.08.899
N050.05.54.193 E019.58.00.901
N050.06.02.221 E019.58.23.650
N050.05.35.556 E019.58.54.278
N050.05.27.114 E019.59.25.217
N050.05.57.080 E019.59.46.655
N050.06.14.159 E020.00.56.887
N050.06.06.962 E020.01.08.353
N050.06.03.676 E020.01.47.978
N050.06.29.686 E020.02.38.245
N050.05.59.651 E020.02.47.396
N050.05.59.021 E020.03.18.486
N050.06.39.910 E020.02.59.212
N050.06.40.302 E020.03.00.446
N050.06.39.852 E020.03.01.318
N050.06.40.464 E020.03.02.520
N050.06.38.095 E020.03.06.628
N050.06.38.848 E020.03.06.710
N050.06.29.995 E020.03.15.394
N050.06.30.467 E020.03.22.558
N050.06.40.795 E020.03.38.243
N050.06.18.576 E020.04.03.256
N050.06.14.310 E020.04.37.254
N050.05.55.349 E020.05.00.265
N050.05.53.804 E020.05.32.784
N050.06.04.270 E020.06.23.411
N050.06.48.002 E020.06.15.422
N050.06.54.824 E020.07.12.925
N050.06.49.273 E020.07.13.678
N050.06.34.819 E020.07.15.294
N050.06.30.510 E020.07.15.456
N050.06.30.614 E020.07.21.778
N050.06.29.916 E020.07.25.489
N050.06.11.203 E020.07.28.247
N050.05.47.764 E020.08.02.634
N050.05.46.237 E020.08.39.386
N050.06.22.997 E020.08.58.150
N050.06.22.982 E020.08.58.236
N050.06.23.450 E020.08.58.380
N050.06.42.131 E020.09.07.916
N050.06.45.590 E020.09.05.310
N050.06.51.300 E020.09.07.308
N050.07.02.060 E020.09.11.963
N050.07.03.173 E020.09.13.183
N050.07.06.571 E020.09.23.386
N050.07.06.398 E020.09.23.782
N050.07.06.708 E020.09.23.803
N050.07.07.835 E020.09.27.180
N050.06.33.548 E020.10.15.902
N050.06.53.798 E020.10.38.111
N050.06.52.380 E020.11.30.415
N050.06.35.993 E020.11.34.976
N050.06.15.433 E020.10.33.215
N050.05.43.822 E020.11.14.798
N050.05.23.737 E020.11.13.776
N050.05.15.407 E020.10.58.404
N050.04.47.212 E020.11.10.255
N050.04.39.932 E020.11.13.218
N050.04.31.303 E020.10.19.740
N050.03.53.896 E020.10.20.478
N050.03.29.606 E020.11.04.708
N050.03.27.356 E020.12.08.258
N050.03.09.122 E020.12.10.022
N050.03.14.062 E020.11.00.776
N050.03.03.038 E020.10.51.118
N050.03.04.720 E020.10.32.740
N050.03.19.361 E020.10.38.093
N050.03.44.597 E020.09.58.079
N050.03.44.518 E020.09.48.200
N050.03.57.190 E020.09.35.244
N050.03.55.274 E020.09.23.990
N050.04.13.357 E020.09.03.866
N050.04.25.165 E020.08.56.569
N050.04.16.853 E020.08.44.030
N050.03.53.183 E020.08.51.569
N050.03.45.644 E020.08.22.081
N050.04.03.720 E020.08.00.539
N050.04.13.566 E020.07.37.751
N050.03.58.640 E020.06.58.536
N050.03.39.413 E020.06.50.472
N050.03.24.851 E020.06.55.012
N050.03.07.445 E020.06.46.908
N050.03.08.143 E020.06.21.492
N050.03.52.776 E020.06.12.082
N050.03.53.471 E020.05.46.658
N050.03.48.719 E020.05.24.176
N050.03.41.371 E020.05.18.690
N050.03.44.626 E020.04.33.452
N050.03.32.605 E020.04.15.370
N050.03.27.896 E020.03.58.536
N050.03.50.515 E020.03.36.864
N050.03.51.253 E020.03.17.089
N050.02.49.038 E020.02.58.718
N050.02.38.828 E020.04.22.188
N050.02.18.571 E020.04.01.470
N050.02.16.235 E020.03.03.683
N050.02.21.210 E020.02.08.552
N050.02.09.953 E020.01.34.950
N050.01.55.074 E020.01.04.256
N050.01.48.688 E020.01.04.404
N050.01.50.023 E020.01.50.920
N050.01.52.180 E020.02.27.542
N050.01.44.958 E020.02.36.168
N050.01.24.787 E020.02.25.339
N050.01.05.056 E020.03.03.856
N050.00.48.647 E020.03.05.630
N050.00.33.761 E020.02.33.536
N050.00.26.575 E020.02.46.385
N050.00.17.248 E020.02.24.036
N050.00.13.165 E020.01.36.199
N050.00.01.048 E020.01.45.901
N049.59.58.654 E020.01.47.125
N049.59.57.520 E020.01.45.743
N049.59.57.451 E020.01.45.602
N050.00.13.892 E020.01.31.274
N050.00.12.780 E020.01.23.502
N050.00.17.122 E020.01.14.286
N050.00.15.430 E020.01.12.724
N050.00.13.774 E020.01.05.542
N050.00.11.858 E020.01.05.599
N050.00.12.305 E020.01.01.373
N050.00.11.513 E020.00.49.615
N050.00.10.271 E020.00.47.354
N050.00.10.436 E020.00.45.310
N050.00.08.863 E020.00.38.120
N050.00.09.101 E020.00.34.729
N050.00.06.876 E020.00.21.989
N050.00.05.623 E020.00.20.362
N050.00.03.154 E020.00.13.709
N050.00.01.577 E020.00.13.536
N049.59.59.885 E020.00.12.899
N049.59.58.859 E020.00.12.308
N049.59.57.815 E020.00.10.757
N049.59.56.497 E020.00.10.156
N049.59.53.120 E020.00.12.053
N049.59.59.237 E019.59.32.471
N049.59.39.570 E019.59.38.836
N049.59.27.488 E020.00.01.109
N049.59.09.114 E020.00.23.303
N049.58.53.836 E019.59.53.239
N049.58.52.230 E019.59.32.057
N049.58.37.646 E019.59.31.704
N049.58.32.423 E019.59.07.613
N049.58.46.124 E019.59.05.125
N049.58.48.396 E019.58.56.824
N049.58.48.785 E019.58.56.978
N049.58.51.438 E019.58.56.762
N049.58.51.730 E019.58.54.606
N049.58.51.103 E019.58.53.116
N049.58.51.056 E019.58.51.035
N049.58.51.679 E019.58.44.818
N049.59.02.216 E019.58.06.301
N049.58.38.813 E019.57.36.148
N049.58.33.704 E019.56.59.381
N049.58.28.376 E019.56.45.161
N049.58.22.584 E019.56.45.920
N049.58.26.303 E019.56.38.987
N049.58.31.400 E019.56.31.906
N049.58.30.590 E019.56.25.573
N049.58.30.900 E019.56.24.976
N049.58.30.313 E019.56.23.413
N049.58.30.094 E019.56.21.703
N049.58.30.522 E019.56.19.568
N049.59.00.665 E019.56.06.436
N049.59.15.191 E019.56.12.408
N049.59.27.179 E019.55.58.584
N049.59.44.524 E019.55.56.165
N049.59.51.652 E019.56.13.247
N050.00.03.046 E019.56.28.946
N050.00.48.604 E019.56.31.103
N050.00.53.384 E019.56.00.150
N049.59.48.952 E019.55.21.036
N049.59.23.820 E019.55.28.902
N049.58.49.015 E019.55.26.036
N049.58.48.630 E019.55.24.722
N049.58.48.259 E019.55.22.526
N049.58.47.042 E019.55.08.688
N049.58.47.075 E019.54.49.583
N049.58.48.911 E019.54.45.810
N049.58.49.127 E019.54.43.898
N049.58.51.229 E019.54.41.656
N049.58.51.877 E019.54.39.697
N049.58.51.474 E019.54.38.599
N049.58.51.143 E019.54.34.614
N049.58.57.097 E019.54.23.447
N049.59.17.308 E019.54.06.980
N049.59.22.657 E019.54.19.789
N049.59.49.222 E019.54.42.970
N050.00.06.876 E019.53.55.298
N050.00.09.356 E019.52.19.445
N049.59.43.274 E019.51.40.914
N049.59.14.514 E019.52.35.281
N049.58.59.304 E019.53.42.616
N049.58.47.939 E019.53.30.883
N049.58.48.626 E019.53.29.944
N049.58.49.120 E019.53.26.696
N049.58.48.929 E019.53.21.304
N049.58.49.199 E019.53.14.474
N049.58.48.148 E019.53.14.284
N049.58.46.567 E019.53.14.669
N049.58.45.451 E019.53.13.762
N049.58.45.203 E019.53.12.426
N049.58.44.616 E019.53.11.227
N049.58.47.442 E019.52.05.092
N049.58.58.598 E019.51.47.758
N049.59.00.460 E019.51.49.568
N049.59.01.140 E019.51.47.200
N049.59.02.184 E019.51.45.594
N049.59.04.628 E019.51.44.413
N049.59.04.423 E019.51.38.711
N049.59.15.187 E019.51.21.985
N049.59.13.528 E019.51.03.622
N049.59.19.781 E019.50.55.478
N049.59.32.222 E019.50.56.796
N049.59.32.276 E019.50.56.861
N049.59.34.076 E019.50.56.994
N049.59.39.530 E019.50.57.570
N049.59.39.505 E019.50.57.390
N049.59.44.041 E019.50.57.721
N049.59.44.318 E019.50.54.092
N049.59.44.592 E019.50.51.508
N049.59.44.549 E019.50.47.738
N049.59.43.602 E019.50.44.873
N049.59.43.544 E019.50.43.656
N049.59.47.443 E019.50.43.192
N049.59.53.646 E019.51.03.064
N050.00.09.767 E019.51.17.402
N050.00.31.658 E019.51.14.900
N050.00.37.782 E019.51.54.482
N050.01.34.453 E019.51.29.923
N050.01.32.891 E019.50.50.399
N050.00.52.456 E019.49.19.542
N050.00.34.229 E019.49.19.290
N050.00.22.428 E019.49.12.072
N050.00.03.701 E019.49.17.512
N049.59.49.729 E019.49.51.067
N049.59.46.547 E019.49.48.878
N049.59.46.694 E019.49.24.996
N049.59.47.062 E019.49.19.830
N049.59.48.466 E019.49.18.574
N049.59.49.920 E019.49.08.310
N049.59.47.839 E019.49.07.608
N049.59.47.116 E019.49.04.674
N049.59.45.776 E019.49.00.487
N050.00.13.532 E019.48.36.695
N050.00.35.590 E019.48.07.376
N050.01.00.196 E019.48.07.708
N050.01.11.906 E019.48.30.438
N050.01.13.570 E019.48.55.850
; - Lublin
URBAN region_URBAN N051.17.04.783 E022.34.37.607
N051.17.04.344 E022.34.41.621
N051.17.03.826 E022.34.44.749
N051.17.03.692 E022.34.50.660
N051.16.44.573 E022.34.44.918
N051.16.23.196 E022.34.35.522
N051.16.06.110 E022.34.36.970
N051.16.20.658 E022.34.49.112
N051.16.18.980 E022.35.05.410
N051.16.48.936 E022.35.32.413
N051.16.45.566 E022.35.56.868
N051.16.25.046 E022.35.50.176
N051.16.12.220 E022.35.44.808
N051.16.07.964 E022.35.54.330
N051.15.57.694 E022.35.44.876
N051.15.40.644 E022.36.05.314
N051.15.32.918 E022.35.46.352
N051.15.21.823 E022.35.53.189
N051.15.37.278 E022.36.35.186
N051.15.51.912 E022.37.41.624
N051.15.35.683 E022.37.45.761
N051.15.25.387 E022.37.20.017
N051.15.14.321 E022.37.44.494
N051.15.03.121 E022.36.48.906
N051.14.51.148 E022.36.40.820
N051.14.46.108 E022.37.33.751
N051.14.18.748 E022.37.23.012
N051.14.16.926 E022.36.13.842
N051.14.08.383 E022.36.15.239
N051.13.59.023 E022.36.38.336
N051.13.38.478 E022.36.14.018
N051.13.27.430 E022.36.49.327
N051.13.20.572 E022.36.35.795
N051.13.20.514 E022.36.01.897
N051.13.00.851 E022.35.56.566
N051.12.48.053 E022.36.06.116
N051.12.42.048 E022.35.52.588
N051.12.27.540 E022.36.03.499
N051.12.23.281 E022.36.11.653
N051.12.06.516 E022.36.10.408
N051.12.01.030 E022.35.51.425
N051.11.38.400 E022.35.53.833
N051.11.26.812 E022.35.29.908
N051.11.32.417 E022.34.45.181
N051.11.48.091 E022.34.47.791
N051.11.51.385 E022.33.45.432
N051.12.16.949 E022.33.14.119
N051.12.20.315 E022.32.51.050
N051.12.47.653 E022.32.48.181
N051.12.52.722 E022.32.23.748
N051.13.04.706 E022.32.33.169
N051.13.25.126 E022.31.55.081
N051.13.44.587 E022.30.37.656
N051.14.23.831 E022.30.14.335
N051.13.52.892 E022.29.09.445
N051.13.59.743 E022.29.14.820
N051.14.23.633 E022.29.02.440
N051.14.58.884 E022.30.23.594
N051.15.09.893 E022.29.45.528
N051.15.27.893 E022.30.07.117
N051.16.09.764 E022.30.08.190
N051.16.33.686 E022.30.08.028
N051.16.45.707 E022.30.31.025
N051.16.42.316 E022.30.40.550
N051.16.00.480 E022.30.53.046
N051.15.39.136 E022.30.59.969
N051.15.44.359 E022.31.39.292
N051.15.42.725 E022.32.11.875
N051.16.13.519 E022.32.25.264
N051.16.15.348 E022.33.19.548
N051.16.54.602 E022.32.56.249
N051.16.59.794 E022.33.26.089
N051.16.37.585 E022.33.30.287
N051.16.18.811 E022.33.41.249
N051.16.18.836 E022.33.53.467
N051.16.36.793 E022.34.00.156
N051.16.37.675 E022.34.13.728
; - Olsztyn
URBAN region_URBAN N053.44.33.886 E020.27.36.144
N053.44.33.522 E020.27.31.399
N053.44.32.647 E020.27.30.593
N053.44.33.310 E020.27.24.221
N053.44.33.583 E020.27.19.822
N053.44.34.732 E020.27.12.956
N053.44.35.531 E020.27.11.668
N053.44.36.733 E020.27.10.505
N053.44.36.640 E020.27.07.124
N053.44.31.553 E020.27.03.679
N053.44.32.798 E020.26.55.662
N053.44.34.879 E020.26.51.626
N053.44.36.614 E020.26.45.560
N053.44.38.519 E020.26.41.492
N053.44.46.154 E020.26.33.907
N053.44.56.422 E020.26.28.709
N053.44.59.798 E020.26.25.742
N053.45.01.174 E020.26.24.410
N053.45.18.666 E020.26.37.403
N053.45.38.945 E020.26.12.498
N053.45.21.488 E020.25.26.951
N053.45.39.841 E020.24.37.656
N053.46.12.479 E020.25.01.290
N053.46.42.323 E020.24.57.690
N053.46.21.382 E020.25.44.184
N053.46.09.530 E020.25.55.963
N053.46.38.381 E020.27.17.197
N053.46.57.047 E020.27.03.823
N053.46.58.588 E020.26.43.663
N053.47.15.511 E020.26.26.009
N053.47.29.746 E020.25.54.044
N053.47.48.361 E020.25.34.907
N053.47.41.809 E020.24.27.486
N053.47.42.277 E020.23.42.900
N053.47.44.671 E020.23.39.073
N053.47.47.281 E020.23.40.751
N053.47.47.342 E020.23.40.538
N053.47.47.746 E020.23.40.816
N053.47.55.777 E020.23.22.960
N053.48.00.439 E020.23.29.465
N053.48.08.953 E020.23.09.445
N053.48.12.971 E020.23.13.240
N053.48.16.096 E020.23.06.032
N053.48.32.746 E020.23.27.899
N053.48.32.436 E020.24.11.768
N053.48.39.704 E020.24.08.759
N053.48.28.004 E020.24.39.294
N053.48.02.660 E020.25.10.114
N053.47.42.878 E020.26.32.550
N053.47.15.893 E020.27.12.002
N053.47.09.182 E020.27.26.536
N053.46.51.334 E020.27.35.579
N053.46.42.917 E020.27.50.148
N053.47.16.318 E020.28.03.749
N053.47.17.520 E020.28.46.848
N053.47.29.454 E020.28.45.138
N053.48.23.263 E020.28.49.660
N053.48.11.732 E020.29.41.694
N053.47.56.702 E020.30.23.731
N053.47.46.907 E020.31.21.468
N053.47.23.975 E020.31.36.343
N053.47.18.002 E020.31.36.473
N053.47.08.120 E020.32.24.122
N053.46.52.910 E020.32.44.570
N053.46.20.093 E020.31.53.537
N053.46.09.494 E020.31.07.784
N053.45.26.557 E020.30.34.243
N053.45.07.456 E020.29.53.012
N053.45.03.917 E020.29.37.291
N053.44.49.636 E020.29.36.964
N053.44.47.681 E020.29.05.424
N053.44.53.390 E020.29.01.622
N053.45.03.586 E020.28.55.646
N053.45.03.481 E020.28.42.722
N053.44.36.895 E020.28.27.530
N053.44.33.274 E020.28.01.765
N053.44.30.311 E020.27.42.959
N053.44.32.942 E020.27.37.588
; - Opole
URBAN region_URBAN N050.41.31.538 E017.51.00.896
N050.41.26.646 E017.51.00.187
N050.41.24.281 E017.51.03.164
N050.41.21.761 E017.51.07.376
N050.41.19.241 E017.51.16.308
N050.41.17.740 E017.51.21.413
N050.41.17.927 E017.51.23.198
N050.41.17.779 E017.51.23.969
N050.41.18.560 E017.51.29.272
N050.41.18.949 E017.51.32.980
N050.41.09.593 E017.51.37.411
N050.40.54.811 E017.52.56.892
N050.41.22.852 E017.52.46.603
N050.41.27.431 E017.53.25.850
N050.40.51.233 E017.53.53.156
N050.41.08.876 E017.54.23.324
N050.42.02.894 E017.54.08.982
N050.42.39.190 E017.53.32.273
N050.42.51.088 E017.54.05.904
N050.42.50.800 E017.54.06.318
N050.42.50.396 E017.54.07.114
N050.42.49.892 E017.54.07.715
N050.42.49.903 E017.54.08.086
N050.42.49.482 E017.54.08.917
N050.42.49.993 E017.54.10.976
N050.42.50.051 E017.54.12.928
N050.42.50.440 E017.54.14.591
N050.42.50.677 E017.54.16.798
N050.42.50.864 E017.54.20.290
N050.42.50.162 E017.54.22.896
N050.42.49.406 E017.54.24.520
N050.42.48.157 E017.54.26.384
N050.42.46.519 E017.54.28.645
N050.42.49.457 E017.54.32.519
N050.42.52.002 E017.54.34.762
N050.42.52.754 E017.54.35.316
N050.42.52.412 E017.54.43.078
N050.42.40.187 E017.55.08.843
N050.42.35.932 E017.55.05.354
N050.42.33.782 E017.55.03.112
N050.42.24.962 E017.54.54.295
N050.42.20.383 E017.54.55.508
N050.42.20.358 E017.54.55.832
N050.42.20.106 E017.54.55.919
N050.42.20.146 E017.54.58.730
N050.42.17.035 E017.55.05.426
N050.42.16.330 E017.55.06.560
N050.42.14.260 E017.55.10.567
N050.42.13.925 E017.55.10.628
N050.42.07.164 E017.55.01.762
N050.42.05.738 E017.55.04.976
N050.42.04.133 E017.55.11.140
N050.42.03.006 E017.55.12.605
N050.41.55.115 E017.55.14.034
N050.42.12.902 E017.55.59.686
N050.41.04.070 E017.55.39.914
N050.41.06.727 E017.56.11.288
N050.41.27.553 E017.56.22.765
N050.41.45.654 E017.56.09.125
N050.41.57.386 E017.56.31.344
N050.41.47.159 E017.56.54.571
N050.42.02.059 E017.57.19.966
N050.42.01.256 E017.57.23.814
N050.42.01.346 E017.57.27.612
N050.42.02.250 E017.57.30.035
N050.42.02.264 E017.57.30.463
N050.42.00.871 E017.57.33.127
N050.41.42.572 E017.57.49.259
N050.41.24.839 E017.57.28.454
N050.40.32.599 E017.58.01.556
N050.40.34.457 E017.58.14.124
N050.41.03.260 E017.58.25.824
N050.41.01.820 E017.58.45.023
N050.41.01.165 E017.58.45.865
N050.40.58.789 E017.58.48.036
N050.40.56.579 E017.58.51.748
N050.41.00.456 E017.59.03.181
N050.40.58.570 E017.59.28.316
N050.40.22.260 E017.59.41.546
N050.40.22.793 E017.59.29.656
N050.40.22.300 E017.59.29.738
N050.40.22.372 E017.59.28.889
N050.40.20.111 E017.59.30.102
N050.40.19.596 E017.59.29.796
N050.40.04.847 E017.59.37.619
N050.40.02.204 E017.59.38.886
N050.40.00.998 E017.59.40.063
N050.40.00.854 E017.59.40.452
N050.40.00.070 E017.59.42.594
N050.39.58.266 E017.59.49.592
N050.39.56.851 E017.59.50.806
N050.39.54.457 E017.59.51.677
N050.39.39.182 E017.59.22.376
N050.38.23.453 E017.59.12.844
N050.38.20.879 E017.58.27.433
N050.39.00.904 E017.58.14.246
N050.39.05.108 E017.57.50.875
N050.38.51.245 E017.57.39.618
N050.38.39.613 E017.57.01.825
N050.38.28.684 E017.56.56.897
N050.37.32.704 E017.58.59.189
N050.37.41.156 E017.59.55.666
N050.37.17.026 E018.00.15.437
N050.37.03.673 E018.00.02.135
N050.37.04.177 E017.59.53.362
N050.36.51.678 E017.59.48.775
N050.37.17.004 E017.58.30.695
N050.37.05.153 E017.58.17.922
N050.36.51.188 E017.58.17.612
N050.36.43.636 E017.57.30.553
N050.36.46.184 E017.57.29.912
N050.37.00.124 E017.57.35.867
N050.37.08.929 E017.57.37.278
N050.37.13.253 E017.57.38.992
N050.37.17.915 E017.57.36.662
N050.37.20.550 E017.57.34.326
N050.37.22.433 E017.57.31.046
N050.37.24.960 E017.57.22.255
N050.37.25.867 E017.57.16.859
N050.37.25.597 E017.57.14.533
N050.37.29.780 E017.57.01.868
N050.37.47.748 E017.57.00.695
N050.38.02.908 E017.56.39.134
N050.38.25.080 E017.56.13.027
N050.38.45.128 E017.56.02.512
N050.39.33.354 E017.55.22.872
N050.39.26.849 E017.54.27.976
N050.38.25.847 E017.54.45.468
N050.38.40.412 E017.53.35.394
N050.38.53.444 E017.53.27.845
N050.39.01.739 E017.52.50.473
N050.39.22.604 E017.53.00.283
N050.39.28.602 E017.52.58.840
N050.39.32.710 E017.52.44.843
N050.39.52.880 E017.52.04.044
N050.39.53.442 E017.52.04.195
N050.39.53.467 E017.52.04.469
N050.39.56.002 E017.52.05.009
N050.39.58.982 E017.52.06.762
N050.39.59.638 E017.52.06.251
N050.39.59.026 E017.52.04.577
N050.39.59.519 E017.52.02.968
N050.40.00.055 E017.51.55.764
N050.40.00.412 E017.51.49.655
N050.40.08.285 E017.51.36.083
N050.40.08.389 E017.51.36.094
N050.40.11.215 E017.51.31.039
N050.40.28.056 E017.51.02.012
N050.40.36.998 E017.51.05.350
N050.40.43.853 E017.51.18.025
N050.40.57.990 E017.51.01.138
N050.41.27.240 E017.50.28.939
N050.41.36.060 E017.50.44.801
; - Poznan
URBAN region_URBAN N052.20.41.446 E016.54.14.342
N052.20.45.020 E016.54.10.555
N052.20.50.179 E016.54.05.879
N052.20.49.996 E016.54.08.827
N052.20.51.713 E016.54.14.267
N052.20.53.502 E016.54.18.454
N052.20.55.356 E016.54.18.439
N052.20.55.475 E016.54.19.879
N052.20.56.404 E016.54.19.872
N052.20.56.839 E016.54.11.974
N052.20.57.919 E016.54.11.837
N052.20.57.970 E016.54.15.037
N052.20.59.089 E016.54.15.340
N052.20.59.251 E016.54.17.532
N052.21.04.104 E016.54.14.800
N052.21.02.898 E016.54.11.675
N052.21.04.288 E016.54.11.351
N052.21.06.016 E016.54.09.522
N052.21.06.818 E016.54.06.757
N052.21.07.772 E016.54.03.989
N052.21.11.372 E016.54.06.408
N052.21.11.830 E016.54.05.087
N052.21.19.451 E016.54.09.356
N052.21.20.178 E016.54.08.222
N052.21.21.290 E016.54.06.271
N052.21.20.858 E016.54.03.640
N052.21.20.221 E016.53.57.754
N052.21.20.275 E016.53.51.922
N052.21.20.930 E016.53.47.900
N052.21.21.143 E016.53.48.174
N052.21.42.149 E016.53.53.318
N052.21.45.479 E016.52.29.719
N052.22.17.857 E016.51.59.015
N052.21.38.588 E016.50.54.064
N052.21.59.324 E016.50.04.099
N052.22.08.105 E016.50.06.580
N052.22.10.654 E016.50.01.169
N052.22.12.882 E016.50.01.856
N052.22.15.776 E016.50.00.701
N052.22.18.901 E016.49.57.234
N052.22.19.582 E016.49.54.570
N052.22.25.723 E016.49.47.885
N052.22.26.263 E016.49.48.572
N052.22.28.913 E016.49.46.402
N052.22.29.762 E016.49.46.661
N052.22.32.153 E016.49.40.886
N052.22.37.722 E016.49.34.828
N052.22.38.374 E016.49.35.731
N052.22.40.019 E016.49.34.432
N052.22.39.893 E016.49.32.466
N052.22.41.376 E016.49.30.853
N052.22.39.940 E016.48.58.968
N052.22.45.070 E016.48.48.074
N052.23.01.478 E016.48.17.046
N052.23.08.567 E016.48.31.752
N052.23.09.294 E016.48.30.352
N052.23.09.805 E016.48.31.378
N052.23.16.458 E016.48.19.339
N052.23.25.526 E016.48.37.624
N052.23.25.832 E016.48.37.264
N052.23.26.790 E016.48.39.384
N052.23.35.110 E016.48.28.912
N052.23.37.867 E016.48.36.637
N052.23.23.014 E016.49.24.312
N052.23.59.136 E016.51.21.866
N052.24.16.718 E016.51.22.050
N052.24.30.114 E016.50.34.354
N052.24.19.919 E016.50.19.896
N052.24.17.287 E016.49.10.506
N052.24.59.796 E016.49.06.146
N052.24.50.188 E016.52.12.652
N052.25.10.578 E016.52.39.198
N052.25.42.575 E016.53.29.814
N052.26.43.940 E016.54.06.437
N052.26.43.526 E016.55.30.227
N052.26.55.126 E016.55.54.314
N052.27.36.007 E016.56.23.564
N052.27.26.989 E016.57.06.556
N052.26.01.889 E016.57.27.000
N052.25.02.003 E016.56.50.327
N052.24.57.568 E016.56.57.448
N052.25.39.745 E016.57.57.823
N052.25.33.434 E016.59.19.108
N052.23.33.277 E016.59.17.455
N052.22.48.014 E016.58.48.144
N052.22.21.508 E016.59.11.684
N052.22.07.122 E016.58.23.686
N052.22.20.399 E016.58.07.133
N052.22.01.801 E016.56.43.235
N052.21.48.838 E016.56.00.053
N052.20.32.669 E016.55.54.318
N052.20.10.676 E016.55.56.435
N052.19.35.234 E016.56.48.516
N052.20.44.851 E016.59.00.798
N052.20.15.400 E016.59.26.671
N052.19.51.013 E016.59.31.096
N052.19.34.090 E016.59.00.136
N052.19.29.730 E016.58.58.087
N052.19.24.856 E016.59.11.519
N052.19.22.458 E016.59.09.575
N052.19.18.674 E016.59.18.370
N052.18.43.272 E016.58.51.974
N052.18.27.004 E016.59.18.002
N052.18.09.598 E016.58.46.736
N052.18.13.439 E016.58.37.682
N052.18.17.370 E016.58.39.799
N052.18.41.699 E016.57.32.029
N052.18.42.340 E016.57.32.411
N052.18.43.114 E016.57.32.256
N052.18.43.855 E016.57.31.648
N052.18.44.345 E016.57.30.236
N052.18.45.212 E016.57.30.182
N052.18.45.734 E016.57.29.272
N052.18.46.022 E016.57.28.022
N052.18.49.237 E016.57.25.880
N052.18.50.054 E016.57.25.675
N052.18.50.954 E016.57.26.071
N052.18.51.480 E016.57.25.715
N052.18.51.908 E016.57.24.102
N052.19.01.974 E016.57.17.384
N052.19.02.824 E016.57.18.446
N052.19.04.782 E016.57.14.497
N052.19.04.976 E016.57.13.021
N052.18.55.620 E016.57.10.058
N052.18.54.000 E016.57.09.090
N052.18.51.984 E016.57.06.862
N052.19.06.006 E016.56.33.814
N052.19.45.793 E016.55.51.344
N052.20.09.557 E016.54.49.547
N052.20.33.191 E016.54.11.614
N052.20.29.843 E016.54.01.746
; - Rzeszów
URBAN region_URBAN N050.03.47.686 E021.57.14.548
N050.03.47.837 E021.57.16.355
N050.03.46.868 E021.57.16.654
N050.03.46.890 E021.57.17.640
N050.03.43.956 E021.57.18.936
N050.03.44.705 E021.57.21.427
N050.03.44.352 E021.57.24.253
N050.03.44.874 E021.57.23.976
N050.03.44.568 E021.57.24.710
N050.03.44.903 E021.57.49.460
N050.03.44.654 E021.57.49.536
N050.03.44.932 E021.57.52.679
N050.03.45.018 E021.57.58.000
N050.03.36.464 E021.58.29.986
N050.03.44.507 E021.58.37.787
N050.03.44.208 E021.58.59.977
N050.03.54.313 E021.59.04.466
N050.03.59.440 E022.00.06.372
N050.03.51.872 E022.00.30.971
N050.03.25.517 E022.01.12.997
N050.03.01.472 E022.01.06.460
N050.03.01.537 E022.01.13.588
N050.03.24.721 E022.01.44.252
N050.03.23.771 E022.01.50.272
N050.03.22.302 E022.01.58.814
N050.03.22.435 E022.02.01.507
N050.03.23.321 E022.02.01.964
N050.03.23.324 E022.02.03.214
N050.03.23.490 E022.02.03.412
N050.03.22.622 E022.02.07.303
N050.03.22.399 E022.02.07.289
N050.03.22.511 E022.02.07.807
N050.03.21.848 E022.02.10.777
N050.03.14.717 E022.02.06.770
N050.03.14.598 E022.02.06.407
N050.03.13.007 E022.02.05.312
N050.03.12.125 E022.02.05.316
N050.03.12.010 E022.02.06.745
N050.03.11.880 E022.02.06.724
N050.03.11.808 E022.02.09.244
N050.03.11.135 E022.02.17.617
N050.03.10.757 E022.02.19.270
N050.03.07.380 E022.02.20.670
N050.03.05.602 E022.02.19.478
N050.03.02.732 E022.02.21.127
N050.03.02.441 E022.02.23.626
N050.03.02.729 E022.02.24.486
N050.03.02.412 E022.02.25.634
N050.02.48.304 E022.02.18.085
N050.02.40.034 E022.02.41.910
N050.02.37.918 E022.02.42.400
N050.02.34.577 E022.02.50.903
N050.02.35.117 E022.02.57.754
N050.02.34.951 E022.03.05.429
N050.02.37.338 E022.03.05.584
N050.02.36.917 E022.03.22.421
N050.02.28.795 E022.03.24.628
N050.02.26.142 E022.03.21.618
N050.02.19.957 E022.03.19.717
N050.02.15.720 E022.03.20.272
N050.02.10.421 E022.03.18.364
N050.02.04.945 E022.03.19.472
N050.01.59.999 E022.03.18.385
N050.01.56.820 E022.03.17.842
N050.01.53.260 E022.03.13.777
N050.01.55.164 E022.02.57.869
N050.01.21.806 E022.02.41.568
N050.01.17.803 E022.02.07.458
N050.00.58.104 E022.01.32.311
N050.00.47.920 E022.01.28.286
N050.00.34.715 E022.02.14.968
N050.00.32.548 E022.02.14.284
N050.00.28.987 E022.02.11.576
N050.00.26.456 E022.02.08.178
N050.00.23.807 E022.02.07.638
N050.00.21.517 E022.02.10.928
N050.00.20.995 E022.02.16.411
N050.00.20.660 E022.02.29.285
N050.00.19.822 E022.02.36.229
N050.00.07.243 E022.02.33.151
N049.59.51.526 E022.02.12.048
N049.59.50.510 E022.01.35.227
N049.59.41.852 E022.01.29.856
N049.59.44.131 E022.01.13.159
N049.59.44.275 E022.01.03.014
N049.59.43.980 E022.00.45.202
N049.59.54.488 E022.00.28.030
N049.59.53.941 E022.00.19.840
N049.59.53.736 E022.00.03.283
N049.59.55.464 E022.00.04.104
N050.00.10.415 E022.00.05.018
N050.00.28.750 E021.59.54.074
N050.01.02.615 E021.59.40.589
N050.00.19.228 E021.58.47.647
N050.00.49.712 E021.57.58.842
N050.01.12.328 E021.58.24.614
N050.01.22.483 E021.58.09.282
N050.01.35.288 E021.58.05.279
N050.01.26.368 E021.57.23.404
N050.01.33.769 E021.57.16.196
N050.01.45.581 E021.57.10.015
N050.02.04.441 E021.58.11.431
N050.02.04.312 E021.58.28.355
N050.02.17.084 E021.58.28.582
N050.02.28.237 E021.58.01.978
N050.02.39.196 E021.58.00.757
N050.02.51.698 E021.57.26.266
N050.02.56.112 E021.57.24.815
N050.03.03.668 E021.57.28.904
N050.03.07.261 E021.57.29.740
N050.03.08.672 E021.57.27.270
N050.03.10.310 E021.57.23.749
N050.03.11.866 E021.57.19.638
N050.03.45.846 E021.57.08.467
N050.03.47.113 E021.57.08.316
; - Szczecin
URBAN region_URBAN N053.22.16.507 E014.44.12.214
N053.22.15.042 E014.44.14.993
N053.22.13.703 E014.44.15.655
N053.22.11.705 E014.44.12.905
N053.22.13.163 E014.44.19.684
N053.22.13.224 E014.44.28.313
N053.21.39.348 E014.44.50.824
N053.21.23.947 E014.45.01.890
N053.21.01.886 E014.45.00.011
N053.20.34.922 E014.45.22.187
N053.20.40.438 E014.46.16.910
N053.20.46.252 E014.46.24.827
N053.20.45.715 E014.46.27.984
N053.20.49.675 E014.46.37.636
N053.20.52.922 E014.46.41.513
N053.20.45.006 E014.47.03.872
N053.20.44.502 E014.47.03.498
N053.20.44.038 E014.47.06.605
N053.20.41.136 E014.47.14.788
N053.20.18.193 E014.46.55.200
N053.20.25.505 E014.46.24.071
N053.20.26.394 E014.46.23.740
N053.20.28.975 E014.46.13.044
N053.20.33.972 E014.46.03.479
N053.20.29.314 E014.45.45.803
N053.20.26.120 E014.45.34.618
N053.20.31.355 E014.45.24.365
N053.20.29.216 E014.45.23.015
N053.20.20.677 E014.45.23.166
N053.20.04.258 E014.45.13.770
N053.20.06.274 E014.44.51.295
N053.20.32.165 E014.44.54.827
N053.21.01.066 E014.44.27.848
N053.20.51.626 E014.43.50.761
N053.21.15.646 E014.43.43.007
N053.21.29.023 E014.43.56.028
N053.21.50.152 E014.43.51.452
N053.22.25.165 E014.41.52.832
N053.22.31.008 E014.41.30.379
N053.22.12.925 E014.40.51.582
N053.22.03.562 E014.39.48.758
N053.21.27.076 E014.39.56.430
N053.21.26.705 E014.39.46.141
N053.21.30.100 E014.39.34.870
N053.21.33.581 E014.39.35.104
N053.21.37.062 E014.39.34.668
N053.21.42.152 E014.39.28.868
N053.21.42.991 E014.39.24.545
N053.22.03.684 E014.39.14.990
N053.22.19.222 E014.38.20.461
N053.22.33.708 E014.37.51.647
N053.22.17.620 E014.36.42.336
N053.22.09.005 E014.36.35.827
N053.21.50.674 E014.37.07.820
N053.21.33.487 E014.36.41.940
N053.21.31.676 E014.36.08.158
N053.20.47.778 E014.34.49.015
N053.20.32.438 E014.34.45.671
N053.20.23.896 E014.34.13.462
N053.20.33.497 E014.34.10.322
N053.20.11.566 E014.33.21.938
N053.20.18.326 E014.33.05.922
N053.20.47.000 E014.33.44.716
N053.21.36.655 E014.35.07.105
N053.22.28.272 E014.36.10.264
N053.22.42.506 E014.37.00.257
N053.22.53.029 E014.37.09.998
N053.23.07.289 E014.37.51.960
N053.23.15.911 E014.37.55.261
N053.23.25.642 E014.37.13.516
N053.23.46.774 E014.37.05.664
N053.23.49.805 E014.36.15.804
N053.23.44.106 E014.35.56.443
N053.24.09.173 E014.35.14.816
N053.24.38.988 E014.34.49.307
N053.24.49.597 E014.34.30.076
N053.25.04.091 E014.33.51.552
N053.25.13.786 E014.33.14.591
N053.24.55.624 E014.32.48.700
N053.24.22.100 E014.32.27.524
N053.23.29.422 E014.31.53.357
N053.23.19.910 E014.31.19.502
N053.23.31.477 E014.30.55.447
N053.24.00.292 E014.30.41.155
N053.24.38.567 E014.31.21.648
N053.24.03.244 E014.30.07.380
N053.24.28.285 E014.29.20.861
N053.24.40.745 E014.29.25.768
N053.24.40.723 E014.29.37.032
N053.25.03.749 E014.29.35.563
N053.25.03.857 E014.28.44.044
N053.25.24.949 E014.28.48.997
N053.25.42.146 E014.29.22.913
N053.25.51.726 E014.29.29.414
N053.25.54.541 E014.30.00.029
N053.26.04.135 E014.29.58.481
N053.26.22.398 E014.29.42.482
N053.26.33.994 E014.29.02.281
N053.26.43.613 E014.28.47.842
N053.27.23.897 E014.28.51.294
N053.27.38.192 E014.29.38.112
N053.27.51.689 E014.29.04.344
N053.28.05.077 E014.29.26.988
N053.27.55.440 E014.29.49.495
N053.28.09.714 E014.30.41.162
N053.28.46.182 E014.30.34.949
N053.29.04.326 E014.31.12.155
N053.29.04.294 E014.31.26.666
N053.28.56.586 E014.31.39.511
N053.28.41.293 E014.31.16.838
N053.28.26.893 E014.31.19.963
N053.28.22.080 E014.31.27.991
N053.28.17.195 E014.32.05.035
N053.28.26.713 E014.32.35.732
N053.28.35.342 E014.32.37.406
N053.28.39.119 E014.33.01.616
N053.27.45.320 E014.33.31.846
N053.27.52.906 E014.34.05.750
N053.27.48.974 E014.34.39.565
N053.27.51.793 E014.35.00.542
N053.28.19.618 E014.34.59.156
N053.28.55.139 E014.34.49.771
N053.29.03.696 E014.35.17.254
N053.29.48.818 E014.35.06.331
N053.29.57.340 E014.35.46.727
N053.30.06.890 E014.36.01.328
N053.30.04.903 E014.36.23.897
N053.30.51.894 E014.36.30.758
N053.31.02.611 E014.35.34.364
N053.31.22.814 E014.35.15.162
N053.31.44.882 E014.35.13.729
N053.31.46.780 E014.35.21.815
N053.31.54.386 E014.35.46.093
N053.31.23.513 E014.36.43.942
N053.30.47.956 E014.37.02.996
N053.29.39.851 E014.36.59.166
N053.28.50.002 E014.36.47.434
N053.28.25.151 E014.36.14.972
N053.27.39.190 E014.35.45.568
N053.27.17.215 E014.35.14.762
N053.26.47.548 E014.34.48.742
N053.26.03.448 E014.34.37.106
N053.25.37.686 E014.33.45.367
N053.25.26.184 E014.33.42.059
N053.25.08.778 E014.34.31.840
N053.24.34.049 E014.35.37.558
N053.24.07.063 E014.36.19.174
N053.23.51.504 E014.37.26.627
N053.23.27.460 E014.37.44.105
N053.23.22.585 E014.38.08.196
N053.23.28.126 E014.39.11.002
N053.23.48.160 E014.39.43.387
N053.23.58.729 E014.39.38.668
N053.24.17.784 E014.40.17.490
N053.24.36.738 E014.41.20.472
N053.24.16.488 E014.41.47.616
N053.23.45.910 E014.41.15.097
N053.23.42.263 E014.40.21.950
N053.22.55.038 E014.41.19.378
N053.22.37.560 E014.42.13.882
N053.21.56.768 E014.44.15.655
; - Szczecin
URBAN region_URBAN N053.23.09.496 E014.46.09.527
N053.23.03.718 E014.46.05.066
N053.23.05.399 E014.46.01.056
N053.22.57.547 E014.45.41.602
N053.22.58.847 E014.45.31.007
N053.22.27.077 E014.44.06.907
N053.22.34.234 E014.44.04.841
N053.23.05.712 E014.44.48.656
N053.23.20.843 E014.45.40.334
N053.23.34.224 E014.45.51.764
N053.23.53.398 E014.45.55.220
N053.24.04.813 E014.46.17.900
; - Torun
URBAN region_URBAN N053.01.29.046 E018.33.44.370
N053.02.10.525 E018.34.05.106
N053.02.16.296 E018.34.33.834
N053.03.08.424 E018.33.58.720
N053.03.26.690 E018.35.36.114
N053.02.23.953 E018.35.55.230
N053.02.38.393 E018.36.38.336
N053.03.01.530 E018.36.59.112
N053.02.50.834 E018.38.12.530
N053.03.20.689 E018.39.00.475
N053.02.50.701 E018.39.54.695
N053.03.07.956 E018.41.14.557
N053.03.08.813 E018.42.18.418
N053.02.45.622 E018.42.35.910
N053.02.27.326 E018.42.13.504
N053.01.47.734 E018.42.30.931
N053.01.41.977 E018.42.11.765
N053.01.28.474 E018.42.08.536
N053.01.10.240 E018.41.06.259
N053.00.56.653 E018.41.54.078
N053.00.19.926 E018.42.27.457
N053.00.06.937 E018.42.26.341
N053.00.07.096 E018.42.24.980
N053.00.07.002 E018.42.23.224
N053.00.06.714 E018.42.21.312
N053.00.04.795 E018.42.17.795
N053.00.01.231 E018.42.18.097
N053.00.00.158 E018.42.19.465
N052.59.59.532 E018.42.10.984
N053.00.01.339 E018.42.08.366
N053.00.02.498 E018.42.05.663
N053.00.02.311 E018.42.01.994
N053.00.01.836 E018.41.58.330
N053.00.01.354 E018.41.57.127
N053.00.46.120 E018.41.03.005
N053.01.06.521 E018.39.30.535
N053.00.54.068 E018.38.17.135
N053.00.36.756 E018.37.26.069
N053.00.08.752 E018.37.43.572
N053.00.10.577 E018.39.12.877
N052.59.23.294 E018.39.11.189
N052.59.24.353 E018.37.54.671
N052.59.03.170 E018.37.11.600
N052.58.59.358 E018.36.22.187
N052.58.59.394 E018.35.42.338
N052.58.47.827 E018.35.24.799
N052.58.46.895 E018.34.41.768
N052.58.31.598 E018.34.25.403
N052.58.30.814 E018.34.13.148
N052.58.30.338 E018.34.12.896
N052.58.29.575 E018.33.20.488
N052.58.35.105 E018.33.22.378
N052.58.41.714 E018.33.30.672
N052.58.48.745 E018.33.32.926
N052.58.55.211 E018.33.37.321
N052.59.08.005 E018.33.41.688
N052.59.41.910 E018.34.19.459
N053.00.04.018 E018.36.15.865
N053.00.25.261 E018.35.59.935
N053.00.18.572 E018.34.33.816
N053.00.30.179 E018.33.47.563
; - Warszawa
URBAN region_URBAN N052.12.30.305 E020.52.19.672
N052.12.34.078 E020.52.20.327
N052.12.48.600 E020.52.23.542
N052.12.55.451 E020.52.24.618
N052.13.00.304 E020.52.25.280
N052.13.00.268 E020.52.28.823
N052.13.10.358 E020.52.29.413
N052.13.28.272 E020.53.37.403
N052.14.46.756 E020.53.40.340
N052.14.56.094 E020.53.19.842
N052.16.07.590 E020.53.33.936
N052.16.47.899 E020.53.51.371
N052.16.56.320 E020.52.45.808
N052.17.11.324 E020.52.46.006
N052.17.26.088 E020.53.33.126
N052.17.43.451 E020.53.23.975
N052.18.15.768 E020.53.24.410
N052.19.02.482 E020.55.19.607
N052.18.33.365 E020.56.06.137
N052.18.02.963 E020.57.15.160
N052.18.16.452 E020.58.17.321
N052.18.42.163 E020.57.23.256
N052.19.07.907 E020.56.21.664
N052.19.48.410 E020.56.03.466
N052.20.27.654 E020.56.04.038
N052.21.08.154 E020.55.45.829
N052.21.28.638 E020.55.43.741
N052.21.26.698 E020.55.48.824
N052.21.28.465 E020.55.51.589
N052.21.35.453 E020.56.01.601
N052.21.28.372 E020.56.20.026
N052.21.29.599 E020.56.19.108
N052.21.29.902 E020.56.19.608
N052.21.37.494 E020.56.13.484
N052.21.40.234 E020.56.20.260
N052.21.41.645 E020.56.19.439
N052.21.42.282 E020.56.20.098
N052.20.47.994 E020.57.21.388
N052.19.59.146 E020.58.24.532
N052.20.10.597 E020.58.39.738
N052.21.36.252 E020.57.59.710
N052.21.38.110 E020.58.11.730
N052.21.32.522 E020.58.14.934
N052.21.32.393 E020.58.40.649
N052.21.43.704 E020.59.22.790
N052.19.26.958 E021.01.11.215
N052.18.43.888 E021.02.08.722
N052.18.47.142 E021.02.40.700
N052.19.05.560 E021.02.48.530
N052.18.53.870 E021.03.10.865
N052.18.19.195 E021.03.17.777
N052.18.29.333 E021.03.55.508
N052.17.39.257 E021.05.00.337
N052.17.48.815 E021.05.09.589
N052.17.52.116 E021.05.10.543
N052.17.44.088 E021.05.15.540
N052.17.40.196 E021.05.19.345
N052.17.23.262 E021.05.36.668
N052.17.17.210 E021.05.42.025
N052.17.10.597 E021.05.45.614
N052.17.09.964 E021.05.57.343
N052.17.05.204 E021.06.01.030
N052.16.56.431 E021.06.04.928
N052.16.49.447 E021.06.07.463
N052.16.48.641 E021.06.06.152
N052.16.42.175 E021.06.08.860
N052.16.30.911 E021.05.34.922
N052.15.47.034 E021.06.31.824
N052.15.33.984 E021.06.48.398
N052.15.34.207 E021.06.53.694
N052.15.49.864 E021.06.50.976
N052.15.48.690 E021.06.40.237
N052.15.54.083 E021.06.36.850
N052.16.05.218 E021.06.44.665
N052.16.16.424 E021.06.34.200
N052.16.28.088 E021.06.29.617
N052.16.31.757 E021.06.59.706
N052.16.31.591 E021.07.01.938
N052.16.33.712 E021.07.19.708
N052.15.34.747 E021.08.14.766
N052.16.14.905 E021.08.48.347
N052.16.43.259 E021.09.56.138
N052.16.04.332 E021.10.54.782
N052.15.50.929 E021.10.46.697
N052.14.59.939 E021.10.47.237
N052.14.55.046 E021.11.00.118
N052.14.48.948 E021.11.03.966
N052.14.48.268 E021.11.02.260
N052.14.46.676 E021.11.02.976
N052.14.43.778 E021.10.45.606
N052.14.42.799 E021.10.36.768
N052.14.42.313 E021.10.36.138
N052.14.39.520 E021.10.39.691
N052.14.37.259 E021.10.43.144
N052.14.33.371 E021.10.47.518
N052.14.26.916 E021.10.57.454
N052.14.23.960 E021.11.03.430
N052.14.21.278 E021.11.08.232
N052.14.20.461 E021.11.10.982
N052.14.15.018 E021.11.23.957
N052.14.20.954 E021.09.47.088
N052.13.02.212 E021.10.19.589
N052.13.08.195 E021.12.21.517
N052.12.10.307 E021.12.42.808
N052.09.55.890 E021.13.45.538
N052.09.31.676 E021.14.04.528
N052.09.27.914 E021.13.53.011
N052.08.58.326 E021.11.19.259
N052.09.01.678 E021.11.17.797
N052.09.00.360 E021.11.09.632
N052.09.14.519 E021.10.56.248
N052.09.50.990 E021.09.25.265
N052.10.57.554 E021.07.41.704
N052.12.15.358 E021.06.37.598
N052.13.05.398 E021.05.40.427
N052.13.13.091 E021.03.48.125
N052.13.03.047 E021.02.55.482
N052.12.51.430 E021.03.06.527
N052.12.49.522 E021.04.58.919
N052.12.28.411 E021.05.47.252
N052.11.15.482 E021.06.15.894
N052.09.56.531 E021.07.19.963
N052.08.59.622 E021.05.24.767
N052.09.53.053 E021.04.37.063
N052.10.01.636 E021.03.22.342
N052.09.48.938 E021.03.22.122
N052.07.48.166 E021.05.08.520
N052.07.36.739 E021.04.51.488
N052.08.02.551 E021.03.50.220
N052.07.53.760 E021.02.42.738
N052.08.12.617 E021.01.43.201
N052.06.23.000 E021.01.52.590
N052.06.22.082 E021.01.09.091
N052.06.21.283 E021.01.09.106
N052.06.21.276 E021.01.07.907
N052.06.20.545 E021.01.07.871
N052.06.18.770 E021.00.34.027
N052.06.30.658 E020.59.38.137
N052.07.40.015 E020.59.22.402
N052.07.46.805 E020.59.44.948
N052.09.10.015 E020.59.29.425
N052.09.33.419 E020.58.37.391
N052.09.59.832 E020.55.39.986
N052.10.39.180 E020.55.21.824
N052.10.57.011 E020.54.45.997
N052.11.08.768 E020.54.52.790
N052.11.08.776 E020.54.33.718
N052.11.07.858 E020.54.33.682
N052.11.07.840 E020.54.33.152
N052.11.05.374 E020.54.33.577
N052.11.04.283 E020.54.33.534
N052.11.04.157 E020.54.31.644
N052.11.06.022 E020.54.27.904
N052.11.03.052 E020.54.14.846
N052.11.02.702 E020.54.09.558
N052.11.03.876 E020.54.06.476
N052.11.03.246 E020.54.00.040
N052.11.02.706 E020.53.59.546
N052.11.02.929 E020.53.57.332
N052.10.58.537 E020.53.55.010
N052.10.56.640 E020.53.46.669
N052.10.56.845 E020.52.10.254
N052.10.56.953 E020.52.03.104
N052.11.15.407 E020.52.00.728
N052.11.17.718 E020.51.59.789
N052.11.19.644 E020.51.58.061
N052.11.22.628 E020.51.58.216
N052.11.23.975 E020.51.57.744
N052.11.15.065 E020.51.22.392
N052.11.15.979 E020.51.21.762
N052.11.18.172 E020.51.24.059
N052.11.21.559 E020.51.25.013
N052.11.25.195 E020.51.25.488
N052.11.27.161 E020.51.25.020
N052.11.43.364 E020.51.14.908
N052.11.49.560 E020.51.13.151
N052.11.58.819 E020.51.09.824
N052.12.08.600 E020.51.10.361
N052.12.14.234 E020.51.09.194
N052.12.20.927 E020.51.20.930
N052.12.26.377 E020.51.30.661
N052.12.28.735 E020.51.45.684
; - Wroclaw
URBAN region_URBAN N051.10.24.557 E017.06.32.864
N051.10.28.841 E017.06.35.046
N051.10.23.207 E017.07.01.139
N051.10.22.933 E017.07.01.492
N051.10.15.089 E017.07.29.226
N051.10.17.062 E017.07.29.608
N051.10.16.867 E017.07.30.511
N051.10.03.983 E017.07.42.398
N051.09.52.776 E017.08.47.134
N051.10.02.687 E017.09.03.020
N051.09.49.900 E017.09.14.573
N051.09.47.495 E017.09.14.335
N051.09.44.042 E017.09.13.619
N051.09.43.942 E017.09.14.584
N051.09.39.877 E017.09.14.184
N051.09.35.320 E017.09.08.644
N051.09.35.467 E017.09.10.462
N051.09.28.001 E017.09.11.164
N051.08.59.039 E017.08.19.849
N051.08.33.011 E017.08.48.098
N051.08.18.143 E017.08.24.284
N051.07.53.296 E017.08.03.556
N051.08.33.479 E017.06.36.947
N051.08.18.676 E017.05.52.606
N051.07.58.505 E017.07.00.404
N051.07.47.528 E017.07.01.906
N051.07.06.434 E017.08.03.203
N051.06.36.158 E017.09.39.301
N051.06.18.223 E017.09.35.996
N051.05.46.208 E017.10.04.152
N051.05.40.844 E017.09.55.562
N051.05.42.666 E017.09.53.644
N051.05.42.738 E017.09.50.497
N051.05.36.712 E017.09.43.628
N051.05.33.547 E017.09.43.096
N051.06.34.600 E017.07.42.442
N051.06.30.654 E017.07.31.361
N051.06.06.707 E017.07.35.918
N051.05.47.987 E017.06.32.638
N051.05.49.124 E017.05.51.605
N051.05.55.316 E017.04.48.504
N051.05.19.475 E017.04.30.914
N051.05.10.453 E017.04.46.639
N051.04.51.272 E017.05.57.530
N051.04.08.396 E017.05.58.816
N051.04.00.584 E017.05.09.859
N051.04.28.628 E017.04.30.598
N051.04.06.830 E017.03.47.866
N051.03.20.938 E017.03.57.053
N051.03.18.047 E017.03.23.915
N051.04.00.980 E017.03.03.661
N051.04.01.070 E017.02.33.691
N051.03.38.160 E017.02.25.674
N051.03.28.260 E017.02.00.384
N051.03.02.376 E017.01.47.629
N051.03.12.784 E017.00.35.014
N051.03.16.070 E017.00.21.164
N051.03.14.893 E017.00.20.272
N051.03.20.660 E016.59.39.984
N051.03.24.466 E016.59.27.848
N051.03.25.088 E016.59.27.020
N051.03.24.808 E016.59.26.761
N051.03.50.796 E016.58.03.904
N051.04.03.742 E016.58.10.261
N051.04.05.603 E016.59.08.639
N051.04.23.520 E016.59.19.759
N051.04.31.544 E016.58.59.282
N051.04.31.732 E016.57.37.242
N051.04.48.734 E016.57.12.064
N051.05.13.560 E016.57.57.917
N051.05.25.566 E016.57.39.028
N051.05.25.667 E016.56.50.100
N051.05.14.795 E016.56.04.301
N051.05.23.784 E016.55.54.854
N051.06.30.467 E016.56.53.484
N051.06.45.454 E016.56.37.748
N051.07.01.477 E016.56.01.478
N051.07.02.561 E016.55.14.110
N051.06.54.648 E016.54.39.348
N051.06.25.772 E016.54.17.172
N051.06.13.849 E016.53.55.039
N051.06.11.912 E016.53.18.726
N051.06.29.905 E016.52.48.770
N051.07.11.687 E016.53.45.701
N051.07.14.790 E016.52.31.487
N051.06.47.887 E016.52.21.961
N051.06.59.976 E016.50.44.084
N051.07.53.807 E016.50.44.153
N051.08.47.641 E016.50.47.378
N051.08.52.634 E016.50.39.484
N051.09.35.446 E016.51.22.208
N051.09.03.488 E016.52.06.406
N051.09.22.406 E016.52.23.826
N051.10.13.206 E016.52.52.370
N051.10.07.140 E016.53.49.268
N051.10.46.949 E016.54.30.470
N051.10.30.925 E016.55.11.539
N051.09.45.040 E016.55.25.637
N051.09.42.973 E016.56.05.147
N051.09.23.929 E016.56.55.662
N051.09.02.992 E016.56.57.170
N051.08.18.010 E016.57.52.312
N051.08.17.930 E016.58.27.066
N051.07.59.880 E016.59.14.384
N051.08.08.822 E016.59.27.060
N051.08.38.767 E016.59.11.393
N051.08.50.568 E017.00.17.809
N051.09.17.485 E017.00.17.935
N051.10.07.435 E016.59.37.064
N051.09.56.700 E016.57.57.427
N051.10.10.711 E016.57.32.184
N051.10.45.408 E016.58.59.279
N051.11.58.308 E016.58.05.797
N051.12.06.235 E016.58.27.973
N051.10.21.328 E017.00.02.423
N051.10.47.125 E017.00.51.559
N051.10.35.065 E017.01.29.449
N051.10.13.080 E017.01.48.310
N051.09.53.993 E017.02.38.796
N051.09.40.914 E017.03.19.822
N051.08.55.727 E017.05.03.865
N051.08.30.887 E017.04.36.844
N051.08.32.698 E017.05.33.738
N051.09.24.232 E017.07.05.754
N051.09.34.247 E017.06.53.179
N051.09.40.406 E017.06.01.058
N051.10.11.345 E017.05.51.778
; - Zielona_Góra
URBAN region_URBAN N051.53.53.758 E015.30.33.188
N051.54.27.760 E015.30.16.146
N051.54.36.738 E015.30.14.699
N051.54.45.882 E015.29.50.773
N051.55.15.686 E015.30.02.552
N051.55.23.869 E015.29.33.785
N051.55.28.088 E015.29.01.730
N051.55.42.107 E015.28.52.338
N051.55.51.949 E015.29.08.574
N051.56.19.982 E015.28.49.786
N051.56.20.238 E015.28.14.437
N051.56.31.186 E015.28.16.234
N051.56.39.005 E015.28.37.261
N051.56.59.924 E015.28.37.628
N051.57.06.030 E015.28.20.053
N051.57.19.940 E015.28.25.115
N051.57.33.656 E015.28.57.508
N051.57.27.526 E015.29.18.298
N051.57.16.567 E015.29.18.107
N051.57.11.444 E015.29.37.309
N051.57.20.236 E015.30.01.580
N051.57.16.981 E015.30.36.886
N051.57.20.941 E015.30.40.176
N051.57.20.862 E015.30.51.426
N051.57.22.795 E015.30.59.501
N051.57.54.479 E015.31.25.806
N051.57.58.403 E015.31.33.920
N051.58.09.530 E015.31.11.611
N051.58.29.298 E015.31.32.884
N051.58.22.030 E015.32.11.346
N051.58.09.811 E015.32.44.891
N051.57.36.364 E015.31.49.591
N051.57.14.594 E015.31.29.896
N051.57.06.476 E015.31.49.033
N051.56.22.704 E015.31.40.181
N051.56.25.033 E015.33.05.404
N051.55.53.947 E015.33.30.521
N051.55.46.207 E015.33.01.447
N051.56.11.339 E015.32.33.004
N051.56.13.528 E015.32.07.328
N051.56.02.569 E015.32.07.127
N051.55.52.792 E015.31.42.841
N051.55.28.895 E015.31.40.789
N051.55.12.324 E015.30.52.290
N051.54.35.417 E015.30.58.036
N051.54.34.333 E015.31.09.257
; - Lódz
URBAN region_URBAN N051.49.46.690 E019.25.07.144
N051.49.48.097 E019.25.11.118
N051.49.51.924 E019.25.28.636
N051.49.52.241 E019.25.30.940
N051.49.52.586 E019.25.46.470
N051.49.55.686 E019.25.56.806
N051.49.55.535 E019.26.00.445
N051.49.56.521 E019.26.08.300
N051.49.57.457 E019.26.09.157
N051.49.38.917 E019.26.35.308
N051.49.30.835 E019.26.05.496
N051.49.10.272 E019.26.13.524
N051.48.55.850 E019.26.26.570
N051.48.59.926 E019.26.33.220
N051.49.12.248 E019.26.31.704
N051.49.34.608 E019.27.21.492
N051.48.58.579 E019.27.45.842
N051.48.46.174 E019.28.05.509
N051.49.17.497 E019.29.51.544
N051.50.12.127 E019.32.12.019
N051.50.03.037 E019.32.26.416
N051.49.04.411 E019.30.21.334
N051.48.23.695 E019.29.55.352
N051.48.17.950 E019.29.55.759
N051.48.05.684 E019.29.45.704
N051.47.51.266 E019.29.55.428
N051.48.11.246 E019.31.46.254
N051.48.04.972 E019.32.09.280
N051.47.55.979 E019.34.58.109
N051.48.37.116 E019.35.13.171
N051.48.36.976 E019.35.38.033
N051.48.04.748 E019.35.41.734
N051.48.26.327 E019.36.37.976
N051.48.18.504 E019.36.54.439
N051.47.46.586 E019.36.04.270
N051.47.41.172 E019.36.49.763
N051.47.28.266 E019.36.53.723
N051.46.38.564 E019.35.19.838
N051.47.27.924 E019.34.05.948
N051.47.34.159 E019.32.13.823
N051.46.35.710 E019.32.03.149
N051.46.25.867 E019.34.46.538
N051.46.11.665 E019.34.52.558
N051.46.18.214 E019.32.12.811
N051.45.58.730 E019.32.09.258
N051.45.25.063 E019.35.33.317
N051.46.00.689 E019.36.50.404
N051.45.55.476 E019.37.00.678
N051.45.48.589 E019.36.50.584
N051.45.40.403 E019.36.33.404
N051.45.39.096 E019.36.36.673
N051.44.54.157 E019.35.30.826
N051.44.57.966 E019.32.49.668
N051.44.46.939 E019.31.58.418
N051.43.56.600 E019.32.07.642
N051.44.37.252 E019.33.25.650
N051.44.20.393 E019.36.17.942
N051.44.41.132 E019.35.55.475
N051.44.52.609 E019.36.16.326
N051.44.36.974 E019.36.47.142
N051.44.53.534 E019.37.18.419
N051.44.48.311 E019.37.30.756
N051.44.06.166 E019.36.28.084
N051.44.21.822 E019.33.32.029
N051.43.36.008 E019.32.20.548
N051.42.53.953 E019.32.47.890
N051.43.05.084 E019.34.14.880
N051.42.42.757 E019.35.31.085
N051.42.26.093 E019.35.16.382
N051.42.42.163 E019.33.24.955
N051.42.28.465 E019.31.41.772
N051.42.38.747 E019.31.38.611
N051.42.46.789 E019.32.11.659
N051.43.03.209 E019.32.11.879
N051.43.25.882 E019.31.54.052
N051.43.35.177 E019.31.42.643
N051.43.22.008 E019.31.07.871
N051.43.32.459 E019.30.30.110
N051.43.26.342 E019.30.21.798
N051.42.54.479 E019.30.31.280
N051.42.41.170 E019.30.24.523
N051.42.34.855 E019.30.55.739
N051.42.26.615 E019.31.02.219
N051.42.16.423 E019.30.47.268
N051.42.26.849 E019.30.14.461
N051.42.26.960 E019.29.51.407
N051.42.18.749 E019.29.51.302
N051.42.15.818 E019.29.19.979
N051.41.54.413 E019.28.48.428
N051.41.52.379 E019.28.45.113
N051.41.52.339 E019.28.53.364
N051.41.46.468 E019.28.27.977
N051.41.46.385 E019.28.09.854
N051.41.45.092 E019.28.01.477
N051.41.20.195 E019.28.07.320
N051.41.20.533 E019.27.41.450
N051.41.16.148 E019.27.42.041
N051.41.15.270 E019.27.20.570
N051.41.22.168 E019.27.10.526
N051.41.17.243 E019.27.03.614
N051.41.09.654 E019.26.21.588
N051.41.10.633 E019.26.02.029
N051.41.09.974 E019.26.00.395
N051.41.10.007 E019.25.59.988
N051.41.09.438 E019.25.59.066
N051.41.06.317 E019.25.51.337
N051.41.13.038 E019.25.28.837
N051.41.11.357 E019.25.14.552
N051.41.24.781 E019.25.05.164
N051.41.27.406 E019.25.08.112
N051.41.28.097 E019.25.05.495
N051.41.31.434 E019.25.02.586
N051.41.33.770 E019.24.57.744
N051.41.35.934 E019.24.35.759
N051.41.43.321 E019.24.07.722
N051.41.40.020 E019.24.06.120
N051.41.40.063 E019.24.05.702
N051.41.35.488 E019.24.01.537
N051.41.36.416 E019.23.55.100
N051.41.53.596 E019.24.03.564
N051.41.47.346 E019.24.26.550
N051.42.16.945 E019.25.06.377
N051.42.23.656 E019.22.48.115
N051.42.39.035 E019.22.51.560
N051.42.33.318 E019.25.18.080
N051.42.37.393 E019.25.24.715
N051.42.51.844 E019.25.05.106
N051.43.08.238 E019.25.11.870
N051.43.06.269 E019.24.52.081
N051.43.28.913 E019.24.35.845
N051.43.35.958 E019.25.10.517
N051.43.51.323 E019.25.17.270
N051.43.58.418 E019.25.38.770
N051.44.07.670 E019.25.35.573
N051.43.59.574 E019.25.07.471
N051.44.20.170 E019.24.51.214
N051.44.20.310 E019.24.16.607
N051.44.06.191 E019.23.12.192
N051.44.52.494 E019.22.41.336
N051.45.13.709 E019.24.08.914
N051.45.22.957 E019.24.05.713
N051.45.26.096 E019.23.50.906
N051.45.35.345 E019.23.47.702
N051.45.59.918 E019.24.02.794
N051.46.24.600 E019.23.49.855
N051.46.12.479 E019.23.00.254
N051.46.20.752 E019.22.43.846
N051.46.41.383 E019.22.14.354
N051.46.57.760 E019.22.27.707
N051.47.00.686 E019.23.07.328
N051.47.15.011 E019.23.19.018
N051.47.18.089 E019.23.19.050
N051.47.30.721 E019.21.55.030
N051.47.59.395 E019.22.11.802
N051.48.12.935 E019.21.17.467
N051.48.21.164 E019.21.12.593
N051.48.53.860 E019.21.52.513
N051.48.42.386 E019.22.41.927
N051.48.51.534 E019.23.05.125
N051.48.56.480 E019.23.53.048
N051.49.05.588 E019.24.26.161
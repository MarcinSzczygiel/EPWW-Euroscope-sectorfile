; Warszawa ACC ES by Marcin Dziadowiec
; aerodromes by Wojciech Bursiak
; All rights reserved

[INFO]
FIR Warszawa 1113 [24.12.2011] by M. Dziadowiec
EPWW_CTR
EPWA
N052.14.21.827
E019.23.31.961
60
37
-4
;-60.8
1

#define Color_7ACI   16777215
#define Color_14ACI       153
#define Color_18ACI        76
#define Color_44ACI     21346
#define Color_45ACI   5014937
#define Color_96ACI     32512
#define Color_186ACI  8323103
#define Color_251ACI  3618615
#define Color_252ACI  8684676
#define Color_253ACI 11382189

#define Color_16ACI       127
#define Color_46ACI     24447
#define Color_96ACI     32512
#define Color_196ACI  8323135
;#define Color_251ACI  5987163

#define gray 22878
#define red2 83
#define twy_epwa 4605761
#define epwa_grass 1456158
#define epwa_twy_edge 218254

#define stargray 2631720



;temp
#define pink 6560511

#define region_URBAN 1644825
#define vistula 1835008

#define nonsch 3646192
#define sch 4970129
#define white 32896
#define maroon 128
#define fuchsia 128
#define teal 8421376
#define blue 5921280
#define TSA 1907997
#define ACC 10580847
#define CTR 1058084
#define MATZ 150
#define PROHI 64
#define yellow 130
#define Blue 1058084
#define red 1058084
#define lime 65280
#define white 1058084
#define green 1058084
#define ILSRED 130
#define build 81
#define reg_build 2631720
#define restr 40
#define dange 128
#define olive 32896
#define oliwe 32896
#define blu 8672768
#define oranz 24767
#define ulica 24767
#define cctr  2309951
#define mrva  2043446
#define river  204344
#define grass 727571

;regions
#define conc 2631720

[ARTCC LOW]

;EPPO
;A
EPPO_TMA_IN N052.37.07.000 E016.20.39.000 N052.34.54.000 E016.57.46.000
N052.34.54.000 E016.57.46.000 N052.27.30.000 E017.16.09.000
N052.27.30.000 E017.16.09.000 N052.24.02.000 E017.24.42.000 
N052.24.02.000 E017.24.42.000 N052.21.39.000 E017.30.34.000
N052.21.39.000 E017.30.34.000 N052.04.28.000 E017.25.32.000
N052.04.28.000 E017.25.32.000 N052.08.37.000 E016.43.29.000
N052.08.37.000 E016.43.29.000 N052.17.11.000 E016.34.45.000
N052.17.11.000 E016.34.45.000 N052.23.20.000 E016.21.21.000
N052.23.20.000 E016.21.21.000 N052.35.36.000 E016.17.13.000
N052.35.36.000 E016.17.13.000 N052.37.07.000 E016.20.39.000

;B
N052.31.27.000 E016.07.51.000 N052.35.36.000 E016.17.13.000
N052.35.36.000 E016.17.13.000 N052.23.20.000 E016.21.22.000
N052.23.20.000 E016.21.22.000 N052.17.11.000 E016.34.45.000
N052.17.11.000 E016.34.45.000 N052.08.37.000 E016.43.29.000
N052.08.37.000 E016.43.29.000 N052.04.28.000 E017.25.32.000
N052.04.28.000 E017.25.32.000 N052.03.33.000 E017.25.16.000
N052.03.33.000 E017.25.16.000 N051.58.59.000 E017.15.46.000
N051.58.59.000 E017.15.46.000 N052.01.49.000 E016.39.00.000
N052.01.49.000 E016.39.00.000 N052.06.28.000 E016.29.47.000
N052.06.28.000 E016.29.47.000 N052.24.14.000 E016.11.09.000
N052.24.14.000 E016.11.09.000 N052.31.27.000 E016.07.51.000

;C
N052.32.54.000 E016.00.43.000 N052.41.32.000 E016.18.19.000
N052.41.32.000 E016.18.19.000 N052.38.41.000 E017.04.53.000
N052.38.41.000 E017.04.53.000 N052.34.27.000 E017.23.00.000
N052.34.27.000 E017.23.00.000 N052.27.30.000 E017.16.09.000
N052.27.30.000 E017.16.09.000 N052.21.39.000 E017.30.34.000
N052.21.39.000 E017.30.34.000 N052.18.32.000 E017.38.11.000
N052.18.32.000 E017.38.11.000 N052.00.17.000 E017.31.55.000
N052.00.17.000 E017.31.55.000 N051.55.02.000 E017.21.00.000
N051.55.02.000 E017.21.00.000 N051.54.43.000 E016.43.44.000
N051.54.43.000 E016.43.44.000 N052.07.05.000 E016.15.21.000
N052.07.05.000 E016.15.21.000 N052.10.57.000 E016.13.11.000
N052.10.57.000 E016.13.11.000 N052.19.28.000 E016.02.12.000
N052.19.28.000 E016.02.12.000 N052.32.54.000 E016.00.43.000

;D
EPPO_TMA_OUT N052.58.51.000 E015.33.30.000 N053.11.18.000 E016.34.37.000
N053.11.18.000 E016.34.37.000 N053.07.15.000 E017.32.10.000
N053.07.15.000 E017.32.10.000 N052.57.24.000 E017.33.21.000
N052.57.24.000 E017.33.21.000 N052.52.24.000 E017.33.58.000
N052.52.24.000 E017.33.58.000 N052.40.17.000 E018.00.00.000
N052.40.17.000 E018.00.00.000 N051.59.48.000 E018.00.00.000
N051.59.48.000 E018.00.00.000 N051.45.00.000 E017.40.42.000
N051.45.00.000 E017.40.42.000 N051.37.03.000 E016.00.00.000
N051.37.03.000 E016.00.00.000 N052.01.40.000 E015.38.26.000
N052.01.40.000 E015.38.26.000 N052.10.46.000 E015.31.08.000
N052.10.46.000 E015.31.08.000 N052.58.51.000 E015.33.30.000


;TMA EPGD A
EPGD_TMA_IN N054.33.34.000 E018.00.31.000 N054.35.50.000 E018.18.27.000
N054.35.50.000 E018.18.27.000 N054.27.47.000 E018.24.44.000
N054.27.47.000 E018.24.44.000 N054.26.56.000 E018.32.40.000
N054.26.56.000 E018.32.40.000 N054.25.09.000 E018.47.50.000
N054.25.09.000 E018.47.50.000 N054.23.00.000 E019.00.00.000
N054.23.00.000 E019.00.00.000 N054.19.18.000 E019.04.57.000
N054.19.18.000 E019.04.57.000 N054.09.00.000 E019.00.00.000
N054.09.00.000 E019.00.00.000 N054.03.20.000 E018.51.59.000
N054.03.20.000 E018.51.59.000 N053.59.58.000 E018.31.28.000
N053.59.58.000 E018.31.28.000 N053.58.38.000 E018.23.30.000
N053.58.38.000 E018.23.30.000 N054.15.00.000 E017.50.00.000
N054.15.00.000 E017.50.00.000 N054.20.17.000 E017.50.00.000
N054.20.17.000 E017.50.00.000 N054.22.22.000 E017.55.13.000
N054.22.22.000 E017.55.13.000 N054.23.23.000 E018.03.00.000
N054.23.23.000 E018.03.00.000 N054.33.34.000 E018.00.31.000

;TMA EPGD B
N054.38.53.000 E017.56.35.000 N054.40.41.000 E018.14.38.000
N054.40.41.000 E018.14.38.000 N054.41.01.000 E018.36.16.000
N054.41.01.000 E018.36.16.000 N054.29.45.000 E018.55.23.000
N054.29.45.000 E018.55.23.000 N054.23.00.000 E019.00.00.000
N054.23.00.000 E019.00.00.000 N054.25.09.000 E018.47.50.000
N054.25.09.000 E018.47.50.000 N054.26.56.000 E018.32.40.000
N054.26.56.000 E018.32.40.000 N054.27.47.000 E018.24.44.000
N054.27.47.000 E018.24.44.000 N054.35.50.000 E018.18.27.000
N054.35.50.000 E018.18.27.000 N054.33.34.000 E018.00.31.000
N054.33.34.000 E018.00.31.000 N054.23.23.000 E018.03.00.000
N054.23.23.000 E018.03.00.000 N054.22.22.000 E017.55.13.000
N054.22.22.000 E017.55.13.000 N054.20.17.000 E017.50.00.000
N054.20.17.000 E017.50.00.000 N054.33.10.000 E017.50.00.000
N054.33.10.000 E017.50.00.000 N054.38.53.000 E017.56.35.000


;TMA EPGD C
N054.47.43.000 E017.49.36.000 N054.48.58.000 E018.23.09.000
N054.48.58.000 E018.23.09.000 N054.32.37.000 E019.06.25.000
N054.32.37.000 E019.06.25.000 N054.09.05.000 E019.15.59.000
N054.09.05.000 E019.15.59.000 N053.52.38.000 E019.07.04.000
N053.52.38.000 E019.07.04.000 N053.51.21.000 E018.51.23.000
N053.51.21.000 E018.51.23.000 N053.49.20.000 E018.31.32.000
N053.49.20.000 E018.31.32.000 N054.10.43.000 E017.49.37.000
N054.10.43.000 E017.49.37.000 N054.08.28.000 E017.30.16.000
N054.08.28.000 E017.30.16.000 N054.13.27.000 E017.26.56.000
N054.13.27.000 E017.26.56.000 N054.23.33.000 E017.24.19.000
N054.23.33.000 E017.24.19.000 N054.32.26.000 E017.30.51.000
N054.32.26.000 E017.30.51.000 N054.47.43.000 E017.49.36.000

;TMA EPGD D
EPGD_TMA_OUT N054.08.28.000 E017.30.16.000 N054.10.43.000 E017.49.37.000
N054.10.43.000 E017.49.37.000 N053.49.20.000 E018.31.32.000
N053.49.20.000 E018.31.32.000 N053.51.21.000 E018.51.23.000
N053.51.21.000 E018.51.23.000 N053.52.38.000 E019.07.04.000
N053.52.38.000 E019.07.04.000 N053.50.31.000 E019.05.56.000
N053.50.31.000 E019.05.56.000 N053.41.43.000 E018.26.19.000
N053.41.43.000 E018.26.19.000 N054.08.28.000 E017.30.16.000

;TMA EPGD E
EPGD_TMA_OUT N055.17.24.000 E018.23.53.000 N054.54.46.000 E018.57.30.000
N054.54.46.000 E018.57.30.000 N054.38.16.000 E019.21.20.000
N054.38.16.000 E019.21.20.000 N054.27.20.000 E019.39.24.000
N054.27.20.000 E019.39.24.000 N054.26.33.000 E019.52.06.000
N054.26.33.000 E019.52.06.000 N054.19.18.000 E019.36.56.000
N054.19.18.000 E019.36.56.000 N054.06.38.000 E019.29.32.000
N054.06.38.000 E019.29.32.000 N054.05.20.000 E019.28.50.000
N054.05.20.000 E019.28.50.000 N053.54.30.000 E019.30.30.000
N053.54.30.000 E019.30.30.000 N053.50.31.000 E019.05.56.000
N053.50.31.000 E019.05.56.000 N053.38.35.000 E018.12.31.000
N053.38.35.000 E018.12.31.000 N054.04.52.000 E017.02.01.000
N054.04.52.000 E017.02.01.000 N054.14.27.000 E016.35.04.000
N054.14.27.000 E016.35.04.000 N054.31.06.000 E016.48.59.000
N054.31.06.000 E016.48.59.000 N054.38.52.000 E016.55.29.000
N054.38.52.000 E016.55.29.000 N055.13.15.000 E017.22.38.000
N055.13.15.000 E017.22.38.000 N055.17.24.000 E018.23.53.000


; LTMA SEKTOR A EPKK
EPKK_TMA_IN N050.10.03.000 E019.22.11.000 N050.21.21.000 E020.02.11.000
N050.21.21.000 E020.02.11.000 N050.21.19.908 E020.02.31.739 ;arc beg
N050.21.19.908 E020.02.31.739 N050.21.14.112 E020.03.18.467
N050.21.14.112 E020.03.18.467 N050.21.07.235 E020.04.04.836
N050.21.07.235 E020.04.04.836 N050.20.59.352 E020.04.50.772
N050.20.59.352 E020.04.50.772 N050.20.50.424 E020.05.36.275
N050.20.50.424 E020.05.36.275 N050.20.40.488 E020.06.21.276
N050.20.40.488 E020.06.21.276 N050.20.29.544 E020.07.05.699
N050.20.29.544 E020.07.05.699 N050.20.17.628 E020.07.49.512
N050.20.17.628 E020.07.49.512 N050.20.04.740 E020.08.32.639
N050.20.04.740 E020.08.32.639 N050.19.50.880 E020.09.15.048
N050.19.50.880 E020.09.15.048 N050.19.36.083 E020.09.56.663
N050.19.36.083 E020.09.56.663 N050.19.20.351 E020.10.37.452
N050.19.20.351 E020.10.37.452 N050.19.03.755 E020.11.17.375
N050.19.03.755 E020.11.17.375 N050.18.46.259 E020.11.56.327
N050.18.46.259 E020.11.56.327 N050.18.27.899 E020.12.34.344
N050.18.27.899 E020.12.34.344 N050.18.08.676 E020.13.11.315
N050.18.08.676 E020.13.11.315 N050.17.48.659 E020.13.47.244
N050.17.48.659 E020.13.47.244 N050.17.27.851 E020.14.22.056
N050.17.27.851 E020.14.22.056 N050.17.06.288 E020.14.55.679
N050.17.06.288 E020.14.55.679 N050.16.43.968 E020.15.28.151
N050.16.43.968 E020.15.28.151 N050.16.20.928 E020.15.59.364
N050.16.20.928 E020.15.59.364 N050.15.57.203 E020.16.29.315
N050.15.57.203 E020.16.29.315 N050.15.32.832 E020.16.57.935
N050.15.32.832 E020.16.57.935 N050.15.07.848 E020.17.25.260
N050.15.07.848 E020.17.25.260 N050.14.42.251 E020.17.51.180
N050.14.42.251 E020.17.51.180 N050.14.16.116 E020.18.15.659
N050.14.16.116 E020.18.15.659 N050.13.49.403 E020.18.38.735
N050.13.49.403 E020.18.38.735 N050.13.22.223 E020.19.00.335
N050.13.22.223 E020.19.00.335 N050.12.54.575 E020.19.20.460
N050.12.54.575 E020.19.20.460 N050.12.26.496 E020.19.39.036
N050.12.26.496 E020.19.39.036 N050.11.57.984 E020.19.56.099
N050.11.57.984 E020.19.56.099 N050.11.29.147 E020.20.11.579
N050.11.29.147 E020.20.11.579 N050.10.59.952 E020.20.25.512
N050.10.59.952 E020.20.25.512 N050.10.30.503 E020.20.37.824
N050.10.30.503 E020.20.37.824 N050.10.00.767 E020.20.48.516
N050.10.00.767 E020.20.48.516 N050.09.30.816 E020.20.57.624
N050.09.30.816 E020.20.57.624 N050.09.00.684 E020.21.05.040
N050.09.00.684 E020.21.05.040 N050.08.30.372 E020.21.10.836
N050.08.30.372 E020.21.10.836 N050.07.59.988 E020.21.15.011
N050.07.59.988 E020.21.15.011 N050.07.24.000 E020.21.13.000 ;arc end
N050.07.24.000 E020.21.13.000 N050.03.25.000 E020.20.56.000
N050.03.25.000 E020.20.56.000 N050.01.55.000 E020.20.49.000
N050.01.55.000 E020.20.49.000 N049.58.24.000 E020.12.13.000
N049.58.24.000 E020.12.13.000 N049.51.39.000 E019.27.39.000
N049.51.39.000 E019.27.39.000 N049.54.13.000 E019.23.26.000
N049.54.13.000 E019.23.26.000 N050.03.53.000 E019.20.20.000
N050.03.53.000 E019.20.20.000 N050.10.03.000 E019.22.11.000

; LTMA SEKTOR A EPKT
N050.38.08.000 E018.38.20.000 N050.39.09.000 E019.12.31.000
N050.39.09.000 E019.12.31.000 N050.39.02.000 E019.20.14.000
N050.39.02.000 E019.20.14.000 N050.39.02.952 E019.21.12.960 ;arc beg
N050.39.02.952 E019.21.12.960 N050.39.01.404 E019.21.47.519
N050.39.01.404 E019.21.47.519 N050.38.59.099 E019.22.22.007
N050.38.59.099 E019.22.22.007 N050.38.56.039 E019.22.56.316
N050.38.56.039 E019.22.56.316 N050.38.52.224 E019.23.30.444
N050.38.52.224 E019.23.30.444 N050.38.47.616 E019.24.04.319
N050.38.47.616 E019.24.04.319 N050.38.42.288 E019.24.37.944
N050.38.42.288 E019.24.37.944 N050.38.36.203 E019.25.11.279
N050.38.36.203 E019.25.11.279 N050.38.29.400 E019.25.44.220
N050.38.29.400 E019.25.44.220 N050.38.21.840 E019.26.16.799
N050.38.21.840 E019.26.16.799 N050.38.13.595 E019.26.48.911
N050.38.13.595 E019.26.48.911 N050.38.04.631 E019.27.20.555
N050.38.04.631 E019.27.20.555 N050.37.54.947 E019.27.51.731
N050.37.54.947 E019.27.51.731 N050.37.44.616 E019.28.22.296
N050.37.44.616 E019.28.22.296 N050.37.33.564 E019.28.52.320
N050.37.33.564 E019.28.52.320 N050.37.21.900 E019.29.21.696
N050.37.21.900 E019.29.21.696 N050.37.09.552 E019.29.50.424
N050.37.09.552 E019.29.50.424 N050.36.56.592 E019.30.18.468
N050.36.56.592 E019.30.18.468 N050.36.43.020 E019.30.45.792
N050.36.43.020 E019.30.45.792 N050.36.28.836 E019.31.12.323
N050.36.28.836 E019.31.12.323 N050.36.14.075 E019.31.38.063
N050.36.14.075 E019.31.38.063 N050.35.58.776 E019.32.03.011
N050.35.58.776 E019.32.03.011 N050.35.42.900 E019.32.27.059
N050.35.42.900 E019.32.27.059 N050.35.26.519 E019.32.50.244
N050.35.26.519 E019.32.50.244 N050.35.09.636 E019.33.12.528
N050.35.09.636 E019.33.12.528 N050.34.52.248 E019.33.33.875
N050.34.52.248 E019.33.33.875 N050.34.34.391 E019.33.54.251
N050.34.34.391 E019.33.54.251 N050.34.16.103 E019.34.13.620
N050.34.16.103 E019.34.13.620 N050.33.57.420 E019.34.31.979
N050.33.57.420 E019.34.31.979 N050.33.38.303 E019.34.49.295
N050.33.38.303 E019.34.49.295 N050.33.18.863 E019.35.05.567
N050.33.18.863 E019.35.05.567 N050.32.59.027 E019.35.20.759
N050.32.59.027 E019.35.20.759 N050.32.38.868 E019.35.34.835
N050.32.38.868 E019.35.34.835 N050.32.18.419 E019.35.47.832
N050.32.18.419 E019.35.47.832 N050.31.57.719 E019.35.59.676
N050.31.57.719 E019.35.59.676 N050.31.36.732 E019.36.10.403
N050.31.36.732 E019.36.10.403 N050.31.15.528 E019.36.19.944
N050.31.15.528 E019.36.19.944 N050.30.54.143 E019.36.28.331
N050.30.54.143 E019.36.28.331 N050.30.32.580 E019.36.35.532
N050.30.32.580 E019.36.35.532 N050.30.10.836 E019.36.41.544
N050.30.10.836 E019.36.41.544 N050.29.49.019 E019.36.46.368
N050.29.49.019 E019.36.46.368 N050.29.27.095 E019.36.50.004
N050.29.27.095 E019.36.50.004 N050.29.05.064 E019.36.52.416
N050.29.05.064 E019.36.52.416 N050.28.43.031 E019.36.53.603
N050.28.43.031 E019.36.53.603 N050.28.20.999 E019.36.53.603
N050.28.20.999 E019.36.53.603 N050.27.58.931 E019.36.52.416
N050.27.58.931 E019.36.52.416 N050.27.36.935 E019.36.50.004
N050.27.36.935 E019.36.50.004 N050.27.15.011 E019.36.46.368
N050.27.15.011 E019.36.46.368 N050.26.53.195 E019.36.41.544
N050.26.53.195 E019.36.41.544 N050.26.31.452 E019.36.35.532
N050.26.31.452 E019.36.35.532 N050.26.09.887 E019.36.28.331
N050.26.09.887 E019.36.28.331 N050.25.48.504 E019.36.19.944
N050.25.48.504 E019.36.19.944 N050.25.27.300 E019.36.10.403
N050.25.27.300 E019.36.10.403 N050.25.06.311 E019.35.59.676
N050.25.06.311 E019.35.59.676 N050.24.45.611 E019.35.47.832
N050.24.45.611 E019.35.47.832 N050.24.25.164 E019.35.34.835
N050.24.25.164 E019.35.34.835 N050.24.05.003 E019.35.20.759
N050.24.05.003 E019.35.20.759 N050.23.45.167 E019.35.05.567
N050.23.45.167 E019.35.05.567 N050.23.25.727 E019.34.49.295
N050.23.25.727 E019.34.49.295 N050.23.06.612 E019.34.31.979
N050.23.06.612 E019.34.31.979 N050.22.47.928 E019.34.13.620
N050.22.47.928 E019.34.13.620 N050.22.29.639 E019.33.54.215
N050.22.29.639 E019.33.54.215 N050.22.11.783 E019.33.33.875
N050.22.11.783 E019.33.33.875 N050.21.54.396 E019.33.12.528
N050.21.54.396 E019.33.12.528 N050.21.37.511 E019.32.50.244
N050.21.37.511 E019.32.50.244 N050.21.21.132 E019.32.27.059
N050.21.21.132 E019.32.27.059 N050.21.05.256 E019.32.03.011
N050.21.05.256 E019.32.03.011 N050.20.49.955 E019.31.38.063
N050.20.49.955 E019.31.38.063 N050.20.35.196 E019.31.12.323
N050.20.35.196 E019.31.12.323 N050.20.21.012 E019.30.45.792
N050.20.21.012 E019.30.45.792 N050.20.07.439 E019.30.18.468
N050.20.07.439 E019.30.18.468 N050.19.54.480 E019.29.50.424
N050.19.54.480 E019.29.50.424 N050.19.42.131 E019.29.21.696
N050.19.42.131 E019.29.21.696 N050.19.30.468 E019.28.52.320
N050.19.30.468 E019.28.52.320 N050.19.19.416 E019.28.22.296
N050.19.19.416 E019.28.22.296 N050.19.09.083 E019.27.51.731
N050.19.09.083 E019.27.51.731 N050.18.59.399 E019.27.20.555
N050.18.59.399 E019.27.20.555 N050.18.50.436 E019.26.48.911
N050.18.50.436 E019.26.48.911 N050.18.42.192 E019.26.16.799
N050.18.42.192 E019.26.16.799 N050.18.34.632 E019.25.44.220
N050.18.34.632 E019.25.44.220 N050.18.27.827 E019.25.11.279
N050.18.27.827 E019.25.11.279 N050.18.21.744 E019.24.37.944
N050.18.21.744 E019.24.37.944 N050.18.16.416 E019.24.04.319
N050.18.16.416 E019.24.04.319 N050.18.11.808 E019.23.30.444
N050.18.11.808 E019.23.30.444 N050.18.07.991 E019.22.56.316
N050.18.07.991 E019.22.56.316 N050.18.04.931 E019.22.22.007
N050.18.04.931 E019.22.22.007 N050.18.02.628 E019.21.47.519
N050.18.02.628 E019.21.47.519 N050.18.01.080 E019.21.12.960
N050.18.01.080 E019.21.12.960 N050.18.00.323 E019.20.38.327
N050.18.00.323 E019.20.38.327 N050.18.00.323 E019.20.03.696
N050.18.00.323 E019.20.03.696 N050.18.01.080 E019.19.29.063
N050.18.01.080 E019.19.29.063 N050.18.02.628 E019.18.54.503
N050.18.02.628 E019.18.54.503 N050.18.04.931 E019.18.20.015
N050.18.04.931 E019.18.20.015 N050.18.08.000 E019.17.55.000 ;arc end
N050.18.08.000 E019.17.55.000 N050.18.49.000 E019.11.45.000
N050.18.49.000 E019.11.45.000 N050.23.48.000 E018.34.18.000
N050.23.48.000 E018.34.18.000 N050.26.36.000 E018.30.22.000
N050.26.36.000 E018.30.22.000 N050.38.08.000 E018.38.20.000



; LTMA EPKK B
N050.40.09.000 E018.30.56.000 N050.42.25.000 E019.41.42.000
N050.42.25.000 E019.41.42.000 N050.22.37.000 E020.15.22.000
N050.22.37.000 E020.15.22.000 N050.20.16.000 E020.19.19.000
N050.20.16.000 E020.19.19.000 N050.01.20.000 E020.30.25.000 
N050.01.20.000 E020.30.25.000 N049.51.56.000 E020.23.50.000
N049.51.56.000 E020.23.50.000 N049.44.39.000 E019.53.22.000
N049.44.39.000 E019.53.22.000 N049.52.00.000 E019.18.04.000
N049.52.00.000 E019.18.04.000 N050.31.16.000 E018.23.48.000
N050.31.16.000 E018.23.48.000 N050.40.09.000 E018.30.56.000

;responsibility boundary between EPKK & EPKT
;N050.49.33.000 E019.41.51.000 N050.42.25.000 E019.41.32.000
;N050.42.25.000 E019.41.32.000 N050.21.45.000 E019.40.00.000
;N050.21.45.000 E019.40.00.000 N050.08.00.000 E019.10.00.000
;N050.08.00.000 E019.10.00.000 N050.08.00.000 E018.56.13.000
;N050.08.00.000 E018.56.13.000 N050.07.58.000 E018.39.24.000

; LTMA EPKK C
N050.42.55.000 E018.29.41.000 N050.46.29.000 E019.06.46.000
N050.46.29.000 E019.06.46.000 N050.48.34.000 E019.30.31.000
N050.48.34.000 E019.30.31.000 N050.49.33.000 E019.41.51.000
N050.49.33.000 E019.41.51.000 N050.42.54.000 E020.06.26.000
N050.42.54.000 E020.06.26.000 N050.35.49.000 E020.10.04.000
N050.35.49.000 E020.10.04.000 N050.32.51.000 E020.20.39.000
N050.32.51.000 E020.20.39.000 N050.22.37.000 E020.15.22.000
N050.22.37.000 E020.15.22.000 N050.42.25.000 E019.41.42.000
N050.42.25.000 E019.41.42.000 N050.40.09.000 E018.30.56.000
N050.40.09.000 E018.30.56.000 N050.31.16.000 E018.23.48.000
N050.31.16.000 E018.23.48.000 N049.52.00.000 E019.18.04.000
N049.52.00.000 E019.18.04.000 N049.52.20.000 E019.00.56.000
N049.52.20.000 E019.00.56.000 N050.13.10.000 E018.32.10.000
N050.13.10.000 E018.32.10.000 N050.27.56.000 E018.11.29.000
N050.27.56.000 E018.11.29.000 N050.31.34.000 E018.14.51.000
N050.31.34.000 E018.14.51.000 N050.39.12.000 E018.24.42.000
N050.39.12.000 E018.24.42.000 N050.42.55.000 E018.29.41.000


; LTMA EPKK D
N049.52.00.000 E019.18.04.000 N049.44.39.000 E019.53.22.000
N049.44.39.000 E019.53.22.000 N049.51.56.000 E020.23.50.000
N049.51.56.000 E020.23.50.000 N050.01.20.000 E020.30.25.000
N050.01.20.000 E020.30.25.000 N050.20.16.000 E020.19.19.000
N050.20.16.000 E020.19.19.000 N050.22.37.000 E020.15.22.000
N050.22.37.000 E020.15.22.000 N050.32.51.000 E020.20.39.000
N050.32.51.000 E020.20.39.000 N050.30.42.000 E020.28.16.000
N050.30.42.000 E020.28.16.000 N050.06.31.000 E020.42.24.000
N050.06.31.000 E020.42.24.000 N049.50.41.000 E020.32.28.000
N049.50.41.000 E020.32.28.000 N049.40.39.000 E019.54.36.000
N049.40.39.000 E019.54.36.000 N049.43.41.000 E019.29.17.000
N049.43.41.000 E019.29.17.000 N049.52.00.000 E019.18.04.000

;uTMA EPKK
EPKK_TMA_OUT N050.02.52.000 E018.05.52.000 N050.22.32.000 E018.06.31.000
N050.22.32.000 E018.06.31.000 N050.27.56.000 E018.11.29.000
N050.27.56.000 E018.11.29.000 N050.31.34.000 E018.14.51.000
N050.31.34.000 E018.14.51.000 N050.39.12.000 E018.24.42.000
N050.39.12.000 E018.24.42.000 N050.42.55.000 E018.29.41.000
N050.42.55.000 E018.29.41.000 N050.53.40.000 E018.44.18.000
N050.53.40.000 E018.44.18.000 N050.56.43.000 E018.51.18.000
N050.56.43.000 E018.51.18.000 N051.00.56.000 E019.57.08.000
N051.00.56.000 E019.57.08.000 N050.42.54.000 E020.06.26.000
N050.42.54.000 E020.06.26.000 N050.35.49.000 E020.10.04.000
N050.35.49.000 E020.10.04.000 N050.32.51.000 E020.20.39.000
N050.32.51.000 E020.20.39.000 N050.30.42.000 E020.28.16.000
N050.30.42.000 E020.28.16.000 N050.10.21.000 E020.59.11.000
N050.10.21.000 E020.59.11.000 N049.50.49.000 E021.13.08.000
N049.50.49.000 E021.13.08.000 N049.43.46.000 E021.11.03.000
N049.43.46.000 E021.11.03.000 N049.29.21.000 E021.11.42.000
N049.29.21.000 E021.11.42.000 N049.24.10.000 E021.11.56.000


;TMA
;a
EPWA_TMA_IN N052.16.15.000 E020.02.27.000 N052.31.23.000 E020.17.05.000
N052.31.23.000 E020.17.05.000 N052.35.35.000 E020.37.26.000
N052.35.35.000 E020.37.26.000 N052.37.53.000 E020.54.28.000
N052.37.53.000 E020.54.28.000 N052.32.45.000 E021.03.32.000
N052.32.45.000 E021.03.32.000 N052.26.00.000 E021.12.19.000
N052.26.00.000 E021.12.19.000 N052.17.00.000 E021.26.15.000
N052.17.00.000 E021.26.15.000 N052.07.00.000 E021.32.41.000
N052.07.00.000 E021.32.41.000 N052.07.17.000 E021.37.21.000
N052.07.17.000 E021.37.21.000 N051.54.39.000 E021.38.10.000
N051.54.39.000 E021.38.10.000 N051.45.14.000 E021.23.53.000
N051.45.14.000 E021.23.53.000 N051.48.52.000 E020.46.16.000
N051.48.52.000 E020.46.16.000 N052.16.15.000 E020.02.27.000

;b
EPWA_TMA_OUT N052.27.09.000 E019.44.14.000 N052.42.16.000 E020.19.42.000
N052.42.16.000 E020.19.42.000 N052.42.37.000 E020.46.02.000
N052.42.37.000 E020.46.02.000 N052.37.53.000 E020.54.28.000
N052.37.53.000 E020.54.28.000 N052.32.45.000 E021.03.32.000
N052.32.45.000 E021.03.32.000 N052.26.00.000 E021.12.19.000
N052.26.00.000 E021.12.19.000 N052.26.22.000 E021.27.36.000
N052.26.22.000 E021.27.36.000 N052.25.59.000 E021.51.34.000
N052.25.59.000 E021.51.34.000 N051.58.37.000 E022.05.27.000
N051.58.37.000 E022.05.27.000 N051.34.15.000 E021.22.54.000
N051.34.15.000 E021.22.54.000 N051.47.03.000 E020.03.38.000
N051.47.03.000 E020.03.38.000 N052.10.39.000 E019.52.17.000
N052.10.39.000 E019.52.17.000 N052.27.09.000 E019.44.14.000

;c
N052.27.09.000 E019.44.14.000 N052.34.37.000 E019.40.33.000
N052.34.37.000 E019.40.33.000 N052.41.43.000 E019.49.12.000
N052.41.43.000 E019.49.12.000 N052.42.16.000 E020.19.42.000
N052.42.16.000 E020.19.42.000 N052.27.09.000 E019.44.14.000

;d
N051.47.03.000 E020.03.38.000 N051.34.15.000 E021.22.54.000
N051.34.15.000 E021.22.54.000 N051.15.12.000 E020.49.58.000
N051.15.12.000 E020.49.58.000 N051.19.00.000 E020.33.02.000
N051.19.00.000 E020.33.02.000 N051.32.13.000 E019.57.41.000
N051.32.13.000 E019.57.41.000 N051.39.58.000 E019.57.37.000
N051.39.58.000 E019.57.37.000 N051.47.03.000 E020.03.38.000

;e
N052.11.00.000 E020.40.00.000 N052.12.28.000 E020.42.01.000
N052.12.28.000 E020.42.01.000 N052.08.52.000 E020.45.47.000
N052.08.52.000 E020.45.47.000 N052.00.43.000 E021.00.38.000
N052.00.43.000 E021.00.38.000 N052.02.23.000 E021.07.19.000
N052.02.23.000 E021.07.19.000 N052.07.57.000 E021.10.36.000
N052.07.57.000 E021.10.36.000 N052.05.34.000 E021.12.39.000
N052.05.34.000 E021.12.39.000 N052.02.25.000 E021.12.31.000
N052.02.25.000 E021.12.31.000 N052.00.20.000 E021.12.04.000
N052.00.20.000 E021.12.04.000 N051.58.38.000 E021.06.59.000
N051.58.38.000 E021.06.59.000 N051.58.40.000 E020.58.15.000
N051.58.40.000 E020.58.15.000 N052.06.04.000 E020.45.30.000
N052.06.04.000 E020.45.30.000 N052.11.00.000 E020.40.00.000

;f
N052.10.08.000 E021.07.31.000 N052.09.52.000 E021.12.26.000
N052.09.52.000 E021.12.26.000 N052.05.34.000 E021.12.39.000
N052.05.34.000 E021.12.39.000 N052.07.57.000 E021.10.36.000
N052.07.57.000 E021.10.36.000 N052.10.08.000 E021.07.31.000

;g
N052.11.00.000 E020.40.00.000 N052.15.46.000 E020.37.35.000
N052.15.46.000 E020.37.35.000 N052.16.55.000 E020.38.52.000
N052.16.55.000 E020.38.52.000 N052.16.47.000 E020.56.21.000
N052.16.47.000 E020.56.21.000 N052.15.38.000 E020.57.05.000
N052.15.38.000 E020.57.05.000 N052.15.48.000 E020.55.56.000
N052.15.48.000 E020.55.56.000 N052.15.47.000 E020.50.10.000
N052.15.47.000 E020.50.10.000 N052.15.32.000 E020.46.15.000
N052.15.32.000 E020.46.15.000 N052.12.28.000 E020.42.01.000
N052.12.28.000 E020.42.01.000 N052.11.00.000 E020.40.00.000

;CTA1
N052.31.36.000 E019.07.52.000 N052.41.43.000 E019.49.12.000
N052.41.43.000 E019.49.12.000 N052.34.37.000 E019.40.33.000
N052.34.37.000 E019.40.33.000 N051.47.03.000 E020.03.38.000
N051.47.03.000 E020.03.38.000 N051.39.58.000 E019.57.37.000
N051.39.58.000 E019.57.37.000 N051.32.13.000 E019.57.41.000
N051.32.13.000 E019.57.41.000 N051.23.16.000 E020.21.42.000
N051.23.16.000 E020.21.42.000 N051.21.00.000 E019.45.06.000
N051.21.00.000 E019.45.06.000 N052.31.36.000 E019.07.52.000

;CTA2
N052.41.43.000 E019.49.12.000 N052.42.16.000 E020.19.42.000
N052.42.16.000 E020.19.42.000 N052.42.37.000 E020.46.02.000
N052.42.37.000 E020.46.02.000 N052.32.44.000 E021.03.32.000
N052.32.44.000 E021.03.32.000 N052.26.00.000 E021.12.19.000
N052.26.00.000 E021.12.19.000 N052.26.25.000 E021.27.36.000
N052.26.25.000 E021.27.36.000 N052.25.59.000 E021.51.34.000
N052.25.59.000 E021.51.34.000 N051.58.37.000 E022.05.27.000
N051.58.37.000 E022.05.27.000 N051.34.15.000 E021.22.54.000
N051.34.15.000 E021.22.54.000 N051.15.12.000 E020.49.58.000
N051.15.12.000 E020.49.58.000 N051.19.00.000 E020.33.02.000
N051.19.00.000 E020.33.02.000 N051.23.16.000 E020.21.42.000
N051.23.16.000 E020.21.42.000 N051.32.13.000 E019.57.41.000
N051.32.13.000 E019.57.41.000 N051.39.58.000 E019.57.37.000
N051.39.58.000 E019.57.37.000 N051.47.03.000 E020.03.38.000
N051.47.03.000 E020.03.38.000 N052.34.37.000 E019.40.33.000
N052.34.37.000 E019.40.33.000 N052.41.43.000 E019.49.12.000 

;CTA3
N051.59.23.000 E019.25.06.000 N052.00.43.000 E019.33.08.000
N052.00.43.000 E019.33.08.000 N052.02.23.000 E019.43.19.000
N052.02.23.000 E019.43.19.000 N052.05.12.000 E019.54.55.000
N052.05.12.000 E019.54.55.000 N051.47.03.000 E020.03.38.000
N051.47.03.000 E020.03.38.000 N051.39.58.000 E019.57.37.000
N051.39.58.000 E019.57.37.000 N051.32.13.000 E019.57.41.000
N051.32.13.000 E019.57.41.000 N051.33.22.000 E019.51.59.000
N051.33.22.000 E019.51.59.000 N051.40.26.000 E019.35.03.000
N051.40.26.000 E019.35.03.000 N051.59.23.000 E019.25.06.000
N051.59.23.000 E019.25.06.000 N051.59.23.000 E019.25.06.000
 
;TMA EPLL
;A
EPLL_TMA N051.47.18.000 E019.05.05.000 N051.51.21.000 E019.26.21.000
N051.51.21.000 E019.26.21.000 N052.02.23.000 E019.43.19.000
N052.02.23.000 E019.43.19.000 N051.59.45.000 E019.57.33.000
N051.59.45.000 E019.57.33.000 N051.48.47.000 E020.02.49.000
N051.48.47.000 E020.02.49.000 N051.42.44.000 E019.47.06.000
N051.42.44.000 E019.47.06.000 N051.41.15.000 E019.39.03.000
N051.41.15.000 E019.39.03.000 N051.42.39.000 E019.30.43.000
N051.42.39.000 E019.30.43.000 N051.37.16.000 E019.18.20.000
N051.37.16.000 E019.18.20.000 N051.39.28.000 E019.09.31.000
N051.39.28.000 E019.09.31.000 N051.47.18.000 E019.05.05.000

;B
N051.53.49.000 E018.52.03.000 N052.02.23.000 E019.43.19.000
N052.02.23.000 E019.43.19.000 N052.05.12.000 E019.54.56.000
N052.05.12.000 E019.54.56.000 N051.59.45.000 E019.57.33.000
N051.59.45.000 E019.57.33.000 N051.48.47.000 E020.02.49.000
N051.48.47.000 E020.02.49.000 N051.47.03.000 E020.03.38.000
N051.47.03.000 E020.03.38.000 N051.39.58.000 E019.57.37.000
N051.39.58.000 E019.57.37.000 N051.32.13.000 E019.57.41.000
N051.32.13.000 E019.57.41.000 N051.33.22.000 E019.51.59.000
N051.33.22.000 E019.51.59.000 N051.40.28.000 E019.34.58.000
N051.40.28.000 E019.34.58.000 N051.37.16.000 E019.18.20.000
N051.37.16.000 E019.18.20.000 N051.39.28.000 E019.09.31.000
N051.39.28.000 E019.09.31.000 N051.43.12.000 E018.54.25.000
N051.43.12.000 E018.54.25.000 N051.47.45.000 E018.51.48.000
N051.47.45.000 E018.51.48.000 N051.53.49.000 E018.52.03.000

;TMA EPRZ
;A
EPRZ_TMA N050.15.16.000 E022.25.16.000 N050.16.25.000 E022.11.30.000
N050.16.25.000 E022.11.30.000 N050.18.36.000 E021.44.12.000
N050.18.36.000 E021.44.12.000 N050.08.28.000 E021.26.20.000
N050.08.28.000 E021.26.20.000 N049.55.22.000 E021.33.07.000
N049.55.22.000 E021.33.07.000 N049.59.09.000 E021.51.02.000
N049.59.09.000 E021.51.02.000 N049.57.36.000 E022.32.13.000
N049.57.36.000 E022.32.13.000 N050.08.38.000 E022.38.49.000
N050.08.38.000 E022.38.49.000 N050.17.35.000 E022.34.38.000
N050.17.35.000 E022.34.38.000 N050.15.16.000 E022.25.16.000

;B
N050.18.36.000 E021.44.12.000 N050.08.28.000 E021.26.20.000
N050.08.28.000 E021.26.20.000 N050.06.00.000 E021.22.00.000
N050.06.00.000 E021.22.00.000 N049.50.35.000 E021.23.30.000
N049.50.35.000 E021.23.30.000 N049.49.01.000 E022.38.24.000
N049.49.01.000 E022.38.24.000 N050.19.37.000 E022.49.00.000
N050.19.37.000 E022.49.00.000 N050.30.34.000 E022.39.08.000
N050.30.34.000 E022.39.08.000 N050.28.05.000 E022.23.20.000
N050.28.05.000 E022.23.20.000 N050.22.43.000 E021.45.10.000
N050.22.43.000 E021.45.10.000 N050.18.36.000 E021.44.12.000


;TMA EPSC
;A
EPSC_TMA N053.47.11.000 E014.40.22.000 N053.45.57.000 E014.54.46.000
N053.45.57.000 E014.54.46.000 N053.35.24.000 E015.24.25.000
N053.35.24.000 E015.24.25.000 N053.25.11.000 E015.27.09.000
N053.25.11.000 E015.27.09.000 N053.19.54.000 E015.12.10.000
N053.19.54.000 E015.12.10.000 N053.18.32.000 E014.57.59.000
N053.18.32.000 E014.57.59.000 N053.36.19.000 E014.36.16.000
N053.36.19.000 E014.36.16.000 N053.47.11.000 E014.40.22.000

;B
N053.47.11.000 E014.40.22.000 N053.45.57.000 E014.54.46.000
N053.45.57.000 E014.54.46.000 N053.43.14.000 E015.23.27.000
N053.43.14.000 E015.23.27.000 N053.28.07.000 E015.33.23.000
N053.28.07.000 E015.33.23.000 N053.18.01.000 E015.31.10.000
N053.18.01.000 E015.31.10.000 N053.15.39.000 E015.22.32.000
N053.15.39.000 E015.22.32.000 N053.18.32.000 E014.57.59.000
N053.18.32.000 E014.57.59.000 N053.36.19.000 E014.36.16.000
N053.36.19.000 E014.36.16.000 N053.47.11.000 E014.40.22.000


;C
N053.47.34.000 E014.35.43.000 N053.41.29.000 E014.33.33.000
N053.41.29.000 E014.33.33.000 N053.41.04.000 E014.16.43.000
N053.41.04.000 E014.16.43.000 N053.41.00.814 E014.16.10.697
N053.41.00.814 E014.16.10.697 N053.41.55.732 E014.16.10.697
N053.41.55.732 E014.16.10.697 N053.48.39.999 E014.15.20.600
N053.48.39.999 E014.15.20.600 N053.51.11.000 E014.13.40.000
N053.51.11.000 E014.13.40.000 N053.50.15.000 E014.19.27.000
N053.50.15.000 E014.19.27.000 N053.47.34.000 E014.35.43.000

;TMA EPWR
;A
EPWR_TMA N051.15.40.000 E016.23.22.000 N051.28.33.000 E017.22.48.000
N051.28.33.000 E017.22.48.000 N051.18.55.000 E017.34.40.000
N051.18.55.000 E017.34.40.000 N050.54.41.000 E017.41.45.000
N050.54.41.000 E017.41.45.000 N050.52.31.000 E017.30.00.000
N050.52.31.000 E017.30.00.000 N050.49.28.000 E016.59.52.000
N050.49.28.000 E016.59.52.000 N051.00.14.000 E016.30.15.000
N051.00.14.000 E016.30.15.000 N051.15.40.000 E016.23.22.000

;B
N051.13.47.000 E016.14.39.000 N051.30.49.000 E016.52.49.000
N051.30.49.000 E016.52.49.000 N051.28.33.000 E017.22.48.000
N051.28.33.000 E017.22.48.000 N051.18.55.000 E017.34.40.000
N051.18.55.000 E017.34.40.000 N050.54.41.000 E017.41.45.000
N050.54.41.000 E017.41.45.000 N050.52.31.000 E017.30.00.000
N050.52.31.000 E017.30.00.000 N050.49.28.000 E016.59.52.000
N050.49.28.000 E016.59.52.000 N050.48.40.000 E016.52.03.000
N050.48.40.000 E016.52.03.000 N050.57.57.000 E016.17.27.000
N050.57.57.000 E016.17.27.000 N051.13.47.000 E016.14.39.000

;C
N051.08.44.000 E016.57.06.000 N051.08.38.000 E017.11.48.000
N051.08.38.000 E017.11.48.000 N051.08.34.404 E017.12.03.311
N051.08.34.404 E017.12.03.311 N051.08.24.180 E017.12.37.404  ;
N051.08.24.180 E017.12.37.404 N051.08.12.839 E017.13.10.595  ;
N051.08.12.839 E017.13.10.595 N051.08.00.420 E017.13.42.779  ;
N051.08.00.420 E017.13.42.779 N051.07.46.991 E017.14.13.883  ;
N051.07.46.991 E017.14.13.883 N051.07.32.520 E017.14.43.871  ;
N051.07.32.520 E017.14.43.871 N051.07.17.112 E017.15.12.563  ;
N051.07.17.112 E017.15.12.563 N051.07.00.768 E017.15.39.959  ;
N051.07.00.768 E017.15.39.959 N051.06.43.524 E017.16.05.951  ;
N051.06.43.524 E017.16.05.951 N051.06.25.452 E017.16.30.468  ;
N051.06.25.452 E017.16.30.468 N051.06.06.624 E017.16.53.472  ;
N051.06.06.624 E017.16.53.472 N051.05.47.040 E017.17.14.855  ;
N051.05.47.040 E017.17.14.855 N051.05.26.808 E017.17.34.584  ;
N051.05.26.808 E017.17.34.584 N051.05.05.928 E017.17.52.584  ;
N051.05.05.928 E017.17.52.584 N051.04.44.508 E017.18.08.855  ;
N051.04.44.508 E017.18.08.855 N051.04.22.547 E017.18.23.292  ;
N051.04.22.547 E017.18.23.292 N051.04.00.191 E017.18.35.891  ;
N051.04.00.191 E017.18.35.891 N051.03.37.403 E017.18.46.620  ;
N051.03.37.403 E017.18.46.620 N051.03.14.328 E017.18.55.440  ;
N051.03.14.328 E017.18.55.440 N051.02.50.964 E017.19.02.315  ;
N051.02.50.964 E017.19.02.315 N051.02.27.420 E017.19.07.248  ;
N051.02.27.420 E017.19.07.248 N051.02.03.732 E017.19.10.200  ;
N051.02.03.732 E017.19.10.200 N051.01.40.007 E017.19.11.208  ;
N051.01.40.007 E017.19.11.208 N051.01.16.283 E017.19.10.200  ;
N051.01.16.283 E017.19.10.200 N051.00.52.595 E017.19.07.248  ;
N051.00.52.595 E017.19.07.248 N051.00.29.051 E017.19.02.315  ;
N051.00.29.051 E017.19.02.315 N051.00.05.687 E017.18.55.440  ;
N051.00.05.687 E017.18.55.440 N050.59.42.612 E017.18.46.620  ;
N050.59.42.612 E017.18.46.620 N050.59.19.824 E017.18.35.891  ;
N050.59.19.824 E017.18.35.891 N050.58.57.468 E017.18.23.292  ;
N050.58.57.468 E017.18.23.292 N050.58.35.507 E017.18.08.855  ;
N050.58.35.507 E017.18.08.855 N050.58.14.087 E017.17.52.584  ;
N050.58.14.087 E017.17.52.584 N050.57.53.207 E017.17.34.584  ;
N050.57.53.207 E017.17.34.584 N050.57.32.975 E017.17.14.855  ;
N050.57.32.975 E017.17.14.855 N050.57.13.391 E017.16.53.472  ;
N050.57.13.391 E017.16.53.472 N050.56.54.563 E017.16.30.468  ;
N050.56.54.563 E017.16.30.468 N050.56.36.491 E017.16.05.951  ;
N050.56.36.491 E017.16.05.951 N050.56.19.247 E017.15.39.959  ;
N050.56.19.247 E017.15.39.959 N050.56.02.903 E017.15.12.563  ;
N050.56.02.903 E017.15.12.563 N050.55.47.495 E017.14.43.871  ;
N050.55.47.495 E017.14.43.871 N050.55.33.024 E017.14.13.883  ;
N050.55.33.024 E017.14.13.883 N050.55.19.596 E017.13.42.779  ;
N050.55.19.596 E017.13.42.779 N050.55.07.176 E017.13.10.595  ;
N050.55.07.176 E017.13.10.595 N050.54.55.835 E017.12.37.404  ;
N050.54.55.835 E017.12.37.404 N050.54.45.611 E017.12.03.311  ;
N050.54.45.611 E017.12.03.311 N050.54.36.540 E017.11.28.428  ;
N050.54.36.540 E017.11.28.428 N050.54.28.619 E017.10.52.859  ;
N050.54.28.619 E017.10.52.859 N050.54.21.851 E017.10.16.643  ;
N050.54.21.851 E017.10.16.643 N050.54.16.308 E017.09.39.924  ;
N050.54.16.308 E017.09.39.924 N050.54.11.987 E017.09.02.808  ;
N050.54.11.987 E017.09.02.808 N050.54.08.892 E017.08.25.368  ;
N050.54.08.892 E017.08.25.368 N050.54.07.019 E017.07.47.711  ;
N050.54.07.019 E017.07.47.711 N050.54.06.408 E017.07.09.984  ;
N050.54.06.408 E017.07.09.984 N050.54.07.019 E017.06.32.255  ;
N050.54.07.019 E017.06.32.255 N050.54.08.000 E017.06.17.000
N050.54.08.000 E017.06.17.000 N050.55.41.000 E017.00.17.000
N050.55.41.000 E017.00.17.000 N051.05.39.000 E017.08.31.000
N051.05.39.000 E017.08.31.000 N051.08.44.000 E016.57.06.000


;DELEGACJA CTR HERRINGSDORF
N053.55.18.710 E014.12.53.060 N053.54.03.710 E014.20.18.070
N053.54.03.710 E014.20.18.070 N053.48.18.710 E014.17.33.090
N053.48.18.710 E014.17.33.090 N053.48.38.710 E014.15.13.080

;DELEGACJA CTA DREWITZ
N052.04.09.000 E014.45.36.000 N052.04.35.000 E014.58.20.000
N052.04.35.000 E014.58.20.000 N051.50.33.000 E015.00.27.000
N051.50.33.000 E015.00.27.000 N051.45.31.000 E014.40.17.000

;DELEGACJA FIS DREWITZ
N051.55.57.000 E014.42.55.000 N051.53.08.000 E014.44.13.000
N051.53.08.000 E014.44.13.000 N051.50.07.000 E014.36.56.000


;BERLIN C
BERLIN N051.55.03.000 E013.00.06.000 N051.55.03.000 E013.17.28.000
N051.55.03.000 E013.17.28.000 N052.02.00.000 E013.47.00.000
N052.02.00.000 E013.47.00.000 N052.10.03.000 E014.15.11.000
N052.10.03.000 E014.15.11.000 N052.19.12.000 E014.23.31.000
N052.19.12.000 E014.23.31.000 N052.20.42.900 E014.23.54.203
N052.20.42.900 E014.23.54.203 N052.23.25.007 E014.24.05.795
N052.23.25.007 E014.24.05.795 N052.26.07.116 E014.23.54.203
N052.26.07.116 E014.23.54.203 N052.28.47.999 E014.23.19.499
N052.28.47.999 E014.23.19.499 N052.31.26.400 E014.22.21.935
N052.31.26.400 E014.22.21.935 N052.34.01.163 E014.21.01.980
N052.34.01.163 E014.21.01.980 N052.36.31.067 E014.19.20.244
N052.36.31.067 E014.19.20.244 N052.38.54.995 E014.17.17.448
N052.38.54.995 E014.17.17.448 N052.41.11.868 E014.14.54.599
N052.41.11.868 E014.14.54.599 N052.42.54.000 E014.12.55.000
N052.42.54.000 E014.12.55.000 N052.54.32.000 E013.53.48.000
N052.54.32.000 E013.53.48.000 N052.52.10.000 E012.40.51.000
N052.52.10.000 E012.40.51.000 N052.51.53.000 E012.33.36.000
N052.51.53.000 E012.33.36.000 N052.49.06.000 E012.24.26.000
N052.49.06.000 E012.24.26.000 N052.48.20.520 E012.23.52.368
N052.48.20.520 E012.23.52.368 N052.45.31.247 E012.21.57.024
N052.45.31.247 E012.21.57.024 N052.42.36.539 E012.20.26.411
N052.42.36.539 E012.20.26.411 N052.39.37.691 E012.19.21.215
N052.39.37.691 E012.19.21.215 N052.36.36.036 E012.18.41.867
N052.36.36.036 E012.18.41.867 N052.33.33.012 E012.18.28.728
N052.33.33.012 E012.18.28.728 N052.30.29.988 E012.18.41.867
N052.30.29.988 E012.18.41.867 N052.27.28.368 E012.19.21.215
N052.27.28.368 E012.19.21.215 N052.24.29.483 E012.20.26.411
N052.24.29.483 E012.20.26.411 N052.21.34.775 E012.21.57.024
N052.21.34.775 E012.21.57.024 N052.20.52.000 E012.22.36.000 
N052.20.52.000 E012.22.36.000 N052.09.00.000 E012.40.47.000
N052.09.00.000 E012.40.47.000 N051.55.03.000 E013.00.06.000


;PRAHA VII
PRAHA N050.28.29.080 E014.41.21.250 N050.29.13.776 E014.39.42.119
N050.29.13.776 E014.39.42.119 N050.29.59.747 E014.37.45.227
N050.29.59.747 E014.37.45.227 N050.30.41.688 E014.35.44.736
N050.30.41.688 E014.35.44.736 N050.31.19.560 E014.33.40.967
N050.31.19.560 E014.33.40.967 N050.31.53.219 E014.31.34.319
N050.31.53.219 E014.31.34.319 N050.32.22.596 E014.29.25.079
N050.32.22.596 E014.29.25.079 N050.32.47.580 E014.27.13.608
N050.32.47.580 E014.27.13.608 N050.33.08.100 E014.25.00.300
N050.33.08.100 E014.25.00.300 N050.33.24.119 E014.22.45.480
N050.33.24.119 E014.22.45.480 N050.33.35.604 E014.20.29.544
N050.33.35.604 E014.20.29.544 N050.33.42.516 E014.18.12.852
N050.33.42.516 E014.18.12.852 N050.33.44.567 E014.15.10.116
N050.33.44.567 E014.15.10.116 N050.33.40.715 E014.12.53.136
N050.33.40.715 E014.12.53.136 N050.33.32.292 E014.10.36.659
N050.33.32.292 E014.10.36.659 N050.33.19.296 E014.08.21.047
N050.33.19.296 E014.08.21.047 N050.33.01.764 E014.06.06.696
N050.33.01.764 E014.06.06.696 N050.32.39.732 E014.03.53.963
N050.32.39.732 E014.03.53.963 N050.32.13.271 E014.01.43.211
N050.32.13.271 E014.01.43.211 N050.31.42.491 E013.59.34.764
N050.31.42.491 E013.59.34.764 N050.31.07.392 E013.57.29.051
N050.31.07.392 E013.57.29.051 N050.30.28.152 E013.55.26.328
N050.30.28.152 E013.55.26.328 N050.29.44.843 E013.53.26.987
N050.29.44.843 E013.53.26.987 N050.28.57.576 E013.51.31.356
N050.28.57.576 E013.51.31.356 N050.28.06.527 E013.49.39.755
N050.28.06.527 E013.49.39.755 N050.27.11.772 E013.47.52.440
N050.27.11.772 E013.47.52.440 N050.26.13.488 E013.46.09.767
N050.26.13.488 E013.46.09.767 N050.25.11.820 E013.44.31.956
N050.25.11.820 E013.44.31.956 N050.24.06.984 E013.42.59.328
N050.24.06.984 E013.42.59.328 N050.22.59.124 E013.41.32.135
N050.22.59.124 E013.41.32.135 N050.21.48.420 E013.40.10.560
N050.21.48.420 E013.40.10.560 N050.20.35.088 E013.38.54.888
N050.20.35.088 E013.38.54.888 N050.19.19.307 E013.37.45.300
N050.19.19.307 E013.37.45.300 N050.18.09.620 E013.36.52.950
;PRAHA VI
N050.18.09.620 E013.36.52.950 N050.12.51.650 E013.15.49.680 
N050.12.51.650 E013.15.49.680 N050.05.22.060 E013.19.35.480
N050.05.22.060 E013.19.35.480 N049.58.43.860 E013.13.16.990
N049.58.43.860 E013.13.16.990 N049.43.12.460 E013.39.22.140
N049.43.12.460 E013.39.22.140 N049.51.39.910 E013.57.59.410
;PRAHA II
N049.51.39.910 E013.57.59.410 N049.47.53.900 E014.05.56.050
;PRAHA III
N049.47.53.900 E014.05.56.050 N049.46.49.290 E014.14.37.560
N049.46.49.290 E014.14.37.560 N049.41.46.520 E014.25.09.570
;PRAHA V
N049.41.46.520 E014.25.09.570 N049.39.23.600 E014.30.06.440
N049.39.23.600 E014.30.06.440 N049.29.54.690 E014.49.39.120
N049.29.54.690 E014.49.39.120 N049.30.31.356 E014.51.35.279
N049.30.31.356 E014.51.35.279 N049.31.46.092 E014.54.24.767
N049.31.46.092 E014.54.24.767 N049.33.06.408 E014.57.07.919
N049.33.06.408 E014.57.07.919 N049.34.32.088 E014.59.44.303
N049.34.32.088 E014.59.44.303 N049.36.02.879 E015.02.13.487
N049.36.02.879 E015.02.13.487 N049.37.38.603 E015.04.35.075
N049.37.38.603 E015.04.35.075 N049.39.18.935 E015.06.48.635
N049.39.18.935 E015.06.48.635 N049.41.03.588 E015.08.53.807
N049.41.03.588 E015.08.53.807 N049.42.52.308 E015.10.50.304
N049.42.52.308 E015.10.50.304 N049.44.35.180 E015.12.02.870
N049.44.35.180 E015.12.02.870 N049.49.40.040 E015.01.51.090
N049.49.40.040 E015.01.51.090 N049.55.03.850 E014.56.02.600
;MTMA KBELY + PRAHA VIII 
N049.55.03.850 E014.56.02.600 N049.56.10.211 E014.56.56.688
N049.56.10.211 E014.56.56.688 N049.57.33.623 E014.57.40.211
N049.57.33.623 E014.57.40.211 N049.58.58.368 E014.58.16.859
N049.58.58.368 E014.58.16.859 N050.00.24.264 E014.58.46.523
N050.00.24.264 E014.58.46.523 N050.01.50.988 E014.59.09.167
N050.01.50.988 E014.59.09.167 N050.03.18.395 E014.59.24.684
N050.03.18.395 E014.59.24.684 N050.04.46.163 E014.59.33.035
N050.04.46.163 E014.59.33.035 N050.06.14.112 E014.59.34.223
N050.06.14.112 E014.59.34.223 N050.07.41.987 E014.59.28.247
N050.07.41.987 E014.59.28.247 N050.09.09.540 E014.59.15.107
N050.09.09.540 E014.59.15.107 N050.10.36.551 E014.58.54.839
N050.10.36.551 E014.58.54.839 N050.12.02.736 E014.58.27.515
N050.12.02.736 E014.58.27.515 N050.13.27.875 E014.57.53.171
N050.13.27.875 E014.57.53.171 N050.14.51.755 E014.57.11.951
N050.14.51.755 E014.57.11.951 N050.16.14.160 E014.56.23.928
N050.16.14.160 E014.56.23.928 N050.17.34.799 E014.55.29.279
N050.17.34.799 E014.55.29.279 N050.18.53.531 E014.54.28.079
N050.18.53.531 E014.54.28.079 N050.20.10.067 E014.53.20.579
N050.20.10.067 E014.53.20.579 N050.21.24.264 E014.52.06.923
N050.21.24.264 E014.52.06.923 N050.22.35.867 E014.50.47.292
N050.22.35.867 E014.50.47.292 N050.23.44.699 E014.49.21.936
N050.23.44.699 E014.49.21.936 N050.24.50.580 E014.47.51.108
N050.24.50.580 E014.47.51.108 N050.25.53.291 E014.46.14.988
N050.25.53.291 E014.46.14.988 N050.26.52.728 E014.44.33.899
N050.26.52.728 E014.44.33.899 N050.27.48.672 E014.42.48.131
N050.27.48.672 E014.42.48.131 N050.28.29.080 E014.41.21.250

[ARTCC HIGH]
;EA11 EAGLE TALON
TALON N054.21.17.000 E015.19.00.000 N053.52.09.000 E015.17.42.000 PROHI
N053.52.09.000 E015.17.42.000 N054.00.00.000 E015.05.00.000 PROHI
N054.00.00.000 E015.05.00.000 N054.16.00.000 E015.00.00.000 PROHI
N054.16.00.000 E015.00.00.000 N054.21.17.000 E015.19.00.000 PROHI

;EA12 EAGLE TALON
N054.21.17.000 E015.19.00.000 N054.26.59.000 E015.51.53.000 PROHI
N054.26.59.000 E015.51.53.000 N054.27.57.000 E015.59.17.000 PROHI
N054.27.57.000 E015.59.17.000 N054.23.00.000 E016.15.00.000 PROHI
N054.23.00.000 E016.15.00.000 N054.18.00.000 E016.25.00.000 PROHI
N054.18.00.000 E016.25.00.000 N054.14.31.000 E016.32.27.000 PROHI
N054.14.31.000 E016.32.27.000 N054.09.35.000 E016.46.08.000 PROHI
N054.09.35.000 E016.46.08.000 N053.52.09.000 E015.17.42.000 PROHI
N053.52.09.000 E015.17.42.000 N054.21.17.000 E015.19.00.000 PROHI

;EA13 EAGLE TALON
N053.52.09.000 E015.17.42.000 N054.09.35.000 E016.46.08.000 PROHI
N054.09.35.000 E016.46.08.000 N053.38.00.000 E018.11.00.000 PROHI
N053.38.00.000 E018.11.00.000 N053.30.44.000 E018.17.57.000 PROHI
N053.30.44.000 E018.17.57.000 N052.58.59.000 E015.57.20.000 PROHI
N052.58.59.000 E015.57.20.000 N053.02.47.000 E015.53.11.000 PROHI
N053.02.47.000 E015.53.11.000 N053.28.07.000 E015.33.23.000 PROHI
N053.28.07.000 E015.33.23.000 N053.43.14.000 E015.23.27.000 PROHI
N053.43.14.000 E015.23.27.000 N053.52.09.000 E015.17.42.000 PROHI

;EA14 EAGLE TALON
N054.21.17.000 E015.19.00.000 N054.26.59.000 E015.51.53.000 PROHI
N054.26.59.000 E015.51.53.000 N054.27.57.000 E015.59.17.000 PROHI
N054.27.57.000 E015.59.17.000 N054.23.00.000 E016.15.00.000 PROHI
N054.23.00.000 E016.15.00.000 N054.18.00.000 E016.25.00.000 PROHI
N054.18.00.000 E016.25.00.000 N054.14.31.000 E016.32.27.000 PROHI
N054.14.31.000 E016.32.27.000 N054.09.35.000 E016.46.08.000 PROHI
N054.09.35.000 E016.46.08.000 N053.38.00.000 E018.11.00.000 PROHI
N053.38.00.000 E018.11.00.000 N053.30.44.000 E018.17.57.000 PROHI
N053.30.44.000 E018.17.57.000 N052.58.59.000 E015.57.20.000 PROHI
N052.58.59.000 E015.57.20.000 N053.02.47.000 E015.53.11.000 PROHI
N053.02.47.000 E015.53.11.000 N053.28.07.000 E015.33.23.000 PROHI
N053.28.07.000 E015.33.23.000 N053.43.14.000 E015.23.27.000 PROHI
N053.43.14.000 E015.23.27.000 N053.52.09.000 E015.17.42.000 PROHI
N053.52.09.000 E015.17.42.000 N054.21.17.000 E015.19.00.000 PROHI

;EA15 EAGLE TALON
N052.58.59.000 E015.57.20.000 N053.30.44.000 E018.17.57.000 PROHI
N053.30.44.000 E018.17.57.000 N053.20.19.000 E018.27.48.000 PROHI
N053.20.19.000 E018.27.48.000 N053.15.55.000 E018.12.18.000 PROHI
N053.15.55.000 E018.12.18.000 N053.07.15.000 E017.32.10.000 PROHI
N053.07.15.000 E017.32.10.000 N052.51.11.000 E016.27.11.000 PROHI
N052.51.11.000 E016.27.11.000 N052.58.59.000 E015.57.20.000 PROHI

;EA16 EAGLE TALON
N053.20.19.000 E018.27.48.000 N052.49.56.000 E018.57.37.000 PROHI
N052.49.56.000 E018.57.37.000 N052.57.24.000 E017.33.21.000 PROHI
N052.57.24.000 E017.33.21.000 N053.07.15.000 E017.32.10.000 PROHI
N053.07.15.000 E017.32.10.000 N053.15.55.000 E018.12.18.000 PROHI
N053.15.55.000 E018.12.18.000 N053.20.19.000 E018.27.48.000 PROHI

;EA17 EAGLE TALON
N052.51.11.000 E016.27.11.000 N053.07.15.000 E017.32.10.000 PROHI
N053.07.15.000 E017.32.10.000 N052.57.24.000 E017.33.21.000 PROHI
N052.57.24.000 E017.33.21.000 N052.49.56.000 E018.57.37.000 PROHI
N052.49.56.000 E018.57.37.000 N052.24.49.000 E018.53.41.000 PROHI
N052.24.49.000 E018.53.41.000 N052.18.32.000 E017.38.11.000 PROHI
N052.18.32.000 E017.38.11.000 N052.51.11.000 E016.27.11.000 PROHI
;LKAA
;granica z FIR poczatek
;T
LKAA N050.51.21.308 E014.49.18.230 N050.50.40.109 E014.49.24.568
N050.50.40.109 E014.49.24.568 N050.50.04.211 E014.49.52.023
N050.50.04.211 E014.49.52.023 N050.50.36.951 E014.51.31.295
N050.50.36.951 E014.51.31.295 N050.50.21.103 E014.52.43.108
N050.50.21.103 E014.52.43.108 N050.50.44.339 E014.54.08.650
N050.50.44.339 E014.54.08.650 N050.50.02.097 E014.57.33.532
N050.50.02.097 E014.57.33.532 N050.50.21.103 E014.59.01.182
N050.50.21.103 E014.59.01.182 N050.52.19.384 E014.59.50.820
N050.52.19.384 E014.59.50.820 N050.53.29.093 E014.59.04.351
N050.53.29.093 E014.59.04.351 N050.54.11.335 E015.00.00.323
N050.54.11.335 E015.00.00.323 N050.55.11.526 E015.00.49.960
N050.55.11.526 E015.00.49.960 N050.55.46.381 E015.00.33.062
N050.55.46.381 E015.00.33.062 N050.57.04.521 E015.00.53.129
N050.57.04.521 E015.00.53.129 N050.57.28.814 E015.00.00.323
N050.57.28.814 E015.00.00.323 N050.57.21.426 E014.58.36.895
N050.57.21.426 E014.58.36.895 N050.57.41.490 E014.58.18.940
N050.57.41.490 E014.58.18.940 N050.58.46.968 E014.59.09.631
N050.58.46.968 E014.59.09.631 N050.59.03.860 E015.00.00.323
N050.59.03.860 E015.00.00.323 N050.59.55.605 E015.01.29.034
N050.59.55.605 E015.01.29.034 N050.58.21.617 E015.02.30.286
N050.58.21.617 E015.02.30.286 N050.59.38.714 E015.04.08.500
N050.59.38.714 E015.04.08.500 N050.59.14.420 E015.04.27.514
N050.59.14.420 E015.04.27.514 N050.58.56.472 E015.06.17.346
N050.58.56.472 E015.06.17.346 N050.58.24.790 E015.05.50.941
N050.58.24.790 E015.05.50.941 N050.57.59.439 E015.06.03.613
N050.57.59.439 E015.06.03.613 N050.57.56.280 E015.06.36.352
N050.57.56.280 E015.06.36.352 N050.57.40.432 E015.08.06.118
N050.57.40.432 E015.08.06.118 N050.58.53.299 E015.08.34.634
N050.58.53.299 E015.08.34.634 N050.59.12.306 E015.09.10.542
N050.59.12.306 E015.09.10.542 N050.59.11.262 E015.10.04.399
N050.59.11.262 E015.10.04.399 N050.57.40.432 E015.10.27.635
N050.57.40.432 E015.10.27.635 N050.57.15.081 E015.11.08.820
N050.57.15.081 E015.11.08.820 N050.57.12.980 E015.11.42.617
N050.57.12.980 E015.11.42.617 N050.57.48.878 E015.12.29.082
N050.57.48.878 E015.12.29.082 N050.57.53.108 E015.13.27.166
N050.57.53.108 E015.13.27.166 N050.57.48.878 E015.14.13.631
N050.57.48.878 E015.14.13.631 N050.57.21.426 E015.14.31.587
N050.57.21.426 E015.14.31.587 N050.57.07.693 E015.15.46.568
N050.57.07.693 E015.15.46.568 N050.55.29.475 E015.17.33.232
N050.55.29.475 E015.17.33.232 N050.54.14.494 E015.16.11.912
N050.54.14.494 E015.16.11.912 N050.53.14.302 E015.15.58.186
N050.53.14.302 E015.15.58.186 N050.50.42.224 E015.17.05.773
N050.50.42.224 E015.17.05.773 N050.49.59.982 E015.17.57.522
N050.49.59.982 E015.17.57.522 N050.49.17.739 E015.20.58.110
N050.49.17.739 E015.20.58.110 N050.48.32.338 E015.21.49.859
N050.48.32.338 E015.21.49.859 N050.46.04.476 E015.21.47.747
N050.46.04.476 E015.21.47.747 N050.45.47.585 E015.22.18.372
N050.45.47.585 E015.22.18.372 N050.45.59.203 E015.22.23.652
N050.45.59.203 E015.22.23.652 N050.45.01.112 E015.22.21.541
N050.45.01.112 E015.22.21.541 N050.44.52.667 E015.23.01.672
N050.44.52.667 E015.23.01.672 N050.45.19.075 E015.24.11.373
N050.45.19.075 E015.24.11.373 N050.46.42.502 E015.25.37.969
N050.46.42.502 E015.25.37.969 N050.46.49.891 E015.26.20.212
N050.46.49.891 E015.26.20.212 N050.46.18.209 E015.27.45.757
N050.46.18.209 E015.27.45.757 N050.45.34.909 E015.28.33.280
N050.45.34.909 E015.28.33.280 N050.45.21.176 E015.29.01.793
N050.45.21.176 E015.29.01.793 N050.45.31.737 E015.30.16.775
N050.45.31.737 E015.30.16.775 N050.44.52.667 E015.30.40.007
N050.44.52.667 E015.30.40.007 N050.44.48.437 E015.31.12.747
N050.44.48.437 E015.31.12.747 N050.45.05.342 E015.32.27.728
N050.45.05.342 E015.32.27.728 N050.44.54.781 E015.33.54.328
N050.44.54.781 E015.33.54.328 N050.45.03.227 E015.34.33.402
N050.45.03.227 E015.34.33.402 N050.44.33.660 E015.36.46.467
N050.44.33.660 E015.36.46.467 N050.43.40.857 E015.38.40.525
N050.43.40.857 E015.38.40.525 N050.43.25.009 E015.40.28.243
N050.43.25.009 E015.40.28.243 N050.42.51.213 E015.40.46.195
N050.42.51.213 E015.40.46.195 N050.42.44.882 E015.41.35.833
N050.42.44.882 E015.41.35.833 N050.42.32.206 E015.43.12.990
N050.42.32.206 E015.43.12.990 N050.42.53.328 E015.45.21.832
N050.42.53.328 E015.45.21.832 N050.42.43.824 E015.46.08.301
N050.42.43.824 E015.46.08.301 N050.43.22.895 E015.48.23.477
N050.43.22.895 E015.48.23.477 N050.42.33.264 E015.49.13.111
N050.42.33.264 E015.49.13.111 N050.38.34.586 E015.51.56.804
N050.38.34.586 E015.51.56.804 N050.38.22.968 E015.52.40.101
N050.38.22.968 E015.52.40.101 N050.39.15.785 E015.55.32.243
N050.39.15.785 E015.55.32.243 N050.39.09.440 E015.56.02.867
N050.39.09.440 E015.56.02.867 N050.39.44.294 E015.57.52.699
N050.39.44.294 E015.57.52.699 N050.38.55.707 E015.59.45.701
N050.38.55.707 E015.59.45.701 N050.38.12.421 E016.00.00.488
N050.38.12.421 E016.00.00.488 N050.37.31.222 E016.00.14.214
N050.37.31.222 E016.00.14.214 N050.37.21.719 E016.00.13.156
N050.37.21.719 E016.00.13.156 N050.37.14.331 E016.00.11.048
N050.37.14.331 E016.00.11.048 N050.37.15.388 E016.00.00.488
N050.37.15.388 E016.00.00.488 N050.37.16.446 E015.59.59.430
N050.37.16.446 E015.59.59.430 N050.37.14.331 E015.59.56.265
N050.37.14.331 E015.59.56.265 N050.37.13.273 E015.59.56.265
N050.37.13.273 E015.59.56.265 N050.37.12.216 E015.59.53.096
N050.37.12.216 E015.59.53.096 N050.37.09.044 E015.59.53.096
N050.37.09.044 E015.59.53.096 N050.37.08.000 E015.59.50.981
N050.37.08.000 E015.59.50.981 N050.37.04.828 E015.59.48.869
N050.37.04.828 E015.59.48.869 N050.36.54.267 E015.59.43.593
N050.36.54.267 E015.59.43.593 N050.36.52.152 E015.59.43.593
N050.36.52.152 E015.59.43.593 N050.36.51.095 E015.59.42.532
N050.36.51.095 E015.59.42.532 N050.36.46.879 E015.59.42.532
N050.36.46.879 E015.59.42.532 N050.36.40.534 E015.59.42.532
N050.36.40.534 E015.59.42.532 N050.36.39.477 E015.59.43.593
N050.36.39.477 E015.59.43.593 N050.36.36.304 E015.59.43.593
N050.36.36.304 E015.59.43.593 N050.36.27.859 E015.59.47.815
N050.36.27.859 E015.59.47.815 N050.36.25.757 E015.59.50.981
N050.36.25.757 E015.59.50.981 N050.36.24.686 E015.59.50.981
N050.36.24.686 E015.59.50.981 N050.36.20.470 E016.00.00.488
N050.36.20.470 E016.00.00.488 N050.36.20.470 E016.00.00.488
N050.36.20.470 E016.00.00.488 N050.36.10.967 E016.00.24.774
N050.36.10.967 E016.00.24.774 N050.36.06.737 E016.00.43.787
N050.36.06.737 E016.00.43.787 N050.36.39.477 E016.03.36.980 
N050.36.39.477 E016.03.36.980 N050.39.24.230 E016.05.39.484 
N050.39.24.230 E016.05.39.484 N050.39.05.210 E016.09.15.984 
N050.39.05.210 E016.09.15.984 N050.37.22.776 E016.11.30.106 
N050.37.22.776 E016.11.30.106 N050.38.01.847 E016.13.26.273 
N050.38.01.847 E016.13.26.273 N050.39.43.237 E016.13.44.229 
N050.39.43.237 E016.13.44.229 N050.39.23.173 E016.17.33.397 
N050.39.23.173 E016.17.33.397 N050.39.27.403 E016.20.25.532 
N050.39.27.403 E016.20.25.532 N050.36.06.737 E016.25.50.803 
N050.36.06.737 E016.25.50.803 N050.34.13.743 E016.26.39.390 
N050.34.13.743 E016.26.39.390 N050.30.08.734 E016.22.21.705 
N050.30.08.734 E016.22.21.705 N050.30.08.734 E016.18.39.926 
N050.30.08.734 E016.18.39.926 N050.25.21.483 E016.11.56.508 
N050.25.21.483 E016.11.56.508 N050.24.19.177 E016.14.58.153 
N050.24.19.177 E016.14.58.153 N050.22.02.932 E016.16.22.638 
N050.22.02.932 E016.16.22.638 N050.22.56.793 E016.20.18.143 
N050.22.56.793 E016.20.18.143 N050.22.09.277 E016.22.14.310 
N050.22.09.277 E016.22.14.310 N050.20.31.059 E016.22.11.145 
N050.20.31.059 E016.22.11.145 N050.19.05.517 E016.26.14.039 
N050.19.05.517 E016.26.14.039 N050.13.40.239 E016.32.49.011 
N050.13.40.239 E016.32.49.011 N050.09.54.250 E016.33.22.808 
N050.09.54.250 E016.33.22.808 N050.07.14.770 E016.37.02.472 
N050.07.14.770 E016.37.02.472 N050.05.54.515 E016.41.30.717 
N050.05.54.515 E016.41.30.717 N050.06.12.464 E016.43.23.712 
N050.06.12.464 E016.43.23.712 N050.12.02.035 E016.49.55.518 
N050.12.02.035 E016.49.55.518 N050.11.45.130 E016.51.49.577 
N050.11.45.130 E016.51.49.577 N050.13.21.233 E016.53.38.349 
N050.13.21.233 E016.53.38.349 N050.13.20.175 E016.57.26.466 
N050.13.20.175 E016.57.26.466 N050.14.12.979 E016.57.41.250 
N050.14.12.979 E016.57.41.250 N050.13.11.730 E016.59.59.595
N050.13.11.730 E016.59.59.595 N050.13.20.175 E017.01.07.181 
N050.13.20.175 E017.01.07.181 N050.15.00.508 E017.00.11.213 
N050.15.00.508 E017.00.11.213 N050.16.26.050 E017.01.14.577 
N050.16.26.050 E017.01.14.577 N050.18.00.038 E016.59.59.595
N050.18.00.038 E016.59.59.595 N050.19.00.230 E016.56.29.433 
N050.19.00.230 E016.56.29.433 N050.24.06.501 E016.51.58.023 
N050.24.06.501 E016.51.58.023 N050.26.43.853 E016.54.08.973 
N050.26.43.853 E016.54.08.973 N050.25.29.929 E016.59.59.595 
N050.25.29.929 E016.59.59.595 N050.23.54.883 E017.04.14.107 
N050.23.54.883 E017.04.14.107 N050.24.14.947 E017.06.15.554 
N050.24.14.947 E017.06.15.554 N050.22.36.729 E017.08.44.460 
N050.22.36.729 E017.08.44.460 N050.23.06.296 E017.11.46.105 
N050.23.06.296 E017.11.46.105 N050.21.42.869 E017.11.03.863 
N050.21.42.869 E017.11.03.863 N050.18.52.841 E017.17.48.345 
N050.18.52.841 E017.17.48.345 N050.19.38.256 E017.20.30.977 
N050.19.38.256 E017.20.30.977 N050.18.59.186 E017.21.30.118 
N050.18.59.186 E017.21.30.118 N050.16.04.929 E017.20.30.977 
N050.16.04.929 E017.20.30.977 N050.15.43.808 E017.21.34.341 
N050.15.43.808 E017.21.34.341 N050.17.01.948 E017.24.23.310 
N050.17.01.948 E017.24.23.310 N050.15.08.954 E017.25.33.018 
N050.15.08.954 E017.25.33.018 N050.16.21.821 E017.29.41.193 
N050.16.21.821 E017.29.41.193 N050.15.52.254 E017.36.30.948 
N050.15.52.254 E017.36.30.948 N050.15.59.642 E017.38.38.733 
N050.15.59.642 E017.38.38.733 N050.17.35.745 E017.40.54.971 
N050.17.35.745 E017.40.54.971 N050.19.20.307 E017.41.01.308 
N050.19.20.307 E017.41.01.308 N050.18.12.714 E017.44.57.865 
N050.18.12.714 E017.44.57.865 N050.15.38.521 E017.43.29.157 
N050.15.38.521 E017.43.29.157 N050.13.44.469 E017.45.32.719 
N050.13.44.469 E017.45.32.719 N050.12.29.487 E017.45.21.101 
N050.12.29.487 E017.45.21.101 N050.11.59.920 E017.42.40.577 
N050.11.59.920 E017.42.40.577 N050.10.58.658 E017.42.16.283 
N050.10.58.658 E017.42.16.283 N050.10.04.797 E017.36.06.662 
N050.10.04.797 E017.36.06.662 N050.09.24.670 E017.35.55.044 
N050.09.24.670 E017.35.55.044 N050.06.15.636 E017.40.13.779 
N050.06.15.636 E017.40.13.779 N050.06.49.433 E017.41.27.710 
N050.06.49.433 E017.41.27.710 N050.06.19.866 E017.43.59.781 
N050.06.19.866 E017.43.59.781 N050.05.37.624 E017.43.24.934 
N050.05.37.624 E017.43.24.934 N049.59.59.670 E017.48.17.466 
N049.59.59.670 E017.48.17.466 N049.59.44.894 E017.49.16.606 
N049.59.44.894 E017.49.16.606 N049.59.08.982 E017.50.30.531 
N049.59.08.982 E017.50.30.531 N049.58.38.358 E017.52.19.309 
N049.58.38.358 E017.52.19.309 N049.58.26.740 E017.53.25.838 
N049.58.26.740 E017.53.25.838 N049.58.28.855 E017.54.17.584 
N049.58.28.855 E017.54.17.584 N049.58.49.976 E017.55.49.464 
N049.58.49.976 E017.55.49.464 N049.59.23.773 E017.56.32.764 
N049.59.23.773 E017.56.32.764 N049.59.59.670 E017.58.06.752 
N049.59.59.670 E017.58.06.752 N049.59.59.670 E017.58.06.752 
N049.59.59.670 E017.58.06.752 N050.00.21.849 E017.58.32.103 
N050.00.21.849 E017.58.32.103 N050.00.50.359 E017.59.11.180 
N050.00.50.359 E017.59.11.180 N050.00.58.818 E017.59.43.912 
N050.00.58.818 E017.59.43.912 N050.00.55.646 E017.59.59.753 
N050.00.55.646 E017.59.59.753 N050.00.22.906 E018.03.21.469 
N050.00.22.906 E018.03.21.469 N050.02.46.539 E018.00.16.651 
N050.02.46.539 E018.00.16.651 N050.03.23.494 E018.03.40.475
N050.03.23.494 E018.03.40.475 N050.02.52.000 E018.05.52.000

;J
N050.02.52.000 E018.05.52.000 N049.59.59.670 E018.06.41.063 
N049.59.59.670 E018.06.41.063 N049.59.53.340 E018.07.11.687 
N049.59.53.340 E018.07.11.687 N049.59.57.556 E018.07.38.096 
N049.59.57.556 E018.07.38.096 N049.59.54.397 E018.08.04.497 
N049.59.54.397 E018.08.04.497 N049.59.17.428 E018.08.57.293 
N049.59.17.428 E018.08.57.293 N049.59.11.097 E018.09.26.867 
N049.59.11.097 E018.09.26.867 N049.59.17.428 E018.09.42.708 
N049.59.17.428 E018.09.42.708 N049.59.59.670 E018.10.33.403 
N049.59.59.670 E018.10.33.403 N049.59.59.670 E018.12.50.691
N049.59.59.670 E018.12.50.691 N049.58.06.676 E018.13.46.666 
N049.58.06.676 E018.13.46.666 N049.57.46.612 E018.16.34.579 
N049.57.46.612 E018.16.34.579 N049.56.09.452 E018.17.21.051 
N049.56.09.452 E018.17.21.051 N049.56.42.191 E018.19.35.166 
N049.56.42.191 E018.19.35.166 N049.55.30.368 E018.20.30.084 
N049.55.30.368 E018.20.30.084 N049.56.15.783 E018.23.58.131 
N049.56.15.783 E018.23.58.131 N049.54.22.788 E018.29.22.344 
N049.54.22.788 E018.29.22.344 N049.54.50.240 E018.34.29.666 
N049.54.50.240 E018.34.29.666 N049.51.33.805 E018.34.29.666 
N049.51.33.805 E018.34.29.666 N049.50.27.283 E018.35.50.979 
N049.50.27.283 E018.35.50.979 N049.49.03.855 E018.34.48.673 
N049.49.03.855 E018.34.48.673 N049.42.55.278 E018.38.11.439 
N049.42.55.278 E018.38.11.439 N049.40.16.869 E018.48.44.025 
N049.40.16.869 E018.48.44.025 N049.32.52.266 E018.51.35.116 
N049.32.52.266 E018.51.35.116 N049.31.27.781 E018.50.49.702 


;granica z fir koniec
N049.31.27.781 E018.50.49.702  N049.30.00.000 E018.40.00.200
N049.30.00.000 E018.40.00.200 N049.30.00.000 E018.36.00.195
N049.30.00.000 E018.36.00.195 N049.29.44.998 E018.34.00.199
N049.29.44.998 E018.34.00.199 N049.28.59.998 E018.32.44.998
N049.28.59.998 E018.32.44.998 N049.27.00.019 E018.32.30.200
N049.27.00.019 E018.32.30.200 N049.22.59.998 E018.26.59.999
N049.22.59.998 E018.26.59.999 N049.19.59.998 E018.22.00.199
N049.19.59.998 E018.22.00.199 N049.18.14.999 E018.16.49.999
N049.18.14.999 E018.16.49.999 N049.16.59.998 E018.11.59.999
N049.16.59.998 E018.11.59.999 N049.14.44.998 E018.10.14.998
N049.14.44.998 E018.10.14.998 N049.07.29.999 E018.06.45.536
N049.07.29.999 E018.06.45.536 N049.02.39.998 E018.04.14.998
N049.02.39.998 E018.04.14.998 N048.59.14.999 E017.55.00.200
N048.59.14.999 E017.55.00.200 N048.55.59.998 E017.51.10.000
N048.55.59.998 E017.51.10.000 N048.51.50.000 E017.42.34.999
N048.51.50.000 E017.42.34.999 N048.49.14.998 E017.32.15.142
N048.49.14.998 E017.32.15.142 N048.49.42.999 E017.24.18.014
N048.49.42.999 E017.24.18.014 N048.52.19.999 E017.11.25.999
N048.52.19.999 E017.11.25.999 N048.46.35.000 E017.03.29.998
N048.46.35.000 E017.03.29.998 N048.37.00.199 E016.56.59.999
N048.37.00.199 E016.56.59.999 N048.43.00.200 E016.54.20.600
N048.43.00.200 E016.54.20.600 N048.43.45.199 E016.52.40.999
N048.43.45.199 E016.52.40.999 N048.43.00.200 E016.50.30.200
N048.43.00.200 E016.50.30.200 N048.44.14.999 E016.43.14.998
N048.44.14.999 E016.43.14.998 N048.47.09.999 E016.37.29.999
N048.47.09.999 E016.37.29.999 N048.48.39.999 E016.28.00.200
N048.48.39.999 E016.28.00.200 N048.43.59.998 E016.22.00.199
N048.43.59.998 E016.22.00.199 N048.44.00.999 E016.19.19.999
N048.44.00.999 E016.19.19.999 N048.44.09.999 E016.16.09.998
N048.44.09.999 E016.16.09.998 N048.44.49.999 E016.06.00.095
N048.44.49.999 E016.06.00.095 N048.46.59.998 E016.01.00.200
N048.46.59.998 E016.01.00.200 N048.51.50.000 E015.50.15.145
N048.51.50.000 E015.50.15.145 N048.51.29.998 E015.41.14.999
N048.51.29.998 E015.41.14.999 N048.53.20.999 E015.36.50.000
N048.53.20.999 E015.36.50.000 N048.58.59.998 E015.20.59.999
N048.58.59.998 E015.20.59.999 N049.00.00.000 E015.09.29.998
N049.00.00.000 E015.09.29.998 N049.00.00.000 E015.00.14.999
N049.00.00.000 E015.00.14.999 N048.47.49.999 E014.57.50.000
N048.47.49.999 E014.57.50.000 N048.46.59.998 E014.49.59.998
N048.46.59.998 E014.49.59.998 N048.43.30.087 E014.46.30.094
N048.43.30.087 E014.46.30.094 N048.38.59.999 E014.43.00.199
N048.38.59.999 E014.43.00.199 N048.34.30.028 E014.43.00.199
N048.34.30.028 E014.43.00.199 N048.37.59.998 E014.37.00.199
N048.37.59.998 E014.37.00.199 N048.37.45.200 E014.30.00.000
N048.37.45.200 E014.30.00.000 N048.35.30.200 E014.22.59.998
N048.35.30.200 E014.22.59.998 N048.34.59.998 E014.16.30.293
N048.34.59.998 E014.16.30.293 N048.35.49.999 E014.10.59.998
N048.35.49.999 E014.10.59.998 N048.40.00.199 E014.03.00.547
N048.40.00.199 E014.03.00.547 N048.42.39.999 E014.00.29.998
N048.42.39.999 E014.00.29.998 N048.45.00.000 E013.55.00.200
N048.45.00.000 E013.55.00.200 N048.46.59.998 E013.49.00.200
N048.46.59.998 E013.49.00.200 N048.52.59.998 E013.45.00.000
N048.52.59.998 E013.45.00.000 N048.52.59.998 E013.40.59.998
N048.52.59.998 E013.40.59.998 N048.58.00.200 E013.35.59.999
N048.58.00.200 E013.35.59.999 N048.58.30.087 E013.30.29.998
N048.58.30.087 E013.30.29.998 N049.00.00.000 E013.24.00.199
N049.00.00.000 E013.24.00.199 N049.02.59.999 E013.24.00.199
N049.02.59.999 E013.24.00.199 N049.07.00.199 E013.16.59.998
N049.07.00.199 E013.16.59.998 N049.07.00.199 E013.13.59.998
N049.07.00.199 E013.13.59.998 N049.19.59.998 E012.58.00.199
N049.19.59.998 E012.58.00.199 N049.20.14.999 E012.48.00.398
N049.20.14.999 E012.48.00.398 N049.25.59.998 E012.40.59.998
N049.25.59.998 E012.40.59.998 N049.31.54.199 E012.36.29.998
N049.31.54.199 E012.36.29.998 N049.40.45.199 E012.31.14.998
N049.40.45.199 E012.31.14.998 N049.41.49.999 E012.26.59.999
N049.41.49.999 E012.26.59.999 N049.46.59.998 E012.28.59.998
N049.46.59.998 E012.28.59.998 N049.55.00.199 E012.34.00.200
N049.55.00.199 E012.34.00.200 N049.58.00.200 E012.30.00.000
N049.58.00.200 E012.30.00.000 N050.06.29.998 E012.12.29.998
N050.06.29.998 E012.12.29.998 N050.10.00.199 E012.12.29.998
N050.10.00.199 E012.12.29.998 N050.12.34.999 E012.10.45.199
N050.12.34.999 E012.10.45.199 N050.18.29.998 E012.07.14.998
N050.18.29.998 E012.07.14.998 N050.19.19.999 E012.05.44.998
N050.19.19.999 E012.05.44.998 N050.19.00.200 E012.10.59.998
N050.19.00.200 E012.10.59.998 N050.12.29.998 E012.18.15.199
N050.12.29.998 E012.18.15.199 N050.17.12.998 E012.22.27.199
N050.17.12.998 E012.22.27.199 N050.23.59.999 E012.31.59.998
N050.23.59.999 E012.31.59.998 N050.27.00.019 E012.49.59.998
N050.27.00.019 E012.49.59.998 N050.25.00.199 E012.56.59.999
N050.25.00.199 E012.56.59.999 N050.27.00.019 E013.01.59.998
N050.27.00.019 E013.01.59.998 N050.28.59.998 E013.03.00.547
N050.28.59.998 E013.03.00.547 N050.31.00.199 E013.10.00.200
N050.31.00.199 E013.10.00.200 N050.37.59.998 E013.24.00.199
N050.37.59.998 E013.24.00.199 N050.36.00.195 E013.28.00.199
N050.36.00.195 E013.28.00.199 N050.43.00.200 E013.35.59.999
N050.43.00.200 E013.35.59.999 N050.44.03.199 E013.47.54.999
N050.44.03.199 E013.47.54.999 N050.46.00.199 E013.53.30.200
N050.46.00.199 E013.53.30.200 N050.47.59.999 E013.56.59.999
N050.47.59.999 E013.56.59.999 N050.52.00.199 E014.19.00.200
N050.52.00.199 E014.19.00.200 N050.55.59.998 E014.22.30.237
N050.55.59.998 E014.22.30.237 N050.58.59.998 E014.14.30.199
N050.58.59.998 E014.14.30.199 N051.02.59.999 E014.19.00.200
N051.02.59.999 E014.19.00.200 N051.02.59.999 E014.24.00.199
N051.02.59.999 E014.24.00.199 N051.00.00.000 E014.34.41.998
N051.00.00.000 E014.34.41.998 N050.55.00.199 E014.37.00.199
N050.55.00.199 E014.37.00.199 N050.49.59.998 E014.37.00.199
N050.49.59.998 E014.37.00.199 N050.49.00.200 E014.41.59.999
N050.49.00.200 E014.41.59.999 N050.49.00.200 E014.48.00.398
N050.49.00.200 E014.48.00.398 N050.51.21.308 E014.49.18.230


;LZBB 
;granica z FIR poczatek 
;J
LZBB N049.31.27.781 E018.50.49.702 N049.30.38.136 E018.57.54.248 
N049.30.38.136 E018.57.54.248 N049.25.37.152 E018.59.20.841 
N049.25.37.152 E018.59.20.841 N049.24.02.107 E018.58.22.757 
N049.24.02.107 E018.58.22.757 N049.24.02.107 E018.59.59.918 
N049.24.02.107 E018.59.59.918 N049.23.39.928 E019.01.58.199 
N049.23.39.928 E019.01.58.199 N049.25.14.987 E019.04.34.493 
N049.25.14.987 E019.04.34.493 N049.24.16.897 E019.08.05.712 
N049.24.16.897 E019.08.05.712 N049.24.48.579 E019.11.30.594 
N049.24.48.579 E019.11.30.594 N049.26.40.516 E019.11.49.600 
N049.26.40.516 E019.11.49.600 N049.27.31.218 E019.14.03.723 
N049.27.31.218 E019.14.03.723 N049.31.24.608 E019.15.20.812 
N049.31.24.608 E019.15.20.812 N049.32.19.526 E019.22.15.855 
N049.32.19.526 E019.22.15.855 N049.34.16.750 E019.23.14.996 
N049.34.16.750 E019.23.14.996 N049.35.56.012 E019.27.37.961 
N049.35.56.012 E019.27.37.961 N049.34.09.348 E019.31.51.415 
N049.34.09.348 E019.31.51.415 N049.30.05.397 E019.33.11.677 
N049.30.05.397 E019.33.11.677 N049.26.44.745 E019.36.27.048 
N049.26.44.745 E019.36.27.048 N049.26.46.860 E019.38.33.783 
N049.26.46.860 E019.38.33.783 N049.24.03.164 E019.38.28.502 
N049.24.03.164 E019.38.28.502 N049.23.12.476 E019.43.54.824 
N049.23.12.476 E019.43.54.824 N049.24.13.725 E019.45.38.322 
N049.24.13.725 E019.45.38.322 N049.24.16.897 E019.47.33.438 
N049.24.16.897 E019.47.33.438 N049.17.35.580 E019.47.43.992 
N049.17.35.580 E019.47.43.992 N049.16.22.713 E019.49.22.209 
N049.16.22.713 E019.49.22.209 N049.13.55.922 E019.46.02.608 
N049.13.55.922 E019.46.02.608 N049.12.18.762 E019.46.15.284 
N049.12.18.762 E019.46.15.284 N049.11.33.347 E019.47.19.705 
N049.11.33.347 E019.47.19.705 N049.11.51.310 E019.48.34.687 
N049.11.51.310 E019.48.34.687 N049.11.25.959 E019.52.37.587 
N049.11.25.959 E019.52.37.587 N049.13.49.591 E019.55.35.003 
N049.13.49.591 E019.55.35.003 N049.13.30.571 E020.00.00.082 
N049.13.30.571 E020.00.00.082 N049.12.22.992 E020.00.51.828 
N049.12.22.992 E020.00.51.828 N049.10.41.602 E020.05.38.029 
N049.10.41.602 E020.05.38.029 N049.17.10.243 E020.08.01.654 
N049.17.10.243 E020.08.01.654 N049.18.38.958 E020.08.37.559 
N049.18.38.958 E020.08.37.559 N049.18.15.721 E020.09.56.764 
N049.18.15.721 E020.09.56.764 N049.20.49.901 E020.13.35.371 
N049.20.49.901 E020.13.35.371 N049.20.52.016 E020.17.31.934 
N049.20.52.016 E020.17.31.934 N049.20.22.449 E020.18.59.584 
N049.20.22.449 E020.18.59.584 N049.23.12.476 E020.18.53.253 
N049.23.12.476 E020.18.53.253 N049.23.57.891 E020.19.17.540 
N049.23.57.891 E020.19.17.540 N049.23.57.891 E020.21.57.007 
N049.23.57.891 E020.21.57.007 N049.22.54.513 E020.23.10.931 
N049.22.54.513 E020.23.10.931 N049.24.23.228 E020.25.58.850 
N049.24.23.228 E020.25.58.850 N049.24.46.464 E020.26.54.819 
N049.24.46.464 E020.26.54.819 N049.24.38.018 E020.29.15.279 
N049.24.38.018 E020.29.15.279 N049.22.57.686 E020.32.39.103 
N049.22.57.686 E020.32.39.103 N049.22.49.240 E020.35.13.289 
N049.22.49.240 E020.35.13.289 N049.24.58.082 E020.37.01.010 
N049.24.58.082 E020.37.01.010 N049.24.01.049 E020.39.28.858 
N049.24.01.049 E020.39.28.858 N049.24.55.967 E020.42.00.930 
N049.24.55.967 E020.42.00.930 N049.24.49.636 E020.43.44.428 
N049.24.49.636 E020.43.44.428 N049.19.58.155 E020.49.22.374 
N049.19.58.155 E020.49.22.374 N049.20.21.391 E020.51.51.280 
N049.20.21.391 E020.51.51.280 N049.19.45.480 E020.52.41.968 
N049.19.45.480 E020.52.41.968 N049.19.05.352 E020.52.32.465 
N049.19.05.352 E020.52.32.465 N049.19.07.467 E020.54.31.804 
N049.19.07.467 E020.54.31.804 N049.17.41.925 E020.56.26.913 
N049.17.41.925 E020.56.26.913 N049.18.18.880 E020.59.27.501 
N049.18.18.880 E020.59.27.501 N049.19.38.091 E021.00.00.240
N049.19.38.091 E021.00.00.240 N049.21.45.876 E021.03.29.344 
N049.21.45.876 E021.03.29.344 N049.22.00.667 E021.06.00.365 
N049.22.00.667 E021.06.00.365 N049.25.08.643 E021.04.02.084 
N049.25.08.643 E021.04.02.084 N049.25.51.942 E021.08.36.666 
N049.25.51.942 E021.08.36.666 N049.24.10.000 E021.11.56.000
;R
N049.24.10.000 E021.11.56.000 N049.27.09.039 E021.17.13.086  
N049.27.09.039 E021.17.13.086 N049.25.48.770 E021.23.22.714 
N049.25.48.770 E021.23.22.714 N049.25.58.273 E021.24.29.243 
N049.25.58.273 E021.24.29.243 N049.24.49.636 E021.27.27.723 
N049.24.49.636 E021.27.27.723 N049.26.37.357 E021.33.57.415 
N049.26.37.357 E021.33.57.415 N049.26.04.618 E021.35.27.180 
N049.26.04.618 E021.35.27.180 N049.26.41.573 E021.38.18.264 
N049.26.41.573 E021.38.18.264 N049.25.08.643 E021.39.58.590 
N049.25.08.643 E021.39.58.590 N049.24.45.406 E021.43.38.255 
N049.24.45.406 E021.43.38.255 N049.21.09.965 E021.46.54.684 
N049.21.09.965 E021.46.54.684 N049.23.23.036 E021.50.48.074 
N049.23.23.036 E021.50.48.074 N049.21.15.252 E021.54.03.452 
N049.21.15.252 E021.54.03.452 N049.20.33.009 E021.56.20.740 
N049.20.33.009 E021.56.20.740 N049.20.43.570 E021.58.23.245 
N049.20.43.570 E021.58.23.245 N049.18.17.836 E022.00.00.405
N049.18.17.836 E022.00.00.405 N049.14.43.452 E022.02.30.368 
N049.14.43.452 E022.02.30.368 N049.13.01.004 E022.03.06.273 
N049.13.01.004 E022.03.06.273 N049.12.03.972 E022.08.41.047 
N049.12.03.972 E022.08.41.047 N049.10.41.602 E022.11.34.247 
N049.10.41.602 E022.11.34.247 N049.11.04.838 E022.14.13.713 
N049.11.04.838 E022.14.13.713 N049.09.10.786 E022.14.07.375 
N049.09.10.786 E022.14.07.375 N049.08.11.638 E022.19.08.360 
N049.08.11.638 E022.19.08.360 N049.08.54.938 E022.22.20.565 
N049.08.54.938 E022.22.20.565 N049.06.17.586 E022.24.57.917 
N049.06.17.586 E022.24.57.917 N049.05.16.338 E022.34.12.363


;granica z FIR koniec

N049.05.16.338 E022.34.12.363 N049.02.30.199 E022.33.15.199
N049.02.30.199 E022.33.15.199 N048.59.39.998 E022.32.09.999
N048.59.39.998 E022.32.09.999 N048.57.15.199 E022.27.44.999
N048.57.15.199 E022.27.44.999 N048.53.30.199 E022.25.30.490
N048.53.30.199 E022.25.30.490 N048.49.54.998 E022.22.30.237
N048.49.54.998 E022.22.30.237 N048.48.29.998 E022.23.14.999
N048.48.29.998 E022.23.14.999 N048.43.59.998 E022.21.00.195
N048.43.59.998 E022.21.00.195 N048.41.01.971 E022.19.35.999
N048.41.01.971 E022.19.35.999 N048.40.12.040 E022.17.54.960
N048.40.12.040 E022.17.54.960 N048.37.17.968 E022.13.57.961
N048.37.17.968 E022.13.57.961 N048.34.58.940 E022.09.43.000
N048.34.58.940 E022.09.43.000 N048.33.24.879 E022.09.32.039
N048.33.24.879 E022.09.32.039 N048.29.53.840 E022.09.30.120
N048.29.53.840 E022.09.30.120 N048.25.19.199 E022.09.12.920
N048.25.19.199 E022.09.12.920 N048.24.38.458 E022.09.11.960
N048.24.38.458 E022.09.11.960 N048.22.44.000 E022.07.32.998
N048.22.44.000 E022.07.32.998 N048.23.24.953 E022.04.47.999
N048.23.24.953 E022.04.47.999 N048.21.54.240 E021.51.15.200
N048.21.54.240 E021.51.15.200 N048.20.30.001 E021.49.59.998
N048.20.30.001 E021.49.59.998 N048.21.15.199 E021.43.59.998
N048.21.15.199 E021.43.59.998 N048.23.59.999 E021.40.54.998
N048.23.59.999 E021.40.54.998 N048.27.29.998 E021.37.29.999
N048.27.29.998 E021.37.29.999 N048.30.33.199 E021.36.48.999
N048.30.33.199 E021.36.48.999 N048.34.30.028 E021.26.30.199
N048.34.30.028 E021.26.30.199 N048.34.35.999 E021.25.50.599
N048.34.35.999 E021.25.50.599 N048.32.59.999 E021.19.19.999
N048.32.59.999 E021.19.19.999 N048.31.29.999 E021.18.29.998
N048.31.29.999 E021.18.29.998 N048.31.29.999 E021.17.30.200
N048.31.29.999 E021.17.30.200 N048.30.29.998 E021.09.29.998
N048.30.29.998 E021.09.29.998 N048.29.30.199 E021.06.47.998
N048.29.30.199 E021.06.47.998 N048.31.14.998 E020.58.00.200
N048.31.14.998 E020.58.00.200 N048.33.15.199 E020.52.29.999
N048.33.15.199 E020.52.29.999 N048.34.59.998 E020.50.30.200
N048.34.59.998 E020.50.30.200 N048.34.14.998 E020.44.45.999
N048.34.14.998 E020.44.45.999 N048.32.15.142 E020.30.00.000
N048.32.15.142 E020.30.00.000 N048.30.55.000 E020.30.37.999
N048.30.55.000 E020.30.37.999 N048.16.59.998 E020.19.59.998
N048.16.59.998 E020.19.59.998 N048.16.00.199 E020.17.09.999
N048.16.00.199 E020.17.09.999 N048.17.20.999 E020.15.00.000
N048.17.20.999 E020.15.00.000 N048.07.59.998 E019.55.59.998
N048.07.59.998 E019.55.59.998 N048.14.30.199 E019.38.59.999
N048.14.30.199 E019.38.59.999 N048.12.29.998 E019.31.59.998
N048.12.29.998 E019.31.59.998 N048.06.00.095 E019.29.44.998
N048.06.00.095 E019.29.44.998 N048.05.23.841 E019.23.34.411
N048.05.23.841 E019.23.34.411 N048.04.00.200 E019.07.01.999
N048.04.00.200 E019.07.01.999 N048.04.30.023 E018.58.59.998
N048.04.30.023 E018.58.59.998 N048.02.30.199 E018.49.00.199
N048.02.30.199 E018.49.00.199 N047.56.30.200 E018.46.24.999
N047.56.30.200 E018.46.24.999 N047.52.59.998 E018.46.59.998
N047.52.59.998 E018.46.59.998 N047.49.00.200 E018.52.29.999
N047.49.00.200 E018.52.29.999 N047.49.00.200 E018.46.00.200
N047.49.00.200 E018.46.00.200 N047.45.00.000 E018.40.30.692
N047.45.00.000 E018.40.30.692 N047.45.52.999 E018.34.14.998
N047.45.52.999 E018.34.14.998 N047.45.51.200 E018.27.53.999
N047.45.51.200 E018.27.53.999 N047.43.59.998 E018.22.00.199
N047.43.59.998 E018.22.00.199 N047.45.20.599 E018.03.50.999
N047.45.20.599 E018.03.50.999 N047.45.00.000 E017.43.59.998
N047.45.00.000 E017.43.59.998 N047.49.08.590 E017.36.42.919
N047.49.08.590 E017.36.42.919 N048.01.19.999 E017.15.10.999
N048.01.19.999 E017.15.10.999 N048.01.00.199 E017.10.00.200
N048.01.00.199 E017.10.00.200 N048.01.59.998 E017.04.59.998
N048.01.59.998 E017.04.59.998 N048.07.59.998 E017.04.00.199
N048.07.59.998 E017.04.00.199 N048.10.00.199 E016.58.59.998
N048.10.00.199 E016.58.59.998 N048.19.32.998 E016.54.32.999
N048.19.32.998 E016.54.32.999 N048.22.59.998 E016.49.59.998
N048.22.59.998 E016.49.59.998 N048.31.00.199 E016.55.59.998
N048.31.00.199 E016.55.59.998 N048.37.00.199 E016.56.59.999
N048.37.00.199 E016.56.59.999 N048.46.35.000 E017.03.29.998
N048.46.35.000 E017.03.29.998 N048.52.19.999 E017.11.25.999
N048.52.19.999 E017.11.25.999 N048.49.42.999 E017.24.18.014
N048.49.42.999 E017.24.18.014 N048.49.14.998 E017.32.15.142
N048.49.14.998 E017.32.15.142 N048.51.50.000 E017.42.34.999
N048.51.50.000 E017.42.34.999 N048.55.59.998 E017.51.10.000
N048.55.59.998 E017.51.10.000 N048.59.14.999 E017.55.00.200
N048.59.14.999 E017.55.00.200 N049.02.39.998 E018.04.14.998
N049.02.39.998 E018.04.14.998 N049.07.29.999 E018.06.45.536
N049.07.29.999 E018.06.45.536 N049.14.44.998 E018.10.14.998
N049.14.44.998 E018.10.14.998 N049.16.59.998 E018.11.59.999
N049.16.59.998 E018.11.59.999 N049.18.14.999 E018.16.49.999
N049.18.14.999 E018.16.49.999 N049.19.59.998 E018.22.00.199
N049.19.59.998 E018.22.00.199 N049.22.59.998 E018.26.59.999
N049.22.59.998 E018.26.59.999 N049.27.00.019 E018.32.30.200
N049.27.00.019 E018.32.30.200 N049.28.59.998 E018.32.44.998
N049.28.59.998 E018.32.44.998 N049.29.44.998 E018.34.00.199
N049.29.44.998 E018.34.00.199 N049.30.00.000 E018.36.00.195
N049.30.00.000 E018.36.00.195 N049.30.00.000 E018.40.00.200
N049.30.00.000 E018.40.00.200 N049.31.27.781 E018.50.49.702


;UKLV
;poczatek granicy z UMMV
UKLV N051.27.54.770 E023.40.28.487 N051.30.38.249 E023.40.20.370
N051.30.38.249 E023.40.20.370 N051.31.50.440 E023.40.47.179
N051.31.50.440 E023.40.47.179 N051.36.10.339 E023.39.12.301
N051.36.10.339 E023.39.12.301 N051.37.08.090 E023.39.28.800
N051.37.08.090 E023.39.28.800 N051.37.59.660 E023.40.22.429
N051.37.59.660 E023.40.22.429 N051.38.30.598 E023.41.36.690
N051.38.30.598 E023.41.36.690 N051.38.49.160 E023.43.42.509
N051.38.49.160 E023.43.42.509 N051.38.36.779 E023.45.25.639
N051.38.36.779 E023.45.25.639 N051.37.41.160 E023.47.43.839
N051.37.41.160 E023.47.43.839 N051.35.00.211 E023.51.16.289
N051.35.00.211 E023.51.16.289 N051.34.16.888 E023.53.15.928
N051.34.16.888 E023.53.15.928 N051.33.52.138 E023.55.46.498
N051.33.52.138 E023.55.46.498 N051.33.37.699 E024.00.24.958
N051.33.37.699 E024.00.24.958 N051.33.48.599 E024.03.16.149
N051.33.48.599 E024.03.16.149 N051.37.20.470 E024.09.00.619
N051.37.20.470 E024.09.00.619 N051.39.38.660 E024.14.16.198
N051.39.38.660 E024.14.16.198 N051.41.17.671 E024.17.28.839
N051.41.17.671 E024.17.28.839 N051.43.00.800 E024.19.46.228
N051.43.00.800 E024.19.46.228 N051.44.37.748 E024.21.19.039
N051.44.37.748 E024.21.19.039 N051.45.45.810 E024.22.06.481
N051.45.45.810 E024.22.06.481 N051.47.26.890 E024.22.47.740
N051.47.26.890 E024.22.47.740 N051.48.49.388 E024.23.39.299
N051.48.49.388 E024.23.39.299 N051.52.19.779 E024.25.28.621
N051.52.19.779 E024.25.28.621 N051.53.09.279 E024.26.57.321
N051.53.09.279 E024.26.57.321 N051.54.23.540 E024.30.35.960
N051.54.23.540 E024.30.35.960 N051.55.08.918 E024.34.35.230
N051.55.08.918 E024.34.35.230 N051.55.27.480 E024.36.57.549
N051.55.27.480 E024.36.57.549 N051.55.10.981 E024.43.43.888
N051.55.10.981 E024.43.43.888 N051.53.38.158 E024.56.04.380
N051.53.38.158 E024.56.04.380 N051.53.35.811 E024.59.10.291
N051.53.35.811 E024.59.10.291 N051.54.17.348 E025.03.01.039
N051.54.17.348 E025.03.01.039 N051.56.31.419 E025.06.06.670
N051.56.31.419 E025.06.06.670 N051.57.12.679 E025.07.33.301
N051.57.12.679 E025.07.33.301 N051.57.45.680 E025.12.48.891
N051.57.45.680 E025.12.48.891 N051.57.43.740 E025.16.48.118
N051.57.43.740 E025.16.48.118 N051.57.27.118 E025.18.56.120
N051.57.27.118 E025.18.56.120 N051.55.31.609 E025.22.20.240
N051.55.31.609 E025.22.20.240 N051.54.50.349 E025.24.42.570
N051.54.50.349 E025.24.42.570 N051.54.31.791 E025.27.27.579
N051.54.31.791 E025.27.27.579 N051.54.13.229 E025.33.55.360
N051.54.13.229 E025.33.55.360 N051.53.29.911 E025.38.21.440
N051.53.29.911 E025.38.21.440 N051.54.13.229 E025.41.22.948
N051.54.13.229 E025.41.22.948 N051.54.56.541 E025.43.43.208
N051.54.56.541 E025.43.43.208 N051.55.17.169 E025.46.32.350
N051.55.17.169 E025.46.32.350 N051.54.24.541 E025.51.56.908
N051.54.24.541 E025.51.56.908 N051.53.38.158 E025.58.13.648
N051.53.38.158 E025.58.13.648 N051.54.23.540 E026.02.50.960
N051.54.23.540 E026.02.50.960 N051.54.25.599 E026.04.29.960
N051.54.25.599 E026.04.29.960 N051.54.09.100 E026.06.22.499
N051.54.09.100 E026.06.22.499 N051.52.23.908 E026.08.26.250
N051.52.23.908 E026.08.26.250 N051.51.32.338 E026.09.59.960
N051.51.32.338 E026.09.59.960 N051.50.46.960 E026.15.37.349
N051.50.46.960 E026.15.37.349 N051.50.28.399 E026.20.01.370
N051.50.28.399 E026.20.01.370 N051.49.34.769 E026.25.37.581
N051.49.34.769 E026.25.37.581 N051.48.49.388 E026.28.26.720
N051.48.49.388 E026.28.26.720 N051.48.08.139 E026.30.16.160
N051.48.08.139 E026.30.16.160 N051.48.18.449 E026.37.10.628
N051.48.18.449 E026.37.10.628 N051.47.26.890 E026.43.09.530
N051.47.26.890 E026.43.09.530 N051.45.19.999 E026.51.10.130
N051.45.19.999 E026.51.10.130 N051.44.50.121 E026.54.07.520
N051.44.50.121 E026.54.07.520 N051.45.04.561 E026.59.41.668
N051.45.04.561 E026.59.41.668 N051.45.58.190 E027.05.38.500
N051.45.58.190 E027.05.38.500 N051.45.31.381 E027.08.02.889
N051.45.31.381 E027.08.02.889 N051.44.19.179 E027.09.46.880
N051.44.19.179 E027.09.46.880 N051.43.09.880 E027.10.04.580
N051.43.09.880 E027.10.04.580 N051.41.34.169 E027.09.25.390
N051.41.34.169 E027.09.25.390 N051.39.34.538 E027.10.19.999
N051.39.34.538 E027.10.19.999 N051.38.12.999 E027.12.04.219
N051.38.12.999 E027.12.04.219 N051.37.47.280 E027.13.34.978
N051.37.47.280 E027.13.34.978 N051.37.06.119 E027.14.47.169
N051.37.06.119 E027.14.47.169 N051.36.10.339 E027.14.34.789
N051.36.10.339 E027.14.34.789 N051.35.35.271 E027.14.01.791
N051.35.35.271 E027.14.01.791 N051.35.06.399 E027.14.40.981
N051.35.06.399 E027.14.40.981 N051.34.33.391 E027.16.28.239
N051.34.33.391 E027.16.28.239 N051.35.14.640 E027.20.11.000
N051.35.14.640 E027.20.11.000 N051.35.14.640 E027.30.11.228
N051.35.14.640 E027.30.11.228 N051.36.12.398 E027.30.58.669
N051.36.12.398 E027.30.58.669 N051.36.57.780 E027.32.17.919
N051.36.57.780 E027.32.17.919 N051.36.53.650 E027.34.22.879
N051.36.53.650 E027.34.22.879 N051.35.14.640 E027.40.50.649
N051.35.14.640 E027.40.50.649 N051.34.29.269 E027.42.54.410
N051.34.29.269 E027.42.54.410 N051.33.37.699 E027.43.31.540
N051.33.37.699 E027.43.31.540 N051.30.29.998 E027.42.35.848
N051.30.29.998 E027.42.35.848 N051.28.59.239 E027.43.06.790
N051.28.59.239 E027.43.06.790 N051.28.09.739 E027.44.41.668

;koniec granicy z UMMV


N051.28.09.739 E027.44.41.668 N051.22.59.998 E027.45.00.000
N051.22.59.998 E027.45.00.000 N050.51.00.195 E027.25.59.998
N050.51.00.195 E027.25.59.998 N050.10.54.199 E027.02.35.998
N050.10.54.199 E027.02.35.998 N049.45.42.200 E027.51.00.195
N049.45.42.200 E027.51.00.195 N048.26.42.663 E027.50.17.998
N048.26.42.663 E027.50.17.998 N048.24.37.101 E027.50.11.669
N048.24.37.101 E027.50.11.669 N048.26.23.960 E027.47.09.329
N048.26.23.960 E027.47.09.329 N048.27.14.839 E027.42.11.879
N048.27.14.839 E027.42.11.879 N048.26.57.519 E027.37.51.200
N048.26.57.519 E027.37.51.200 N048.27.53.211 E027.35.10.320
N048.27.53.211 E027.35.10.320 N048.27.53.211 E027.33.51.940
N048.27.53.211 E027.33.51.940 N048.25.22.918 E027.29.20.979
N048.25.22.918 E027.29.20.979 N048.24.53.758 E027.25.51.340
N048.24.53.758 E027.25.51.340 N048.25.57.709 E027.22.47.758
N048.25.57.709 E027.22.47.758 N048.25.41.199 E027.19.52.438
N048.25.41.199 E027.19.52.438 N048.23.06.500 E027.16.15.859
N048.23.06.500 E027.16.15.859 N048.23.53.941 E027.13.18.469
N048.23.53.941 E027.13.18.469 N048.23.00.319 E027.08.29.698
N048.23.00.319 E027.08.29.698 N048.23.10.629 E027.07.09.260
N048.23.10.629 E027.07.09.260 N048.25.22.641 E027.04.40.749
N048.25.22.641 E027.04.40.749 N048.25.45.328 E027.03.03.808
N048.25.45.328 E027.03.03.808 N048.25.18.508 E027.02.03.991
N048.25.18.508 E027.02.03.991 N048.23.37.449 E027.02.08.109
N048.23.37.449 E027.02.08.109 N048.22.52.160 E027.01.10.358
N048.22.52.160 E027.01.10.358 N048.22.12.601 E026.58.24.870
N048.22.12.601 E026.58.24.870 N048.22.43.820 E026.55.48.579
N048.22.43.820 E026.55.48.579 N048.25.16.449 E026.52.47.120
N048.25.16.449 E026.52.47.120 N048.25.51.520 E026.50.06.190
N048.25.51.520 E026.50.06.190 N048.25.45.328 E026.46.06.920
N048.25.45.328 E026.46.06.920 N048.25.26.760 E026.44.09.351
N048.25.26.760 E026.44.09.351 N048.25.02.000 E026.43.11.589
N048.25.02.000 E026.43.11.589 N048.24.14.569 E026.42.46.839
N048.24.14.569 E026.42.46.839 N048.21.23.371 E026.43.44.590
N048.21.23.371 E026.43.44.590 N048.19.58.799 E026.42.15.901
N048.19.58.799 E026.42.15.901 N048.18.40.420 E026.39.59.770
N048.18.40.420 E026.39.59.770 N048.17.22.160 E026.38.24.889
N048.17.22.160 E026.38.24.889 N048.14.24.291 E026.36.08.161
N048.14.24.291 E026.36.08.161 N048.12.27.919 E026.31.46.999
N048.12.27.919 E026.31.46.999 N048.12.41.939 E026.30.57.880
N048.12.41.939 E026.30.57.880 N048.12.57.380 E026.27.57.628
N048.12.57.380 E026.27.57.628 N048.11.11.759 E026.18.58.381
N048.11.11.759 E026.18.58.381 N048.10.00.919 E026.19.20.938
N048.10.00.919 E026.19.20.938 N048.06.32.749 E026.17.24.129
N048.06.32.749 E026.17.24.129 N048.04.46.120 E026.16.27.880
N048.04.46.120 E026.16.27.880 N048.01.37.970 E026.12.49.920
N048.01.37.970 E026.12.49.920 N047.59.43.900 E026.11.00.959
N047.59.43.900 E026.11.00.959 N047.58.56.960 E026.06.04.960
N047.58.56.960 E026.06.04.960 N047.58.53.990 E026.01.15.988
N047.58.53.990 E026.01.15.988 N047.58.30.889 E025.56.23.920
N047.58.30.889 E025.56.23.920 N047.58.23.840 E025.55.04.079
N047.58.23.840 E025.55.04.079 N047.57.45.921 E025.52.08.968
N047.57.45.921 E025.52.08.968 N047.56.25.920 E025.47.30.929
N047.56.25.920 E025.47.30.929 N047.56.08.980 E025.45.39.959
N047.56.08.980 E025.45.39.959 N047.56.02.990 E025.31.09.929
N047.56.02.990 E025.31.09.929 N047.55.19.960 E025.26.26.109
N047.55.19.960 E025.26.26.109 N047.54.59.080 E025.21.41.079
N047.54.59.080 E025.21.41.079 N047.54.38.800 E025.18.47.998
N047.54.38.800 E025.18.47.998 N047.53.08.080 E025.14.15.939
N047.53.08.080 E025.14.15.939 N047.52.15.079 E025.13.07.919
N047.52.15.079 E025.13.07.919 N047.51.47.960 E025.13.06.600
N047.51.47.960 E025.13.06.600 N047.50.13.999 E025.11.21.019
N047.50.13.999 E025.11.21.019 N047.46.26.900 E025.08.10.119
N047.46.26.900 E025.08.10.119 N047.44.27.000 E025.04.16.939
N047.44.27.000 E025.04.16.939 N047.43.24.970 E024.59.32.089
N047.43.24.970 E024.59.32.089 N047.42.43.920 E024.54.46.999
N047.42.43.920 E024.54.46.999 N047.42.57.949 E024.53.50.931
N047.42.57.949 E024.53.50.931 N047.43.59.998 E024.52.59.599
N047.43.59.998 E024.52.59.599 N047.48.46.951 E024.48.59.879
N047.48.46.951 E024.48.59.879 N047.50.05.949 E024.44.11.940
N047.50.05.949 E024.44.11.940 N047.51.55.889 E024.40.13.918
N047.51.55.889 E024.40.13.918 N047.52.21.040 E024.40.05.120
N047.52.21.040 E024.40.05.120 N047.53.34.920 E024.40.26.960
N047.53.34.920 E024.40.26.960 N047.55.57.079 E024.37.01.959
N047.55.57.079 E024.37.01.959 N047.56.58.879 E024.34.25.989
N047.56.58.879 E024.34.25.989 N047.57.22.701 E024.29.54.459
N047.57.22.701 E024.29.54.459 N047.57.33.771 E024.25.41.311
N047.57.33.771 E024.25.41.311 N047.57.10.960 E024.24.13.960
N047.57.10.960 E024.24.13.960 N047.55.44.839 E024.19.36.940
N047.55.44.839 E024.19.36.940 N047.54.14.911 E024.14.58.898
N047.54.14.911 E024.14.58.898 N047.54.42.958 E024.07.31.918
N047.54.42.958 E024.07.31.918 N047.56.17.019 E024.05.21.980
N047.56.17.019 E024.05.21.980 N047.57.23.489 E024.01.43.399
N047.57.23.489 E024.01.43.399 N047.58.02.959 E023.48.51.749
N047.58.02.959 E023.48.51.749 N047.59.57.739 E023.34.04.940
N047.59.57.739 E023.34.04.940 N047.59.23.159 E023.30.49.150
N047.59.23.159 E023.30.49.150 N047.59.09.919 E023.30.44.040
N047.59.09.919 E023.30.44.040 N047.58.38.931 E023.29.32.839
N047.58.38.931 E023.29.32.839 N047.59.04.919 E023.27.48.949
N047.59.04.919 E023.27.48.949 N048.02.47.968 E023.17.45.661
N048.02.47.968 E023.17.45.661 N048.04.38.539 E023.16.37.959
N048.04.38.539 E023.16.37.959 N048.05.28.528 E023.15.31.129
N048.05.28.528 E023.15.31.129 N048.06.29.689 E023.10.33.000
N048.06.29.689 E023.10.33.000 N048.06.14.990 E023.08.54.578
N048.06.14.990 E023.08.54.578 N048.05.12.649 E023.07.22.259
N048.05.12.649 E023.07.22.259 N048.02.37.978 E023.06.23.338
N048.02.37.978 E023.06.23.338 N048.00.49.168 E023.05.19.150
N048.00.49.168 E023.05.19.150 N047.59.27.279 E023.01.57.291
N047.59.27.279 E023.01.57.291 N047.57.13.949 E022.53.46.100
N047.57.13.949 E022.53.46.100 N047.59.43.900 E022.51.47.908
N047.59.43.900 E022.51.47.908 N048.02.25.000 E022.53.09.999
N048.02.25.000 E022.53.09.999 N048.05.10.208 E022.50.30.818
N048.05.10.208 E022.50.30.818 N048.07.04.920 E022.47.17.079
N048.07.04.920 E022.47.17.079 N048.06.51.901 E022.44.15.979
N048.06.51.901 E022.44.15.979 N048.05.42.291 E022.40.57.248
N048.05.42.291 E022.40.57.248 N048.06.05.911 E022.37.13.969
N048.06.05.911 E022.37.13.969 N048.07.43.060 E022.36.06.930
N048.07.43.060 E022.36.06.930 N048.09.03.088 E022.35.44.039
N048.09.03.088 E022.35.44.039 N048.10.24.970 E022.34.31.879
N048.10.24.970 E022.34.31.879 N048.10.59.998 E022.34.14.998
N048.10.59.998 E022.34.14.998 N048.11.27.059 E022.34.34.939
N048.11.27.059 E022.34.34.939 N048.11.40.959 E022.34.31.879
N048.11.40.959 E022.34.31.879 N048.12.58.119 E022.31.54.159
N048.12.58.119 E022.31.54.159 N048.15.01.990 E022.29.04.909
N048.15.01.990 E022.29.04.909 N048.14.41.978 E022.26.38.079
N048.14.41.978 E022.26.38.079 N048.15.47.991 E022.21.52.988
N048.15.47.991 E022.21.52.988 N048.17.06.169 E022.20.53.408
N048.17.06.169 E022.20.53.408 N048.17.58.999 E022.20.14.839
N048.17.58.999 E022.20.14.839 N048.18.46.789 E022.19.36.631
N048.18.46.789 E022.19.36.631 N048.19.43.949 E022.18.52.919
N048.19.43.949 E022.18.52.919 N048.21.41.939 E022.19.10.880
N048.21.41.939 E022.19.10.880 N048.23.00.931 E022.15.16.959
N048.23.00.931 E022.15.16.959 N048.23.34.969 E022.15.41.918
N048.23.34.969 E022.15.41.918 N048.23.48.991 E022.16.09.969
N048.23.48.991 E022.16.09.969 N048.24.14.990 E022.16.16.989
N048.24.14.990 E022.16.16.989 N048.24.25.920 E022.16.07.910
N048.24.25.920 E022.16.07.910 N048.24.45.928 E022.11.09.120
N048.24.45.928 E022.11.09.120 N048.24.38.458 E022.09.11.960

;poczatek wspolnej z LZBB
N049.05.16.338 E022.34.12.363 N049.02.30.199 E022.33.15.199
N049.02.30.199 E022.33.15.199 N048.59.39.998 E022.32.09.999
N048.59.39.998 E022.32.09.999 N048.57.15.199 E022.27.44.999
N048.57.15.199 E022.27.44.999 N048.53.30.199 E022.25.30.490
N048.53.30.199 E022.25.30.490 N048.49.54.998 E022.22.30.237
N048.49.54.998 E022.22.30.237 N048.48.29.998 E022.23.14.999
N048.48.29.998 E022.23.14.999 N048.43.59.998 E022.21.00.195
N048.43.59.998 E022.21.00.195 N048.41.01.971 E022.19.35.999
N048.41.01.971 E022.19.35.999 N048.40.12.040 E022.17.54.960
N048.40.12.040 E022.17.54.960 N048.37.17.968 E022.13.57.961
N048.37.17.968 E022.13.57.961 N048.34.58.940 E022.09.43.000
N048.34.58.940 E022.09.43.000 N048.33.24.879 E022.09.32.039
N048.33.24.879 E022.09.32.039 N048.29.53.840 E022.09.30.120
N048.29.53.840 E022.09.30.120 N048.25.19.199 E022.09.12.920
N048.25.19.199 E022.09.12.920 N048.24.38.458 E022.09.11.960
;koniec wspolnej z LZBB

;poczatek granicy z FIR
;R
N049.05.16.338 E022.34.12.363 N049.05.29.013 E022.36.51.829
N049.05.29.013 E022.36.51.829 N049.02.30.526 E022.41.35.915
N049.02.30.526 E022.41.35.915 N049.03.27.559 E022.46.41.115
N049.03.27.559 E022.46.41.115 N049.02.21.023 E022.48.26.728
N049.02.21.023 E022.48.26.728 N049.05.34.286 E022.54.08.898
N049.05.34.286 E022.54.08.898 N049.07.08.275 E022.50.11.277
N049.07.08.275 E022.50.11.277 N049.09.35.066 E022.47.41.314
N049.09.35.066 E022.47.41.314 N049.09.51.971 E022.45.02.905
N049.09.51.971 E022.45.02.905 N049.10.58.507 E022.45.25.083
N049.10.58.507 E022.45.25.083 N049.10.29.984 E022.43.44.751
N049.10.29.984 E022.43.44.751 N049.10.25.768 E022.42.47.725
N049.10.25.768 E022.42.47.725 N049.11.23.844 E022.43.12.011
N049.11.23.844 E022.43.12.011 N049.13.08.406 E022.45.05.013
N049.13.08.406 E022.45.05.013 N049.13.50.649 E022.43.58.483
N049.13.50.649 E022.43.58.483 N049.16.30.102 E022.47.21.250
N049.16.30.102 E022.47.21.250 N049.19.35.977 E022.48.47.850
N049.19.35.977 E022.48.47.850 N049.26.59.536 E022.41.46.476
N049.26.59.536 E022.41.46.476 N049.28.33.524 E022.42.07.597
N049.28.33.524 E022.42.07.597 N049.31.36.227 E022.40.00.863
N049.31.36.227 E022.40.00.863 N049.32.41.691 E022.40.10.366
N049.32.41.691 E022.40.10.366 N049.41.21.290 E022.48.04.550
N049.41.21.290 E022.48.04.550 N049.43.01.609 E022.51.12.526
N049.43.01.609 E022.51.12.526 N049.51.07.410 E022.59.59.512
N049.51.07.410 E022.59.59.512 N049.52.26.622 E023.02.05.182
N049.52.26.622 E023.02.05.182 N049.53.10.965 E023.02.35.814
N049.53.10.965 E023.02.35.814 N049.53.48.992 E023.03.13.833
N049.53.48.992 E023.03.13.833 N049.56.01.006 E023.05.55.408
N049.56.01.006 E023.05.55.408 N049.56.41.134 E023.06.22.867
N049.56.41.134 E023.06.22.867 N049.57.18.089 E023.07.04.052
N049.57.18.089 E023.07.04.052 N049.57.39.210 E023.07.46.294
N049.57.39.210 E023.07.46.294 N049.58.11.949 E023.08.19.033
N049.58.11.949 E023.08.19.033 N049.58.32.013 E023.08.54.945
N049.58.32.013 E023.08.54.945 N049.59.59.670 E023.10.39.494
N049.59.59.670 E023.10.39.494 N050.01.03.034 E023.12.05.036
N050.01.03.034 E023.12.05.036 N050.03.36.170 E023.14.10.706
N050.03.36.170 E023.14.10.706 N050.04.04.679 E023.15.44.701
N050.04.04.679 E023.15.44.701 N050.05.49.228 E023.17.37.695
N050.05.49.228 E023.17.37.695 N050.08.16.033 E023.21.38.481
N050.08.16.033 E023.21.38.481 N050.10.45.996 E023.25.54.057
N050.10.45.996 E023.25.54.057 N050.12.21.042 E023.27.25.937
N050.12.21.042 E023.27.25.937 N050.16.38.726 E023.35.53.904
N050.16.38.726 E023.35.53.904 N050.18.12.714 E023.36.50.930
N050.18.12.714 E023.36.50.930 N050.19.46.702 E023.40.12.646
N050.19.46.702 E023.40.12.646 N050.20.40.562 E023.41.23.405
N050.20.40.562 E023.41.23.405 N050.23.44.323 E023.43.24.852
N050.23.44.323 E023.43.24.852 N050.24.20.220 E023.45.04.120
N050.24.20.220 E023.45.04.120 N050.25.10.922 E023.47.14.019
N050.25.10.922 E023.47.14.019 N050.24.50.858 E023.54.41.795
N050.24.50.858 E023.54.41.795 N050.25.25.699 E023.59.59.670
N050.25.25.699 E023.59.59.670 N050.27.10.247 E024.02.58.150
N050.27.10.247 E024.02.58.150 N050.38.18.752 E024.05.59.795
N050.38.18.752 E024.05.59.795 N050.41.15.110 E024.03.57.291
N050.41.15.110 E024.03.57.291 N050.42.58.615 E024.04.50.094
N050.42.58.615 E024.04.50.094 N050.46.25.597 E023.59.59.670
N050.46.25.597 E023.59.59.670 N050.47.00.451 E023.58.13.014
N050.47.00.451 E023.58.13.014 N050.48.56.618 E023.58.04.561
N050.48.56.618 E023.58.04.561 N050.50.27.448 E023.59.59.670
N050.50.27.448 E023.59.59.670 N050.50.14.772 E024.06.40.980
N050.50.14.772 E024.06.40.980 N050.51.49.818 E024.08.56.160
N050.51.49.818 E024.08.56.160 N050.56.29.680 E023.59.59.670
N050.56.29.680 E023.59.59.670 N050.56.56.075 E023.59.14.263
N050.56.56.075 E023.59.14.263 N050.57.16.139 E023.58.49.976
N050.57.16.139 E023.58.49.976 N050.58.43.796 E023.58.24.632
N050.58.43.796 E023.58.24.632 N050.58.58.586 E023.58.09.841
N050.58.58.586 E023.58.09.841 N050.59.59.835 E023.56.21.063
N050.59.59.835 E023.56.21.063 N051.00.09.338 E023.55.45.158
N051.00.09.338 E023.55.45.158 N051.02.18.181 E023.56.03.114
N051.02.18.181 E023.56.03.114 N051.04.08.016 E023.55.18.757
N051.04.08.016 E023.55.18.757 N051.07.19.165 E023.51.34.869
N051.07.19.165 E023.51.34.869 N051.08.56.325 E023.52.42.463
N051.08.56.325 E023.52.42.463 N051.13.01.334 E023.44.37.718
N051.13.01.334 E023.44.37.718 N051.16.11.425 E023.43.22.737
N051.16.11.425 E023.43.22.737 N051.17.30.636 E023.39.15.620
N051.17.30.636 E023.39.15.620 N051.18.51.949 E023.38.44.989
N051.18.51.949 E023.38.44.989 N051.20.01.657 E023.39.06.110
N051.20.01.657 E023.39.06.110 N051.24.39.405 E023.42.29.934
N051.24.39.405 E023.42.29.934 N051.26.46.119 E023.39.31.454
N051.26.46.119 E023.39.31.454 N051.27.54.770 E023.40.28.487
;koniec granicy z FIR


UMMV N054.00.00.330 E023.28.52.530 N053.54.32.489 E023.37.06.481
N053.54.32.489 E023.37.06.481 N053.53.59.999 E023.48.00.398
N053.53.59.999 E023.48.00.398 N053.55.44.691 E023.55.38.251
N053.55.44.691 E023.55.38.251 N053.56.21.811 E024.11.45.628
N053.56.21.811 E024.11.45.628 N053.54.11.869 E024.17.21.840
N053.54.11.869 E024.17.21.840 N053.53.28.550 E024.24.41.180
N053.53.28.550 E024.24.41.180 N054.00.47.998 E024.40.03.667
N054.00.47.998 E024.40.03.667 N054.00.05.000 E024.41.35.599
N054.00.05.000 E024.41.35.599 N053.56.52.760 E024.44.47.828
N053.56.52.760 E024.44.47.828 N053.58.17.320 E024.48.12.120
N053.58.17.320 E024.48.12.120 N054.03.57.661 E024.48.24.411
N054.03.57.661 E024.48.24.411 N054.06.10.000 E024.47.39.998
N054.06.10.000 E024.47.39.998 N054.08.30.199 E024.50.09.999
N054.08.30.199 E024.50.09.999 N054.09.29.998 E024.58.19.999
N054.09.29.998 E024.58.19.999 N054.08.44.998 E025.00.00.000
N054.08.44.998 E025.00.00.000 N054.07.59.998 E025.03.00.547
N054.07.59.998 E025.03.00.547 N054.10.44.999 E025.10.32.761
N054.10.44.999 E025.10.32.761 N054.12.16.819 E025.13.52.831
N054.12.16.819 E025.13.52.831 N054.16.27.998 E025.16.06.999
N054.16.27.998 E025.16.06.999 N054.15.59.590 E025.27.23.450
N054.15.59.590 E025.27.23.450 N054.15.12.149 E025.32.34.918
N054.15.12.149 E025.32.34.918 N054.12.46.299 E025.34.00.559
N054.12.46.299 E025.34.00.559 N054.10.52.251 E025.35.07.551
N054.10.52.251 E025.35.07.551 N054.09.19.429 E025.34.18.079
N054.09.19.429 E025.34.18.079 N054.08.09.301 E025.42.55.771
N054.08.09.301 E025.42.55.771 N054.10.00.199 E025.46.59.998
N054.10.00.199 E025.46.59.998 N054.14.43.270 E025.46.44.720
N054.14.43.270 E025.46.44.720 N054.16.59.998 E025.43.00.200
N054.16.59.998 E025.43.00.200 N054.18.17.780 E025.35.42.619
N054.18.17.780 E025.35.42.619 N054.19.44.410 E025.35.05.488
N054.19.44.410 E025.35.05.488 N054.28.00.200 E025.37.00.199
N054.28.00.200 E025.37.00.199 N054.33.21.229 E025.43.43.208
N054.33.21.229 E025.43.43.208 N054.35.18.380 E025.44.00.430
N054.35.18.380 E025.44.00.430 N054.38.05.539 E025.44.24.169
N054.38.05.539 E025.44.24.169 N054.47.11.130 E025.46.14.401
N054.47.11.130 E025.46.14.401 N054.52.41.998 E025.49.00.199
N054.52.41.998 E025.49.00.199 N054.57.54.878 E026.08.37.769
N054.57.54.878 E026.08.37.769 N055.00.00.000 E026.13.00.200
N055.00.00.000 E026.13.00.200 N055.02.42.730 E026.14.29.281
N055.02.42.730 E026.14.29.281 N055.05.33.928 E026.14.06.590
N055.05.33.928 E026.14.06.590 N055.08.16.879 E026.16.20.668
N055.08.16.879 E026.16.20.668 N055.07.56.251 E026.19.57.241
N055.07.56.251 E026.19.57.241 N055.06.04.870 E026.27.04.208
N055.06.04.870 E026.27.04.208 N055.07.25.309 E026.30.32.540
N055.07.25.309 E026.30.32.540 N055.08.33.381 E026.40.08.840
N055.08.33.381 E026.40.08.840 N055.12.01.699 E026.43.15.718
N055.12.01.699 E026.43.15.718 N055.15.52.718 E026.51.22.499
N055.15.52.718 E026.51.22.499 N055.17.46.168 E026.51.06.199
N055.17.46.168 E026.51.06.199 N055.18.06.789 E026.48.35.431
N055.18.06.789 E026.48.35.431 N055.17.58.538 E026.31.50.919
N055.17.58.538 E026.31.50.919 N055.19.06.610 E026.27.31.120
N055.19.06.610 E026.27.31.120 N055.21.26.870 E026.27.47.530
N055.21.26.870 E026.27.47.530 N055.22.34.939 E026.30.26.348
N055.22.34.939 E026.30.26.348 N055.26.58.959 E026.33.17.549
N055.26.58.959 E026.33.17.549 N055.36.24.119 E026.38.49.639
N055.36.24.119 E026.38.49.639 N055.40.50.600 E026.37.50.599
;koniec granicy z EYVL
N055.40.50.600 E026.37.50.599 N055.42.34.999 E026.39.45.037
N055.42.34.999 E026.39.45.037 N055.41.14.999 E026.45.15.199
N055.41.14.999 E026.45.15.199 N055.42.44.999 E026.51.20.600
N055.42.44.999 E026.51.20.600 N055.44.30.199 E026.52.59.998
N055.44.30.199 E026.52.59.998 N055.46.45.200 E026.53.59.999
N055.46.45.200 E026.53.59.999 N055.49.59.998 E026.59.35.599
N055.49.59.998 E026.59.35.599 N055.50.44.998 E027.08.59.999
N055.50.44.998 E027.08.59.999 N055.49.24.999 E027.12.44.999
N055.49.24.999 E027.12.44.999 N055.48.20.600 E027.20.30.001
N055.48.20.600 E027.20.30.001 N055.47.15.142 E027.31.59.998
N055.47.15.142 E027.31.59.998 N055.47.30.199 E027.35.54.999
N055.47.30.199 E027.35.54.999 N055.51.00.195 E027.38.09.999
N055.51.00.195 E027.38.09.999 N055.51.44.999 E027.37.50.599
N055.51.44.999 E027.37.50.599 N055.54.45.037 E027.38.35.600
N055.54.45.037 E027.38.35.600 N055.55.35.000 E027.38.59.999
N055.55.35.000 E027.38.59.999 N056.00.29.998 E027.48.50.999
N056.00.29.998 E027.48.50.999 N056.04.09.998 E027.53.49.999
N056.04.09.998 E027.53.49.999 N056.07.00.199 E027.55.59.998
N056.07.00.199 E027.55.59.998 N056.10.23.998 E028.08.48.200
N056.10.23.998 E028.08.48.200 N056.08.59.999 E028.10.00.200
N056.08.59.999 E028.10.00.200 N056.02.59.999 E028.19.59.998
N056.02.59.999 E028.19.59.998 N056.06.00.095 E028.23.30.200
N056.06.00.095 E028.23.30.200 N056.06.00.095 E028.38.59.999
N056.06.00.095 E028.38.59.999 N056.01.29.999 E028.42.50.000
N056.01.29.999 E028.42.50.000 N055.57.29.998 E028.43.40.000
N055.57.29.998 E028.43.40.000 N055.56.30.200 E028.51.00.195
N055.56.30.200 E028.51.00.195 N055.58.59.998 E028.51.29.998
N055.58.59.998 E028.51.29.998 N056.01.59.998 E029.04.00.199
N056.01.59.998 E029.04.00.199 N055.57.00.039 E029.25.00.200
N055.57.00.039 E029.25.00.200 N055.54.39.999 E029.28.00.200
N055.54.39.999 E029.28.00.200 N055.53.59.999 E029.24.29.998
N055.53.59.999 E029.24.29.998 N055.47.59.999 E029.20.49.999
N055.47.59.999 E029.20.49.999 N055.41.30.200 E029.30.00.000
N055.41.30.200 E029.30.00.000 N055.46.29.999 E029.37.59.998
N055.46.29.999 E029.37.59.998 N055.51.29.998 E029.58.00.200
N055.51.29.998 E029.58.00.200 N055.51.20.600 E030.15.29.998
N055.51.20.600 E030.15.29.998 N055.47.59.999 E030.28.59.998
N055.47.59.999 E030.28.59.998 N055.43.40.000 E030.36.20.600
N055.43.40.000 E030.36.20.600 N055.38.59.999 E030.40.00.200
N055.38.59.999 E030.40.00.200 N055.35.20.000 E030.46.00.200
N055.35.20.000 E030.46.00.200 N055.37.29.999 E030.51.39.999
N055.37.29.999 E030.51.39.999 N055.37.18.200 E030.55.54.200
N055.37.18.200 E030.55.54.200 N055.23.59.999 E030.55.59.998
N055.23.59.999 E030.55.59.998 N055.17.59.999 E030.48.39.999
N055.17.59.999 E030.48.39.999 N055.11.39.998 E030.56.59.999
N055.11.39.998 E030.56.59.999 N055.02.30.199 E031.01.35.000
N055.02.30.199 E031.01.35.000 N054.57.44.999 E030.55.50.599
N054.57.44.999 E030.55.50.599 N054.57.00.039 E030.51.15.200
N054.57.00.039 E030.51.15.200 N054.47.39.998 E030.46.29.999
N054.47.39.998 E030.46.29.999 N054.45.45.023 E030.53.30.200
N054.45.45.023 E030.53.30.200 N054.38.59.999 E031.06.45.536
N054.38.59.999 E031.06.45.536 N054.34.40.000 E031.08.20.999
N054.34.40.000 E031.08.20.999 N054.30.00.000 E031.04.40.999
N054.30.00.000 E031.04.40.999 N054.27.20.600 E031.14.30.199
N054.27.20.600 E031.14.30.199 N054.19.59.998 E031.19.00.199
N054.19.59.998 E031.19.00.199 N054.14.20.000 E031.19.59.998
N054.14.20.000 E031.19.59.998 N054.09.45.137 E031.31.00.200
N054.09.45.137 E031.31.00.200 N054.06.39.999 E031.40.59.998
N054.06.39.999 E031.40.59.998 N054.06.29.998 E031.45.29.998
N054.06.29.998 E031.45.29.998 N054.04.00.200 E031.51.00.195
N054.04.00.200 E031.51.00.195 N054.00.00.000 E031.52.29.999
N054.00.00.000 E031.52.29.999 N053.51.20.600 E031.48.00.398
N053.51.20.600 E031.48.00.398 N053.47.59.999 E031.45.44.999
N053.47.59.999 E031.45.44.999 N053.46.29.999 E031.54.29.998
N053.46.29.999 E031.54.29.998 N053.49.00.200 E032.07.00.199
N053.49.00.200 E032.07.00.199 N053.43.59.998 E032.27.00.019
N053.43.59.998 E032.27.00.019 N053.40.59.998 E032.31.29.999
N053.40.59.998 E032.31.29.999 N053.38.30.199 E032.25.00.199
N053.38.30.199 E032.25.00.199 N053.33.44.999 E032.27.00.019
N053.33.44.999 E032.27.00.019 N053.30.29.998 E032.37.00.199
N053.30.29.998 E032.37.00.199 N053.28.00.200 E032.45.00.000
N053.28.00.200 E032.45.00.000 N053.21.20.600 E032.42.29.998
N053.21.20.600 E032.42.29.998 N053.07.59.998 E032.19.30.028
N053.07.59.998 E032.19.30.028 N053.04.59.998 E032.09.39.999
N053.04.59.998 E032.09.39.999 N053.05.49.999 E031.55.00.200
N053.05.49.999 E031.55.00.200 N053.07.29.999 E031.48.20.599
N053.07.29.999 E031.48.20.599 N053.11.44.998 E031.46.00.200
N053.11.44.998 E031.46.00.200 N053.13.00.200 E031.36.00.195
N053.13.00.200 E031.36.00.195 N053.13.00.200 E031.25.00.200
N053.13.00.200 E031.25.00.200 N053.07.29.999 E031.22.30.237
N053.07.29.999 E031.22.30.237 N053.06.29.998 E031.24.15.200
N053.06.29.998 E031.24.15.200 N053.01.45.200 E031.16.00.200
N053.01.45.200 E031.16.00.200 N052.52.45.200 E031.25.45.199
N052.52.45.200 E031.25.45.199 N052.51.00.195 E031.33.00.398
N052.51.00.195 E031.33.00.398 N052.43.59.998 E031.35.30.200
N052.43.59.998 E031.35.30.200 N052.40.00.199 E031.31.00.200
N052.40.00.199 E031.31.00.200 N052.34.59.998 E031.36.00.195
N052.34.59.998 E031.36.00.195 N052.22.00.199 E031.37.29.999
N052.22.00.199 E031.37.29.999 N052.19.00.200 E031.34.29.999
N052.19.00.200 E031.34.29.999 N052.09.45.137 E031.47.30.200
N052.09.45.137 E031.47.30.200 N052.06.54.140 E031.47.35.998
N052.06.54.140 E031.47.35.998 N052.05.48.811 E031.46.39.921
N052.05.48.811 E031.46.39.921 N052.05.59.931 E031.38.01.489
N052.05.59.931 E031.38.01.489 N052.06.15.209 E031.33.25.289
N052.06.15.209 E031.33.25.289 N052.06.22.161 E031.28.26.450
N052.06.22.161 E031.28.26.450 N052.06.02.710 E031.23.29.871
N052.06.02.710 E031.23.29.871 N052.05.19.640 E031.21.14.039
N052.05.19.640 E031.21.14.039 N052.03.54.899 E031.19.20.841
N052.03.54.899 E031.19.20.841 N052.02.30.159 E031.18.12.920
N052.02.30.159 E031.18.12.920 N052.01.47.999 E031.17.16.321
N052.01.47.999 E031.17.16.321 N052.01.47.999 E031.14.55.960
N052.01.47.999 E031.14.55.960 N052.02.24.608 E031.09.59.389
N052.02.24.608 E031.09.59.389 N052.02.56.558 E031.08.15.248
N052.02.56.558 E031.08.15.248 N052.03.00.730 E031.06.01.670
N052.03.00.730 E031.06.01.670 N052.03.41.119 E031.02.53.768
N052.03.41.119 E031.02.53.768 N052.03.52.120 E030.59.09.639
N052.03.52.120 E030.59.09.639 N052.03.17.119 E030.57.56.761
N052.03.17.119 E030.57.56.761 N051.57.04.831 E030.50.26.368
N051.57.04.831 E030.50.26.368 N051.53.16.418 E030.46.34.370
N051.53.16.418 E030.46.34.370 N051.49.35.230 E030.41.06.809
N051.49.35.230 E030.41.06.809 N051.48.12.430 E030.39.44.640
N051.48.12.430 E030.39.44.640 N051.47.05.910 E030.39.29.408
N051.47.05.910 E030.39.29.408 N051.45.41.821 E030.38.53.181
N051.45.41.821 E030.38.53.181 N051.44.30.130 E030.37.30.878
N051.44.30.130 E030.37.30.878 N051.43.06.571 E030.37.44.378
N051.43.06.571 E030.37.44.378 N051.42.03.769 E030.37.23.160
N051.42.03.769 E030.37.23.160 N051.41.47.500 E030.36.40.910
N051.41.47.500 E030.36.40.910 N051.41.32.110 E030.35.12.400
N051.41.32.110 E030.35.12.400 N051.41.03.231 E030.34.31.148
N051.41.03.231 E030.34.31.148 N051.40.00.850 E030.33.57.470
N051.40.00.850 E030.33.57.470 N051.38.53.289 E030.32.48.920
N051.38.53.289 E030.32.48.920 N051.37.15.848 E030.33.20.559
N051.37.15.848 E030.33.20.559 N051.35.58.171 E030.32.20.248
N051.35.58.171 E030.32.20.248 N051.34.35.159 E030.31.59.970
N051.34.35.159 E030.31.59.970 N051.33.27.119 E030.32.22.970
N051.33.27.119 E030.32.22.970 N051.29.02.601 E030.34.45.919
N051.29.02.601 E030.34.45.919 N051.26.51.360 E030.36.12.218
N051.26.51.360 E030.36.12.218 N051.24.47.559 E030.37.52.730
N051.24.47.559 E030.37.52.730 N051.22.32.811 E030.38.29.320
N051.22.32.811 E030.38.29.320 N051.21.13.880 E030.38.05.668
N051.21.13.880 E030.38.05.668 N051.19.27.890 E030.37.03.788
N051.19.27.890 E030.37.03.788 N051.19.06.999 E030.36.24.200
N051.19.06.999 E030.36.24.200 N051.18.03.319 E030.35.18.589
N051.18.03.319 E030.35.18.589 N051.16.41.519 E030.34.57.471
N051.16.41.519 E030.34.57.471 N051.15.21.110 E030.33.57.481
N051.15.21.110 E030.33.57.481 N051.15.38.689 E030.30.49.460
N051.15.38.689 E030.30.49.460 N051.16.34.330 E030.27.41.439
N051.16.34.330 E030.27.41.439 N051.18.27.111 E030.24.40.460
N051.18.27.111 E030.24.40.460 N051.19.50.509 E030.22.53.810
N051.19.50.509 E030.22.53.810 N051.21.06.868 E030.21.48.960
N051.21.06.868 E030.21.48.960 N051.25.55.671 E030.18.19.648
N051.25.55.671 E030.18.19.648 N051.26.54.830 E030.16.24.358
N051.26.54.830 E030.16.24.358 N051.28.12.860 E030.10.56.161
N051.28.12.860 E030.10.56.161 N051.28.32.430 E030.06.38.339
N051.28.32.430 E030.06.38.339 N051.28.26.920 E030.01.14.991
N051.28.26.920 E030.01.14.991 N051.27.56.739 E029.57.52.869
N051.27.56.739 E029.57.52.869 N051.27.09.878 E029.54.47.188
N051.27.09.878 E029.54.47.188 N051.27.08.729 E029.51.27.120
N051.27.08.729 E029.51.27.120 N051.27.53.809 E029.47.20.641
N051.27.53.809 E029.47.20.641 N051.28.56.780 E029.44.50.218
N051.28.56.780 E029.44.50.218 N051.29.43.141 E029.41.08.271
N051.29.43.141 E029.41.08.271 N051.29.31.919 E029.38.29.468
N051.29.31.919 E029.38.29.468 N051.28.17.569 E029.36.01.198
N051.28.17.569 E029.36.01.198 N051.25.28.851 E029.32.05.380
N051.25.28.851 E029.32.05.380 N051.23.30.901 E029.32.04.200
N051.23.30.901 E029.32.04.200 N051.22.38.308 E029.30.13.258
N051.22.38.308 E029.30.13.258 N051.22.42.420 E029.23.02.511
N051.22.42.420 E029.23.02.511 N051.23.33.079 E029.20.09.848
N051.23.33.079 E029.20.09.848 N051.24.32.920 E029.18.55.360
N051.24.32.920 E029.18.55.360 N051.35.29.960 E029.14.04.560
N051.35.29.960 E029.14.04.560 N051.37.00.109 E029.10.12.939
N051.37.00.109 E029.10.12.939 N051.37.16.039 E029.08.12.519
N051.37.16.039 E029.08.12.519 N051.36.55.119 E029.06.16.419
N051.36.55.119 E029.06.16.419 N051.34.19.318 E029.03.20.300
N051.34.19.318 E029.03.20.300 N051.33.33.411 E029.00.36.550
N051.33.33.411 E029.00.36.550 N051.33.07.039 E028.54.54.871
N051.33.07.039 E028.54.54.871 N051.32.42.410 E028.52.41.210
N051.32.42.410 E028.52.41.210 N051.31.44.259 E028.49.56.578
N051.31.44.259 E028.49.56.578 N051.30.05.248 E028.48.36.129
N051.30.05.248 E028.48.36.129 N051.27.56.869 E028.48.30.128
N051.27.56.869 E028.48.30.128 N051.25.57.730 E028.48.11.379
N051.25.57.730 E028.48.11.379 N051.25.02.880 E028.47.09.499
N051.25.02.880 E028.47.09.499 N051.25.00.079 E028.44.43.389
N051.25.00.079 E028.44.43.389 N051.25.37.419 E028.41.49.599
N051.25.37.419 E028.41.49.599 N051.26.22.228 E028.40.16.939
N051.26.22.228 E028.40.16.939 N051.27.52.898 E028.39.44.039
N051.27.52.898 E028.39.44.039 N051.31.11.000 E028.40.42.031
N051.31.11.000 E028.40.42.031 N051.32.15.190 E028.40.08.720
N051.32.15.190 E028.40.08.720 N051.32.37.888 E028.38.13.210
N051.32.37.888 E028.38.13.210 N051.32.42.080 E028.34.13.951
N051.32.42.080 E028.34.13.951 N051.32.25.439 E028.30.18.270
N051.32.25.439 E028.30.18.270 N051.32.11.389 E028.28.08.461
N051.32.11.389 E028.28.08.461 N051.32.25.990 E028.25.02.071
N051.32.25.990 E028.25.02.071 N051.32.54.110 E028.22.57.190
N051.32.54.110 E028.22.57.190 N051.33.59.378 E028.21.13.500
N051.33.59.378 E028.21.13.500 N051.35.08.901 E028.19.18.400
N051.35.08.901 E028.19.18.400 N051.35.49.581 E028.17.34.861
N051.35.49.581 E028.17.34.861 N051.36.47.858 E028.16.44.079
N051.36.47.858 E028.16.44.079 N051.38.25.000 E028.17.19.240
N051.38.25.000 E028.17.19.240 N051.39.12.358 E028.16.36.260
N051.39.12.358 E028.16.36.260 N051.39.15.000 E028.14.43.760
N051.39.15.000 E028.14.43.760 N051.38.46.679 E028.13.22.400
N051.38.46.679 E028.13.22.400 N051.37.35.828 E028.12.23.281
N051.37.35.828 E028.12.23.281 N051.35.54.560 E028.10.16.910
N051.35.54.560 E028.10.16.910 N051.34.59.790 E028.06.50.209
N051.34.59.790 E028.06.50.209 N051.33.36.860 E028.02.25.040
N051.33.36.860 E028.02.25.040 N051.33.17.071 E027.58.26.731
N051.33.17.071 E027.58.26.731 N051.34.05.210 E027.56.49.840
N051.34.05.210 E027.56.49.840 N051.35.53.840 E027.55.21.000
N051.35.53.840 E027.55.21.000 N051.36.10.429 E027.53.28.230
N051.36.10.429 E027.53.28.230 N051.35.47.760 E027.52.05.278
N051.35.47.760 E027.52.05.278 N051.34.47.830 E027.50.46.759
N051.34.47.830 E027.50.46.759 N051.31.39.421 E027.49.56.549
N051.31.39.421 E027.49.56.549 N051.30.13.831 E027.49.21.190
N051.30.13.831 E027.49.21.190 N051.28.34.489 E027.48.01.749
N051.28.34.489 E027.48.01.749 N051.27.59.428 E027.46.22.738
N051.27.59.428 E027.46.22.738 N051.28.04.508 E027.45.36.539
N051.28.04.508 E027.45.36.539 N051.28.09.739 E027.44.41.668



N051.28.09.739 E027.44.41.668 N051.28.59.239 E027.43.06.790
N051.28.59.239 E027.43.06.790 N051.30.29.998 E027.42.35.848
N051.30.29.998 E027.42.35.848 N051.33.37.699 E027.43.31.540
N051.33.37.699 E027.43.31.540 N051.34.29.269 E027.42.54.410
N051.34.29.269 E027.42.54.410 N051.35.14.640 E027.40.50.649
N051.35.14.640 E027.40.50.649 N051.36.53.650 E027.34.22.879
N051.36.53.650 E027.34.22.879 N051.36.57.780 E027.32.17.919
N051.36.57.780 E027.32.17.919 N051.36.12.398 E027.30.58.669
N051.36.12.398 E027.30.58.669 N051.35.14.640 E027.30.11.228
N051.35.14.640 E027.30.11.228 N051.35.14.640 E027.20.11.000
N051.35.14.640 E027.20.11.000 N051.34.33.391 E027.16.28.239
N051.34.33.391 E027.16.28.239 N051.35.06.399 E027.14.40.981
N051.35.06.399 E027.14.40.981 N051.35.35.271 E027.14.01.791
N051.35.35.271 E027.14.01.791 N051.36.10.339 E027.14.34.789
N051.36.10.339 E027.14.34.789 N051.37.06.119 E027.14.47.169
N051.37.06.119 E027.14.47.169 N051.37.47.280 E027.13.34.978
N051.37.47.280 E027.13.34.978 N051.38.12.999 E027.12.04.219
N051.38.12.999 E027.12.04.219 N051.39.34.538 E027.10.19.999
N051.39.34.538 E027.10.19.999 N051.41.34.169 E027.09.25.390
N051.41.34.169 E027.09.25.390 N051.43.09.880 E027.10.04.580
N051.43.09.880 E027.10.04.580 N051.44.19.179 E027.09.46.880
N051.44.19.179 E027.09.46.880 N051.45.31.381 E027.08.02.889
N051.45.31.381 E027.08.02.889 N051.45.58.190 E027.05.38.500
N051.45.58.190 E027.05.38.500 N051.45.04.561 E026.59.41.668
N051.45.04.561 E026.59.41.668 N051.44.50.121 E026.54.07.520
N051.44.50.121 E026.54.07.520 N051.45.19.999 E026.51.10.130
N051.45.19.999 E026.51.10.130 N051.47.26.890 E026.43.09.530
N051.47.26.890 E026.43.09.530 N051.48.18.449 E026.37.10.628
N051.48.18.449 E026.37.10.628 N051.48.08.139 E026.30.16.160
N051.48.08.139 E026.30.16.160 N051.48.53.110 E026.28.14.588
N051.48.53.110 E026.28.14.588 N051.49.34.769 E026.25.37.581
N051.49.34.769 E026.25.37.581 N051.50.28.399 E026.20.01.370
N051.50.28.399 E026.20.01.370 N051.50.46.960 E026.15.37.349
N051.50.46.960 E026.15.37.349 N051.51.32.338 E026.09.59.960
N051.51.32.338 E026.09.59.960 N051.52.23.908 E026.08.26.250
N051.52.23.908 E026.08.26.250 N051.54.09.100 E026.06.22.499
N051.54.09.100 E026.06.22.499 N051.54.25.599 E026.04.29.960
N051.54.25.599 E026.04.29.960 N051.54.23.540 E026.02.50.960
N051.54.23.540 E026.02.50.960 N051.53.38.158 E025.58.13.648
N051.53.38.158 E025.58.13.648 N051.54.24.541 E025.51.56.908
N051.54.24.541 E025.51.56.908 N051.55.17.169 E025.46.32.350
N051.55.17.169 E025.46.32.350 N051.54.56.541 E025.43.43.208
N051.54.56.541 E025.43.43.208 N051.54.13.229 E025.41.22.948
N051.54.13.229 E025.41.22.948 N051.53.29.911 E025.38.21.440
N051.53.29.911 E025.38.21.440 N051.54.13.229 E025.33.55.360
N051.54.13.229 E025.33.55.360 N051.54.31.791 E025.27.27.579
N051.54.31.791 E025.27.27.579 N051.54.50.349 E025.24.42.570
N051.54.50.349 E025.24.42.570 N051.55.31.609 E025.22.20.240
N051.55.31.609 E025.22.20.240 N051.57.27.118 E025.18.56.120
N051.57.27.118 E025.18.56.120 N051.57.43.740 E025.16.48.118
N051.57.43.740 E025.16.48.118 N051.57.45.680 E025.12.48.891
N051.57.45.680 E025.12.48.891 N051.57.12.679 E025.07.33.301
N051.57.12.679 E025.07.33.301 N051.56.31.419 E025.06.06.670
N051.56.31.419 E025.06.06.670 N051.54.17.348 E025.03.01.039
N051.54.17.348 E025.03.01.039 N051.53.35.811 E024.59.10.291
N051.53.35.811 E024.59.10.291 N051.53.38.158 E024.56.04.380
N051.53.38.158 E024.56.04.380 N051.55.10.981 E024.43.43.888
N051.55.10.981 E024.43.43.888 N051.55.27.480 E024.36.57.549
N051.55.27.480 E024.36.57.549 N051.54.23.540 E024.30.35.960
N051.54.23.540 E024.30.35.960 N051.53.09.279 E024.26.57.321
N051.53.09.279 E024.26.57.321 N051.52.19.779 E024.25.28.621
N051.52.19.779 E024.25.28.621 N051.47.26.890 E024.22.47.740
N051.47.26.890 E024.22.47.740 N051.45.45.810 E024.22.06.481
N051.45.45.810 E024.22.06.481 N051.43.00.800 E024.19.46.228
N051.43.00.800 E024.19.46.228 N051.41.17.671 E024.17.28.839
N051.41.17.671 E024.17.28.839 N051.39.38.660 E024.14.16.198
N051.39.38.660 E024.14.16.198 N051.37.20.470 E024.09.00.619
N051.37.20.470 E024.09.00.619 N051.33.48.599 E024.03.16.149
N051.33.48.599 E024.03.16.149 N051.33.37.699 E024.00.24.958
N051.33.37.699 E024.00.24.958 N051.33.52.138 E023.55.46.498
N051.33.52.138 E023.55.46.498 N051.34.16.888 E023.53.15.928
N051.34.16.888 E023.53.15.928 N051.35.00.211 E023.51.16.289
N051.35.00.211 E023.51.16.289 N051.37.41.160 E023.47.43.839
N051.37.41.160 E023.47.43.839 N051.38.36.779 E023.45.25.639
N051.38.36.779 E023.45.25.639 N051.38.49.160 E023.43.42.509
N051.38.49.160 E023.43.42.509 N051.38.30.598 E023.41.36.690
N051.38.30.598 E023.41.36.690 N051.37.59.660 E023.40.22.429
N051.37.59.660 E023.40.22.429 N051.37.08.090 E023.39.28.800
N051.37.08.090 E023.39.28.800 N051.36.10.339 E023.39.12.301
N051.36.10.339 E023.39.12.301 N051.31.50.440 E023.40.47.179
N051.31.50.440 E023.40.47.179 N051.30.38.249 E023.40.20.370
N051.30.38.249 E023.40.20.370 N051.27.54.770 E023.40.28.487 
;granica FIR poczatek
;R
N051.27.54.770 E023.40.28.487 N051.32.05.066 E023.34.22.024
N051.32.05.066 E023.34.22.024 N051.33.42.226 E023.34.46.317
N051.33.42.226 E023.34.46.317 N051.37.09.208 E023.32.36.418
N051.37.09.208 E023.32.36.418 N051.39.29.669 E023.32.42.756
N051.39.29.669 E023.32.42.756 N051.39.47.631 E023.33.28.163
N051.39.47.631 E023.33.28.163 N051.42.57.708 E023.33.29.228
N051.42.57.708 E023.33.29.228 N051.43.30.448 E023.32.27.972
N051.43.30.448 E023.32.27.972 N051.44.46.487 E023.32.31.138
N051.44.46.487 E023.32.31.138 N051.47.52.362 E023.38.44.989
N051.47.52.362 E023.38.44.989 N051.51.04.568 E023.36.42.484
N051.51.04.568 E023.36.42.484 N051.51.46.810 E023.37.18.396
N051.51.46.810 E023.37.18.396 N051.53.03.907 E023.36.49.879
N051.53.03.907 E023.36.49.879 N051.53.34.531 E023.38.14.364
N051.53.34.531 E023.38.14.364 N051.54.49.513 E023.37.03.605
N051.54.49.513 E023.37.03.605 N051.55.41.258 E023.37.24.727
N051.55.41.258 E023.37.24.727 N052.00.00.000 E023.41.37.131
N052.00.00.000 E023.41.37.131 N052.01.26.600 E023.39.37.792
N052.01.26.600 E023.39.37.792 N052.05.07.315 E023.38.53.441
N052.05.07.315 E023.38.53.441 N052.06.51.864 E023.36.25.586
N052.06.51.864 E023.36.25.586 N052.06.52.921 E023.33.04.934
N052.06.52.921 E023.33.04.934 N052.09.09.152 E023.29.55.894
N052.09.09.152 E023.29.55.894 N052.10.37.866 E023.30.05.397
N052.10.37.866 E023.30.05.397 N052.10.32.593 E023.26.07.783
N052.10.32.593 E023.26.07.783 N052.11.17.000 E023.24.16.000
;E
N052.11.17.000 E023.24.16.000 N052.12.23.472 E023.22.18.615
N052.12.23.472 E023.22.18.615 N052.13.59.575 E023.12.06.093
N052.13.59.575 E023.12.06.093 N052.14.48.162 E023.11.51.303
N052.14.48.162 E023.11.51.303 N052.15.29.347 E023.12.36.718
N052.15.29.347 E023.12.36.718 N052.16.36.927 E023.12.06.093
N052.16.36.927 E023.12.06.093 N052.17.06.508 E023.10.18.372
N052.17.06.508 E023.10.18.372 N052.21.47.414 E023.14.29.719
N052.21.47.414 E023.14.29.719 N052.27.50.705 E023.18.28.390
N052.27.50.705 E023.18.28.390 N052.33.23.371 E023.25.09.700
N052.33.23.371 E023.25.09.700 N052.36.39.806 E023.33.58.795
N052.36.39.806 E023.33.58.795 N052.40.01.515 E023.54.54.470
N052.40.01.515 E023.54.54.470 N052.56.26.838 E023.56.20.013
N052.56.26.838 E023.56.20.013 N052.57.34.417 E023.57.04.370
N052.57.34.417 E023.57.04.370 N052.58.14.559 E023.56.34.796
N052.58.14.559 E023.56.34.796 N053.00.00.165 E023.56.49.579
N053.00.00.165 E023.56.49.579 N053.04.08.332 E023.53.25.756
N053.04.08.332 E023.53.25.756 N053.09.07.202 E023.55.16.642
N053.09.07.202 E023.55.16.642 N053.11.48.783 E023.52.05.494
N053.11.48.783 E023.52.05.494 N053.13.43.906 E023.52.15.004
N053.13.43.906 E023.52.15.004 N053.18.04.749 E023.46.38.108
N053.18.04.749 E023.46.38.108 N053.22.52.000 E023.44.23.000
;S
N053.22.52.000 E023.44.23.000 N053.35.23.932 E023.38.10.141
N053.35.23.932 E023.38.10.141 N053.36.03.002 E023.37.01.497
N053.36.03.002 E023.37.01.497 N053.40.13.298 E023.36.11.860
N053.40.13.298 E023.36.11.860 N053.44.15.135 E023.36.29.809
N053.44.15.135 E023.36.29.809 N053.46.54.601 E023.33.39.781
N053.46.54.601 E023.33.39.781 N053.50.41.661 E023.33.36.616
N053.50.41.661 E023.33.36.616 N054.00.00.330 E023.28.52.530
;granica FIR koniec

;;;;;;;UMKK
;umkk/esaa pocz
UMKK N055.51.00.195 E017.33.00.398 N056.05.41.999 E018.01.05.998
;umkk/esaa koniec
N056.05.41.999 E018.01.05.998 N055.22.23.998 E020.38.35.998
N055.22.23.998 E020.38.35.998 N055.16.54.199 E020.57.24.199
N055.16.54.199 E020.57.24.199 N055.14.44.519 E021.16.35.360
N055.14.44.519 E021.16.35.360 N055.17.05.190 E021.21.15.379
N055.17.05.190 E021.21.15.379 N055.17.26.451 E021.23.19.100
N055.17.26.451 E021.23.19.100 N055.15.10.119 E021.26.03.039
N055.15.10.119 E021.26.03.039 N055.13.51.639 E021.26.44.879
N055.13.51.639 E021.26.44.879 N055.12.35.470 E021.28.58.999
N055.12.35.470 E021.28.58.999 N055.11.40.160 E021.30.07.491
N055.11.40.160 E021.30.07.491 N055.11.21.260 E021.31.17.770
N055.11.21.260 E021.31.17.770 N055.11.55.388 E021.34.31.350
N055.11.55.388 E021.34.31.350 N055.11.16.400 E021.37.38.499
N055.11.16.400 E021.37.38.499 N055.07.40.598 E021.44.55.129
N055.07.40.598 E021.44.55.129 N055.07.12.039 E021.49.17.641
N055.07.12.039 E021.49.17.641 N055.05.55.230 E021.50.59.971
N055.05.55.230 E021.50.59.971 N055.04.32.318 E021.57.07.430
N055.04.32.318 E021.57.07.430 N055.05.07.879 E022.02.04.340
N055.05.07.879 E022.02.04.340 N055.03.42.000 E022.02.13.559
N055.03.42.000 E022.02.13.559 N055.01.34.280 E022.04.15.758
N055.01.34.280 E022.04.15.758 N055.02.13.808 E022.07.52.730
N055.02.13.808 E022.07.52.730 N055.03.01.828 E022.08.30.159
N055.03.01.828 E022.08.30.159 N055.03.48.830 E022.13.56.359
N055.03.48.830 E022.13.56.359 N055.03.23.979 E022.25.10.160
N055.03.23.979 E022.25.10.160 N055.02.52.360 E022.28.08.648
N055.02.52.360 E022.28.08.648 N055.04.18.530 E022.34.51.229
N055.04.18.530 E022.34.51.229 N054.56.58.261 E022.41.55.928
N054.56.58.261 E022.41.55.928 N054.55.17.191 E022.46.52.950
N054.55.17.191 E022.46.52.950 N054.52.58.231 E022.50.28.629
N054.52.58.231 E022.50.28.629 N054.51.34.430 E022.51.33.469
N054.51.34.430 E022.51.33.469 N054.47.20.720 E022.50.15.999
N054.47.20.720 E022.50.15.999 N054.41.42.449 E022.42.55.749
N054.41.42.449 E022.42.55.749 N054.30.21.780 E022.40.41.671
N054.30.21.780 E022.40.41.671 N054.23.56.159 E022.45.18.840
N054.23.56.159 E022.45.18.840 N054.22.02.534 E022.47.14.912
granica FIR poczatek
;S
N054.22.02.534 E022.47.14.912 N054.21.29.795 E022.43.04.623
N054.21.29.795 E022.43.04.623 N054.20.02.138 E022.00.00.405
N054.20.02.138 E022.00.00.405 N054.19.50.520 E021.53.00.089
N054.19.50.520 E021.53.00.089 N054.19.53.692 E021.33.56.357
N054.19.53.692 E021.33.56.357 N054.19.12.507 E021.27.26.665
N054.19.12.507 E021.27.26.665 N054.21.12.890 E021.00.00.240
N054.21.12.890 E021.00.00.240 N054.22.04.635 E020.38.20.214
N054.22.04.635 E020.38.20.214 N054.22.54.000 E020.30.00.000
N054.22.54.000 E020.30.00.000 N054.24.27.210 E020.15.35.760
N054.24.27.210 E020.15.35.760 N054.24.30.383 E020.11.12.803
N054.24.30.383 E020.11.12.803 N054.25.11.568 E020.05.30.634
N054.25.11.568 E020.05.30.634 N054.25.17.899 E020.00.00.000

;G
N054.25.17.899 E020.00.00.000 N054.25.34.804 E019.58.27.145
N054.25.34.804 E019.58.27.145 N054.25.52.753 E019.54.30.589
N054.25.52.753 E019.54.30.589 N054.26.09.644 E019.52.46.033
N054.26.09.644 E019.52.46.033 N054.26.11.759 E019.51.27.879
N054.26.11.759 E019.51.27.879 N054.26.27.607 E019.49.06.368
N054.26.27.607 E019.49.06.368 N054.26.31.837 E019.48.14.623
N054.26.31.837 E019.48.14.623 N054.27.29.998 E019.38.30.200
N054.27.29.998 E019.38.30.200 N054.36.11.998 E019.24.24.199
N054.36.11.998 E019.24.24.199 N055.17.24.000 E018.23.03.000
;granica FIR koneic

;LOA3
N055.17.24.000 E018.23.03.000 N055.51.00.195 E017.33.00.398
 

;;;;;;;;;;;;EYVL

;poczatek granicy z UMKK
;umkk/esaa pocz
EYVL N056.20.43.000 E018.30.23.999 N056.05.41.999 E018.01.05.998
;umkk/essa koni

N056.05.41.999 E018.01.05.998 N055.22.23.998 E020.38.35.998
N055.22.23.998 E020.38.35.998 N055.16.54.199 E020.57.24.199
N055.16.54.199 E020.57.24.199 N055.14.44.519 E021.16.35.360
N055.14.44.519 E021.16.35.360 N055.17.05.190 E021.21.15.379
N055.17.05.190 E021.21.15.379 N055.17.26.451 E021.23.19.100
N055.17.26.451 E021.23.19.100 N055.15.10.119 E021.26.03.039
N055.15.10.119 E021.26.03.039 N055.13.51.639 E021.26.44.879
N055.13.51.639 E021.26.44.879 N055.12.35.470 E021.28.58.999
N055.12.35.470 E021.28.58.999 N055.11.40.160 E021.30.07.491
N055.11.40.160 E021.30.07.491 N055.11.21.260 E021.31.17.770
N055.11.21.260 E021.31.17.770 N055.11.55.388 E021.34.31.350
N055.11.55.388 E021.34.31.350 N055.11.16.400 E021.37.38.499
N055.11.16.400 E021.37.38.499 N055.07.40.598 E021.44.55.129
N055.07.40.598 E021.44.55.129 N055.07.12.039 E021.49.17.641
N055.07.12.039 E021.49.17.641 N055.05.55.230 E021.50.59.971
N055.05.55.230 E021.50.59.971 N055.04.32.318 E021.57.07.430
N055.04.32.318 E021.57.07.430 N055.05.07.879 E022.02.04.340
N055.05.07.879 E022.02.04.340 N055.03.42.000 E022.02.13.559
N055.03.42.000 E022.02.13.559 N055.01.34.280 E022.04.15.758
N055.01.34.280 E022.04.15.758 N055.02.13.808 E022.07.52.730
N055.02.13.808 E022.07.52.730 N055.03.01.828 E022.08.30.159
N055.03.01.828 E022.08.30.159 N055.03.48.830 E022.13.56.359
N055.03.48.830 E022.13.56.359 N055.03.23.979 E022.25.10.160
N055.03.23.979 E022.25.10.160 N055.02.52.360 E022.28.08.648
N055.02.52.360 E022.28.08.648 N055.04.18.530 E022.34.51.229
N055.04.18.530 E022.34.51.229 N054.56.58.261 E022.41.55.928
N054.56.58.261 E022.41.55.928 N054.55.17.191 E022.46.52.950
N054.55.17.191 E022.46.52.950 N054.52.58.231 E022.50.28.629
N054.52.58.231 E022.50.28.629 N054.51.34.430 E022.51.33.469
N054.51.34.430 E022.51.33.469 N054.47.20.720 E022.50.15.999
N054.47.20.720 E022.50.15.999 N054.41.42.449 E022.42.55.749
N054.41.42.449 E022.42.55.749 N054.30.21.780 E022.40.41.671
N054.30.21.780 E022.40.41.671 N054.23.56.159 E022.45.18.840
N054.23.56.159 E022.45.18.840 N054.22.02.534 E022.47.14.912
;koniec granicy z UMKK


N056.20.43.000 E018.30.23.999 N056.17.52.000 E018.53.56.000
N056.17.52.000 E018.53.56.000 N056.08.45.999 E020.04.55.999
N056.08.45.999 E020.04.55.999 N056.04.00.200 E020.40.00.200
N056.04.00.200 E020.40.00.200 N056.04.01.999 E020.44.52.000
N056.04.01.999 E020.44.52.000 N056.04.09.200 E021.03.51.998
N056.04.09.200 E021.03.51.998 N056.04.26.000 E021.05.36.999
N056.04.26.000 E021.05.36.999 N056.10.46.999 E021.16.45.200
N056.10.46.999 E021.16.45.200 N056.12.21.999 E021.18.43.999
N056.12.21.999 E021.18.43.999 N056.17.39.200 E021.32.07.000
N056.17.39.200 E021.32.07.000 N056.25.35.489 E022.08.31.509
N056.25.35.489 E022.08.31.509 N056.24.13.600 E022.19.19.120
N056.24.13.600 E022.19.19.120 N056.23.59.819 E022.33.49.089
N056.23.59.819 E022.33.49.089 N056.21.28.609 E022.41.03.919
N056.21.28.609 E022.41.03.919 N056.25.07.251 E022.56.14.139
N056.25.07.251 E022.56.14.139 N056.18.21.999 E023.05.31.999
N056.18.21.999 E023.05.31.999 N056.20.47.788 E023.10.36.960
N056.20.47.788 E023.10.36.960 N056.22.15.999 E023.12.21.999
N056.22.15.999 E023.12.21.999 N056.22.19.999 E023.15.37.999
N056.22.19.999 E023.15.37.999 N056.18.48.999 E023.30.26.319
N056.18.48.999 E023.30.26.319 N056.22.17.000 E023.45.20.599
N056.22.17.000 E023.45.20.599 N056.16.42.999 E024.03.55.999
N056.16.42.999 E024.03.55.999 N056.15.44.211 E024.28.07.140
N056.15.44.211 E024.28.07.140 N056.22.08.000 E024.37.49.000
N056.22.08.000 E024.37.49.000 N056.26.45.589 E024.53.15.889
N056.26.45.589 E024.53.15.889 N056.10.24.330 E025.08.18.999
N056.10.24.330 E025.08.18.999 N055.59.08.600 E025.56.51.570
N055.59.08.600 E025.56.51.570 N055.40.50.600 E026.37.50.599


;poczatek granicy z UMMV
N055.40.50.600 E026.37.50.599 N055.36.24.119 E026.38.49.639
N055.36.24.119 E026.38.49.639 N055.26.58.959 E026.33.17.549
N055.26.58.959 E026.33.17.549 N055.22.34.939 E026.30.26.348
N055.22.34.939 E026.30.26.348 N055.21.26.870 E026.27.47.530
N055.21.26.870 E026.27.47.530 N055.19.06.610 E026.27.31.120
N055.19.06.610 E026.27.31.120 N055.17.58.538 E026.31.50.919
N055.17.58.538 E026.31.50.919 N055.18.06.789 E026.48.35.431
N055.18.06.789 E026.48.35.431 N055.17.46.168 E026.51.06.199
N055.17.46.168 E026.51.06.199 N055.15.52.718 E026.51.22.499
N055.15.52.718 E026.51.22.499 N055.12.01.699 E026.43.15.718
N055.12.01.699 E026.43.15.718 N055.08.33.381 E026.40.08.840
N055.08.33.381 E026.40.08.840 N055.07.25.309 E026.30.32.540
N055.07.25.309 E026.30.32.540 N055.06.04.870 E026.27.04.208
N055.06.04.870 E026.27.04.208 N055.07.56.251 E026.19.57.241
N055.07.56.251 E026.19.57.241 N055.08.16.879 E026.16.20.668
N055.08.16.879 E026.16.20.668 N055.05.33.928 E026.14.06.590
N055.05.33.928 E026.14.06.590 N055.02.42.730 E026.14.29.281
N055.02.42.730 E026.14.29.281 N055.00.00.000 E026.13.00.200
N055.00.00.000 E026.13.00.200 N054.57.54.878 E026.08.37.769
N054.57.54.878 E026.08.37.769 N054.52.41.998 E025.49.00.199
N054.52.41.998 E025.49.00.199 N054.47.11.130 E025.46.14.401
N054.47.11.130 E025.46.14.401 N054.38.05.539 E025.44.24.169
N054.38.05.539 E025.44.24.169 N054.33.21.229 E025.43.43.208
N054.33.21.229 E025.43.43.208 N054.28.00.200 E025.37.00.199
N054.28.00.200 E025.37.00.199 N054.19.44.410 E025.35.05.488
N054.19.44.410 E025.35.05.488 N054.18.17.780 E025.35.42.619
N054.18.17.780 E025.35.42.619 N054.16.59.998 E025.43.00.200
N054.16.59.998 E025.43.00.200 N054.14.43.270 E025.46.44.720
N054.14.43.270 E025.46.44.720 N054.10.00.199 E025.46.59.998
N054.10.00.199 E025.46.59.998 N054.08.09.301 E025.42.55.771
N054.08.09.301 E025.42.55.771 N054.09.19.429 E025.34.18.079
N054.09.19.429 E025.34.18.079 N054.10.52.251 E025.35.07.551
N054.10.52.251 E025.35.07.551 N054.15.12.149 E025.32.34.918
N054.15.12.149 E025.32.34.918 N054.15.59.590 E025.27.23.450
N054.15.59.590 E025.27.23.450 N054.16.27.998 E025.16.06.999
N054.16.27.998 E025.16.06.999 N054.12.16.819 E025.13.52.831
N054.12.16.819 E025.13.52.831 N054.10.44.999 E025.10.32.761
N054.10.44.999 E025.10.32.761 N054.07.59.998 E025.03.00.547
N054.07.59.998 E025.03.00.547 N054.08.44.998 E025.00.00.000
N054.08.44.998 E025.00.00.000 N054.09.29.998 E024.58.19.999
N054.09.29.998 E024.58.19.999 N054.08.30.199 E024.50.09.999
N054.08.30.199 E024.50.09.999 N054.06.10.000 E024.47.39.998
N054.06.10.000 E024.47.39.998 N054.03.57.661 E024.48.24.411
N054.03.57.661 E024.48.24.411 N053.58.17.320 E024.48.12.120
N053.58.17.320 E024.48.12.120 N053.56.52.760 E024.44.47.828
N053.56.52.760 E024.44.47.828 N054.00.05.000 E024.41.35.599
N054.00.05.000 E024.41.35.599 N054.00.47.998 E024.40.03.667
N054.00.47.998 E024.40.03.667 N053.53.28.550 E024.24.41.180
N053.53.28.550 E024.24.41.180 N053.54.11.869 E024.17.21.840
N053.54.11.869 E024.17.21.840 N053.56.21.811 E024.11.45.628
N053.56.21.811 E024.11.45.628 N053.55.44.691 E023.55.38.251
N053.55.44.691 E023.55.38.251 N053.53.59.999 E023.48.00.398
N053.53.59.999 E023.48.00.398 N053.54.32.489 E023.37.06.481
N053.54.32.489 E023.37.06.481 N054.00.00.330 E023.28.52.530

;granica z FIR
;s
N054.00.00.330 E023.28.52.530 N054.00.23.552 E023.29.02.033
N054.00.23.552 E023.29.02.033 N054.01.00.521 E023.29.46.391
N054.01.00.521 E023.29.46.391 N054.01.32.203 E023.30.47.646
N054.01.32.203 E023.30.47.646 N054.07.50.270 E023.30.05.397
N054.07.50.270 E023.30.05.397 N054.13.37.726 E023.21.52.214
N054.13.37.726 E023.21.52.214 N054.18.53.487 E023.02.54.820
N054.18.53.487 E023.02.54.820 N054.20.44.380 E023.03.30.725
N054.20.44.380 E023.03.30.725 N054.22.19.426 E022.59.59.512
N054.22.19.426 E022.59.59.512 N054.25.43.250 E022.51.27.316
N054.25.43.250 E022.51.27.316 N054.24.31.440 E022.48.24.613
N054.24.31.440 E022.48.24.613 N054.22.02.534 E022.47.14.912
;granica z FIR koniec






;;ESAA EPWW LOA
EPWW N055.07.59.000 E016.15.21.150 N055.17.24.000 E018.23.03.000

;;;;;;ESAA
ESAA N054.55.00.199 E014.21.26.999 N054.55.00.199 E012.50.59.999
N054.55.00.199 E012.50.59.999 N055.20.12.199 E012.38.26.998
N055.20.12.199 E012.38.26.998 N055.25.08.479 E012.36.24.811
N055.25.08.479 E012.36.24.811 N055.29.44.728 E012.42.53.150
N055.29.44.728 E012.42.53.150 N055.32.57.109 E012.44.28.449
N055.32.57.109 E012.44.28.449 N055.36.17.629 E012.52.47.200
N055.36.17.629 E012.52.47.200 N055.38.27.999 E012.53.56.000
N055.38.27.999 E012.53.56.000 N055.49.49.709 E012.42.31.420
N055.49.49.709 E012.42.31.420 N055.52.11.589 E012.41.41.949
N055.52.11.589 E012.41.41.949 N055.53.29.999 E012.40.41.998
N055.53.29.999 E012.40.41.998 N055.55.52.568 E012.38.28.111
N055.55.52.568 E012.38.28.111 N055.58.51.999 E012.39.06.998
N055.58.51.999 E012.39.06.998 N056.01.58.000 E012.39.24.998
N056.01.58.000 E012.39.24.998 N056.03.30.999 E012.38.26.600
N056.03.30.999 E012.38.26.600 N056.09.51.199 E012.26.23.999
N056.09.51.199 E012.26.23.999 N056.12.52.999 E012.22.05.599
N056.12.52.999 E012.22.05.599 N058.30.00.000 E010.30.00.000
N058.30.00.000 E010.30.00.000 N058.45.39.999 E010.35.31.999
N058.45.39.999 E010.35.31.999 N058.53.31.999 E010.38.20.000
N058.53.31.999 E010.38.20.000 N058.58.59.998 E011.07.00.199
N058.58.59.998 E011.07.00.199 N059.01.26.101 E011.09.13.309
N059.01.26.101 E011.09.13.309 N059.04.59.998 E011.19.59.998
N059.04.59.998 E011.19.59.998 N059.01.22.339 E011.23.05.229
N059.01.22.339 E011.23.05.229 N058.53.59.999 E011.25.59.998
N058.53.59.999 E011.25.59.998 N058.52.00.199 E011.31.59.998
N058.52.00.199 E011.31.59.998 N058.56.48.069 E011.43.48.040
N058.56.48.069 E011.43.48.040 N059.13.37.549 E011.50.35.858
N059.13.37.549 E011.50.35.858 N059.37.49.389 E011.40.33.870
N059.37.49.389 E011.40.33.870 N059.41.06.910 E011.56.44.829
N059.41.06.910 E011.56.44.829 N059.44.44.199 E011.58.41.339
N059.44.44.199 E011.58.41.339 N059.47.02.461 E011.55.27.159
N059.47.02.461 E011.55.27.159 N059.50.29.979 E011.50.56.839
N059.50.29.979 E011.50.56.839 N059.53.26.599 E011.56.39.998
N059.53.26.599 E011.56.39.998 N059.54.14.461 E011.58.24.358
N059.54.14.461 E011.58.24.358 N059.53.36.380 E012.10.23.610
N059.53.36.380 E012.10.23.610 N059.58.58.450 E012.23.55.840
N059.58.58.450 E012.23.55.840 N060.08.58.480 E012.32.55.120
N060.08.58.480 E012.32.55.120 N060.16.58.490 E012.31.54.998
N060.16.58.490 E012.31.54.998 N060.23.58.520 E012.36.55.000
N060.23.58.520 E012.36.55.000 N060.27.58.528 E012.37.54.991
N060.27.58.528 E012.37.54.991 N061.00.58.590 E012.15.54.860
N061.00.58.590 E012.15.54.860 N061.02.58.610 E012.40.54.901
N061.02.58.610 E012.40.54.901 N061.11.58.639 E012.46.54.890
N061.11.58.639 E012.46.54.890 N061.21.58.658 E012.51.54.871
N061.21.58.658 E012.51.54.871 N061.33.58.679 E012.33.54.788
N061.33.58.679 E012.33.54.788 N061.33.58.679 E012.24.54.770
N061.33.58.679 E012.24.54.770 N061.42.58.690 E012.08.54.711
N061.42.58.690 E012.08.54.711 N062.15.58.770 E012.18.54.640
N062.15.58.770 E012.18.54.640 N062.36.28.810 E012.03.54.539
N062.36.28.810 E012.03.54.539 N062.44.58.840 E012.09.54.529
N062.44.58.840 E012.09.54.529 N062.53.58.858 E012.05.54.488
N062.53.58.858 E012.05.54.488 N062.59.58.880 E012.14.54.488
N062.59.58.880 E012.14.54.488 N063.15.58.910 E012.00.54.410
N063.15.58.910 E012.00.54.410 N063.27.58.949 E012.13.54.400
N063.27.58.949 E012.13.54.400 N063.34.58.958 E012.09.54.370
N063.34.58.958 E012.09.54.370 N063.58.59.119 E012.44.54.369
N063.58.59.119 E012.44.54.369 N064.04.59.080 E013.09.54.399
N064.04.59.080 E013.09.54.399 N064.00.59.101 E013.57.54.529
N064.00.59.101 E013.57.54.529 N064.10.59.131 E014.11.54.531
N064.10.59.131 E014.11.54.531 N064.27.59.169 E014.09.54.460
N064.27.59.169 E014.09.54.460 N064.35.59.168 E013.39.54.370
N064.35.59.168 E013.39.54.370 N065.17.59.308 E014.29.54.340
N065.17.59.308 E014.29.54.340 N065.44.59.380 E014.34.54.249
N065.44.59.380 E014.34.54.249 N065.48.59.400 E014.36.54.259
N065.48.59.400 E014.36.54.259 N066.07.59.440 E014.31.54.159
N066.07.59.440 E014.31.54.159 N066.08.59.460 E014.59.54.229
N066.08.59.460 E014.59.54.229 N066.16.59.498 E015.29.54.268
N066.16.59.498 E015.29.54.268 N066.28.59.530 E015.22.54.209
N066.28.59.530 E015.22.54.209 N066.35.59.560 E015.39.54.219
N066.35.59.560 E015.39.54.219 N066.52.59.609 E016.01.54.210
N066.52.59.609 E016.01.54.210 N067.01.59.649 E016.24.54.241
N067.01.59.649 E016.24.54.241 N067.11.59.679 E016.24.54.201
N067.11.59.679 E016.24.54.201 N067.25.59.700 E016.04.54.120
N067.25.59.700 E016.04.54.120 N067.30.59.720 E016.09.54.920
N067.30.59.720 E016.09.54.920 N067.31.59.728 E016.24.54.118
N067.31.59.728 E016.24.54.118 N067.54.59.799 E016.44.54.160
N067.54.59.799 E016.44.54.160 N068.06.59.849 E017.16.54.120
N068.06.59.849 E017.16.54.120 N067.56.59.848 E017.56.54.268
N067.56.59.848 E017.56.54.268 N068.12.59.900 E018.11.54.239
N068.12.59.900 E018.11.54.239 N068.31.59.948 E018.09.54.158
N068.31.59.948 E018.09.54.158 N068.33.59.968 E018.24.55.191
N068.33.59.968 E018.24.55.191 N068.30.30.661 E018.37.18.339
N068.30.30.661 E018.37.18.339 N068.31.59.980 E018.59.54.301
N068.31.59.980 E018.59.54.301 N068.21.20.998 E019.55.15.999
N068.21.20.998 E019.55.15.999 N068.29.13.621 E020.14.04.801
N068.29.13.621 E020.14.04.801 N068.32.44.131 E019.59.21.310
N068.32.44.131 E019.59.21.310 N068.47.19.658 E020.20.00.830
N068.47.19.658 E020.20.00.830 N068.58.00.040 E020.20.54.510
N068.58.00.040 E020.20.54.510 N069.03.18.799 E020.04.19.040
N069.03.18.799 E020.04.19.040 N069.03.36.178 E020.32.54.999
N069.03.36.178 E020.32.54.999 N068.57.24.811 E020.55.14.789
N068.57.24.811 E020.55.14.789 N068.53.57.368 E020.53.27.531
N068.53.57.368 E020.53.27.531 N068.32.03.199 E021.59.42.765
N068.32.03.199 E021.59.42.765 N068.22.45.390 E022.49.39.880
N068.22.45.390 E022.49.39.880 N068.14.21.591 E023.08.52.999
N068.14.21.591 E023.08.52.999 N068.07.21.748 E023.09.32.220
N068.07.21.748 E023.09.32.220 N068.08.50.661 E023.18.15.120
N068.08.50.661 E023.18.15.120 N067.56.44.588 E023.39.15.321
N067.56.44.588 E023.39.15.321 N067.52.03.039 E023.29.52.231
N067.52.03.039 E023.29.52.231 N067.28.05.728 E023.26.31.138
N067.28.05.728 E023.26.31.138 N067.25.27.670 E023.45.57.520
N067.25.27.670 E023.45.57.520 N067.17.28.561 E023.45.03.898
N067.17.28.561 E023.45.03.898 N067.10.04.960 E023.35.13.999
N067.10.04.960 E023.35.13.999 N066.48.34.891 E024.00.28.951
N066.48.34.891 E024.00.28.951 N066.26.11.410 E023.38.21.688
N066.26.11.410 E023.38.21.688 N066.11.47.080 E023.45.17.308
N066.11.47.080 E023.45.17.308 N066.09.33.688 E023.54.26.978
N066.09.33.688 E023.54.26.978 N066.05.25.999 E023.56.08.998
N066.05.25.999 E023.56.08.998 N065.31.48.907 E024.08.24.053
N065.31.48.907 E024.08.24.053 N064.40.59.998 E022.55.00.200
N064.40.59.998 E022.55.00.200 N063.37.00.199 E021.30.00.000
N063.37.00.199 E021.30.00.000 N063.28.30.087 E020.40.00.200
N063.28.30.087 E020.40.00.200 N063.10.00.199 E020.10.00.200
N063.10.00.199 E020.10.00.200 N061.40.00.199 E019.30.00.000
N061.40.00.199 E019.30.00.000 N061.00.00.000 E019.19.05.599
N061.00.00.000 E019.19.05.599 N060.18.02.998 E019.07.55.999
N060.18.02.998 E019.07.55.999 N060.11.30.200 E019.05.12.199
N060.11.30.200 E019.05.12.199 N059.33.46.000 E019.58.59.600
N059.33.46.000 E019.58.59.600 N059.15.24.200 E020.32.39.200
N059.15.24.200 E020.32.39.200 N059.00.00.000 E021.00.00.000
N059.00.00.000 E021.00.00.000 N057.34.09.998 E020.08.59.999
N057.34.09.998 E020.08.59.999 N057.00.00.000 E019.49.59.998
N057.00.00.000 E019.49.59.998 N056.20.43.000 E018.30.23.999

;eyvl/umkk/esaa
N056.20.43.000 E018.30.23.999 N056.05.41.999 E018.01.05.998
N056.05.41.999 E018.01.05.998 N055.51.00.195 E017.33.00.398
;eyvl/umkk/esaa


;LOA_1
N055.51.00.195 E017.33.00.398 N055.07.59.000 E016.15.21.150

;EPWW_ESAA_G
N055.07.59.000 E016.15.21.150 N054.57.13.000 E015.55.53.000

;epww_esaa_b
N054.57.13.000 E015.55.53.000 N054.54.58.840 E015.51.52.920




RONNE N054.55.00.199 E014.21.26.999 N054.52.23.405 E014.25.06.863
N054.52.23.405 E014.25.06.863 N054.50.36.270 E014.28.56.663
N054.50.36.270 E014.28.56.663 N054.49.14.010 E014.33.15.339
N054.49.14.010 E014.33.15.339 N054.48.18.721 E014.37.55.097
N054.48.18.721 E014.37.55.097 N054.47.52.294 E014.42.47.239
N054.47.52.294 E014.42.47.239 N054.47.54.904 E014.47.43.765
N054.47.54.904 E014.47.43.765 N054.48.27.100 E014.52.33.585
N054.48.27.100 E014.52.33.585 N054.49.27.693 E014.57.09.905
N054.49.27.693 E014.57.09.905 N054.50.54.840 E015.01.23.653
N054.50.54.840 E015.01.23.653 N054.52.45.895 E015.05.07.118
N054.52.45.895 E015.05.07.118 N054.55.00.199 E015.08.07.999
N054.55.00.199 E015.08.07.999 N054.54.58.840 E015.51.52.920
N054.54.58.840 E015.51.52.920 N054.41.06.000 E015.43.09.000
N054.41.06.000 E015.43.09.000 N054.23.06.000 E015.23.46.000
N054.23.06.000 E015.23.46.000 N054.15.45.000 E015.03.21.000
N054.15.45.000 E015.03.21.000 N054.19.59.434 E014.16.56.190
N054.19.59.434 E014.16.56.190 N054.55.00.199 E014.21.26.999

RONNE_EXCLUDE N054.45.34.000 E014.20.12.000 N054.46.00.000 E014.35.30.000
N054.46.00.000 E014.35.30.000 N054.35.00.000 E014.39.45.000
N054.35.00.000 E014.39.45.000 N054.35.00.000 E015.14.00.000
N054.35.00.000 E015.14.00.000 N054.35.09.000 E015.26.54.000
N054.35.09.000 E015.26.54.000 N054.31.54.000 E015.33.12.000
N054.31.54.000 E015.33.12.000 N054.23.06.000 E015.23.46.000
N054.23.06.000 E015.23.46.000 N054.15.45.000 E015.03.21.000
N054.15.45.000 E015.03.21.000 N054.19.59.434 E014.16.56.190
N054.19.59.434 E014.16.56.190 N054.45.34.000 E014.20.12.000


;COORD:N054.19.59.434:E014.16.56.190


;EPWW_ESAA_B
ESAA N054.54.58.840 E015.51.52.920 N054.55.00.199 E015.08.07.999
N054.55.00.199 E015.08.07.999 N054.52.45.895 E015.05.07.118
N054.52.45.895 E015.05.07.118 N054.50.54.840 E015.01.23.653
N054.50.54.840 E015.01.23.653 N054.49.27.693 E014.57.09.905
N054.49.27.693 E014.57.09.905 N054.48.27.100 E014.52.33.585
N054.48.27.100 E014.52.33.585 N054.47.54.904 E014.47.43.765
N054.47.54.904 E014.47.43.765 N054.47.52.294 E014.42.47.239
N054.47.52.294 E014.42.47.239 N054.48.18.721 E014.37.55.097
N054.48.18.721 E014.37.55.097 N054.49.14.010 E014.33.15.339
N054.49.14.010 E014.33.15.339 N054.50.36.270 E014.28.56.663
N054.50.36.270 E014.28.56.663 N054.52.23.405 E014.25.06.863
N054.52.23.405 E014.25.06.863 N054.55.00.199 E014.21.26.999






EDWW  N051.50.27.999 E011.12.29.998 N051.54.23.999 E011.07.48.806
N051.54.23.999 E011.07.48.806 N052.22.24.999 E011.04.13.000
N052.22.24.999 E011.04.13.000 N054.07.59.998 E011.15.29.998
N054.07.59.998 E011.15.29.998 N054.27.00.019 E012.00.00.000
N054.27.00.019 E012.00.00.000 N054.43.59.998 E012.31.00.199
N054.43.59.998 E012.31.00.199 N054.55.00.199 E012.50.59.999

;granica essa eddw poczatek
N054.55.00.199 E012.50.59.999 N054.55.00.199 E014.10.00.200
N054.55.00.199 E014.10.00.200 N054.55.00.199 E014.21.26.999

;;granica essa edww koniec

;granica z FIRem
;B
N054.55.00.199 E014.21.26.999 N054.07.40.999 E014.15.20.998
N054.07.40.999 E014.15.20.998 N054.07.33.999 E014.12.05.000
N054.07.33.999 E014.12.05.000 N053.59.16.999 E014.14.31.999
N053.59.16.999 E014.14.31.999 N053.57.44.999 E014.13.59.998
N053.57.44.999 E014.13.59.998 N053.55.59.998 E014.13.59.998
N053.55.59.998 E014.13.59.998 N053.55.45.998 E014.13.41.998
N053.55.45.998 E014.13.41.998 N053.55.40.000 E014.13.33.999
N053.55.40.000 E014.13.33.999 N053.55.19.999 E014.13.00.199
N053.55.19.999 E014.13.00.199 N053.48.39.999 E014.15.20.600
N053.48.39.999 E014.15.20.600 N053.41.55.732 E014.16.10.697
N053.41.55.732 E014.16.10.697 N053.41.00.814 E014.16.10.697 
N053.41.00.814 E014.16.10.697 N053.40.34.419 E014.16.42.375 
N053.40.34.419 E014.16.42.375 N053.39.33.157 E014.16.30.761 
N053.39.33.157 E014.16.30.761 N053.38.51.972 E014.17.01.389 
N053.38.51.972 E014.17.01.389 N053.37.57.068 E014.16.51.882 
N053.37.57.068 E014.16.51.882 N053.36.16.735 E014.18.46.995 
N053.36.16.735 E014.18.46.995 N053.34.48.020 E014.18.41.714 
N053.34.48.020 E014.18.41.714 N053.33.18.262 E014.18.54.390 
N053.33.18.262 E014.18.54.390 N053.32.27.560 E014.18.12.144 
N053.32.27.560 E014.18.12.144 N053.31.50.605 E014.18.08.975 
N053.31.50.605 E014.18.08.975 N053.31.29.484 E014.18.39.603 
N053.31.29.484 E014.18.39.603 N053.30.29.279 E014.18.53.329 
N053.30.29.279 E014.18.53.329 N053.29.47.036 E014.19.46.135 
N053.29.47.036 E014.19.46.135 N053.29.26.972 E014.20.48.445 
N053.29.26.972 E014.20.48.445 N053.26.54.894 E014.21.15.901 
N053.26.54.894 E014.21.15.901 N053.26.24.270 E014.21.40.191 
N053.26.24.270 E014.21.40.191 N053.26.06.321 E014.22.06.592 
N053.26.06.321 E014.22.06.592 N053.24.32.333 E014.21.49.694 
N053.24.32.333 E014.21.49.694 N053.24.06.982 E014.22.20.322 
N053.24.06.982 E014.22.20.322 N053.22.32.994 E014.23.02.564 
N053.22.32.994 E014.23.02.564 N053.22.01.312 E014.23.09.956 
N053.22.01.312 E014.23.09.956 N053.21.08.509 E014.23.06.787 
N053.21.08.509 E014.23.06.787 N053.20.49.503 E014.23.20.520 
N053.20.49.503 E014.23.20.520 N053.19.45.081 E014.24.09.097 
N053.19.45.081 E014.24.09.097 N053.18.33.258 E014.23.40.584 
N053.18.33.258 E014.23.40.584 N053.17.34.124 E014.24.29.164 
N053.17.34.124 E014.24.29.164 N053.16.29.703 E014.24.36.556 
N053.16.29.703 E014.24.36.556 N053.15.22.110 E014.26.23.219 
N053.15.22.110 E014.26.23.219 N053.13.52.352 E014.25.23.024 
N053.13.52.352 E014.25.23.024 N053.11.58.286 E014.23.52.202 
N053.11.58.286 E014.23.52.202 N053.11.22.388 E014.22.28.771 
N053.11.22.388 E014.22.28.771 N053.10.35.916 E014.21.57.089
N053.10.35.916 E014.21.57.089 N053.10.00.000 E014.21.57.089
N053.10.00.000 E014.21.57.089 N053.09.45.228 E014.21.56.035
;D
N053.09.45.228 E014.21.56.035 N053.07.51.176 E014.22.55.172
N053.07.51.176 E014.22.55.172 N053.03.26.090 E014.21.18.016
N053.03.26.090 E014.21.18.016 N053.02.07.950 E014.19.52.470
N053.02.07.950 E014.19.52.470 N053.00.00.165 E014.15.51.684
N053.00.00.165 E014.15.51.684 N052.58.55.744 E014.14.11.361
N052.58.55.744 E014.14.11.361 N052.58.30.393 E014.11.53.013
N052.58.30.393 E014.11.53.013 N052.57.04.850 E014.08.35.527
N052.57.04.850 E014.08.35.527 N052.56.51.118 E014.08.23.909
N052.56.51.118 E014.08.23.909 N052.55.46.696 E014.08.24.966
N052.55.46.696 E014.08.24.966 N052.54.19.053 E014.08.57.702
N052.54.19.053 E014.08.57.702 N052.52.03.866 E014.09.17.769
N052.52.03.866 E014.09.17.769 N052.50.29.878 E014.07.44.835
N052.50.29.878 E014.07.44.835 N052.49.23.342 E014.07.17.379
N052.49.23.342 E014.07.17.379 N052.48.40.042 E014.08.09.125
N052.48.40.042 E014.08.09.125 N052.48.53.775 E014.10.21.133
N052.48.53.775 E014.10.21.133 N052.48.24.208 E014.12.54.265
N052.48.24.208 E014.12.54.265 N052.46.50.220 E014.15.28.451
N052.46.50.220 E014.15.28.451 N052.45.34.181 E014.16.52.939
N052.45.34.181 E014.16.52.939 N052.43.54.906 E014.21.40.191
N052.43.54.906 E014.21.40.191 N052.42.18.803 E014.23.19.463
N052.42.18.803 E014.23.19.463 N052.41.22.828 E014.24.48.170
N052.41.22.828 E014.24.48.170 N052.39.46.725 E014.26.17.939
N052.39.46.725 E014.26.17.939 N052.39.35.107 E014.27.28.694
N052.39.35.107 E014.27.28.694 N052.38.56.037 E014.27.48.761
N052.38.56.037 E014.27.48.761 N052.38.34.915 E014.28.43.676
N052.38.34.915 E014.28.43.676 N052.35.29.041 E014.36.17.792
N052.35.29.041 E014.36.17.792 N052.33.49.779 E014.38.11.848
N052.33.49.779 E014.38.11.848 N052.33.01.192 E014.38.07.625
N052.33.01.192 E014.38.07.625 N052.32.25.294 E014.37.20.099
N052.32.25.294 E014.37.20.099 N052.30.34.401 E014.36.25.181
N052.30.34.401 E014.36.25.181 N052.29.55.331 E014.36.55.808
N052.29.55.331 E014.36.55.808 N052.29.24.706 E014.38.07.625
N052.29.24.706 E014.38.07.625 N052.27.58.107 E014.38.04.456
N052.27.58.107 E014.38.04.456 N052.27.20.080 E014.36.50.528
N052.27.20.080 E014.36.50.528 N052.26.54.743 E014.36.43.136
N052.26.54.743 E014.36.43.136 N052.25.54.538 E014.35.24.986
N052.25.54.538 E014.35.24.986 N052.25.23.914 E014.33.24.596
N052.25.23.914 E014.33.24.596 N052.24.48.016 E014.32.31.790
N052.24.48.016 E014.32.31.790 N052.23.42.537 E014.32.36.013
N052.23.42.537 E014.32.36.013 N052.22.53.950 E014.32.19.118
N052.22.53.950 E014.32.19.118 N052.22.20.154 E014.32.48.688
N052.22.20.154 E014.32.48.688 N052.22.00.090 E014.33.14.032
N052.22.00.090 E014.33.14.032 N052.21.52.701 E014.33.22.481
N052.21.52.701 E014.33.22.481 N052.20.39.835 E014.33.18.255
N052.20.39.835 E014.33.18.255 N052.18.33.107 E014.34.00.501
N052.18.33.107 E014.34.00.501 N052.17.39.247 E014.35.03.865
N052.17.39.247 E014.35.03.865 N052.17.04.393 E014.35.13.368
N052.17.04.393 E014.35.13.368 N052.16.51.717 E014.34.58.584
N052.16.51.717 E014.34.58.584 N052.16.21.093 E014.34.30.071
N052.16.21.093 E014.34.30.071 N052.16.01.029 E014.34.56.469
N052.16.01.029 E014.34.56.469 N052.15.30.405 E014.35.28.155
N052.15.30.405 E014.35.28.155 N052.13.56.403 E014.42.03.127
N052.13.56.403 E014.42.03.127 N052.13.07.830 E014.42.40.089
N052.13.07.830 E014.42.40.089 N052.11.39.115 E014.42.37.978
N052.11.39.115 E014.42.37.978 N052.11.06.376 E014.41.32.499
N052.11.06.376 E014.41.32.499 N052.10.22.032 E014.41.12.435
N052.10.22.032 E014.41.12.435 N052.09.42.948 E014.42.10.519
N052.09.42.948 E014.42.10.519 N052.09.00.706 E014.42.34.809
N052.09.00.706 E014.42.34.809 N052.08.14.234 E014.41.31.445
N052.08.14.234 E014.41.31.445 N052.07.07.711 E014.40.50.257
N052.07.07.711 E014.40.50.257 N052.05.42.169 E014.40.56.594
N052.05.42.169 E014.40.56.594 N052.04.48.309 E014.41.30.391
N052.04.48.309 E014.41.30.391 N052.03.57.621 E014.44.24.641
N052.03.57.621 E014.44.24.641 N052.03.26.982 E014.44.58.434
N052.03.26.982 E014.44.58.434 N052.02.24.676 E014.45.01.603
N052.02.24.676 E014.45.01.603 N052.01.54.052 E014.44.24.641
N052.01.54.052 E014.44.24.641 N052.00.44.357 E014.44.20.418
N052.00.44.357 E014.44.20.418 N052.00.00.000 E014.43.54.017
N052.00.00.000 E014.43.54.017 N051.59.20.916 E014.42.48.538
N051.59.20.916 E014.42.48.538 N051.57.50.100 E014.43.04.379
N051.57.50.100 E014.43.04.379 N051.57.21.591 E014.42.34.809
N051.57.21.591 E014.42.34.809 N051.56.16.112 E014.42.39.035
N051.56.16.112 E014.42.39.035 N051.55.14.864 E014.43.07.548
N051.55.14.864 E014.43.07.548 N051.54.09.385 E014.41.59.962
N051.54.09.385 E014.41.59.962 N051.52.26.938 E014.41.20.881
N051.52.26.938 E014.41.20.881 N051.51.59.485 E014.40.46.034
N051.51.59.485 E014.40.46.034 N051.52.11.104 E014.39.54.285
N051.52.11.104 E014.39.54.285 N051.50.00.146 E014.37.57.061
N051.50.00.146 E014.37.57.061 N051.49.48.528 E014.36.36.799
N051.49.48.528 E014.36.36.799 N051.48.38.834 E014.35.34.489
N051.48.38.834 E014.35.34.489 N051.47.43.916 E014.35.32.378
N051.47.43.916 E014.35.32.378 N051.47.00.616 E014.36.05.117
N051.47.00.616 E014.36.05.117 N051.46.04.641 E014.38.12.902
N051.46.04.641 E014.38.12.902 N051.44.54.946 E014.39.15.211
N051.44.54.946 E014.39.15.211 N051.43.29.404 E014.39.02.539
N051.43.29.404 E014.39.02.539 N051.42.00.689 E014.40.06.960
;granica FIR koniec
;granica z edmm
N051.42.00.689 E014.40.06.960 N051.30.29.998 E013.45.00.000
N051.30.29.998 E013.45.00.000 N051.30.29.998 E013.05.59.999
N051.30.29.998 E013.05.59.999 N051.37.29.999 E012.38.25.000
N051.37.29.999 E012.38.25.000 N051.52.35.000 E012.12.06.200
N051.52.35.000 E012.12.06.200 N051.54.24.199 E012.00.00.000
N051.54.24.199 E012.00.00.000 N051.50.27.999 E011.12.29.998
;gr z eddm koniec





EDMM N049.06.39.999 E010.28.45.200 N049.10.42.999 E010.35.16.000
N049.10.42.999 E010.35.16.000 N049.26.30.200 E010.58.00.199
N049.26.30.200 E010.58.00.199 N049.59.58.999 E010.39.38.998
N049.59.58.999 E010.39.38.998 N050.13.36.998 E010.17.20.999
N050.13.36.998 E010.17.20.999 N050.30.00.000 E010.31.18.200
N050.30.00.000 E010.31.18.200 N050.32.13.999 E010.33.51.199
N050.32.13.999 E010.33.51.199 N050.39.26.999 E010.42.10.000
N050.39.26.999 E010.42.10.000 N051.19.59.998 E010.29.34.999
N051.19.59.998 E010.29.34.999 N051.20.02.999 E010.23.14.999
N051.20.02.999 E010.23.14.999 N051.34.00.200 E010.41.59.999
N051.34.00.200 E010.41.59.999 N051.50.27.999 E011.12.29.998
;edww/edmm poczatek
N051.50.27.999 E011.12.29.998 N051.54.24.199 E012.00.00.000
N051.54.24.199 E012.00.00.000 N051.52.35.000 E012.12.06.200
N051.52.35.000 E012.12.06.200 N051.37.29.999 E012.38.25.000
N051.37.29.999 E012.38.25.000 N051.30.29.998 E013.05.59.999
N051.30.29.998 E013.05.59.999 N051.30.29.998 E013.45.00.000
N051.30.29.998 E013.45.00.000 N051.42.00.689 E014.40.06.960
;edww/edmm koniec

; GRANICA Z FIR WARSZAWA POCZATEK
;D
N051.42.00.689 E014.40.06.960 N051.38.29.477 E014.45.14.279
N051.38.29.477 E014.45.14.279 N051.37.43.005 E014.45.13.218
N051.37.43.005 E014.45.13.218 N051.37.02.878 E014.45.43.849
N051.37.02.878 E014.45.43.849 N051.35.51.054 E014.45.23.782
N051.35.51.054 E014.45.23.782 N051.35.23.602 E014.45.31.174
N051.35.23.602 E014.45.31.174 N051.35.02.481 E014.45.50.183
N051.35.02.481 E014.45.50.183 N051.32.33.575 E014.43.18.109
N051.32.33.575 E014.43.18.109 N051.31.54.505 E014.42.54.876
N051.31.54.505 E014.42.54.876 N051.31.37.600 E014.42.59.099
N051.31.37.600 E014.42.59.099 N051.31.34.441 E014.43.10.714
N051.31.34.441 E014.43.10.714 N051.31.23.867 E014.43.52.956
N051.31.23.867 E014.43.52.956 N051.30.55.357 E014.44.04.574
N051.30.55.357 E014.44.04.574 N051.30.42.000 E014.43.50.848
;T
N051.30.42.000 E014.43.50.848 N051.30.31.078 E014.43.50.848
N051.30.31.078 E014.43.50.848 N051.30.01.497 E014.44.23.587
N051.30.01.497 E014.44.23.587 N051.29.39.318 E014.47.47.408
N051.29.39.318 E014.47.47.408 N051.28.59.191 E014.49.00.278
N051.28.59.191 E014.49.00.278 N051.26.22.896 E014.57.26.136
N051.26.22.896 E014.57.26.136 N051.24.54.182 E014.58.25.277
N051.24.54.182 E014.58.25.277 N051.24.16.169 E014.57.32.471
N051.24.16.169 E014.57.32.471 N051.23.45.545 E014.57.49.369
N051.23.45.545 E014.57.49.369 N051.23.11.748 E014.57.35.643
N051.23.11.748 E014.57.35.643 N051.22.07.327 E014.57.51.484
N051.22.07.327 E014.57.51.484 N051.21.05.021 E014.58.44.287
N051.21.05.021 E014.58.44.287 N051.20.29.109 E014.58.49.567
N051.20.29.109 E014.58.49.567 N051.19.47.924 E014.58.22.108
N051.19.47.924 E014.58.22.108 N051.19.03.567 E014.58.28.446
N051.19.03.567 E014.58.28.446 N051.17.34.852 E014.59.52.934
N051.17.34.852 E014.59.52.934 N051.16.56.840 E015.00.00.323
N051.16.56.840 E015.00.00.323 N051.15.50.304 E015.01.33.257
N051.15.50.304 E015.01.33.257 N051.14.14.201 E015.01.56.493
N051.14.14.201 E015.01.56.493 N051.08.35.204 E015.00.00.323
N051.08.35.204 E015.00.00.323 N051.07.34.999 E014.59.29.698
N051.07.34.999 E014.59.29.698 N051.06.25.304 E014.59.38.148
N051.06.25.304 E014.59.38.148 N051.03.50.067 E014.58.31.612
N051.03.50.067 E014.58.31.612 N051.03.02.538 E014.58.31.612
N051.03.02.538 E014.58.31.612 N051.02.27.684 E014.58.05.210
N051.02.27.684 E014.58.05.210 N051.01.58.117 E014.58.08.382
N051.01.58.117 E014.58.08.382 N051.00.51.581 E014.56.55.512
N051.00.51.581 E014.56.55.512 N050.59.59.835 E014.56.58.678
N050.59.59.835 E014.56.58.678 N050.59.02.802 E014.56.05.874
N050.59.02.802 E014.56.05.874 N050.58.25.847 E014.56.02.706
N050.58.25.847 E014.56.02.706 N050.58.00.496 E014.55.23.632
N050.58.00.496 E014.55.23.632 N050.56.53.960 E014.55.08.845
N050.56.53.960 E014.55.08.845 N050.56.08.559 E014.54.00.201
N050.56.08.559 E014.54.00.201 N050.55.34.763 E014.53.50.698
N050.55.34.763 E014.53.50.698 N050.54.29.284 E014.54.00.201
N050.54.29.284 E014.54.00.201 N050.51.21.308 E014.49.18.230

; GRANICA Z FIR WARSZAWA KONIEC


N050.51.21.308 E014.49.18.230 N050.49.00.200 E014.48.00.398
N050.49.00.200 E014.48.00.398 N050.49.00.200 E014.41.59.999
N050.49.00.200 E014.41.59.999 N050.49.59.998 E014.37.00.199
N050.49.59.998 E014.37.00.199 N050.55.00.199 E014.37.00.199
N050.55.00.199 E014.37.00.199 N051.00.00.000 E014.34.41.998
N051.00.00.000 E014.34.41.998 N051.02.59.999 E014.24.00.199
N051.02.59.999 E014.24.00.199 N051.02.59.999 E014.19.00.200
N051.02.59.999 E014.19.00.200 N050.58.59.998 E014.14.30.199
N050.58.59.998 E014.14.30.199 N050.55.59.998 E014.22.30.237
N050.55.59.998 E014.22.30.237 N050.52.00.199 E014.19.00.200
N050.52.00.199 E014.19.00.200 N050.47.59.999 E013.56.59.999
N050.47.59.999 E013.56.59.999 N050.46.00.199 E013.53.30.200
N050.46.00.199 E013.53.30.200 N050.44.03.199 E013.47.54.999
N050.44.03.199 E013.47.54.999 N050.43.00.200 E013.35.59.999
N050.43.00.200 E013.35.59.999 N050.36.00.195 E013.28.00.199
N050.36.00.195 E013.28.00.199 N050.37.59.998 E013.24.00.199
N050.37.59.998 E013.24.00.199 N050.31.00.199 E013.10.00.200
N050.31.00.199 E013.10.00.200 N050.28.59.998 E013.03.00.547
N050.28.59.998 E013.03.00.547 N050.27.00.019 E013.01.59.998
N050.27.00.019 E013.01.59.998 N050.25.00.199 E012.56.59.999
N050.25.00.199 E012.56.59.999 N050.27.00.019 E012.49.59.998
N050.27.00.019 E012.49.59.998 N050.23.59.999 E012.31.59.998
N050.23.59.999 E012.31.59.998 N050.17.12.998 E012.22.27.199
N050.17.12.998 E012.22.27.199 N050.12.29.998 E012.18.15.199
N050.12.29.998 E012.18.15.199 N050.19.00.200 E012.10.59.998
N050.19.00.200 E012.10.59.998 N050.19.19.999 E012.05.44.998
N050.19.19.999 E012.05.44.998 N050.18.29.998 E012.07.14.998
N050.18.29.998 E012.07.14.998 N050.12.34.999 E012.10.45.199
N050.12.34.999 E012.10.45.199 N050.10.00.199 E012.12.29.998
N050.10.00.199 E012.12.29.998 N050.06.29.998 E012.12.29.998
N050.06.29.998 E012.12.29.998 N049.58.00.200 E012.30.00.000
N049.58.00.200 E012.30.00.000 N049.55.00.199 E012.34.00.200
N049.55.00.199 E012.34.00.200 N049.46.59.998 E012.28.59.998
N049.46.59.998 E012.28.59.998 N049.41.49.999 E012.26.59.999
N049.41.49.999 E012.26.59.999 N049.40.45.199 E012.31.14.998
N049.40.45.199 E012.31.14.998 N049.31.54.199 E012.36.29.998
N049.31.54.199 E012.36.29.998 N049.25.59.998 E012.40.59.998
N049.25.59.998 E012.40.59.998 N049.20.14.999 E012.48.00.398
N049.20.14.999 E012.48.00.398 N049.19.59.998 E012.58.00.199
N049.19.59.998 E012.58.00.199 N049.07.00.199 E013.13.59.998
N049.07.00.199 E013.13.59.998 N049.07.00.199 E013.16.59.998
N049.07.00.199 E013.16.59.998 N049.02.59.999 E013.24.00.199
N049.02.59.999 E013.24.00.199 N049.00.00.000 E013.24.00.199
N049.00.00.000 E013.24.00.199 N048.58.30.087 E013.30.29.998
N048.58.30.087 E013.30.29.998 N048.58.00.200 E013.35.59.999
N048.58.00.200 E013.35.59.999 N048.52.59.998 E013.40.59.998
N048.52.59.998 E013.40.59.998 N048.52.59.998 E013.45.00.000
N048.52.59.998 E013.45.00.000 N048.46.59.998 E013.49.00.200
N048.46.59.998 E013.49.00.200 N048.37.59.998 E013.48.00.398
N048.37.59.998 E013.48.00.398 N048.31.59.998 E013.43.00.199
N048.31.59.998 E013.43.00.199 N048.34.59.998 E013.30.00.000
N048.34.59.998 E013.30.00.000 N048.32.59.999 E013.26.59.999
N048.32.59.999 E013.26.59.999 N048.22.00.199 E013.25.00.200
N048.22.00.199 E013.25.00.200 N048.17.59.999 E013.15.00.000
N048.17.59.999 E013.15.00.000 N048.16.59.998 E013.04.00.200
N048.16.59.998 E013.04.00.200 N048.13.00.200 E012.56.59.999
N048.13.00.200 E012.56.59.999 N048.13.00.200 E012.49.59.998
N048.13.00.200 E012.49.59.998 N048.06.00.095 E012.45.00.000
N048.06.00.095 E012.45.00.000 N047.57.29.998 E012.54.00.199
N047.57.29.998 E012.54.00.199 N047.52.59.998 E012.58.59.998
N047.52.59.998 E012.58.59.998 N047.45.00.000 E012.55.00.200
N047.45.00.000 E012.55.00.200 N047.43.30.087 E013.00.39.999
N047.43.30.087 E013.00.39.999 N047.38.59.999 E013.05.59.999
N047.38.59.999 E013.05.59.999 N047.28.59.998 E013.01.00.199
N047.28.59.998 E013.01.00.199 N047.28.00.200 E012.55.00.200
N047.28.00.200 E012.55.00.200 N047.32.59.999 E012.48.00.398
N047.32.59.999 E012.48.00.398 N047.37.00.199 E012.49.00.200
N047.37.00.199 E012.49.00.200 N047.40.50.600 E012.44.54.999
N047.40.50.600 E012.44.54.999 N047.37.29.999 E012.30.44.999
N047.37.29.999 E012.30.44.999 N047.40.59.998 E012.26.59.999
N047.40.59.998 E012.26.59.999 N047.40.59.998 E012.15.00.000
N047.40.59.998 E012.15.00.000 N047.42.00.039 E012.11.59.999
N047.42.00.039 E012.11.59.999 N047.37.00.199 E012.13.00.199
N047.37.00.199 E012.13.00.199 N047.35.30.200 E011.44.20.000
N047.35.30.200 E011.44.20.000 N047.27.00.019 E011.19.59.998
N047.27.00.019 E011.19.59.998 N047.23.59.999 E011.19.00.200
N047.23.59.999 E011.19.00.200 N047.22.59.998 E011.15.00.000
N047.22.59.998 E011.15.00.000 N047.25.00.199 E011.16.00.199
N047.25.00.199 E011.16.00.199 N047.25.59.998 E011.13.59.998
N047.25.59.998 E011.13.59.998 N047.25.00.199 E011.05.59.999
N047.25.00.199 E011.05.59.999 N047.25.00.199 E010.55.00.200
N047.25.00.199 E010.55.00.200 N047.28.00.200 E010.55.59.998
N047.28.00.200 E010.55.59.998 N047.28.00.200 E010.52.00.199
N047.28.00.200 E010.52.00.199 N047.31.00.199 E010.55.00.200
N047.31.00.199 E010.55.00.200 N047.31.00.199 E010.46.00.199
N047.31.00.199 E010.46.00.199 N047.33.34.999 E010.43.59.998
N047.33.34.999 E010.43.59.998 N047.34.00.200 E010.34.59.998
N047.34.00.200 E010.34.59.998 N047.31.59.998 E010.33.00.398
N047.31.59.998 E010.33.00.398 N047.31.59.998 E010.28.59.998
N047.31.59.998 E010.28.59.998 N047.34.59.998 E010.28.00.199
N047.34.59.998 E010.28.00.199 N047.34.00.200 E010.25.59.998
N047.34.00.200 E010.25.59.998 N047.25.59.998 E010.28.00.199
N047.25.59.998 E010.28.00.199 N047.19.00.200 E010.19.00.200
N047.19.00.200 E010.19.00.200 N047.16.00.199 E010.10.59.998
N047.16.00.199 E010.10.59.998 N047.22.59.998 E010.13.59.998
N047.22.59.998 E010.13.59.998 N047.22.00.199 E010.07.00.199
N047.22.00.199 E010.07.00.199 N047.25.00.199 E010.04.59.998
N047.25.00.199 E010.04.59.998 N047.25.59.998 E010.05.59.999
N047.25.59.998 E010.05.59.999 N047.31.51.999 E009.55.15.999
N047.31.51.999 E009.55.15.999 N047.32.59.999 E009.50.59.999
N047.32.59.999 E009.50.59.999 N047.36.00.195 E009.48.00.398
N047.36.00.195 E009.48.00.398 N047.34.00.200 E009.45.00.000
N047.34.00.200 E009.45.00.000 N047.32.59.999 E009.43.59.998
N047.32.59.999 E009.43.59.998 N047.31.59.998 E009.34.00.200
N047.31.59.998 E009.34.00.200 N047.35.09.999 E009.26.59.999
N047.35.09.999 E009.26.59.999 N047.37.29.999 E009.21.20.600
N047.37.29.999 E009.21.20.600 N047.38.59.999 E009.19.00.200
N047.38.59.999 E009.19.00.200 N047.40.00.199 E009.13.59.998
N047.40.00.199 E009.13.59.998 N047.46.59.998 E009.13.59.998
N047.46.59.998 E009.13.59.998 N047.47.30.199 E009.13.59.998
N047.47.30.199 E009.13.59.998 N047.47.59.999 E009.33.00.398
N047.47.59.999 E009.33.00.398 N048.31.40.999 E009.33.00.398
N048.31.40.999 E009.33.00.398 N048.37.17.000 E009.37.27.998
N048.37.17.000 E009.37.27.998 N048.48.38.599 E009.46.35.999
N048.48.38.599 E009.46.35.999 N048.56.54.999 E010.05.48.998
N048.56.54.999 E010.05.48.998 N049.06.39.999 E010.28.45.200



;EPWW D
;;;GRANICA PANSTWA

EPWW N053.10.00.000 E014.21.57.089 N53.09.45.228 E014.21.56.035
N053.09.45.228 E014.21.56.035 N53.07.51.176 E014.22.55.172
N053.07.51.176 E014.22.55.172 N53.03.26.090 E014.21.18.016
N053.03.26.090 E014.21.18.016 N53.02.07.950 E014.19.52.470
N053.02.07.950 E014.19.52.470 N53.00.00.165 E014.15.51.684
N053.00.00.165 E014.15.51.684 N52.58.55.744 E014.14.11.361
N052.58.55.744 E014.14.11.361 N52.58.30.393 E014.11.53.013
N052.58.30.393 E014.11.53.013 N52.57.04.850 E014.08.35.527
N052.57.04.850 E014.08.35.527 N52.56.51.118 E014.08.23.909
N052.56.51.118 E014.08.23.909 N52.55.46.696 E014.08.24.966
N052.55.46.696 E014.08.24.966 N52.54.19.053 E014.08.57.702
N052.54.19.053 E014.08.57.702 N52.52.03.866 E014.09.17.769
N052.52.03.866 E014.09.17.769 N52.50.29.878 E014.07.44.835
N052.50.29.878 E014.07.44.835 N52.49.23.342 E014.07.17.379
N052.49.23.342 E014.07.17.379 N52.48.40.042 E014.08.09.125
N052.48.40.042 E014.08.09.125 N52.48.53.775 E014.10.21.133
N052.48.53.775 E014.10.21.133 N52.48.24.208 E014.12.54.265
N052.48.24.208 E014.12.54.265 N52.46.50.220 E014.15.28.451
N052.46.50.220 E014.15.28.451 N52.45.34.181 E014.16.52.939
N052.45.34.181 E014.16.52.939 N52.43.54.906 E014.21.40.191
N052.43.54.906 E014.21.40.191 N52.43.43.000 E014.21.40.191
N052.43.43.000 E014.21.40.191 N52.43.54.906 E014.21.40.191
N052.43.54.906 E014.21.40.191 N52.42.18.803 E014.23.19.463
N052.42.18.803 E014.23.19.463 N52.41.22.828 E014.24.48.170
N052.41.22.828 E014.24.48.170 N52.39.46.725 E014.26.17.939
N052.39.46.725 E014.26.17.939 N52.39.35.107 E014.27.28.694
N052.39.35.107 E014.27.28.694 N52.38.56.037 E014.27.48.761
N052.38.56.037 E014.27.48.761 N52.38.34.915 E014.28.43.676
N052.38.34.915 E014.28.43.676 N52.35.29.041 E014.36.17.792
N052.35.29.041 E014.36.17.792 N52.33.49.779 E014.38.11.848
N052.33.49.779 E014.38.11.848 N52.33.01.192 E014.38.07.625
N052.33.01.192 E014.38.07.625 N52.32.25.294 E014.37.20.099
N052.32.25.294 E014.37.20.099 N52.30.34.401 E014.36.25.181
N052.30.34.401 E014.36.25.181 N52.29.55.331 E014.36.55.808
N052.29.55.331 E014.36.55.808 N52.29.24.706 E014.38.07.625
N052.29.24.706 E014.38.07.625 N52.27.58.107 E014.38.04.456
N052.27.58.107 E014.38.04.456 N52.27.20.080 E014.36.50.528
N052.27.20.080 E014.36.50.528 N52.26.54.743 E014.36.43.136
N052.26.54.743 E014.36.43.136 N52.25.54.538 E014.35.24.986
N052.25.54.538 E014.35.24.986 N52.25.23.914 E014.33.24.596
N052.25.23.914 E014.33.24.596 N52.24.48.016 E014.32.31.790
N052.24.48.016 E014.32.31.790 N52.23.42.537 E014.32.36.013
N052.23.42.537 E014.32.36.013 N52.22.53.950 E014.32.19.118
N052.22.53.950 E014.32.19.118 N52.22.20.154 E014.32.48.688
N052.22.20.154 E014.32.48.688 N52.22.00.090 E014.33.14.032
N052.22.00.090 E014.33.14.032 N52.21.52.701 E014.33.22.481
N052.21.52.701 E014.33.22.481 N52.20.39.835 E014.33.18.255
N052.20.39.835 E014.33.18.255 N52.18.33.107 E014.34.00.501
N052.18.33.107 E014.34.00.501 N52.17.39.247 E014.35.03.865
N052.17.39.247 E014.35.03.865 N52.17.04.393 E014.35.13.368
N052.17.04.393 E014.35.13.368 N52.16.51.717 E014.34.58.584
N052.16.51.717 E014.34.58.584 N52.16.21.093 E014.34.30.071
N052.16.21.093 E014.34.30.071 N52.16.01.029 E014.34.56.469
N052.16.01.029 E014.34.56.469 N52.15.30.405 E014.35.28.155
N052.15.30.405 E014.35.28.155 N52.13.56.403 E014.42.03.127
N052.13.56.403 E014.42.03.127 N52.13.07.830 E014.42.40.089
N052.13.07.830 E014.42.40.089 N52.11.39.115 E014.42.37.978
N052.11.39.115 E014.42.37.978 N52.11.06.376 E014.41.32.499
N052.11.06.376 E014.41.32.499 N52.10.22.032 E014.41.12.435
N052.10.22.032 E014.41.12.435 N52.09.42.948 E014.42.10.519
N052.09.42.948 E014.42.10.519 N52.09.00.706 E014.42.34.809
N052.09.00.706 E014.42.34.809 N52.08.14.234 E014.41.31.445
N052.08.14.234 E014.41.31.445 N52.07.07.711 E014.40.50.257
N052.07.07.711 E014.40.50.257 N52.05.42.169 E014.40.56.594
N052.05.42.169 E014.40.56.594 N52.04.48.309 E014.41.30.391
N052.04.48.309 E014.41.30.391 N52.03.57.621 E014.44.24.641
N052.03.57.621 E014.44.24.641 N52.03.26.982 E014.44.58.434
N052.03.26.982 E014.44.58.434 N52.02.24.676 E014.45.01.603
N052.02.24.676 E014.45.01.603 N52.01.54.052 E014.44.24.641
N052.01.54.052 E014.44.24.641 N52.00.44.357 E014.44.20.418
N052.00.44.357 E014.44.20.418 N52.00.00.000 E014.43.54.017
N052.00.00.000 E014.43.54.017 N51.59.20.916 E014.42.48.538
N051.59.20.916 E014.42.48.538 N51.57.50.100 E014.43.04.379
N051.57.50.100 E014.43.04.379 N51.57.21.591 E014.42.34.809
N051.57.21.591 E014.42.34.809 N51.56.16.112 E014.42.39.035
N051.56.16.112 E014.42.39.035 N51.55.14.864 E014.43.07.548
N051.55.14.864 E014.43.07.548 N51.54.09.385 E014.41.59.962
N051.54.09.385 E014.41.59.962 N51.52.26.938 E014.41.20.881
N051.52.26.938 E014.41.20.881 N51.51.59.485 E014.40.46.034
N051.51.59.485 E014.40.46.034 N51.52.11.104 E014.39.54.285
N051.52.11.104 E014.39.54.285 N51.50.00.146 E014.37.57.061
N051.50.00.146 E014.37.57.061 N51.49.48.528 E014.36.36.799
N051.49.48.528 E014.36.36.799 N51.48.38.834 E014.35.34.489
N051.48.38.834 E014.35.34.489 N51.47.43.916 E014.35.32.378
N051.47.43.916 E014.35.32.378 N51.47.00.616 E014.36.05.117
N051.47.00.616 E014.36.05.117 N51.46.04.641 E014.38.12.902
N051.46.04.641 E014.38.12.902 N51.44.54.946 E014.39.15.211
N051.44.54.946 E014.39.15.211 N51.43.29.404 E014.39.02.539
N051.43.29.404 E014.39.02.539 N51.42.00.689 E014.40.06.960
N051.42.00.689 E014.40.06.960 N51.38.29.477 E014.45.14.279
N051.38.29.477 E014.45.14.279 N51.37.43.005 E014.45.13.218
N051.37.43.005 E014.45.13.218 N51.37.02.878 E014.45.43.849
N051.37.02.878 E014.45.43.849 N51.35.51.054 E014.45.23.782
N051.35.51.054 E014.45.23.782 N51.35.23.602 E014.45.31.174
N051.35.23.602 E014.45.31.174 N51.35.02.481 E014.45.50.183
N051.35.02.481 E014.45.50.183 N51.32.33.575 E014.43.18.109
N051.32.33.575 E014.43.18.109 N51.31.54.505 E014.42.54.876
N051.31.54.505 E014.42.54.876 N51.31.37.600 E014.42.59.099
N051.31.37.600 E014.42.59.099 N51.31.34.441 E014.43.10.714
N051.31.34.441 E014.43.10.714 N51.31.23.867 E014.43.52.956
N051.31.23.867 E014.43.52.956 N51.30.55.357 E014.44.04.574
N051.30.55.357 E014.44.04.574 N51.30.42.000 E014.43.50.848


;SEKTOR D
N051.30.42.000 E014.43.50.848 N051.37.04.000 E016.00.14.000
N051.37.04.000 E016.00.14.000 N051.38.52.000 E016.20.21.000
N051.38.52.000 E016.20.21.000 N051.42.00.000 E016.59.51.000
N051.42.00.000 E016.59.51.000 N051.43.48.000 E017.23.56.000
N051.43.48.000 E017.23.56.000 N051.45.00.000 E017.40.42.000
N051.45.00.000 E017.40.42.000 N052.42.48.000 E017.37.28.000
N052.42.48.000 E017.37.28.000 N053.11.18.000 E016.34.37.000
N053.11.18.000 E016.34.37.000 N052.43.43.000 E014.21.40.191


;EPWW_C
N051.45.00.000 E017.40.42.000 N051.29.18.000 E018.00.29.000
N051.29.18.000 E018.00.29.000 N050.53.40.000 E018.44.18.000
N050.53.40.000 E018.44.18.000 N051.08.57.000 E019.06.43.000
N051.08.57.000 E019.06.43.000 N051.29.45.000 E020.13.47.000
N051.29.45.000 E020.13.47.000 N052.06.24.000 E020.19.13.000
N052.06.24.000 E020.19.13.000 N052.27.07.000 E019.48.33.000
N052.27.07.000 E019.48.33.000 N052.42.48.000 E017.37.28.000
N052.42.48.000 E017.37.28.000 N051.45.00.000 E017.40.42.000

;EPWW_T
N051.30.42.000 E014.43.50.848 N051.30.31.078 E014.43.50.848
N051.30.31.078 E014.43.50.848 N051.30.01.497 E014.44.23.587
N051.30.01.497 E014.44.23.587 N051.29.39.318 E014.47.47.408
N051.29.39.318 E014.47.47.408 N051.28.59.191 E014.49.00.278
N051.28.59.191 E014.49.00.278 N051.26.22.896 E014.57.26.136
N051.26.22.896 E014.57.26.136 N051.24.54.182 E014.58.25.277
N051.24.54.182 E014.58.25.277 N051.24.16.169 E014.57.32.471
N051.24.16.169 E014.57.32.471 N051.23.45.545 E014.57.49.369
N051.23.45.545 E014.57.49.369 N051.23.11.748 E014.57.35.643
N051.23.11.748 E014.57.35.643 N051.22.07.327 E014.57.51.484
N051.22.07.327 E014.57.51.484 N051.21.05.021 E014.58.44.287
N051.21.05.021 E014.58.44.287 N051.20.29.109 E014.58.49.567
N051.20.29.109 E014.58.49.567 N051.19.47.924 E014.58.22.108
N051.19.47.924 E014.58.22.108 N051.19.03.567 E014.58.28.446
N051.19.03.567 E014.58.28.446 N051.17.34.852 E014.59.52.934
N051.17.34.852 E014.59.52.934 N051.16.56.840 E015.00.00.323
N051.16.56.840 E015.00.00.323 N051.15.50.304 E015.01.33.257
N051.15.50.304 E015.01.33.257 N051.14.14.201 E015.01.56.493
N051.14.14.201 E015.01.56.493 N051.08.35.204 E015.00.00.323
N051.08.35.204 E015.00.00.323 N051.07.34.999 E014.59.29.698
N051.07.34.999 E014.59.29.698 N051.06.25.304 E014.59.38.148
N051.06.25.304 E014.59.38.148 N051.03.50.067 E014.58.31.612
N051.03.50.067 E014.58.31.612 N051.03.02.538 E014.58.31.612
N051.03.02.538 E014.58.31.612 N051.02.27.684 E014.58.05.210
N051.02.27.684 E014.58.05.210 N051.01.58.117 E014.58.08.382
N051.01.58.117 E014.58.08.382 N051.00.51.581 E014.56.55.512
N051.00.51.581 E014.56.55.512 N050.59.59.835 E014.56.58.678
N050.59.59.835 E014.56.58.678 N050.59.02.802 E014.56.05.874
N050.59.02.802 E014.56.05.874 N050.58.25.847 E014.56.02.706
N050.58.25.847 E014.56.02.706 N050.58.00.496 E014.55.23.632
N050.58.00.496 E014.55.23.632 N050.56.53.960 E014.55.08.845
N050.56.53.960 E014.55.08.845 N050.56.08.559 E014.54.00.201
N050.56.08.559 E014.54.00.201 N050.55.34.763 E014.53.50.698
N050.55.34.763 E014.53.50.698 N050.54.29.284 E014.54.00.201
N050.54.29.284 E014.54.00.201 N050.51.21.308 E014.49.18.230
N050.51.21.308 E014.49.18.230 N050.50.40.109 E014.49.24.568
N050.50.40.109 E014.49.24.568 N050.50.04.211 E014.49.52.023
N050.50.04.211 E014.49.52.023 N050.50.36.951 E014.51.31.295
N050.50.36.951 E014.51.31.295 N050.50.21.103 E014.52.43.108
N050.50.21.103 E014.52.43.108 N050.50.44.339 E014.54.08.650
N050.50.44.339 E014.54.08.650 N050.50.02.097 E014.57.33.532
N050.50.02.097 E014.57.33.532 N050.50.21.103 E014.59.01.182
N050.50.21.103 E014.59.01.182 N050.52.19.384 E014.59.50.820
N050.52.19.384 E014.59.50.820 N050.53.29.093 E014.59.04.351
N050.53.29.093 E014.59.04.351 N050.54.11.335 E015.00.00.323
N050.54.11.335 E015.00.00.323 N050.55.11.526 E015.00.49.960
N050.55.11.526 E015.00.49.960 N050.55.46.381 E015.00.33.062
N050.55.46.381 E015.00.33.062 N050.57.04.521 E015.00.53.129
N050.57.04.521 E015.00.53.129 N050.57.28.814 E015.00.00.323
N050.57.28.814 E015.00.00.323 N050.57.21.426 E014.58.36.895
N050.57.21.426 E014.58.36.895 N050.57.41.490 E014.58.18.940
N050.57.41.490 E014.58.18.940 N050.58.46.968 E014.59.09.631
N050.58.46.968 E014.59.09.631 N050.59.03.860 E015.00.00.323
N050.59.03.860 E015.00.00.323 N050.59.55.605 E015.01.29.034
N050.59.55.605 E015.01.29.034 N050.58.21.617 E015.02.30.286
N050.58.21.617 E015.02.30.286 N050.59.38.714 E015.04.08.500
N050.59.38.714 E015.04.08.500 N050.59.14.420 E015.04.27.514
N050.59.14.420 E015.04.27.514 N050.58.56.472 E015.06.17.346
N050.58.56.472 E015.06.17.346 N050.58.24.790 E015.05.50.941
N050.58.24.790 E015.05.50.941 N050.57.59.439 E015.06.03.613
N050.57.59.439 E015.06.03.613 N050.57.56.280 E015.06.36.352
N050.57.56.280 E015.06.36.352 N050.57.40.432 E015.08.06.118
N050.57.40.432 E015.08.06.118 N050.58.53.299 E015.08.34.634
N050.58.53.299 E015.08.34.634 N050.59.12.306 E015.09.10.542
N050.59.12.306 E015.09.10.542 N050.59.11.262 E015.10.04.399
N050.59.11.262 E015.10.04.399 N050.57.40.432 E015.10.27.635
N050.57.40.432 E015.10.27.635 N050.57.15.081 E015.11.08.820
N050.57.15.081 E015.11.08.820 N050.57.12.980 E015.11.42.617
N050.57.12.980 E015.11.42.617 N050.57.48.878 E015.12.29.082
N050.57.48.878 E015.12.29.082 N050.57.53.108 E015.13.27.166
N050.57.53.108 E015.13.27.166 N050.57.48.878 E015.14.13.631
N050.57.48.878 E015.14.13.631 N050.57.21.426 E015.14.31.587
N050.57.21.426 E015.14.31.587 N050.57.07.693 E015.15.46.568
N050.57.07.693 E015.15.46.568 N050.55.29.475 E015.17.33.232
N050.55.29.475 E015.17.33.232 N050.54.14.494 E015.16.11.912
N050.54.14.494 E015.16.11.912 N050.53.14.302 E015.15.58.186
N050.53.14.302 E015.15.58.186 N050.50.42.224 E015.17.05.773
N050.50.42.224 E015.17.05.773 N050.49.59.982 E015.17.57.522
N050.49.59.982 E015.17.57.522 N050.49.17.739 E015.20.58.110
N050.49.17.739 E015.20.58.110 N050.48.32.338 E015.21.49.859
N050.48.32.338 E015.21.49.859 N050.46.04.476 E015.21.47.747
N050.46.04.476 E015.21.47.747 N050.45.47.585 E015.22.18.372
N050.45.47.585 E015.22.18.372 N050.45.59.203 E015.22.23.652
N050.45.59.203 E015.22.23.652 N050.45.01.112 E015.22.21.541
N050.45.01.112 E015.22.21.541 N050.44.52.667 E015.23.01.672
N050.44.52.667 E015.23.01.672 N050.45.19.075 E015.24.11.373
N050.45.19.075 E015.24.11.373 N050.46.42.502 E015.25.37.969
N050.46.42.502 E015.25.37.969 N050.46.49.891 E015.26.20.212
N050.46.49.891 E015.26.20.212 N050.46.18.209 E015.27.45.757
N050.46.18.209 E015.27.45.757 N050.45.34.909 E015.28.33.280
N050.45.34.909 E015.28.33.280 N050.45.21.176 E015.29.01.793
N050.45.21.176 E015.29.01.793 N050.45.31.737 E015.30.16.775
N050.45.31.737 E015.30.16.775 N050.44.52.667 E015.30.40.007
N050.44.52.667 E015.30.40.007 N050.44.48.437 E015.31.12.747
N050.44.48.437 E015.31.12.747 N050.45.05.342 E015.32.27.728
N050.45.05.342 E015.32.27.728 N050.44.54.781 E015.33.54.328
N050.44.54.781 E015.33.54.328 N050.45.03.227 E015.34.33.402
N050.45.03.227 E015.34.33.402 N050.44.33.660 E015.36.46.467
N050.44.33.660 E015.36.46.467 N050.43.40.857 E015.38.40.525
N050.43.40.857 E015.38.40.525 N050.43.25.009 E015.40.28.243
N050.43.25.009 E015.40.28.243 N050.42.51.213 E015.40.46.195
N050.42.51.213 E015.40.46.195 N050.42.44.882 E015.41.35.833
N050.42.44.882 E015.41.35.833 N050.42.32.206 E015.43.12.990
N050.42.32.206 E015.43.12.990 N050.42.53.328 E015.45.21.832
N050.42.53.328 E015.45.21.832 N050.42.43.824 E015.46.08.301
N050.42.43.824 E015.46.08.301 N050.43.22.895 E015.48.23.477
N050.43.22.895 E015.48.23.477 N050.42.33.264 E015.49.13.111
N050.42.33.264 E015.49.13.111 N050.38.34.586 E015.51.56.804
N050.38.34.586 E015.51.56.804 N050.38.22.968 E015.52.40.101
N050.38.22.968 E015.52.40.101 N050.39.15.785 E015.55.32.243
N050.39.15.785 E015.55.32.243 N050.39.09.440 E015.56.02.867
N050.39.09.440 E015.56.02.867 N050.39.44.294 E015.57.52.699
N050.39.44.294 E015.57.52.699 N050.38.55.707 E015.59.45.701
N050.38.55.707 E015.59.45.701 N050.38.12.421 E016.00.00.488
N050.38.12.421 E016.00.00.488 N050.37.31.222 E016.00.14.214
N050.37.31.222 E016.00.14.214 N050.37.21.719 E016.00.13.156
N050.37.21.719 E016.00.13.156 N050.37.14.331 E016.00.11.048
N050.37.14.331 E016.00.11.048 N050.37.15.388 E016.00.00.488
N050.37.15.388 E016.00.00.488 N050.37.16.446 E015.59.59.430
N050.37.16.446 E015.59.59.430 N050.37.14.331 E015.59.56.265
N050.37.14.331 E015.59.56.265 N050.37.13.273 E015.59.56.265
N050.37.13.273 E015.59.56.265 N050.37.12.216 E015.59.53.096
N050.37.12.216 E015.59.53.096 N050.37.09.044 E015.59.53.096
N050.37.09.044 E015.59.53.096 N050.37.08.000 E015.59.50.981
N050.37.08.000 E015.59.50.981 N050.37.04.828 E015.59.48.869
N050.37.04.828 E015.59.48.869 N050.36.54.267 E015.59.43.593
N050.36.54.267 E015.59.43.593 N050.36.52.152 E015.59.43.593
N050.36.52.152 E015.59.43.593 N050.36.51.095 E015.59.42.532
N050.36.51.095 E015.59.42.532 N050.36.46.879 E015.59.42.532
N050.36.46.879 E015.59.42.532 N050.36.40.534 E015.59.42.532
N050.36.40.534 E015.59.42.532 N050.36.39.477 E015.59.43.593
N050.36.39.477 E015.59.43.593 N050.36.36.304 E015.59.43.593
N050.36.36.304 E015.59.43.593 N050.36.27.859 E015.59.47.815
N050.36.27.859 E015.59.47.815 N050.36.25.757 E015.59.50.981
N050.36.25.757 E015.59.50.981 N050.36.24.686 E015.59.50.981
N050.36.24.686 E015.59.50.981 N050.36.20.470 E016.00.00.488
N050.36.20.470 E016.00.00.488 N050.36.20.470 E016.00.00.488
N050.36.20.470 E016.00.00.488 N050.36.10.967 E016.00.24.774
N050.36.10.967 E016.00.24.774 N050.36.06.737 E016.00.43.787
N050.36.06.737 E016.00.43.787 N050.36.39.477 E016.03.36.980
N050.36.39.477 E016.03.36.980 N050.39.24.230 E016.05.39.484
N050.39.24.230 E016.05.39.484 N050.39.05.210 E016.09.15.984
N050.39.05.210 E016.09.15.984 N050.37.22.776 E016.11.30.106
N050.37.22.776 E016.11.30.106 N050.38.01.847 E016.13.26.273
N050.38.01.847 E016.13.26.273 N050.39.43.237 E016.13.44.229
N050.39.43.237 E016.13.44.229 N050.39.23.173 E016.17.33.397
N050.39.23.173 E016.17.33.397 N050.39.27.403 E016.20.25.532
N050.39.27.403 E016.20.25.532 N050.36.06.737 E016.25.50.803
N050.36.06.737 E016.25.50.803 N050.34.13.743 E016.26.39.390
N050.34.13.743 E016.26.39.390 N050.30.08.734 E016.22.21.705
N050.30.08.734 E016.22.21.705 N050.30.08.734 E016.18.39.926
N050.30.08.734 E016.18.39.926 N050.25.21.483 E016.11.56.508
N050.25.21.483 E016.11.56.508 N050.24.19.177 E016.14.58.153
N050.24.19.177 E016.14.58.153 N050.22.02.932 E016.16.22.638
N050.22.02.932 E016.16.22.638 N050.22.56.793 E016.20.18.143
N050.22.56.793 E016.20.18.143 N050.22.09.277 E016.22.14.310
N050.22.09.277 E016.22.14.310 N050.20.31.059 E016.22.11.145
N050.20.31.059 E016.22.11.145 N050.19.05.517 E016.26.14.039
N050.19.05.517 E016.26.14.039 N050.13.40.239 E016.32.49.011
N050.13.40.239 E016.32.49.011 N050.09.54.250 E016.33.22.808
N050.09.54.250 E016.33.22.808 N050.07.14.770 E016.37.02.472
N050.07.14.770 E016.37.02.472 N050.05.54.515 E016.41.30.717
N050.05.54.515 E016.41.30.717 N050.06.12.464 E016.43.23.712
N050.06.12.464 E016.43.23.712 N050.12.02.035 E016.49.55.518
N050.12.02.035 E016.49.55.518 N050.11.45.130 E016.51.49.577
N050.11.45.130 E016.51.49.577 N050.13.21.233 E016.53.38.349
N050.13.21.233 E016.53.38.349 N050.13.20.175 E016.57.26.466
N050.13.20.175 E016.57.26.466 N050.14.12.979 E016.57.41.250
N050.14.12.979 E016.57.41.250 N050.13.11.730 E016.59.59.595
N050.13.11.730 E016.59.59.595 N050.13.20.175 E017.01.07.181
N050.13.20.175 E017.01.07.181 N050.15.00.508 E017.00.11.213
N050.15.00.508 E017.00.11.213 N050.16.26.050 E017.01.14.577
N050.16.26.050 E017.01.14.577 N050.18.00.038 E016.59.59.595
N050.18.00.038 E016.59.59.595 N050.19.00.230 E016.56.29.433
N050.19.00.230 E016.56.29.433 N050.24.06.501 E016.51.58.023
N050.24.06.501 E016.51.58.023 N050.26.43.853 E016.54.08.973
N050.26.43.853 E016.54.08.973 N050.25.29.929 E016.59.59.595
N050.25.29.929 E016.59.59.595 N050.23.54.883 E017.04.14.107
N050.23.54.883 E017.04.14.107 N050.24.14.947 E017.06.15.554
N050.24.14.947 E017.06.15.554 N050.22.36.729 E017.08.44.460
N050.22.36.729 E017.08.44.460 N050.23.06.296 E017.11.46.105
N050.23.06.296 E017.11.46.105 N050.21.42.869 E017.11.03.863
N050.21.42.869 E017.11.03.863 N050.18.52.841 E017.17.48.345
N050.18.52.841 E017.17.48.345 N050.19.38.256 E017.20.30.977
N050.19.38.256 E017.20.30.977 N050.18.59.186 E017.21.30.118
N050.18.59.186 E017.21.30.118 N050.16.04.929 E017.20.30.977
N050.16.04.929 E017.20.30.977 N050.15.43.808 E017.21.34.341
N050.15.43.808 E017.21.34.341 N050.17.01.948 E017.24.23.310
N050.17.01.948 E017.24.23.310 N050.15.08.954 E017.25.33.018
N050.15.08.954 E017.25.33.018 N050.16.21.821 E017.29.41.193
N050.16.21.821 E017.29.41.193 N050.15.52.254 E017.36.30.948
N050.15.52.254 E017.36.30.948 N050.15.59.642 E017.38.38.733
N050.15.59.642 E017.38.38.733 N050.17.35.745 E017.40.54.971
N050.17.35.745 E017.40.54.971 N050.19.20.307 E017.41.01.308
N050.19.20.307 E017.41.01.308 N050.18.12.714 E017.44.57.865
N050.18.12.714 E017.44.57.865 N050.15.38.521 E017.43.29.157
N050.15.38.521 E017.43.29.157 N050.13.44.469 E017.45.32.719
N050.13.44.469 E017.45.32.719 N050.12.29.487 E017.45.21.101
N050.12.29.487 E017.45.21.101 N050.11.59.920 E017.42.40.577
N050.11.59.920 E017.42.40.577 N050.10.58.658 E017.42.16.283
N050.10.58.658 E017.42.16.283 N050.10.04.797 E017.36.06.662
N050.10.04.797 E017.36.06.662 N050.09.24.670 E017.35.55.044
N050.09.24.670 E017.35.55.044 N050.06.15.636 E017.40.13.779
N050.06.15.636 E017.40.13.779 N050.06.49.433 E017.41.27.710
N050.06.49.433 E017.41.27.710 N050.06.19.866 E017.43.59.781
N050.06.19.866 E017.43.59.781 N050.05.37.624 E017.43.24.934
N050.05.37.624 E017.43.24.934 N049.59.59.670 E017.48.17.466
N049.59.59.670 E017.48.17.466 N049.59.44.894 E017.49.16.606
N049.59.44.894 E017.49.16.606 N049.59.08.982 E017.50.30.531
N049.59.08.982 E017.50.30.531 N049.58.38.358 E017.52.19.309
N049.58.38.358 E017.52.19.309 N049.58.26.740 E017.53.25.838
N049.58.26.740 E017.53.25.838 N049.58.28.855 E017.54.17.584
N049.58.28.855 E017.54.17.584 N049.58.49.976 E017.55.49.464
N049.58.49.976 E017.55.49.464 N049.59.23.773 E017.56.32.764
N049.59.23.773 E017.56.32.764 N049.59.59.670 E017.58.06.752
N049.59.59.670 E017.58.06.752 N049.59.59.670 E017.58.06.752
N049.59.59.670 E017.58.06.752 N050.00.21.849 E017.58.32.103
N050.00.21.849 E017.58.32.103 N050.00.50.359 E017.59.11.180
N050.00.50.359 E017.59.11.180 N050.00.58.818 E017.59.43.912
N050.00.58.818 E017.59.43.912 N050.00.55.646 E017.59.59.753
N050.00.55.646 E017.59.59.753 N050.00.22.906 E018.03.21.469
N050.00.22.906 E018.03.21.469 N050.02.46.539 E018.00.16.651
N050.02.46.539 E018.00.16.651 N050.03.23.494 E018.03.40.475
N050.03.23.494 E018.03.40.475 N050.02.52.000 E018.05.52.000
N050.02.52.000 E018.05.52.000 N050.25.08.000 E018.06.36.000
N050.25.08.000 E018.06.36.000 N050.53.40.000 E018.44.18.000

;EPWW_J
N051.29.45.000 E020.13.47.000 N051.12.56.000 E021.22.18.000
N051.12.56.000 E021.22.18.000 N050.11.58.000 E021.20.57.000
N050.11.58.000 E021.20.57.000 N049.55.48.000 E021.10.31.000
N049.55.48.000 E021.10.31.000 N049.24.10.000 E021.11.56.000
;granica FIR J
N050.02.52.000 E018.05.52.000 N049.59.59.670 E018.06.41.063 
N049.59.59.670 E018.06.41.063 N049.59.53.340 E018.07.11.687 
N049.59.53.340 E018.07.11.687 N049.59.57.556 E018.07.38.096 
N049.59.57.556 E018.07.38.096 N049.59.54.397 E018.08.04.497 
N049.59.54.397 E018.08.04.497 N049.59.17.428 E018.08.57.293 
N049.59.17.428 E018.08.57.293 N049.59.11.097 E018.09.26.867 
N049.59.11.097 E018.09.26.867 N049.59.17.428 E018.09.42.708 
N049.59.17.428 E018.09.42.708 N049.59.59.670 E018.10.33.403 
N049.59.59.670 E018.10.33.403 N049.59.59.670 E018.12.50.691
N049.59.59.670 E018.12.50.691 N049.58.06.676 E018.13.46.666 
N049.58.06.676 E018.13.46.666 N049.57.46.612 E018.16.34.579 
N049.57.46.612 E018.16.34.579 N049.56.09.452 E018.17.21.051 
N049.56.09.452 E018.17.21.051 N049.56.42.191 E018.19.35.166 
N049.56.42.191 E018.19.35.166 N049.55.30.368 E018.20.30.084 
N049.55.30.368 E018.20.30.084 N049.56.15.783 E018.23.58.131 
N049.56.15.783 E018.23.58.131 N049.54.22.788 E018.29.22.344 
N049.54.22.788 E018.29.22.344 N049.54.50.240 E018.34.29.666 
N049.54.50.240 E018.34.29.666 N049.51.33.805 E018.34.29.666 
N049.51.33.805 E018.34.29.666 N049.50.27.283 E018.35.50.979 
N049.50.27.283 E018.35.50.979 N049.49.03.855 E018.34.48.673 
N049.49.03.855 E018.34.48.673 N049.42.55.278 E018.38.11.439 
N049.42.55.278 E018.38.11.439 N049.40.16.869 E018.48.44.025 
N049.40.16.869 E018.48.44.025 N049.32.52.266 E018.51.35.116 
N049.32.52.266 E018.51.35.116 N049.31.27.781 E018.50.49.702 
N049.31.27.781 E018.50.49.702 N049.30.38.136 E018.57.54.248 
N049.30.38.136 E018.57.54.248 N049.25.37.152 E018.59.20.841 
N049.25.37.152 E018.59.20.841 N049.24.02.107 E018.58.22.757 
N049.24.02.107 E018.58.22.757 N049.24.02.107 E018.59.59.918 
N049.24.02.107 E018.59.59.918 N049.23.39.928 E019.01.58.199 
N049.23.39.928 E019.01.58.199 N049.25.14.987 E019.04.34.493 
N049.25.14.987 E019.04.34.493 N049.24.16.897 E019.08.05.712 
N049.24.16.897 E019.08.05.712 N049.24.48.579 E019.11.30.594 
N049.24.48.579 E019.11.30.594 N049.26.40.516 E019.11.49.600 
N049.26.40.516 E019.11.49.600 N049.27.31.218 E019.14.03.723 
N049.27.31.218 E019.14.03.723 N049.31.24.608 E019.15.20.812 
N049.31.24.608 E019.15.20.812 N049.32.19.526 E019.22.15.855 
N049.32.19.526 E019.22.15.855 N049.34.16.750 E019.23.14.996 
N049.34.16.750 E019.23.14.996 N049.35.56.012 E019.27.37.961 
N049.35.56.012 E019.27.37.961 N049.34.09.348 E019.31.51.415 
N049.34.09.348 E019.31.51.415 N049.30.05.397 E019.33.11.677 
N049.30.05.397 E019.33.11.677 N049.26.44.745 E019.36.27.048 
N049.26.44.745 E019.36.27.048 N049.26.46.860 E019.38.33.783 
N049.26.46.860 E019.38.33.783 N049.24.03.164 E019.38.28.502 
N049.24.03.164 E019.38.28.502 N049.23.12.476 E019.43.54.824 
N049.23.12.476 E019.43.54.824 N049.24.13.725 E019.45.38.322 
N049.24.13.725 E019.45.38.322 N049.24.16.897 E019.47.33.438 
N049.24.16.897 E019.47.33.438 N049.17.35.580 E019.47.43.992 
N049.17.35.580 E019.47.43.992 N049.16.22.713 E019.49.22.209 
N049.16.22.713 E019.49.22.209 N049.13.55.922 E019.46.02.608 
N049.13.55.922 E019.46.02.608 N049.12.18.762 E019.46.15.284 
N049.12.18.762 E019.46.15.284 N049.11.33.347 E019.47.19.705 
N049.11.33.347 E019.47.19.705 N049.11.51.310 E019.48.34.687 
N049.11.51.310 E019.48.34.687 N049.11.25.959 E019.52.37.587 
N049.11.25.959 E019.52.37.587 N049.13.49.591 E019.55.35.003 
N049.13.49.591 E019.55.35.003 N049.13.30.571 E020.00.00.082 
N049.13.30.571 E020.00.00.082 N049.12.22.992 E020.00.51.828 
N049.12.22.992 E020.00.51.828 N049.10.41.602 E020.05.38.029 
N049.10.41.602 E020.05.38.029 N049.17.10.243 E020.08.01.654 
N049.17.10.243 E020.08.01.654 N049.18.38.958 E020.08.37.559 
N049.18.38.958 E020.08.37.559 N049.18.15.721 E020.09.56.764 
N049.18.15.721 E020.09.56.764 N049.20.49.901 E020.13.35.371 
N049.20.49.901 E020.13.35.371 N049.20.52.016 E020.17.31.934 
N049.20.52.016 E020.17.31.934 N049.20.22.449 E020.18.59.584 
N049.20.22.449 E020.18.59.584 N049.23.12.476 E020.18.53.253 
N049.23.12.476 E020.18.53.253 N049.23.57.891 E020.19.17.540 
N049.23.57.891 E020.19.17.540 N049.23.57.891 E020.21.57.007 
N049.23.57.891 E020.21.57.007 N049.22.54.513 E020.23.10.931 
N049.22.54.513 E020.23.10.931 N049.24.23.228 E020.25.58.850 
N049.24.23.228 E020.25.58.850 N049.24.46.464 E020.26.54.819 
N049.24.46.464 E020.26.54.819 N049.24.38.018 E020.29.15.279 
N049.24.38.018 E020.29.15.279 N049.22.57.686 E020.32.39.103 
N049.22.57.686 E020.32.39.103 N049.22.49.240 E020.35.13.289 
N049.22.49.240 E020.35.13.289 N049.24.58.082 E020.37.01.010 
N049.24.58.082 E020.37.01.010 N049.24.01.049 E020.39.28.858 
N049.24.01.049 E020.39.28.858 N049.24.55.967 E020.42.00.930 
N049.24.55.967 E020.42.00.930 N049.24.49.636 E020.43.44.428 
N049.24.49.636 E020.43.44.428 N049.19.58.155 E020.49.22.374 
N049.19.58.155 E020.49.22.374 N049.20.21.391 E020.51.51.280 
N049.20.21.391 E020.51.51.280 N049.19.45.480 E020.52.41.968 
N049.19.45.480 E020.52.41.968 N049.19.05.352 E020.52.32.465 
N049.19.05.352 E020.52.32.465 N049.19.07.467 E020.54.31.804 
N049.19.07.467 E020.54.31.804 N049.17.41.925 E020.56.26.913 
N049.17.41.925 E020.56.26.913 N049.18.18.880 E020.59.27.501 
N049.18.18.880 E020.59.27.501 N049.19.38.091 E021.00.00.240
N049.19.38.091 E021.00.00.240 N049.21.45.876 E021.03.29.344 
N049.21.45.876 E021.03.29.344 N049.22.00.667 E021.06.00.365 
N049.22.00.667 E021.06.00.365 N049.25.08.643 E021.04.02.084 
N049.25.08.643 E021.04.02.084 N049.25.51.942 E021.08.36.666 
N049.25.51.942 E021.08.36.666 N049.24.10.000 E021.11.56.000


;EPWW_R
EPWW N051.29.45.000 E020.13.47.000 N051.48.33.000 E020.16.33.000
N051.48.33.000 E020.16.33.000 N051.48.33.000 E022.05.57.000
N051.48.33.000 E022.05.57.000 N052.11.17.000 E023.24.16.000 


;GRANICA FIR
N049.24.10.000 E021.11.56.000 N049.27.09.039 E021.17.13.086 
N049.27.09.039 E021.17.13.086 N049.25.48.770 E021.23.22.714
N049.25.48.770 E021.23.22.714 N049.25.58.273 E021.24.29.243
N049.25.58.273 E021.24.29.243 N049.24.49.636 E021.27.27.723
N049.24.49.636 E021.27.27.723 N049.26.37.357 E021.33.57.415
N049.26.37.357 E021.33.57.415 N049.26.04.618 E021.35.27.180
N049.26.04.618 E021.35.27.180 N049.26.41.573 E021.38.18.264
N049.26.41.573 E021.38.18.264 N049.25.08.643 E021.39.58.590
N049.25.08.643 E021.39.58.590 N049.24.45.406 E021.43.38.255
N049.24.45.406 E021.43.38.255 N049.21.09.965 E021.46.54.684
N049.21.09.965 E021.46.54.684 N049.23.23.036 E021.50.48.074
N049.23.23.036 E021.50.48.074 N049.21.15.252 E021.54.03.452
N049.21.15.252 E021.54.03.452 N049.20.33.009 E021.56.20.740
N049.20.33.009 E021.56.20.740 N049.20.43.570 E021.58.23.245
N049.20.43.570 E021.58.23.245 N049.18.17.836 E022.00.00.405
N049.18.17.836 E022.00.00.405 N049.14.43.452 E022.02.30.368
N049.14.43.452 E022.02.30.368 N049.13.01.004 E022.03.06.273
N049.13.01.004 E022.03.06.273 N049.12.03.972 E022.08.41.047
N049.12.03.972 E022.08.41.047 N049.10.41.602 E022.11.34.247
N049.10.41.602 E022.11.34.247 N049.11.04.838 E022.14.13.713
N049.11.04.838 E022.14.13.713 N049.09.10.786 E022.14.07.375
N049.09.10.786 E022.14.07.375 N049.08.11.638 E022.19.08.360
N049.08.11.638 E022.19.08.360 N049.08.54.938 E022.22.20.565
N049.08.54.938 E022.22.20.565 N049.06.17.586 E022.24.57.917
N049.06.17.586 E022.24.57.917 N049.05.16.338 E022.34.12.363
N049.05.16.338 E022.34.12.363 N049.05.29.013 E022.36.51.829
N049.05.29.013 E022.36.51.829 N049.02.30.526 E022.41.35.915
N049.02.30.526 E022.41.35.915 N049.03.27.559 E022.46.41.115
N049.03.27.559 E022.46.41.115 N049.02.21.023 E022.48.26.728
N049.02.21.023 E022.48.26.728 N049.05.34.286 E022.54.08.898
N049.05.34.286 E022.54.08.898 N049.07.08.275 E022.50.11.277
N049.07.08.275 E022.50.11.277 N049.09.35.066 E022.47.41.314
N049.09.35.066 E022.47.41.314 N049.09.51.971 E022.45.02.905
N049.09.51.971 E022.45.02.905 N049.10.58.507 E022.45.25.083
N049.10.58.507 E022.45.25.083 N049.10.29.984 E022.43.44.751
N049.10.29.984 E022.43.44.751 N049.10.25.768 E022.42.47.725
N049.10.25.768 E022.42.47.725 N049.11.23.844 E022.43.12.011
N049.11.23.844 E022.43.12.011 N049.13.08.406 E022.45.05.013
N049.13.08.406 E022.45.05.013 N049.13.50.649 E022.43.58.483
N049.13.50.649 E022.43.58.483 N049.16.30.102 E022.47.21.250
N049.16.30.102 E022.47.21.250 N049.19.35.977 E022.48.47.850
N049.19.35.977 E022.48.47.850 N049.26.59.536 E022.41.46.476
N049.26.59.536 E022.41.46.476 N049.28.33.524 E022.42.07.597
N049.28.33.524 E022.42.07.597 N049.31.36.227 E022.40.00.863
N049.31.36.227 E022.40.00.863 N049.32.41.691 E022.40.10.366
N049.32.41.691 E022.40.10.366 N049.41.21.290 E022.48.04.550
N049.41.21.290 E022.48.04.550 N049.43.01.609 E022.51.12.526
N049.43.01.609 E022.51.12.526 N049.51.07.410 E022.59.59.512
N049.51.07.410 E022.59.59.512 N049.52.26.622 E023.02.05.182
N049.52.26.622 E023.02.05.182 N049.53.10.965 E023.02.35.814
N049.53.10.965 E023.02.35.814 N049.53.48.992 E023.03.13.833
N049.53.48.992 E023.03.13.833 N049.56.01.006 E023.05.55.408
N049.56.01.006 E023.05.55.408 N049.56.41.134 E023.06.22.867
N049.56.41.134 E023.06.22.867 N049.57.18.089 E023.07.04.052
N049.57.18.089 E023.07.04.052 N049.57.39.210 E023.07.46.294
N049.57.39.210 E023.07.46.294 N049.58.11.949 E023.08.19.033
N049.58.11.949 E023.08.19.033 N049.58.32.013 E023.08.54.945
N049.58.32.013 E023.08.54.945 N049.59.59.670 E023.10.39.494
N049.59.59.670 E023.10.39.494 N050.01.03.034 E023.12.05.036
N050.01.03.034 E023.12.05.036 N050.03.36.170 E023.14.10.706
N050.03.36.170 E023.14.10.706 N050.04.04.679 E023.15.44.701
N050.04.04.679 E023.15.44.701 N050.05.49.228 E023.17.37.695
N050.05.49.228 E023.17.37.695 N050.08.16.033 E023.21.38.481
N050.08.16.033 E023.21.38.481 N050.10.45.996 E023.25.54.057
N050.10.45.996 E023.25.54.057 N050.12.21.042 E023.27.25.937
N050.12.21.042 E023.27.25.937 N050.16.38.726 E023.35.53.904
N050.16.38.726 E023.35.53.904 N050.18.12.714 E023.36.50.930
N050.18.12.714 E023.36.50.930 N050.19.46.702 E023.40.12.646
N050.19.46.702 E023.40.12.646 N050.20.40.562 E023.41.23.405
N050.20.40.562 E023.41.23.405 N050.23.44.323 E023.43.24.852
N050.23.44.323 E023.43.24.852 N050.24.20.220 E023.45.04.120
N050.24.20.220 E023.45.04.120 N050.25.10.922 E023.47.14.019
N050.25.10.922 E023.47.14.019 N050.24.50.858 E023.54.41.795
N050.24.50.858 E023.54.41.795 N050.25.25.699 E023.59.59.670
N050.25.25.699 E023.59.59.670 N050.27.10.247 E024.02.58.150
N050.27.10.247 E024.02.58.150 N050.38.18.752 E024.05.59.795
N050.38.18.752 E024.05.59.795 N050.41.15.110 E024.03.57.291
N050.41.15.110 E024.03.57.291 N050.42.58.615 E024.04.50.094
N050.42.58.615 E024.04.50.094 N050.46.25.597 E023.59.59.670
N050.46.25.597 E023.59.59.670 N050.47.00.451 E023.58.13.014
N050.47.00.451 E023.58.13.014 N050.48.56.618 E023.58.04.561
N050.48.56.618 E023.58.04.561 N050.50.27.448 E023.59.59.670
N050.50.27.448 E023.59.59.670 N050.50.14.772 E024.06.40.980
N050.50.14.772 E024.06.40.980 N050.51.49.818 E024.08.56.160
N050.51.49.818 E024.08.56.160 N050.56.29.680 E023.59.59.670
N050.56.29.680 E023.59.59.670 N050.56.56.075 E023.59.14.263
N050.56.56.075 E023.59.14.263 N050.57.16.139 E023.58.49.976
N050.57.16.139 E023.58.49.976 N050.58.43.796 E023.58.24.632
N050.58.43.796 E023.58.24.632 N050.58.58.586 E023.58.09.841
N050.58.58.586 E023.58.09.841 N050.59.59.835 E023.56.21.063
N050.59.59.835 E023.56.21.063 N051.00.09.338 E023.55.45.158
N051.00.09.338 E023.55.45.158 N051.02.18.181 E023.56.03.114
N051.02.18.181 E023.56.03.114 N051.04.08.016 E023.55.18.757
N051.04.08.016 E023.55.18.757 N051.07.19.165 E023.51.34.869
N051.07.19.165 E023.51.34.869 N051.08.56.325 E023.52.42.463
N051.08.56.325 E023.52.42.463 N051.13.01.334 E023.44.37.718
N051.13.01.334 E023.44.37.718 N051.16.11.425 E023.43.22.737
N051.16.11.425 E023.43.22.737 N051.17.30.636 E023.39.15.620
N051.17.30.636 E023.39.15.620 N051.18.51.949 E023.38.44.989
N051.18.51.949 E023.38.44.989 N051.20.01.657 E023.39.06.110
N051.20.01.657 E023.39.06.110 N051.24.39.405 E023.42.29.934
N051.24.39.405 E023.42.29.934 N051.26.46.119 E023.39.31.454
N051.26.46.119 E023.39.31.454 N051.27.54.770 E023.40.28.487
N051.27.54.770 E023.40.28.487 N051.32.05.066 E023.34.22.024
N051.32.05.066 E023.34.22.024 N051.33.42.226 E023.34.46.317
N051.33.42.226 E023.34.46.317 N051.37.09.208 E023.32.36.418
N051.37.09.208 E023.32.36.418 N051.39.29.669 E023.32.42.756
N051.39.29.669 E023.32.42.756 N051.39.47.631 E023.33.28.163
N051.39.47.631 E023.33.28.163 N051.42.57.708 E023.33.29.228
N051.42.57.708 E023.33.29.228 N051.43.30.448 E023.32.27.972
N051.43.30.448 E023.32.27.972 N051.44.46.487 E023.32.31.138
N051.44.46.487 E023.32.31.138 N051.47.52.362 E023.38.44.989
N051.47.52.362 E023.38.44.989 N051.51.04.568 E023.36.42.484
N051.51.04.568 E023.36.42.484 N051.51.46.810 E023.37.18.396
N051.51.46.810 E023.37.18.396 N051.53.03.907 E023.36.49.879
N051.53.03.907 E023.36.49.879 N051.53.34.531 E023.38.14.364
N051.53.34.531 E023.38.14.364 N051.54.49.513 E023.37.03.605
N051.54.49.513 E023.37.03.605 N051.55.41.258 E023.37.24.727
N051.55.41.258 E023.37.24.727 N052.00.00.000 E023.41.37.131
N052.00.00.000 E023.41.37.131 N052.01.26.600 E023.39.37.792
N052.01.26.600 E023.39.37.792 N052.05.07.315 E023.38.53.441
N052.05.07.315 E023.38.53.441 N052.06.51.864 E023.36.25.586
N052.06.51.864 E023.36.25.586 N052.06.52.921 E023.33.04.934
N052.06.52.921 E023.33.04.934 N052.09.09.152 E023.29.55.894
N052.09.09.152 E023.29.55.894 N052.10.37.866 E023.30.05.397
N052.10.37.866 E023.30.05.397 N052.10.32.593 E023.26.07.783
N052.10.32.593 E023.26.07.783 N052.11.17.000 E023.24.16.000

;EPWW_E
N052.27.07.000 E019.48.33.000 N052.36.02.000 E020.00.15.000
N052.36.02.000 E020.00.15.000 N052.42.16.000 E020.19.42.000
N052.42.16.000 E020.19.42.000 N053.00.00.000 E020.30.00.000
N053.00.00.000 E020.30.00.000 N053.17.39.000 E022.55.45.000
N053.17.39.000 E022.55.45.000 N053.22.52.000 E023.44.23.000

;GRANICA FIR E
N052.11.17.000 E023.24.16.000 N052.12.23.472 E023.22.18.615
N052.12.23.472 E023.22.18.615 N052.13.59.575 E023.12.06.093
N052.13.59.575 E023.12.06.093 N052.14.48.162 E023.11.51.303
N052.14.48.162 E023.11.51.303 N052.15.29.347 E023.12.36.718
N052.15.29.347 E023.12.36.718 N052.16.36.927 E023.12.06.093
N052.16.36.927 E023.12.06.093 N052.17.06.508 E023.10.18.372
N052.17.06.508 E023.10.18.372 N052.21.47.414 E023.14.29.719
N052.21.47.414 E023.14.29.719 N052.27.50.705 E023.18.28.390
N052.27.50.705 E023.18.28.390 N052.33.23.371 E023.25.09.700
N052.33.23.371 E023.25.09.700 N052.36.39.806 E023.33.58.795
N052.36.39.806 E023.33.58.795 N052.40.01.515 E023.54.54.470
N052.40.01.515 E023.54.54.470 N052.56.26.838 E023.56.20.013
N052.56.26.838 E023.56.20.013 N052.57.34.417 E023.57.04.370
N052.57.34.417 E023.57.04.370 N052.58.14.559 E023.56.34.796
N052.58.14.559 E023.56.34.796 N053.00.00.165 E023.56.49.579
N053.00.00.165 E023.56.49.579 N053.04.08.332 E023.53.25.756
N053.04.08.332 E023.53.25.756 N053.09.07.202 E023.55.16.642
N053.09.07.202 E023.55.16.642 N053.11.48.783 E023.52.05.494
N053.11.48.783 E023.52.05.494 N053.13.43.906 E023.52.15.004
N053.13.43.906 E023.52.15.004 N053.18.04.749 E023.46.38.108
N053.18.04.749 E023.46.38.108 N053.22.52.000 E023.44.23.000

;EPWW_G
N053.00.00.000 E020.30.00.000 N052.42.16.000 E020.19.42.000
N052.42.16.000 E020.19.42.000 N052.35.51.000 E019.59.44.000
N052.35.51.000 E019.59.44.000 N052.27.07.000 E019.48.33.000
N052.27.07.000 E019.48.33.000 N052.42.48.000 E017.37.28.000
N052.42.48.000 E017.37.28.000 N053.11.18.000 E016.34.37.000
N053.11.18.000 E016.34.37.000 N053.42.22.000 E017.00.13.000
N053.42.22.000 E017.00.13.000 N054.13.51.000 E017.24.49.000
N054.13.51.000 E017.24.49.000 N054.57.13.000 E015.55.53.000


;granica FIR pocz
N055.17.24.000 E018.23.03.000 N054.36.11.998 E019.24.24.199
N054.36.11.998 E019.24.24.199 N054.27.29.998 E019.38.30.200
N054.27.29.998 E019.38.30.200 N054.26.31.837 E019.48.14.623
N054.26.31.837 E019.48.14.623 N054.26.27.607 E019.49.06.368
N054.26.27.607 E019.49.06.368 N054.26.11.759 E019.51.27.879
N054.26.11.759 E019.51.27.879 N054.26.09.644 E019.52.46.033
N054.26.09.644 E019.52.46.033 N054.25.52.753 E019.54.30.589
N054.25.52.753 E019.54.30.589 N054.25.34.804 E019.58.27.145
N054.25.34.804 E019.58.27.145 N054.25.17.899 E020.00.00.082
N054.25.17.899 E020.00.00.082 N054.25.11.568 E020.05.30.634
N054.25.11.568 E020.05.30.634 N054.24.30.383 E020.11.12.803
N054.24.30.383 E020.11.12.803 N054.24.27.210 E020.15.35.760
N054.24.27.210 E020.15.35.760 N054.22.54.000 E020.30.00.000
;granica FIR koniec
N054.36.11.998 E019.24.24.199 N054.27.29.998 E019.38.30.200


;G/S
N054.25.17.899 E020.00.00.000 N053.00.00.000 E020.30.00.000


;EPWW_B
;B
N054.54.58.840 E015.51.52.920 N054.55.00.199 E015.08.07.999
N054.55.00.199 E015.08.07.999 N054.52.45.895 E015.05.07.118
N054.52.45.895 E015.05.07.118 N054.50.54.840 E015.01.23.653
N054.50.54.840 E015.01.23.653 N054.49.27.693 E014.57.09.905
N054.49.27.693 E014.57.09.905 N054.48.27.100 E014.52.33.585
N054.48.27.100 E014.52.33.585 N054.47.54.904 E014.47.43.765
N054.47.54.904 E014.47.43.765 N054.47.52.294 E014.42.47.239
N054.47.52.294 E014.42.47.239 N054.48.18.721 E014.37.55.097
N054.48.18.721 E014.37.55.097 N054.49.14.010 E014.33.15.339
N054.49.14.010 E014.33.15.339 N054.50.36.270 E014.28.56.663
N054.50.36.270 E014.28.56.663 N054.52.23.405 E014.25.06.863
N054.52.23.405 E014.25.06.863 N054.55.00.199 E014.21.26.999

N054.55.00.199 E014.21.26.999 N054.07.40.999 E014.15.20.998
N054.07.40.999 E014.15.20.998 N054.07.33.999 E014.12.05.000
N054.07.33.999 E014.12.05.000 N053.59.16.999 E014.14.31.999
N053.59.16.999 E014.14.31.999 N053.57.44.999 E014.13.59.998
N053.57.44.999 E014.13.59.998 N053.55.59.998 E014.13.59.998
N053.55.59.998 E014.13.59.998 N053.55.45.998 E014.13.41.998
N053.55.45.998 E014.13.41.998 N053.55.40.000 E014.13.33.999
N053.55.40.000 E014.13.33.999 N053.55.19.999 E014.13.00.199
N053.55.19.999 E014.13.00.199 N053.48.39.999 E014.15.20.600
N053.48.39.999 E014.15.20.600 N053.41.55.732 E014.16.10.697
N053.41.55.732 E014.16.10.697 N053.41.00.814 E014.16.10.697 
N053.41.00.814 E014.16.10.697 N053.40.34.419 E014.16.42.375 
N053.40.34.419 E014.16.42.375 N053.39.33.157 E014.16.30.761 
N053.39.33.157 E014.16.30.761 N053.38.51.972 E014.17.01.389 
N053.38.51.972 E014.17.01.389 N053.37.57.068 E014.16.51.882 
N053.37.57.068 E014.16.51.882 N053.36.16.735 E014.18.46.995 
N053.36.16.735 E014.18.46.995 N053.34.48.020 E014.18.41.714 
N053.34.48.020 E014.18.41.714 N053.33.18.262 E014.18.54.390 
N053.33.18.262 E014.18.54.390 N053.32.27.560 E014.18.12.144 
N053.32.27.560 E014.18.12.144 N053.31.50.605 E014.18.08.975 
N053.31.50.605 E014.18.08.975 N053.31.29.484 E014.18.39.603 
N053.31.29.484 E014.18.39.603 N053.30.29.279 E014.18.53.329 
N053.30.29.279 E014.18.53.329 N053.29.47.036 E014.19.46.135 
N053.29.47.036 E014.19.46.135 N053.29.26.972 E014.20.48.445 
N053.29.26.972 E014.20.48.445 N053.26.54.894 E014.21.15.901 
N053.26.54.894 E014.21.15.901 N053.26.24.270 E014.21.40.191 
N053.26.24.270 E014.21.40.191 N053.26.06.321 E014.22.06.592 
N053.26.06.321 E014.22.06.592 N053.24.32.333 E014.21.49.694 
N053.24.32.333 E014.21.49.694 N053.24.06.982 E014.22.20.322 
N053.24.06.982 E014.22.20.322 N053.22.32.994 E014.23.02.564 
N053.22.32.994 E014.23.02.564 N053.22.01.312 E014.23.09.956 
N053.22.01.312 E014.23.09.956 N053.21.08.509 E014.23.06.787 
N053.21.08.509 E014.23.06.787 N053.20.49.503 E014.23.20.520 
N053.20.49.503 E014.23.20.520 N053.19.45.081 E014.24.09.097 
N053.19.45.081 E014.24.09.097 N053.18.33.258 E014.23.40.584 
N053.18.33.258 E014.23.40.584 N053.17.34.124 E014.24.29.164 
N053.17.34.124 E014.24.29.164 N053.16.29.703 E014.24.36.556 
N053.16.29.703 E014.24.36.556 N053.15.22.110 E014.26.23.219 
N053.15.22.110 E014.26.23.219 N053.13.52.352 E014.25.23.024 
N053.13.52.352 E014.25.23.024 N053.11.58.286 E014.23.52.202 
N053.11.58.286 E014.23.52.202 N053.11.22.388 E014.22.28.771 
N053.11.22.388 E014.22.28.771 N053.10.35.916 E014.21.57.089
N053.10.35.916 E014.21.57.089 N053.10.00.000 E014.21.57.089
N053.10.00.000 E014.21.57.089 N053.09.45.228 E014.21.56.035



;EPWW_S


;GRANICA FIR S
N053.22.52.000 E023.44.23.000 N053.35.23.932 E023.38.10.141
N053.35.23.932 E023.38.10.141 N053.36.03.002 E023.37.01.497
N053.36.03.002 E023.37.01.497 N053.40.13.298 E023.36.11.860
N053.40.13.298 E023.36.11.860 N053.44.15.135 E023.36.29.809
N053.44.15.135 E023.36.29.809 N053.46.54.601 E023.33.39.781
N053.46.54.601 E023.33.39.781 N053.50.41.661 E023.33.36.616
N053.50.41.661 E023.33.36.616 N054.00.00.330 E023.28.52.530
N054.00.00.330 E023.28.52.530 N054.00.23.552 E023.29.02.033
N054.00.23.552 E023.29.02.033 N054.01.00.521 E023.29.46.391
N054.01.00.521 E023.29.46.391 N054.01.32.203 E023.30.47.646
N054.01.32.203 E023.30.47.646 N054.07.50.270 E023.30.05.397
N054.07.50.270 E023.30.05.397 N054.13.37.726 E023.21.52.214
N054.13.37.726 E023.21.52.214 N054.18.53.487 E023.02.54.820
N054.18.53.487 E023.02.54.820 N054.20.44.380 E023.03.30.725
N054.20.44.380 E023.03.30.725 N054.22.19.426 E022.59.59.512
N054.22.19.426 E022.59.59.512 N054.25.43.250 E022.51.27.316
N054.25.43.250 E022.51.27.316 N054.24.31.440 E022.48.24.613
N054.24.31.440 E022.48.24.613 N054.22.02.534 E022.47.14.912
N054.22.02.534 E022.47.14.912 N054.21.29.795 E022.43.04.623
N054.21.29.795 E022.43.04.623 N054.20.02.138 E022.00.00.405
N054.20.02.138 E022.00.00.405 N054.19.50.520 E021.53.00.089
N054.19.50.520 E021.53.00.089 N054.19.53.692 E021.33.56.357
N054.19.53.692 E021.33.56.357 N054.19.12.507 E021.27.26.665
N054.19.12.507 E021.27.26.665 N054.21.12.890 E021.00.00.240
N054.21.12.890 E021.00.00.240 N054.22.04.635 E020.38.20.214
N054.22.04.635 E020.38.20.214 N054.22.54.000 E020.30.00.000

[ARTCC]

;B
POLAND N053.41.55.732 E014.16.10.697 N053.41.00.814 E014.16.10.697 
N053.41.00.814 E014.16.10.697 N053.40.34.419 E014.16.42.375 
N053.40.34.419 E014.16.42.375 N053.39.33.157 E014.16.30.761 
N053.39.33.157 E014.16.30.761 N053.38.51.972 E014.17.01.389 
N053.38.51.972 E014.17.01.389 N053.37.57.068 E014.16.51.882 
N053.37.57.068 E014.16.51.882 N053.36.16.735 E014.18.46.995 
N053.36.16.735 E014.18.46.995 N053.34.48.020 E014.18.41.714 
N053.34.48.020 E014.18.41.714 N053.33.18.262 E014.18.54.390 
N053.33.18.262 E014.18.54.390 N053.32.27.560 E014.18.12.144 
N053.32.27.560 E014.18.12.144 N053.31.50.605 E014.18.08.975 
N053.31.50.605 E014.18.08.975 N053.31.29.484 E014.18.39.603 
N053.31.29.484 E014.18.39.603 N053.30.29.279 E014.18.53.329 
N053.30.29.279 E014.18.53.329 N053.29.47.036 E014.19.46.135 
N053.29.47.036 E014.19.46.135 N053.29.26.972 E014.20.48.445 
N053.29.26.972 E014.20.48.445 N053.26.54.894 E014.21.15.901 
N053.26.54.894 E014.21.15.901 N053.26.24.270 E014.21.40.191 
N053.26.24.270 E014.21.40.191 N053.26.06.321 E014.22.06.592 
N053.26.06.321 E014.22.06.592 N053.24.32.333 E014.21.49.694 
N053.24.32.333 E014.21.49.694 N053.24.06.982 E014.22.20.322 
N053.24.06.982 E014.22.20.322 N053.22.32.994 E014.23.02.564 
N053.22.32.994 E014.23.02.564 N053.22.01.312 E014.23.09.956 
N053.22.01.312 E014.23.09.956 N053.21.08.509 E014.23.06.787 
N053.21.08.509 E014.23.06.787 N053.20.49.503 E014.23.20.520 
N053.20.49.503 E014.23.20.520 N053.19.45.081 E014.24.09.097 
N053.19.45.081 E014.24.09.097 N053.18.33.258 E014.23.40.584 
N053.18.33.258 E014.23.40.584 N053.17.34.124 E014.24.29.164 
N053.17.34.124 E014.24.29.164 N053.16.29.703 E014.24.36.556 
N053.16.29.703 E014.24.36.556 N053.15.22.110 E014.26.23.219 
N053.15.22.110 E014.26.23.219 N053.13.52.352 E014.25.23.024 
N053.13.52.352 E014.25.23.024 N053.11.58.286 E014.23.52.202 
N053.11.58.286 E014.23.52.202 N053.11.22.388 E014.22.28.771 
N053.11.22.388 E014.22.28.771 N053.10.35.916 E014.21.57.089
N053.10.35.916 E014.21.57.089 N053.10.00.000 E014.21.57.089
N053.10.00.000 E014.21.57.089 N053.09.45.228 E014.21.56.035


;D
N053.09.45.228 E014.21.56.035 N053.07.51.176 E014.22.55.172
N053.07.51.176 E014.22.55.172 N053.03.26.090 E014.21.18.016
N053.03.26.090 E014.21.18.016 N053.02.07.950 E014.19.52.470
N053.02.07.950 E014.19.52.470 N053.00.00.165 E014.15.51.684
N053.00.00.165 E014.15.51.684 N052.58.55.744 E014.14.11.361
N052.58.55.744 E014.14.11.361 N052.58.30.393 E014.11.53.013
N052.58.30.393 E014.11.53.013 N052.57.04.850 E014.08.35.527
N052.57.04.850 E014.08.35.527 N052.56.51.118 E014.08.23.909
N052.56.51.118 E014.08.23.909 N052.55.46.696 E014.08.24.966
N052.55.46.696 E014.08.24.966 N052.54.19.053 E014.08.57.702
N052.54.19.053 E014.08.57.702 N052.52.03.866 E014.09.17.769
N052.52.03.866 E014.09.17.769 N052.50.29.878 E014.07.44.835
N052.50.29.878 E014.07.44.835 N052.49.23.342 E014.07.17.379
N052.49.23.342 E014.07.17.379 N052.48.40.042 E014.08.09.125
N052.48.40.042 E014.08.09.125 N052.48.53.775 E014.10.21.133
N052.48.53.775 E014.10.21.133 N052.48.24.208 E014.12.54.265
N052.48.24.208 E014.12.54.265 N052.46.50.220 E014.15.28.451
N052.46.50.220 E014.15.28.451 N052.45.34.181 E014.16.52.939
N052.45.34.181 E014.16.52.939 N052.43.54.906 E014.21.40.191
N052.43.54.906 E014.21.40.191 N052.42.18.803 E014.23.19.463
N052.42.18.803 E014.23.19.463 N052.41.22.828 E014.24.48.170
N052.41.22.828 E014.24.48.170 N052.39.46.725 E014.26.17.939
N052.39.46.725 E014.26.17.939 N052.39.35.107 E014.27.28.694
N052.39.35.107 E014.27.28.694 N052.38.56.037 E014.27.48.761
N052.38.56.037 E014.27.48.761 N052.38.34.915 E014.28.43.676
N052.38.34.915 E014.28.43.676 N052.35.29.041 E014.36.17.792
N052.35.29.041 E014.36.17.792 N052.33.49.779 E014.38.11.848
N052.33.49.779 E014.38.11.848 N052.33.01.192 E014.38.07.625
N052.33.01.192 E014.38.07.625 N052.32.25.294 E014.37.20.099
N052.32.25.294 E014.37.20.099 N052.30.34.401 E014.36.25.181
N052.30.34.401 E014.36.25.181 N052.29.55.331 E014.36.55.808
N052.29.55.331 E014.36.55.808 N052.29.24.706 E014.38.07.625
N052.29.24.706 E014.38.07.625 N052.27.58.107 E014.38.04.456
N052.27.58.107 E014.38.04.456 N052.27.20.080 E014.36.50.528
N052.27.20.080 E014.36.50.528 N052.26.54.743 E014.36.43.136
N052.26.54.743 E014.36.43.136 N052.25.54.538 E014.35.24.986
N052.25.54.538 E014.35.24.986 N052.25.23.914 E014.33.24.596
N052.25.23.914 E014.33.24.596 N052.24.48.016 E014.32.31.790
N052.24.48.016 E014.32.31.790 N052.23.42.537 E014.32.36.013
N052.23.42.537 E014.32.36.013 N052.22.53.950 E014.32.19.118
N052.22.53.950 E014.32.19.118 N052.22.20.154 E014.32.48.688
N052.22.20.154 E014.32.48.688 N052.22.00.090 E014.33.14.032
N052.22.00.090 E014.33.14.032 N052.21.52.701 E014.33.22.481
N052.21.52.701 E014.33.22.481 N052.20.39.835 E014.33.18.255
N052.20.39.835 E014.33.18.255 N052.18.33.107 E014.34.00.501
N052.18.33.107 E014.34.00.501 N052.17.39.247 E014.35.03.865
N052.17.39.247 E014.35.03.865 N052.17.04.393 E014.35.13.368
N052.17.04.393 E014.35.13.368 N052.16.51.717 E014.34.58.584
N052.16.51.717 E014.34.58.584 N052.16.21.093 E014.34.30.071
N052.16.21.093 E014.34.30.071 N052.16.01.029 E014.34.56.469
N052.16.01.029 E014.34.56.469 N052.15.30.405 E014.35.28.155
N052.15.30.405 E014.35.28.155 N052.13.56.403 E014.42.03.127
N052.13.56.403 E014.42.03.127 N052.13.07.830 E014.42.40.089
N052.13.07.830 E014.42.40.089 N052.11.39.115 E014.42.37.978
N052.11.39.115 E014.42.37.978 N052.11.06.376 E014.41.32.499
N052.11.06.376 E014.41.32.499 N052.10.22.032 E014.41.12.435
N052.10.22.032 E014.41.12.435 N052.09.42.948 E014.42.10.519
N052.09.42.948 E014.42.10.519 N052.09.00.706 E014.42.34.809
N052.09.00.706 E014.42.34.809 N052.08.14.234 E014.41.31.445
N052.08.14.234 E014.41.31.445 N052.07.07.711 E014.40.50.257
N052.07.07.711 E014.40.50.257 N052.05.42.169 E014.40.56.594
N052.05.42.169 E014.40.56.594 N052.04.48.309 E014.41.30.391
N052.04.48.309 E014.41.30.391 N052.03.57.621 E014.44.24.641
N052.03.57.621 E014.44.24.641 N052.03.26.982 E014.44.58.434
N052.03.26.982 E014.44.58.434 N052.02.24.676 E014.45.01.603
N052.02.24.676 E014.45.01.603 N052.01.54.052 E014.44.24.641
N052.01.54.052 E014.44.24.641 N052.00.44.357 E014.44.20.418
N052.00.44.357 E014.44.20.418 N052.00.00.000 E014.43.54.017
N052.00.00.000 E014.43.54.017 N051.59.20.916 E014.42.48.538
N051.59.20.916 E014.42.48.538 N051.57.50.100 E014.43.04.379
N051.57.50.100 E014.43.04.379 N051.57.21.591 E014.42.34.809
N051.57.21.591 E014.42.34.809 N051.56.16.112 E014.42.39.035
N051.56.16.112 E014.42.39.035 N051.55.14.864 E014.43.07.548
N051.55.14.864 E014.43.07.548 N051.54.09.385 E014.41.59.962
N051.54.09.385 E014.41.59.962 N051.52.26.938 E014.41.20.881
N051.52.26.938 E014.41.20.881 N051.51.59.485 E014.40.46.034
N051.51.59.485 E014.40.46.034 N051.52.11.104 E014.39.54.285
N051.52.11.104 E014.39.54.285 N051.50.00.146 E014.37.57.061
N051.50.00.146 E014.37.57.061 N051.49.48.528 E014.36.36.799
N051.49.48.528 E014.36.36.799 N051.48.38.834 E014.35.34.489
N051.48.38.834 E014.35.34.489 N051.47.43.916 E014.35.32.378
N051.47.43.916 E014.35.32.378 N051.47.00.616 E014.36.05.117
N051.47.00.616 E014.36.05.117 N051.46.04.641 E014.38.12.902
N051.46.04.641 E014.38.12.902 N051.44.54.946 E014.39.15.211
N051.44.54.946 E014.39.15.211 N051.43.29.404 E014.39.02.539
N051.43.29.404 E014.39.02.539 N051.42.00.689 E014.40.06.960
N051.42.00.689 E014.40.06.960 N051.38.29.477 E014.45.14.279
N051.38.29.477 E014.45.14.279 N051.37.43.005 E014.45.13.218
N051.37.43.005 E014.45.13.218 N051.37.02.878 E014.45.43.849
N051.37.02.878 E014.45.43.849 N051.35.51.054 E014.45.23.782
N051.35.51.054 E014.45.23.782 N051.35.23.602 E014.45.31.174
N051.35.23.602 E014.45.31.174 N051.35.02.481 E014.45.50.183
N051.35.02.481 E014.45.50.183 N051.32.33.575 E014.43.18.109
N051.32.33.575 E014.43.18.109 N051.31.54.505 E014.42.54.876
N051.31.54.505 E014.42.54.876 N051.31.37.600 E014.42.59.099
N051.31.37.600 E014.42.59.099 N051.31.34.441 E014.43.10.714
N051.31.34.441 E014.43.10.714 N051.31.23.867 E014.43.52.956
N051.31.23.867 E014.43.52.956 N051.30.55.357 E014.44.04.574
N051.30.55.357 E014.44.04.574 N051.30.42.000 E014.43.50.848

;- NOAA object 46
;T
N051.30.42.000 E014.43.50.848 N051.30.31.078 E014.43.50.848
N051.30.31.078 E014.43.50.848 N051.30.01.497 E014.44.23.587
N051.30.01.497 E014.44.23.587 N051.29.39.318 E014.47.47.408
N051.29.39.318 E014.47.47.408 N051.28.59.191 E014.49.00.278
N051.28.59.191 E014.49.00.278 N051.26.22.896 E014.57.26.136
N051.26.22.896 E014.57.26.136 N051.24.54.182 E014.58.25.277
N051.24.54.182 E014.58.25.277 N051.24.16.169 E014.57.32.471
N051.24.16.169 E014.57.32.471 N051.23.45.545 E014.57.49.369
N051.23.45.545 E014.57.49.369 N051.23.11.748 E014.57.35.643
N051.23.11.748 E014.57.35.643 N051.22.07.327 E014.57.51.484
N051.22.07.327 E014.57.51.484 N051.21.05.021 E014.58.44.287
N051.21.05.021 E014.58.44.287 N051.20.29.109 E014.58.49.567
N051.20.29.109 E014.58.49.567 N051.19.47.924 E014.58.22.108
N051.19.47.924 E014.58.22.108 N051.19.03.567 E014.58.28.446
N051.19.03.567 E014.58.28.446 N051.17.34.852 E014.59.52.934
N051.17.34.852 E014.59.52.934 N051.16.56.840 E015.00.00.323
N051.16.56.840 E015.00.00.323 N051.15.50.304 E015.01.33.257
N051.15.50.304 E015.01.33.257 N051.14.14.201 E015.01.56.493
N051.14.14.201 E015.01.56.493 N051.08.35.204 E015.00.00.323
N051.08.35.204 E015.00.00.323 N051.07.34.999 E014.59.29.698
N051.07.34.999 E014.59.29.698 N051.06.25.304 E014.59.38.148
N051.06.25.304 E014.59.38.148 N051.03.50.067 E014.58.31.612
N051.03.50.067 E014.58.31.612 N051.03.02.538 E014.58.31.612
N051.03.02.538 E014.58.31.612 N051.02.27.684 E014.58.05.210
N051.02.27.684 E014.58.05.210 N051.01.58.117 E014.58.08.382
N051.01.58.117 E014.58.08.382 N051.00.51.581 E014.56.55.512
N051.00.51.581 E014.56.55.512 N050.59.59.835 E014.56.58.678
N050.59.59.835 E014.56.58.678 N050.59.02.802 E014.56.05.874
N050.59.02.802 E014.56.05.874 N050.58.25.847 E014.56.02.706
N050.58.25.847 E014.56.02.706 N050.58.00.496 E014.55.23.632
N050.58.00.496 E014.55.23.632 N050.56.53.960 E014.55.08.845
N050.56.53.960 E014.55.08.845 N050.56.08.559 E014.54.00.201
N050.56.08.559 E014.54.00.201 N050.55.34.763 E014.53.50.698
N050.55.34.763 E014.53.50.698 N050.54.29.284 E014.54.00.201
N050.54.29.284 E014.54.00.201 N050.51.21.308 E014.49.18.230
N050.51.21.308 E014.49.18.230 N050.50.40.109 E014.49.24.568
N050.50.40.109 E014.49.24.568 N050.50.04.211 E014.49.52.023
N050.50.04.211 E014.49.52.023 N050.50.36.951 E014.51.31.295
N050.50.36.951 E014.51.31.295 N050.50.21.103 E014.52.43.108
N050.50.21.103 E014.52.43.108 N050.50.44.339 E014.54.08.650
N050.50.44.339 E014.54.08.650 N050.50.02.097 E014.57.33.532
N050.50.02.097 E014.57.33.532 N050.50.21.103 E014.59.01.182
N050.50.21.103 E014.59.01.182 N050.52.19.384 E014.59.50.820
N050.52.19.384 E014.59.50.820 N050.53.29.093 E014.59.04.351
N050.53.29.093 E014.59.04.351 N050.54.11.335 E015.00.00.323
N050.54.11.335 E015.00.00.323 N050.55.11.526 E015.00.49.960
N050.55.11.526 E015.00.49.960 N050.55.46.381 E015.00.33.062
N050.55.46.381 E015.00.33.062 N050.57.04.521 E015.00.53.129
N050.57.04.521 E015.00.53.129 N050.57.28.814 E015.00.00.323
N050.57.28.814 E015.00.00.323 N050.57.21.426 E014.58.36.895
N050.57.21.426 E014.58.36.895 N050.57.41.490 E014.58.18.940
N050.57.41.490 E014.58.18.940 N050.58.46.968 E014.59.09.631
N050.58.46.968 E014.59.09.631 N050.59.03.860 E015.00.00.323
N050.59.03.860 E015.00.00.323 N050.59.55.605 E015.01.29.034
N050.59.55.605 E015.01.29.034 N050.58.21.617 E015.02.30.286
N050.58.21.617 E015.02.30.286 N050.59.38.714 E015.04.08.500
N050.59.38.714 E015.04.08.500 N050.59.14.420 E015.04.27.514
N050.59.14.420 E015.04.27.514 N050.58.56.472 E015.06.17.346
N050.58.56.472 E015.06.17.346 N050.58.24.790 E015.05.50.941
N050.58.24.790 E015.05.50.941 N050.57.59.439 E015.06.03.613
N050.57.59.439 E015.06.03.613 N050.57.56.280 E015.06.36.352
N050.57.56.280 E015.06.36.352 N050.57.40.432 E015.08.06.118
N050.57.40.432 E015.08.06.118 N050.58.53.299 E015.08.34.634
N050.58.53.299 E015.08.34.634 N050.59.12.306 E015.09.10.542
N050.59.12.306 E015.09.10.542 N050.59.11.262 E015.10.04.399
N050.59.11.262 E015.10.04.399 N050.57.40.432 E015.10.27.635
N050.57.40.432 E015.10.27.635 N050.57.15.081 E015.11.08.820
N050.57.15.081 E015.11.08.820 N050.57.12.980 E015.11.42.617
N050.57.12.980 E015.11.42.617 N050.57.48.878 E015.12.29.082
N050.57.48.878 E015.12.29.082 N050.57.53.108 E015.13.27.166
N050.57.53.108 E015.13.27.166 N050.57.48.878 E015.14.13.631
N050.57.48.878 E015.14.13.631 N050.57.21.426 E015.14.31.587
N050.57.21.426 E015.14.31.587 N050.57.07.693 E015.15.46.568
N050.57.07.693 E015.15.46.568 N050.55.29.475 E015.17.33.232
N050.55.29.475 E015.17.33.232 N050.54.14.494 E015.16.11.912
N050.54.14.494 E015.16.11.912 N050.53.14.302 E015.15.58.186
N050.53.14.302 E015.15.58.186 N050.50.42.224 E015.17.05.773
N050.50.42.224 E015.17.05.773 N050.49.59.982 E015.17.57.522
N050.49.59.982 E015.17.57.522 N050.49.17.739 E015.20.58.110
N050.49.17.739 E015.20.58.110 N050.48.32.338 E015.21.49.859
N050.48.32.338 E015.21.49.859 N050.46.04.476 E015.21.47.747
N050.46.04.476 E015.21.47.747 N050.45.47.585 E015.22.18.372
N050.45.47.585 E015.22.18.372 N050.45.59.203 E015.22.23.652
N050.45.59.203 E015.22.23.652 N050.45.01.112 E015.22.21.541
N050.45.01.112 E015.22.21.541 N050.44.52.667 E015.23.01.672
N050.44.52.667 E015.23.01.672 N050.45.19.075 E015.24.11.373
N050.45.19.075 E015.24.11.373 N050.46.42.502 E015.25.37.969
N050.46.42.502 E015.25.37.969 N050.46.49.891 E015.26.20.212
N050.46.49.891 E015.26.20.212 N050.46.18.209 E015.27.45.757
N050.46.18.209 E015.27.45.757 N050.45.34.909 E015.28.33.280
N050.45.34.909 E015.28.33.280 N050.45.21.176 E015.29.01.793
N050.45.21.176 E015.29.01.793 N050.45.31.737 E015.30.16.775
N050.45.31.737 E015.30.16.775 N050.44.52.667 E015.30.40.007
N050.44.52.667 E015.30.40.007 N050.44.48.437 E015.31.12.747
N050.44.48.437 E015.31.12.747 N050.45.05.342 E015.32.27.728
N050.45.05.342 E015.32.27.728 N050.44.54.781 E015.33.54.328
N050.44.54.781 E015.33.54.328 N050.45.03.227 E015.34.33.402
N050.45.03.227 E015.34.33.402 N050.44.33.660 E015.36.46.467
N050.44.33.660 E015.36.46.467 N050.43.40.857 E015.38.40.525
N050.43.40.857 E015.38.40.525 N050.43.25.009 E015.40.28.243
N050.43.25.009 E015.40.28.243 N050.42.51.213 E015.40.46.195
N050.42.51.213 E015.40.46.195 N050.42.44.882 E015.41.35.833
N050.42.44.882 E015.41.35.833 N050.42.32.206 E015.43.12.990
N050.42.32.206 E015.43.12.990 N050.42.53.328 E015.45.21.832
N050.42.53.328 E015.45.21.832 N050.42.43.824 E015.46.08.301
N050.42.43.824 E015.46.08.301 N050.43.22.895 E015.48.23.477
N050.43.22.895 E015.48.23.477 N050.42.33.264 E015.49.13.111
N050.42.33.264 E015.49.13.111 N050.38.34.586 E015.51.56.804
N050.38.34.586 E015.51.56.804 N050.38.22.968 E015.52.40.101
N050.38.22.968 E015.52.40.101 N050.39.15.785 E015.55.32.243
N050.39.15.785 E015.55.32.243 N050.39.09.440 E015.56.02.867
N050.39.09.440 E015.56.02.867 N050.39.44.294 E015.57.52.699
N050.39.44.294 E015.57.52.699 N050.38.55.707 E015.59.45.701
N050.38.55.707 E015.59.45.701 N050.38.12.421 E016.00.00.488
N050.38.12.421 E016.00.00.488 N050.37.31.222 E016.00.14.214
N050.37.31.222 E016.00.14.214 N050.37.21.719 E016.00.13.156
N050.37.21.719 E016.00.13.156 N050.37.14.331 E016.00.11.048
N050.37.14.331 E016.00.11.048 N050.37.15.388 E016.00.00.488
N050.37.15.388 E016.00.00.488 N050.37.16.446 E015.59.59.430
N050.37.16.446 E015.59.59.430 N050.37.14.331 E015.59.56.265
N050.37.14.331 E015.59.56.265 N050.37.13.273 E015.59.56.265
N050.37.13.273 E015.59.56.265 N050.37.12.216 E015.59.53.096
N050.37.12.216 E015.59.53.096 N050.37.09.044 E015.59.53.096
N050.37.09.044 E015.59.53.096 N050.37.08.000 E015.59.50.981
N050.37.08.000 E015.59.50.981 N050.37.04.828 E015.59.48.869
N050.37.04.828 E015.59.48.869 N050.36.54.267 E015.59.43.593
N050.36.54.267 E015.59.43.593 N050.36.52.152 E015.59.43.593
N050.36.52.152 E015.59.43.593 N050.36.51.095 E015.59.42.532
N050.36.51.095 E015.59.42.532 N050.36.46.879 E015.59.42.532
N050.36.46.879 E015.59.42.532 N050.36.40.534 E015.59.42.532
N050.36.40.534 E015.59.42.532 N050.36.39.477 E015.59.43.593
N050.36.39.477 E015.59.43.593 N050.36.36.304 E015.59.43.593
N050.36.36.304 E015.59.43.593 N050.36.27.859 E015.59.47.815
N050.36.27.859 E015.59.47.815 N050.36.25.757 E015.59.50.981
N050.36.25.757 E015.59.50.981 N050.36.24.686 E015.59.50.981
N050.36.24.686 E015.59.50.981 N050.36.20.470 E016.00.00.488
N050.36.20.470 E016.00.00.488 N050.36.20.470 E016.00.00.488
N050.36.20.470 E016.00.00.488 N050.36.10.967 E016.00.24.774
N050.36.10.967 E016.00.24.774 N050.36.06.737 E016.00.43.787
N050.36.06.737 E016.00.43.787 N050.36.39.477 E016.03.36.980 
N050.36.39.477 E016.03.36.980 N050.39.24.230 E016.05.39.484 
N050.39.24.230 E016.05.39.484 N050.39.05.210 E016.09.15.984 
N050.39.05.210 E016.09.15.984 N050.37.22.776 E016.11.30.106 
N050.37.22.776 E016.11.30.106 N050.38.01.847 E016.13.26.273 
N050.38.01.847 E016.13.26.273 N050.39.43.237 E016.13.44.229 
N050.39.43.237 E016.13.44.229 N050.39.23.173 E016.17.33.397 
N050.39.23.173 E016.17.33.397 N050.39.27.403 E016.20.25.532 
N050.39.27.403 E016.20.25.532 N050.36.06.737 E016.25.50.803 
N050.36.06.737 E016.25.50.803 N050.34.13.743 E016.26.39.390 
N050.34.13.743 E016.26.39.390 N050.30.08.734 E016.22.21.705 
N050.30.08.734 E016.22.21.705 N050.30.08.734 E016.18.39.926 
N050.30.08.734 E016.18.39.926 N050.25.21.483 E016.11.56.508 
N050.25.21.483 E016.11.56.508 N050.24.19.177 E016.14.58.153 
N050.24.19.177 E016.14.58.153 N050.22.02.932 E016.16.22.638 
N050.22.02.932 E016.16.22.638 N050.22.56.793 E016.20.18.143 
N050.22.56.793 E016.20.18.143 N050.22.09.277 E016.22.14.310 
N050.22.09.277 E016.22.14.310 N050.20.31.059 E016.22.11.145 
N050.20.31.059 E016.22.11.145 N050.19.05.517 E016.26.14.039 
N050.19.05.517 E016.26.14.039 N050.13.40.239 E016.32.49.011 
N050.13.40.239 E016.32.49.011 N050.09.54.250 E016.33.22.808 
N050.09.54.250 E016.33.22.808 N050.07.14.770 E016.37.02.472 
N050.07.14.770 E016.37.02.472 N050.05.54.515 E016.41.30.717 
N050.05.54.515 E016.41.30.717 N050.06.12.464 E016.43.23.712 
N050.06.12.464 E016.43.23.712 N050.12.02.035 E016.49.55.518 
N050.12.02.035 E016.49.55.518 N050.11.45.130 E016.51.49.577 
N050.11.45.130 E016.51.49.577 N050.13.21.233 E016.53.38.349 
N050.13.21.233 E016.53.38.349 N050.13.20.175 E016.57.26.466 
N050.13.20.175 E016.57.26.466 N050.14.12.979 E016.57.41.250 
N050.14.12.979 E016.57.41.250 N050.13.11.730 E016.59.59.595
N050.13.11.730 E016.59.59.595 N050.13.20.175 E017.01.07.181 
N050.13.20.175 E017.01.07.181 N050.15.00.508 E017.00.11.213 
N050.15.00.508 E017.00.11.213 N050.16.26.050 E017.01.14.577 
N050.16.26.050 E017.01.14.577 N050.18.00.038 E016.59.59.595
N050.18.00.038 E016.59.59.595 N050.19.00.230 E016.56.29.433 
N050.19.00.230 E016.56.29.433 N050.24.06.501 E016.51.58.023 
N050.24.06.501 E016.51.58.023 N050.26.43.853 E016.54.08.973 
N050.26.43.853 E016.54.08.973 N050.25.29.929 E016.59.59.595 
N050.25.29.929 E016.59.59.595 N050.23.54.883 E017.04.14.107 
N050.23.54.883 E017.04.14.107 N050.24.14.947 E017.06.15.554 
N050.24.14.947 E017.06.15.554 N050.22.36.729 E017.08.44.460 
N050.22.36.729 E017.08.44.460 N050.23.06.296 E017.11.46.105 
N050.23.06.296 E017.11.46.105 N050.21.42.869 E017.11.03.863 
N050.21.42.869 E017.11.03.863 N050.18.52.841 E017.17.48.345 
N050.18.52.841 E017.17.48.345 N050.19.38.256 E017.20.30.977 
N050.19.38.256 E017.20.30.977 N050.18.59.186 E017.21.30.118 
N050.18.59.186 E017.21.30.118 N050.16.04.929 E017.20.30.977 
N050.16.04.929 E017.20.30.977 N050.15.43.808 E017.21.34.341 
N050.15.43.808 E017.21.34.341 N050.17.01.948 E017.24.23.310 
N050.17.01.948 E017.24.23.310 N050.15.08.954 E017.25.33.018 
N050.15.08.954 E017.25.33.018 N050.16.21.821 E017.29.41.193 
N050.16.21.821 E017.29.41.193 N050.15.52.254 E017.36.30.948 
N050.15.52.254 E017.36.30.948 N050.15.59.642 E017.38.38.733 
N050.15.59.642 E017.38.38.733 N050.17.35.745 E017.40.54.971 
N050.17.35.745 E017.40.54.971 N050.19.20.307 E017.41.01.308 
N050.19.20.307 E017.41.01.308 N050.18.12.714 E017.44.57.865 
N050.18.12.714 E017.44.57.865 N050.15.38.521 E017.43.29.157 
N050.15.38.521 E017.43.29.157 N050.13.44.469 E017.45.32.719 
N050.13.44.469 E017.45.32.719 N050.12.29.487 E017.45.21.101 
N050.12.29.487 E017.45.21.101 N050.11.59.920 E017.42.40.577 
N050.11.59.920 E017.42.40.577 N050.10.58.658 E017.42.16.283 
N050.10.58.658 E017.42.16.283 N050.10.04.797 E017.36.06.662 
N050.10.04.797 E017.36.06.662 N050.09.24.670 E017.35.55.044 
N050.09.24.670 E017.35.55.044 N050.06.15.636 E017.40.13.779 
N050.06.15.636 E017.40.13.779 N050.06.49.433 E017.41.27.710 
N050.06.49.433 E017.41.27.710 N050.06.19.866 E017.43.59.781 
N050.06.19.866 E017.43.59.781 N050.05.37.624 E017.43.24.934 
N050.05.37.624 E017.43.24.934 N049.59.59.670 E017.48.17.466 
N049.59.59.670 E017.48.17.466 N049.59.44.894 E017.49.16.606 
N049.59.44.894 E017.49.16.606 N049.59.08.982 E017.50.30.531 
N049.59.08.982 E017.50.30.531 N049.58.38.358 E017.52.19.309 
N049.58.38.358 E017.52.19.309 N049.58.26.740 E017.53.25.838 
N049.58.26.740 E017.53.25.838 N049.58.28.855 E017.54.17.584 
N049.58.28.855 E017.54.17.584 N049.58.49.976 E017.55.49.464 
N049.58.49.976 E017.55.49.464 N049.59.23.773 E017.56.32.764 
N049.59.23.773 E017.56.32.764 N049.59.59.670 E017.58.06.752 
N049.59.59.670 E017.58.06.752 N049.59.59.670 E017.58.06.752 
N049.59.59.670 E017.58.06.752 N050.00.21.849 E017.58.32.103 
N050.00.21.849 E017.58.32.103 N050.00.50.359 E017.59.11.180 
N050.00.50.359 E017.59.11.180 N050.00.58.818 E017.59.43.912 
N050.00.58.818 E017.59.43.912 N050.00.55.646 E017.59.59.753 
N050.00.55.646 E017.59.59.753 N050.00.22.906 E018.03.21.469 
N050.00.22.906 E018.03.21.469 N050.02.46.539 E018.00.16.651 
N050.02.46.539 E018.00.16.651 N050.03.23.494 E018.03.40.475
N050.03.23.494 E018.03.40.475 N050.02.52.000 E018.05.52.000




;J
N050.02.52.000 E018.05.52.000 N049.59.59.670 E018.06.41.063 
N049.59.59.670 E018.06.41.063 N049.59.53.340 E018.07.11.687 
N049.59.53.340 E018.07.11.687 N049.59.57.556 E018.07.38.096 
N049.59.57.556 E018.07.38.096 N049.59.54.397 E018.08.04.497 
N049.59.54.397 E018.08.04.497 N049.59.17.428 E018.08.57.293 
N049.59.17.428 E018.08.57.293 N049.59.11.097 E018.09.26.867 
N049.59.11.097 E018.09.26.867 N049.59.17.428 E018.09.42.708 
N049.59.17.428 E018.09.42.708 N049.59.59.670 E018.10.33.403 
N049.59.59.670 E018.10.33.403 N049.59.59.670 E018.12.50.691
N049.59.59.670 E018.12.50.691 N049.58.06.676 E018.13.46.666 
N049.58.06.676 E018.13.46.666 N049.57.46.612 E018.16.34.579 
N049.57.46.612 E018.16.34.579 N049.56.09.452 E018.17.21.051 
N049.56.09.452 E018.17.21.051 N049.56.42.191 E018.19.35.166 
N049.56.42.191 E018.19.35.166 N049.55.30.368 E018.20.30.084 
N049.55.30.368 E018.20.30.084 N049.56.15.783 E018.23.58.131 
N049.56.15.783 E018.23.58.131 N049.54.22.788 E018.29.22.344 
N049.54.22.788 E018.29.22.344 N049.54.50.240 E018.34.29.666 
N049.54.50.240 E018.34.29.666 N049.51.33.805 E018.34.29.666 
N049.51.33.805 E018.34.29.666 N049.50.27.283 E018.35.50.979 
N049.50.27.283 E018.35.50.979 N049.49.03.855 E018.34.48.673 
N049.49.03.855 E018.34.48.673 N049.42.55.278 E018.38.11.439 
N049.42.55.278 E018.38.11.439 N049.40.16.869 E018.48.44.025 
N049.40.16.869 E018.48.44.025 N049.32.52.266 E018.51.35.116 
N049.32.52.266 E018.51.35.116 N049.31.27.781 E018.50.49.702 
N049.31.27.781 E018.50.49.702 N049.30.38.136 E018.57.54.248 
N049.30.38.136 E018.57.54.248 N049.25.37.152 E018.59.20.841 
N049.25.37.152 E018.59.20.841 N049.24.02.107 E018.58.22.757 
N049.24.02.107 E018.58.22.757 N049.24.02.107 E018.59.59.918 
N049.24.02.107 E018.59.59.918 N049.23.39.928 E019.01.58.199 
N049.23.39.928 E019.01.58.199 N049.25.14.987 E019.04.34.493 
N049.25.14.987 E019.04.34.493 N049.24.16.897 E019.08.05.712 
N049.24.16.897 E019.08.05.712 N049.24.48.579 E019.11.30.594 
N049.24.48.579 E019.11.30.594 N049.26.40.516 E019.11.49.600 
N049.26.40.516 E019.11.49.600 N049.27.31.218 E019.14.03.723 
N049.27.31.218 E019.14.03.723 N049.31.24.608 E019.15.20.812 
N049.31.24.608 E019.15.20.812 N049.32.19.526 E019.22.15.855 
N049.32.19.526 E019.22.15.855 N049.34.16.750 E019.23.14.996 
N049.34.16.750 E019.23.14.996 N049.35.56.012 E019.27.37.961 
N049.35.56.012 E019.27.37.961 N049.34.09.348 E019.31.51.415 
N049.34.09.348 E019.31.51.415 N049.30.05.397 E019.33.11.677 
N049.30.05.397 E019.33.11.677 N049.26.44.745 E019.36.27.048 
N049.26.44.745 E019.36.27.048 N049.26.46.860 E019.38.33.783 
N049.26.46.860 E019.38.33.783 N049.24.03.164 E019.38.28.502 
N049.24.03.164 E019.38.28.502 N049.23.12.476 E019.43.54.824 
N049.23.12.476 E019.43.54.824 N049.24.13.725 E019.45.38.322 
N049.24.13.725 E019.45.38.322 N049.24.16.897 E019.47.33.438 
N049.24.16.897 E019.47.33.438 N049.17.35.580 E019.47.43.992 
N049.17.35.580 E019.47.43.992 N049.16.22.713 E019.49.22.209 
N049.16.22.713 E019.49.22.209 N049.13.55.922 E019.46.02.608 
N049.13.55.922 E019.46.02.608 N049.12.18.762 E019.46.15.284 
N049.12.18.762 E019.46.15.284 N049.11.33.347 E019.47.19.705 
N049.11.33.347 E019.47.19.705 N049.11.51.310 E019.48.34.687 
N049.11.51.310 E019.48.34.687 N049.11.25.959 E019.52.37.587 
N049.11.25.959 E019.52.37.587 N049.13.49.591 E019.55.35.003 
N049.13.49.591 E019.55.35.003 N049.13.30.571 E020.00.00.082 
N049.13.30.571 E020.00.00.082 N049.12.22.992 E020.00.51.828 
N049.12.22.992 E020.00.51.828 N049.10.41.602 E020.05.38.029 
N049.10.41.602 E020.05.38.029 N049.17.10.243 E020.08.01.654 
N049.17.10.243 E020.08.01.654 N049.18.38.958 E020.08.37.559 
N049.18.38.958 E020.08.37.559 N049.18.15.721 E020.09.56.764 
N049.18.15.721 E020.09.56.764 N049.20.49.901 E020.13.35.371 
N049.20.49.901 E020.13.35.371 N049.20.52.016 E020.17.31.934 
N049.20.52.016 E020.17.31.934 N049.20.22.449 E020.18.59.584 
N049.20.22.449 E020.18.59.584 N049.23.12.476 E020.18.53.253 
N049.23.12.476 E020.18.53.253 N049.23.57.891 E020.19.17.540 
N049.23.57.891 E020.19.17.540 N049.23.57.891 E020.21.57.007 
N049.23.57.891 E020.21.57.007 N049.22.54.513 E020.23.10.931 
N049.22.54.513 E020.23.10.931 N049.24.23.228 E020.25.58.850 
N049.24.23.228 E020.25.58.850 N049.24.46.464 E020.26.54.819 
N049.24.46.464 E020.26.54.819 N049.24.38.018 E020.29.15.279 
N049.24.38.018 E020.29.15.279 N049.22.57.686 E020.32.39.103 
N049.22.57.686 E020.32.39.103 N049.22.49.240 E020.35.13.289 
N049.22.49.240 E020.35.13.289 N049.24.58.082 E020.37.01.010 
N049.24.58.082 E020.37.01.010 N049.24.01.049 E020.39.28.858 
N049.24.01.049 E020.39.28.858 N049.24.55.967 E020.42.00.930 
N049.24.55.967 E020.42.00.930 N049.24.49.636 E020.43.44.428 
N049.24.49.636 E020.43.44.428 N049.19.58.155 E020.49.22.374 
N049.19.58.155 E020.49.22.374 N049.20.21.391 E020.51.51.280 
N049.20.21.391 E020.51.51.280 N049.19.45.480 E020.52.41.968 
N049.19.45.480 E020.52.41.968 N049.19.05.352 E020.52.32.465 
N049.19.05.352 E020.52.32.465 N049.19.07.467 E020.54.31.804 
N049.19.07.467 E020.54.31.804 N049.17.41.925 E020.56.26.913 
N049.17.41.925 E020.56.26.913 N049.18.18.880 E020.59.27.501 
N049.18.18.880 E020.59.27.501 N049.19.38.091 E021.00.00.240
N049.19.38.091 E021.00.00.240 N049.21.45.876 E021.03.29.344 
N049.21.45.876 E021.03.29.344 N049.22.00.667 E021.06.00.365 
N049.22.00.667 E021.06.00.365 N049.25.08.643 E021.04.02.084 
N049.25.08.643 E021.04.02.084 N049.25.51.942 E021.08.36.666 
N049.25.51.942 E021.08.36.666 N049.24.10.000 E021.11.56.000


;R
N049.24.10.000 E021.11.56.000 N049.27.09.039 E021.17.13.086  
N049.27.09.039 E021.17.13.086 N049.25.48.770 E021.23.22.714 
N049.25.48.770 E021.23.22.714 N049.25.58.273 E021.24.29.243 
N049.25.58.273 E021.24.29.243 N049.24.49.636 E021.27.27.723 
N049.24.49.636 E021.27.27.723 N049.26.37.357 E021.33.57.415 
N049.26.37.357 E021.33.57.415 N049.26.04.618 E021.35.27.180 
N049.26.04.618 E021.35.27.180 N049.26.41.573 E021.38.18.264 
N049.26.41.573 E021.38.18.264 N049.25.08.643 E021.39.58.590 
N049.25.08.643 E021.39.58.590 N049.24.45.406 E021.43.38.255 
N049.24.45.406 E021.43.38.255 N049.21.09.965 E021.46.54.684 
N049.21.09.965 E021.46.54.684 N049.23.23.036 E021.50.48.074 
N049.23.23.036 E021.50.48.074 N049.21.15.252 E021.54.03.452 
N049.21.15.252 E021.54.03.452 N049.20.33.009 E021.56.20.740 
N049.20.33.009 E021.56.20.740 N049.20.43.570 E021.58.23.245 
N049.20.43.570 E021.58.23.245 N049.18.17.836 E022.00.00.405
N049.18.17.836 E022.00.00.405 N049.14.43.452 E022.02.30.368 
N049.14.43.452 E022.02.30.368 N049.13.01.004 E022.03.06.273 
N049.13.01.004 E022.03.06.273 N049.12.03.972 E022.08.41.047 
N049.12.03.972 E022.08.41.047 N049.10.41.602 E022.11.34.247 
N049.10.41.602 E022.11.34.247 N049.11.04.838 E022.14.13.713 
N049.11.04.838 E022.14.13.713 N049.09.10.786 E022.14.07.375 
N049.09.10.786 E022.14.07.375 N049.08.11.638 E022.19.08.360 
N049.08.11.638 E022.19.08.360 N049.08.54.938 E022.22.20.565 
N049.08.54.938 E022.22.20.565 N049.06.17.586 E022.24.57.917 
N049.06.17.586 E022.24.57.917 N049.05.16.338 E022.34.12.363
N049.05.16.338 E022.34.12.363 N049.05.29.013 E022.36.51.829
N049.05.29.013 E022.36.51.829 N049.02.30.526 E022.41.35.915
N049.02.30.526 E022.41.35.915 N049.03.27.559 E022.46.41.115
N049.03.27.559 E022.46.41.115 N049.02.21.023 E022.48.26.728
N049.02.21.023 E022.48.26.728 N049.05.34.286 E022.54.08.898
N049.05.34.286 E022.54.08.898 N049.07.08.275 E022.50.11.277
N049.07.08.275 E022.50.11.277 N049.09.35.066 E022.47.41.314
N049.09.35.066 E022.47.41.314 N049.09.51.971 E022.45.02.905
N049.09.51.971 E022.45.02.905 N049.10.58.507 E022.45.25.083
N049.10.58.507 E022.45.25.083 N049.10.29.984 E022.43.44.751
N049.10.29.984 E022.43.44.751 N049.10.25.768 E022.42.47.725
N049.10.25.768 E022.42.47.725 N049.11.23.844 E022.43.12.011
N049.11.23.844 E022.43.12.011 N049.13.08.406 E022.45.05.013
N049.13.08.406 E022.45.05.013 N049.13.50.649 E022.43.58.483
N049.13.50.649 E022.43.58.483 N049.16.30.102 E022.47.21.250
N049.16.30.102 E022.47.21.250 N049.19.35.977 E022.48.47.850
N049.19.35.977 E022.48.47.850 N049.26.59.536 E022.41.46.476
N049.26.59.536 E022.41.46.476 N049.28.33.524 E022.42.07.597
N049.28.33.524 E022.42.07.597 N049.31.36.227 E022.40.00.863
N049.31.36.227 E022.40.00.863 N049.32.41.691 E022.40.10.366
N049.32.41.691 E022.40.10.366 N049.41.21.290 E022.48.04.550
N049.41.21.290 E022.48.04.550 N049.43.01.609 E022.51.12.526
N049.43.01.609 E022.51.12.526 N049.51.07.410 E022.59.59.512
N049.51.07.410 E022.59.59.512 N049.52.26.622 E023.02.05.182
N049.52.26.622 E023.02.05.182 N049.53.10.965 E023.02.35.814
N049.53.10.965 E023.02.35.814 N049.53.48.992 E023.03.13.833
N049.53.48.992 E023.03.13.833 N049.56.01.006 E023.05.55.408
N049.56.01.006 E023.05.55.408 N049.56.41.134 E023.06.22.867
N049.56.41.134 E023.06.22.867 N049.57.18.089 E023.07.04.052
N049.57.18.089 E023.07.04.052 N049.57.39.210 E023.07.46.294
N049.57.39.210 E023.07.46.294 N049.58.11.949 E023.08.19.033
N049.58.11.949 E023.08.19.033 N049.58.32.013 E023.08.54.945
N049.58.32.013 E023.08.54.945 N049.59.59.670 E023.10.39.494
N049.59.59.670 E023.10.39.494 N050.01.03.034 E023.12.05.036
N050.01.03.034 E023.12.05.036 N050.03.36.170 E023.14.10.706
N050.03.36.170 E023.14.10.706 N050.04.04.679 E023.15.44.701
N050.04.04.679 E023.15.44.701 N050.05.49.228 E023.17.37.695
N050.05.49.228 E023.17.37.695 N050.08.16.033 E023.21.38.481
N050.08.16.033 E023.21.38.481 N050.10.45.996 E023.25.54.057
N050.10.45.996 E023.25.54.057 N050.12.21.042 E023.27.25.937
N050.12.21.042 E023.27.25.937 N050.16.38.726 E023.35.53.904
N050.16.38.726 E023.35.53.904 N050.18.12.714 E023.36.50.930
N050.18.12.714 E023.36.50.930 N050.19.46.702 E023.40.12.646
N050.19.46.702 E023.40.12.646 N050.20.40.562 E023.41.23.405
N050.20.40.562 E023.41.23.405 N050.23.44.323 E023.43.24.852
N050.23.44.323 E023.43.24.852 N050.24.20.220 E023.45.04.120
N050.24.20.220 E023.45.04.120 N050.25.10.922 E023.47.14.019
N050.25.10.922 E023.47.14.019 N050.24.50.858 E023.54.41.795
N050.24.50.858 E023.54.41.795 N050.25.25.699 E023.59.59.670
N050.25.25.699 E023.59.59.670 N050.27.10.247 E024.02.58.150
N050.27.10.247 E024.02.58.150 N050.38.18.752 E024.05.59.795
N050.38.18.752 E024.05.59.795 N050.41.15.110 E024.03.57.291
N050.41.15.110 E024.03.57.291 N050.42.58.615 E024.04.50.094
N050.42.58.615 E024.04.50.094 N050.46.25.597 E023.59.59.670
N050.46.25.597 E023.59.59.670 N050.47.00.451 E023.58.13.014
N050.47.00.451 E023.58.13.014 N050.48.56.618 E023.58.04.561
N050.48.56.618 E023.58.04.561 N050.50.27.448 E023.59.59.670
N050.50.27.448 E023.59.59.670 N050.50.14.772 E024.06.40.980
N050.50.14.772 E024.06.40.980 N050.51.49.818 E024.08.56.160
N050.51.49.818 E024.08.56.160 N050.56.29.680 E023.59.59.670
N050.56.29.680 E023.59.59.670 N050.56.56.075 E023.59.14.263
N050.56.56.075 E023.59.14.263 N050.57.16.139 E023.58.49.976
N050.57.16.139 E023.58.49.976 N050.58.43.796 E023.58.24.632
N050.58.43.796 E023.58.24.632 N050.58.58.586 E023.58.09.841
N050.58.58.586 E023.58.09.841 N050.59.59.835 E023.56.21.063
N050.59.59.835 E023.56.21.063 N051.00.09.338 E023.55.45.158
N051.00.09.338 E023.55.45.158 N051.02.18.181 E023.56.03.114
N051.02.18.181 E023.56.03.114 N051.04.08.016 E023.55.18.757
N051.04.08.016 E023.55.18.757 N051.07.19.165 E023.51.34.869
N051.07.19.165 E023.51.34.869 N051.08.56.325 E023.52.42.463
N051.08.56.325 E023.52.42.463 N051.13.01.334 E023.44.37.718
N051.13.01.334 E023.44.37.718 N051.16.11.425 E023.43.22.737
N051.16.11.425 E023.43.22.737 N051.17.30.636 E023.39.15.620
N051.17.30.636 E023.39.15.620 N051.18.51.949 E023.38.44.989
N051.18.51.949 E023.38.44.989 N051.20.01.657 E023.39.06.110
N051.20.01.657 E023.39.06.110 N051.24.39.405 E023.42.29.934
N051.24.39.405 E023.42.29.934 N051.26.46.119 E023.39.31.454
N051.26.46.119 E023.39.31.454 N051.27.54.770 E023.40.28.487
N051.27.54.770 E023.40.28.487 N051.32.05.066 E023.34.22.024
N051.32.05.066 E023.34.22.024 N051.33.42.226 E023.34.46.317
N051.33.42.226 E023.34.46.317 N051.37.09.208 E023.32.36.418
N051.37.09.208 E023.32.36.418 N051.39.29.669 E023.32.42.756
N051.39.29.669 E023.32.42.756 N051.39.47.631 E023.33.28.163
N051.39.47.631 E023.33.28.163 N051.42.57.708 E023.33.29.228
N051.42.57.708 E023.33.29.228 N051.43.30.448 E023.32.27.972
N051.43.30.448 E023.32.27.972 N051.44.46.487 E023.32.31.138
N051.44.46.487 E023.32.31.138 N051.47.52.362 E023.38.44.989
N051.47.52.362 E023.38.44.989 N051.51.04.568 E023.36.42.484
N051.51.04.568 E023.36.42.484 N051.51.46.810 E023.37.18.396
N051.51.46.810 E023.37.18.396 N051.53.03.907 E023.36.49.879
N051.53.03.907 E023.36.49.879 N051.53.34.531 E023.38.14.364
N051.53.34.531 E023.38.14.364 N051.54.49.513 E023.37.03.605
N051.54.49.513 E023.37.03.605 N051.55.41.258 E023.37.24.727
N051.55.41.258 E023.37.24.727 N052.00.00.000 E023.41.37.131
N052.00.00.000 E023.41.37.131 N052.01.26.600 E023.39.37.792
N052.01.26.600 E023.39.37.792 N052.05.07.315 E023.38.53.441
N052.05.07.315 E023.38.53.441 N052.06.51.864 E023.36.25.586
N052.06.51.864 E023.36.25.586 N052.06.52.921 E023.33.04.934
N052.06.52.921 E023.33.04.934 N052.09.09.152 E023.29.55.894
N052.09.09.152 E023.29.55.894 N052.10.37.866 E023.30.05.397
N052.10.37.866 E023.30.05.397 N052.10.32.593 E023.26.07.783
N052.10.32.593 E023.26.07.783 N052.11.17.000 E023.24.16.000


;E 
N052.11.17.000 E023.24.16.000 N052.12.23.472 E023.22.18.615
N052.12.23.472 E023.22.18.615 N052.13.59.575 E023.12.06.093
N052.13.59.575 E023.12.06.093 N052.14.48.162 E023.11.51.303
N052.14.48.162 E023.11.51.303 N052.15.29.347 E023.12.36.718
N052.15.29.347 E023.12.36.718 N052.16.36.927 E023.12.06.093
N052.16.36.927 E023.12.06.093 N052.17.06.508 E023.10.18.372
N052.17.06.508 E023.10.18.372 N052.21.47.414 E023.14.29.719
N052.21.47.414 E023.14.29.719 N052.27.50.705 E023.18.28.390
N052.27.50.705 E023.18.28.390 N052.33.23.371 E023.25.09.700
N052.33.23.371 E023.25.09.700 N052.36.39.806 E023.33.58.795
N052.36.39.806 E023.33.58.795 N052.40.01.515 E023.54.54.470
N052.40.01.515 E023.54.54.470 N052.56.26.838 E023.56.20.013
N052.56.26.838 E023.56.20.013 N052.57.34.417 E023.57.04.370
N052.57.34.417 E023.57.04.370 N052.58.14.559 E023.56.34.796
N052.58.14.559 E023.56.34.796 N053.00.00.165 E023.56.49.579
N053.00.00.165 E023.56.49.579 N053.04.08.332 E023.53.25.756
N053.04.08.332 E023.53.25.756 N053.09.07.202 E023.55.16.642
N053.09.07.202 E023.55.16.642 N053.11.48.783 E023.52.05.494
N053.11.48.783 E023.52.05.494 N053.13.43.906 E023.52.15.004
N053.13.43.906 E023.52.15.004 N053.18.04.749 E023.46.38.108
N053.18.04.749 E023.46.38.108 N053.22.52.000 E023.44.23.000

;S
N053.22.52.000 E023.44.23.000 N053.35.23.932 E023.38.10.141
N053.35.23.932 E023.38.10.141 N053.36.03.002 E023.37.01.497
N053.36.03.002 E023.37.01.497 N053.40.13.298 E023.36.11.860
N053.40.13.298 E023.36.11.860 N053.44.15.135 E023.36.29.809
N053.44.15.135 E023.36.29.809 N053.46.54.601 E023.33.39.781
N053.46.54.601 E023.33.39.781 N053.50.41.661 E023.33.36.616
N053.50.41.661 E023.33.36.616 N054.00.00.330 E023.28.52.530
;granica z EYVL poczatek
N054.00.00.330 E023.28.52.530 N054.00.23.552 E023.29.02.033
N054.00.23.552 E023.29.02.033 N054.01.00.521 E023.29.46.391
N054.01.00.521 E023.29.46.391 N054.01.32.203 E023.30.47.646
N054.01.32.203 E023.30.47.646 N054.07.50.270 E023.30.05.397
N054.07.50.270 E023.30.05.397 N054.13.37.726 E023.21.52.214
N054.13.37.726 E023.21.52.214 N054.18.53.487 E023.02.54.820
N054.18.53.487 E023.02.54.820 N054.20.44.380 E023.03.30.725
N054.20.44.380 E023.03.30.725 N054.22.19.426 E022.59.59.512
N054.22.19.426 E022.59.59.512 N054.25.43.250 E022.51.27.316
N054.25.43.250 E022.51.27.316 N054.24.31.440 E022.48.24.613
N054.24.31.440 E022.48.24.613 N054.22.02.534 E022.47.14.912
;granica z EYVL koniec
N054.22.02.534 E022.47.14.912 N054.21.29.795 E022.43.04.623
N054.21.29.795 E022.43.04.623 N054.20.02.138 E022.00.00.405
N054.20.02.138 E022.00.00.405 N054.19.50.520 E021.53.00.089
N054.19.50.520 E021.53.00.089 N054.19.53.692 E021.33.56.357
N054.19.53.692 E021.33.56.357 N054.19.12.507 E021.27.26.665
N054.19.12.507 E021.27.26.665 N054.21.12.890 E021.00.00.240
N054.21.12.890 E021.00.00.240 N054.22.04.635 E020.38.20.214
N054.22.04.635 E020.38.20.214 N054.22.54.000 E020.30.00.000

;G
N054.22.54.000 E020.30.00.000  N054.24.27.210 E020.15.35.760
N054.24.27.210 E020.15.35.760 N054.24.30.383 E020.11.12.803
N054.24.30.383 E020.11.12.803 N054.25.11.568 E020.05.30.634
N054.25.11.568 E020.05.30.634 N054.25.17.899 E020.00.00.082
N054.25.17.899 E020.00.00.082 N054.25.34.804 E019.58.27.145
N054.25.34.804 E019.58.27.145 N054.25.52.753 E019.54.30.589
N054.25.52.753 E019.54.30.589 N054.26.09.644 E019.52.46.033
N054.26.09.644 E019.52.46.033 N054.26.11.759 E019.51.27.879
N054.26.11.759 E019.51.27.879 N054.26.27.607 E019.49.06.368
N054.26.27.607 E019.49.06.368 N054.26.31.837 E019.48.14.623




;;;;;;ZALEW WISLANY;;;;;;; 
;- NOAA object 131
N054.26.31.837 E019.48.14.623 N054.25.58.040 E019.47.23.935 
N054.25.58.040 E019.47.23.935 N054.26.07.543 E019.45.54.163 
N054.26.07.543 E019.45.54.163 N054.25.54.868 E019.44.47.634 
N054.25.54.868 E019.44.47.634 N054.25.42.192 E019.44.32.843 
N054.25.42.192 E019.44.32.843 N054.25.08.395 E019.44.57.137 
N054.25.08.395 E019.44.57.137 N054.24.50.446 E019.44.44.461 
N054.24.50.446 E019.44.44.461 N054.24.34.599 E019.44.05.391 
N054.24.34.599 E019.44.05.391 N054.24.09.261 E019.43.08.358 
N054.24.09.261 E019.43.08.358 N054.23.30.191 E019.43.03.078 
N054.23.30.191 E019.43.03.078 N054.23.09.070 E019.42.45.129 
N054.23.09.070 E019.42.45.129 N054.22.43.719 E019.42.06.052 
N054.22.43.719 E019.42.06.052 N054.22.33.159 E019.41.26.975 
N054.22.33.159 E019.41.26.975 N054.22.08.865 E019.41.38.593 
N054.22.08.865 E019.41.38.593 N054.21.32.953 E019.40.20.439 
N054.21.32.953 E019.40.20.439 N054.21.21.335 E019.40.15.166 
N054.21.21.335 E019.40.15.166 N054.20.43.323 E019.38.41.171 
N054.20.43.323 E019.38.41.171 N054.20.25.374 E019.37.17.743 
N054.20.25.374 E019.37.17.743 N054.20.25.374 E019.36.35.501 
N054.20.25.374 E019.36.35.501 N054.20.31.705 E019.35.41.640 
N054.20.31.705 E019.35.41.640 N054.20.28.546 E019.35.36.360 
N054.20.28.546 E019.35.36.360 N054.20.25.374 E019.34.18.213 
N054.20.25.374 E019.34.18.213 N054.20.10.583 E019.33.05.339 
N054.20.10.583 E019.33.05.339 N054.19.55.807 E019.32.29.435 
N054.19.55.807 E019.32.29.435 N054.19.36.787 E019.32.06.199 
N054.19.36.787 E019.32.06.199 N054.19.36.787 E019.31.35.574 
N054.19.36.787 E019.31.35.574 N054.19.22.010 E019.31.06.000 
N054.19.22.010 E019.31.06.000 N054.19.25.169 E019.30.29.038 
N054.19.25.169 E019.30.29.038 N054.19.18.838 E019.29.59.471 
N054.19.18.838 E019.29.59.471 N054.17.56.468 E019.27.44.291 
N054.17.56.468 E019.27.44.291 N054.17.24.786 E019.26.41.985 
N054.17.24.786 E019.26.41.985 N054.17.22.671 E019.26.24.029 
N054.17.22.671 E019.26.24.029 N054.17.08.938 E019.25.50.233 
N054.17.08.938 E019.25.50.233 N054.15.44.453 E019.23.57.238 
N054.15.44.453 E019.23.57.238 N054.15.03.268 E019.23.50.901 
N054.15.03.268 E019.23.50.901 N054.14.11.523 E019.23.26.607 
N054.14.11.523 E019.23.26.607 N054.13.41.942 E019.23.08.658 
N054.13.41.942 E019.23.08.658 N054.13.19.777 E019.22.41.199 
N054.13.19.777 E019.22.41.199 N054.13.13.433 E019.22.24.301 
N054.13.13.433 E019.22.24.301 N054.13.13.433 E019.22.00.014 
N054.13.13.433 E019.22.00.014 N054.13.32.439 E019.21.44.173 
N054.13.32.439 E019.21.44.173 N054.13.50.402 E019.21.56.842 
N054.13.50.402 E019.21.56.842 N054.14.14.681 E019.22.32.753 
N054.14.14.681 E019.22.32.753 N054.15.23.332 E019.23.02.320 
N054.15.23.332 E019.23.02.320 N054.16.44.659 E019.24.08.849 
N054.16.44.659 E019.24.08.849 N054.16.46.760 E019.24.00.404 
N054.16.46.760 E019.24.00.404 N054.16.38.314 E019.23.44.563 
N054.16.38.314 E019.23.44.563 N054.16.02.402 E019.23.14.996 
N054.16.02.402 E019.23.14.996 N054.15.55.014 E019.23.00.206 
N054.15.55.014 E019.23.00.206 N054.15.55.014 E019.22.35.919 
N054.15.55.014 E019.22.35.919 N054.16.28.811 E019.20.05.956 
N054.16.28.811 E019.20.05.956 N054.16.37.256 E019.18.11.904 
N054.16.37.256 E019.18.11.904 N054.16.43.587 E019.17.53.948 
N054.16.43.587 E019.17.53.948 N054.16.40.429 E019.17.35.992 
N054.16.40.429 E019.17.35.992 N054.16.47.817 E019.17.32.827 
N054.16.47.817 E019.17.32.827 N054.16.52.047 E019.17.24.381 
N054.16.52.047 E019.17.24.381 N054.16.48.875 E019.16.47.412 
N054.16.48.875 E019.16.47.412 N054.16.30.926 E019.16.24.176 
N054.16.30.926 E019.16.24.176 N054.16.37.256 E019.15.41.933 
N054.16.37.256 E019.15.41.933 N054.16.23.537 E019.15.20.812 
N054.16.23.537 E019.15.20.812 N054.16.33.040 E019.15.20.812 
N054.16.33.040 E019.15.20.812 N054.16.41.486 E019.15.38.768 
N054.16.41.486 E019.15.38.768 N054.16.47.817 E019.15.32.430 
N054.16.47.817 E019.15.32.430 N054.17.02.607 E019.15.45.106 
N054.17.02.607 E019.15.45.106 N054.17.38.505 E019.15.02.863 
N054.17.38.505 E019.15.02.863 N054.18.27.092 E019.16.03.055 
N054.18.27.092 E019.16.03.055 N054.18.32.366 E019.15.38.768 
N054.18.32.366 E019.15.38.768 N054.18.53.487 E019.15.38.768 
N054.18.53.487 E019.15.38.768 N054.19.11.450 E019.15.02.863 
N054.19.11.450 E019.15.02.863 N054.19.20.953 E019.15.09.201 
N054.19.20.953 E019.15.09.201 N054.19.45.233 E019.15.02.863 
N054.19.45.233 E019.15.02.863 N054.19.52.635 E019.14.48.080 
N054.19.52.635 E019.14.48.080 N054.19.49.462 E019.13.54.219 
N054.19.49.462 E019.13.54.219 N054.19.56.851 E019.13.33.098 
N054.19.56.851 E019.13.33.098 N054.20.11.641 E019.13.39.429 
N054.20.11.641 E019.13.39.429 N054.20.22.202 E019.14.05.837 
N054.20.22.202 E019.14.05.837 N054.20.34.877 E019.14.41.742 
N054.20.34.877 E019.14.41.742 N054.20.40.150 E019.15.23.985 
N054.20.40.150 E019.15.23.985 N054.20.52.826 E019.16.11.507 
N054.20.52.826 E019.16.11.507 N054.21.07.616 E019.18.41.471 
N054.21.07.616 E019.18.41.471 N054.21.01.272 E019.21.06.154 
N054.21.01.272 E019.21.06.154 N054.21.07.616 E019.21.17.772 
N054.21.07.616 E019.21.17.772 N054.21.16.062 E019.22.11.632 
N054.21.16.062 E019.22.11.632 N054.21.43.514 E019.23.23.442 
N054.21.43.514 E019.23.23.442 N054.21.58.304 E019.24.47.933 
N054.21.58.304 E019.24.47.933 N054.22.16.253 E019.25.53.405 
N054.22.16.253 E019.25.53.405 N054.22.25.757 E019.26.11.361 
N054.22.25.757 E019.26.11.361 N054.22.31.044 E019.26.41.985 
N054.22.31.044 E019.26.41.985 N054.22.47.949 E019.26.56.769 
N054.22.47.949 E019.26.56.769 N054.22.58.496 E019.27.23.170 
N054.22.58.496 E019.27.23.170 N054.23.28.076 E019.29.17.229 
N054.23.28.076 E019.29.17.229 N054.23.43.911 E019.29.54.191 
N054.23.43.911 E019.29.54.191 N054.23.46.025 E019.30.11.089 
N054.23.46.025 E019.30.11.089 N054.23.52.356 E019.30.17.427 
N054.23.52.356 E019.30.17.427 N054.23.55.529 E019.30.41.714 
N054.23.55.529 E019.30.41.714 N054.24.10.319 E019.31.23.956 
N054.24.10.319 E019.31.23.956 N054.24.16.650 E019.32.17.817 
N054.24.16.650 E019.32.17.817 N054.24.25.096 E019.32.47.384 
N054.24.25.096 E019.32.47.384 N054.25.07.338 E019.34.18.213 
N054.25.07.338 E019.34.18.213 N054.25.28.459 E019.35.41.640 
N054.25.28.459 E019.35.41.640 N054.26.01.198 E019.36.35.501 
N054.26.01.198 E019.36.35.501 N054.26.11.759 E019.37.09.291 
N054.26.11.759 E019.37.09.291 N054.26.23.377 E019.37.14.571 
N054.26.23.377 E019.37.14.571 N054.26.44.498 E019.38.08.432 
N054.26.44.498 E019.38.08.432 N054.26.57.174 E019.38.21.107 
N054.26.57.174 E019.38.21.107 N054.27.11.964 E019.39.02.292 
N054.27.11.964 E019.39.02.292 N054.27.28.856 E019.39.19.190

;- NOAA object 134
N054.27.45.747 E019.38.41.171 N054.27.33.085 E019.39.04.407 
N054.27.33.085 E019.39.04.407 N054.27.28.856 E019.39.19.190 

;- NOAA object 133
N054.27.45.747 E019.38.41.171 N054.26.22.320 E019.35.59.596 
N054.26.22.320 E019.35.59.596 N054.25.15.797 E019.33.18.015 
N054.25.15.797 E019.33.18.015 N054.24.34.599 E019.30.59.669 
N054.24.34.599 E019.30.59.669 N054.24.21.937 E019.30.35.376 
N054.24.21.937 E019.30.35.376 N054.23.21.732 E019.26.53.603 
N054.23.21.732 E019.26.53.603 N054.22.58.496 E019.24.53.207 
N054.22.58.496 E019.24.53.207 N054.22.45.834 E019.24.12.022 
N054.22.45.834 E019.24.12.022 N054.22.22.598 E019.21.48.396 
N054.22.22.598 E019.21.48.396 N054.22.09.922 E019.20.59.816 
N054.22.09.922 E019.20.59.816 N054.22.07.808 E019.20.23.911 
N054.22.07.808 E019.20.23.911 N054.22.01.477 E019.19.59.618 
N054.22.01.477 E019.19.59.618 N054.21.58.304 E019.19.17.375 
N054.21.58.304 E019.19.17.375 N054.21.51.974 E019.18.59.426 
N054.21.51.974 E019.18.59.426 N054.21.51.974 E019.18.29.853 
N054.21.51.974 E019.18.29.853 N054.21.46.686 E019.18.05.566 
N054.21.46.686 E019.18.05.566 N054.21.46.686 E019.17.42.330 
N054.21.46.686 E019.17.42.330 N054.21.34.011 E019.16.23.125 
N054.21.34.011 E019.16.23.125 N054.21.22.393 E019.13.29.926 
N054.21.22.393 E019.13.29.926 N054.21.16.062 E019.12.59.301 
N054.21.16.062 E019.12.59.301 N054.21.10.789 E019.11.29.536 
N054.21.10.789 E019.11.29.536 N054.21.04.444 E019.10.53.632 
N054.21.04.444 E019.10.53.632 N054.21.01.272 E019.08.29.999 
N054.21.01.272 E019.08.29.999 N054.20.58.113 E019.08.23.668 
N054.20.58.113 E019.08.23.668 N054.20.58.113 E019.07.41.426 
N054.20.58.113 E019.07.41.426 N054.20.54.941 E019.07.35.088 
N054.20.54.941 E019.07.35.088 N054.20.54.941 E019.06.59.183 
N054.20.54.941 E019.06.59.183 N054.20.49.667 E019.06.00.043 
N054.20.49.667 E019.06.00.043 N054.20.49.667 E019.04.29.220 
N054.20.49.667 E019.04.29.220 N054.20.46.495 E019.04.23.940 
N054.20.46.495 E019.04.23.940 N054.20.43.323 E019.02.18.263 
N054.20.43.323 E019.02.18.263 N054.20.40.150 E019.02.11.932 
N054.20.40.150 E019.02.11.932 N054.20.40.150 E019.01.11.727 
N054.20.40.150 E019.01.11.727 N054.20.36.992 E019.01.05.396 
N054.20.36.992 E019.01.05.396 N054.20.40.150 E019.00.53.778 
N054.20.40.150 E019.00.53.778 N054.20.40.150 E018.59.59.918 
N054.20.40.150 E018.59.59.918 N054.20.43.323 E018.58.23.815 
N054.20.43.323 E018.58.23.815 N054.20.57.056 E018.57.44.738 
N054.20.57.056 E018.57.44.738 N054.21.01.272 E018.57.36.292 
N054.21.01.272 E018.57.36.292 N054.20.58.113 E018.57.17.286 
N054.20.58.113 E018.57.17.286 N054.21.23.450 E018.57.21.508 
N054.21.23.450 E018.57.21.508 N054.21.25.565 E018.57.12.005 
N054.21.25.565 E018.57.12.005 N054.21.08.674 E018.56.57.215 
N054.21.08.674 E018.56.57.215 N054.20.03.195 E018.56.38.209 
N054.20.03.195 E018.56.38.209 N054.19.52.635 E018.56.23.425 
N054.19.52.635 E018.56.23.425 N054.20.14.813 E018.56.21.310 
N054.20.14.813 E018.56.21.310 N054.21.03.387 E018.56.44.546 
N054.21.03.387 E018.56.44.546 N054.21.19.234 E018.56.42.431 
N054.21.19.234 E018.56.42.431 N054.21.04.444 E018.56.18.145 
N054.21.04.444 E018.56.18.145 N054.20.43.323 E018.55.17.947 
N054.20.43.323 E018.55.17.947 N054.20.49.667 E018.53.17.550 
N054.20.49.667 E018.53.17.550 N054.21.01.272 E018.51.36.167 
N054.21.01.272 E018.51.36.167 N054.21.28.737 E018.49.11.491 
N054.21.28.737 E018.49.11.491 N054.22.19.426 E018.47.41.719 
N054.22.19.426 E018.47.41.719 N054.22.19.426 E018.47.17.432 
N054.22.19.426 E018.47.17.432 N054.22.25.757 E018.46.54.196 
N054.22.25.757 E018.46.54.196 N054.22.08.865 E018.46.57.368 
N054.22.08.865 E018.46.57.368 N054.22.04.635 E018.47.41.719 
N054.22.04.635 E018.47.41.719 N054.22.00.419 E018.47.44.891 
N054.22.00.419 E018.47.44.891 N054.21.54.075 E018.47.33.273 
N054.21.54.075 E018.47.33.273 N054.21.44.572 E018.48.15.515 
N054.21.44.572 E018.48.15.515 N054.21.26.623 E018.47.08.979 
N054.21.26.623 E018.47.08.979 N054.20.52.826 E018.47.36.438 
N054.20.52.826 E018.47.36.438 N054.20.46.495 E018.49.06.210 
N054.20.46.495 E018.49.06.210 N054.20.39.093 E018.49.27.332 
N054.20.39.093 E018.49.27.332 N054.20.34.877 E018.49.24.159 
N054.20.34.877 E018.49.24.159 N054.20.34.877 E018.49.06.210 
N054.20.34.877 E018.49.06.210 N054.20.40.150 E018.48.48.255 
N054.20.40.150 E018.48.48.255 N054.20.36.992 E018.47.48.056 
N054.20.36.992 E018.47.48.056 N054.21.03.387 E018.47.08.979 
N054.21.03.387 E018.47.08.979 N054.21.18.177 E018.47.08.979 
N054.21.18.177 E018.47.08.979 N054.21.39.298 E018.46.51.031 
N054.21.39.298 E018.46.51.031 N054.21.47.744 E018.46.26.737 
N054.21.47.744 E018.46.26.737 N054.22.00.419 E018.46.26.737 
N054.22.00.419 E018.46.26.737 N054.22.02.534 E018.46.51.031 
N054.22.02.534 E018.46.51.031 N054.22.12.037 E018.46.44.693 
N054.22.12.037 E018.46.44.693 N054.22.22.598 E018.46.29.909 
N054.22.22.598 E018.46.29.909 N054.22.19.426 E018.45.59.278 
N054.22.19.426 E018.45.59.278 N054.22.16.253 E018.45.53.998 
N054.22.16.253 E018.45.53.998 N054.22.19.426 E018.44.35.851 
N054.22.19.426 E018.44.35.851 N054.22.36.331 E018.43.32.487 
N054.22.36.331 E018.43.32.487 N054.23.30.191 E018.41.56.384 
N054.23.30.191 E018.41.56.384 N054.23.59.758 E018.41.51.104 
N054.23.59.758 E018.41.51.104 N054.23.59.758 E018.41.33.148 
N054.23.59.758 E018.41.33.148 N054.24.12.434 E018.41.39.486 
N054.24.12.434 E018.41.39.486 N054.24.17.707 E018.41.02.524 
N054.24.17.707 E018.41.02.524 N054.24.27.210 E018.40.57.243 
N054.24.27.210 E018.40.57.243 N054.24.37.771 E018.40.36.122 
N054.24.37.771 E018.40.36.122 N054.24.46.217 E018.39.47.542 
N054.24.46.217 E018.39.47.542 N054.24.42.001 E018.39.39.096 
N054.24.42.001 E018.39.39.096 N054.24.27.210 E018.39.50.707 
N054.24.27.210 E018.39.50.707 N054.24.37.771 E018.39.35.924 
N054.24.37.771 E018.39.35.924 N054.24.31.440 E018.39.11.637 
N054.24.31.440 E018.39.11.637 N054.24.31.440 E018.38.42.063 
N054.24.31.440 E018.38.42.063 N054.24.37.771 E018.38.06.159 
N054.24.37.771 E018.38.06.159 N054.25.22.128 E018.36.23.718 
N054.25.22.128 E018.36.23.718 N054.26.11.759 E018.34.57.125 
N054.26.11.759 E018.34.57.125 N054.27.20.410 E018.33.50.589 
N054.27.20.410 E018.33.50.589 N054.28.02.652 E018.33.45.309 
N054.28.02.652 E018.33.45.309 N054.28.36.449 E018.33.50.589 
N054.28.36.449 E018.33.50.589 N054.29.02.844 E018.34.14.883 
N054.29.02.844 E018.34.14.883 N054.29.17.634 E018.34.14.883 
N054.29.17.634 E018.34.14.883 N054.30.50.565 E018.33.08.347 
N054.30.50.565 E018.33.08.347 N054.31.00.068 E018.33.09.404 
N054.31.00.068 E018.33.09.404 N054.31.08.527 E018.33.38.971 
N054.31.08.527 E018.33.38.971 N054.31.10.628 E018.33.11.512 
N054.31.10.628 E018.33.11.512 N054.31.14.858 E018.33.08.347 
N054.31.14.858 E018.33.08.347 N054.31.16.973 E018.33.29.468 
N054.31.16.973 E018.33.29.468 N054.31.26.476 E018.33.38.971 
N054.31.26.476 E018.33.38.971 N054.31.28.591 E018.33.06.232 
N054.31.28.591 E018.33.06.232 N054.31.32.807 E018.33.03.067 
N054.31.32.807 E018.33.03.067 N054.31.37.037 E018.33.35.806 
N054.31.37.037 E018.33.35.806 N054.31.47.597 E018.33.45.309 
N054.31.47.597 E018.33.45.309 N054.31.47.597 E018.33.03.067 
N054.31.47.597 E018.33.03.067 N054.31.53.928 E018.32.56.729 
N054.31.53.928 E018.32.56.729 N054.32.00.273 E018.33.21.022 
N054.32.00.273 E018.33.21.022 N054.32.04.489 E018.33.17.850 
N054.32.04.489 E018.33.17.850 N054.32.04.489 E018.32.41.945 
N054.32.04.489 E018.32.41.945 N054.31.46.540 E018.31.53.365 
N054.31.46.540 E018.31.53.365 N054.31.52.871 E018.31.54.423 
N054.31.52.871 E018.31.54.423 N054.32.02.388 E018.32.20.824 
N054.32.02.388 E018.32.20.824 N054.32.07.661 E018.32.06.034 
N054.32.07.661 E018.32.06.034 N054.31.58.158 E018.31.36.467 
N054.31.58.158 E018.31.36.467 N054.32.08.719 E018.31.56.531 
N054.32.08.719 E018.31.56.531 N054.32.13.992 E018.31.53.365 
N054.32.13.992 E018.31.53.365 N054.32.12.935 E018.31.41.747 
N054.32.12.935 E018.31.41.747 N054.32.07.661 E018.31.23.791 
N054.32.07.661 E018.31.23.791 N054.32.19.279 E018.31.30.129 
N054.32.19.279 E018.31.30.129 N054.32.16.107 E018.30.59.505 
N054.32.16.107 E018.30.59.505 N054.32.39.343 E018.30.44.721 
N054.32.39.343 E018.30.44.721 N054.32.22.451 E018.31.41.747 
N054.32.22.451 E018.31.41.747 N054.32.22.451 E018.32.23.990 
N054.32.22.451 E018.32.23.990 N054.32.12.935 E018.32.35.608 
N054.32.12.935 E018.32.35.608 N054.32.13.992 E018.32.53.557 
N054.32.13.992 E018.32.53.557 N054.32.18.222 E018.33.08.347 
N054.32.18.222 E018.33.08.347 N054.32.29.840 E018.33.08.347 
N054.32.29.840 E018.33.08.347 N054.32.34.056 E018.33.17.850 
N054.32.34.056 E018.33.17.850 N054.32.25.610 E018.33.35.806 
N054.32.25.610 E018.33.35.806 N054.32.26.667 E018.33.50.589 
N054.32.26.667 E018.33.50.589 N054.32.41.458 E018.33.26.296 
N054.32.41.458 E018.33.26.296 N054.33.05.751 E018.33.45.309 
N054.33.05.751 E018.33.45.309 N054.33.47.994 E018.33.08.347 
N054.33.47.994 E018.33.08.347 N054.34.12.274 E018.33.08.347 
N054.34.12.274 E018.33.08.347 N054.34.50.300 E018.32.50.391 
N054.34.50.300 E018.32.50.391 N054.35.32.542 E018.31.56.531 
N054.35.32.542 E018.31.56.531 N054.36.45.409 E018.30.51.052 
N054.36.45.409 E018.30.51.052 N054.37.41.385 E018.30.44.721 
N054.37.41.385 E018.30.44.721 N054.38.29.958 E018.31.15.346 
N054.38.29.958 E018.31.15.346 N054.38.29.958 E018.31.02.670 
N054.38.29.958 E018.31.02.670 N054.38.07.779 E018.30.41.549 
N054.38.07.779 E018.30.41.549 N054.37.58.276 E018.29.54.026 
N054.37.58.276 E018.29.54.026 N054.37.53.003 E018.29.11.784 
N054.37.53.003 E018.29.11.784 N054.37.55.104 E018.28.47.497 
N054.37.55.104 E018.28.47.497 N054.38.05.678 E018.28.03.140 
N054.38.05.678 E018.28.03.140 N054.38.12.009 E018.28.03.140 
N054.38.12.009 E018.28.03.140 N054.38.23.627 E018.28.26.376 
N054.38.23.627 E018.28.26.376 N054.38.44.748 E018.28.21.096 
N054.38.44.748 E018.28.21.096 N054.38.51.079 E018.28.39.044 
N054.38.51.079 E018.28.39.044 N054.39.05.869 E018.28.39.044 
N054.39.05.869 E018.28.39.044 N054.39.30.163 E018.27.56.802 
N054.39.30.163 E018.27.56.802 N054.40.30.354 E018.28.09.478 
N054.40.30.354 E018.28.09.478 N054.41.03.094 E018.28.03.140 
N054.41.03.094 E018.28.03.140 N054.41.32.661 E018.28.26.376 
N054.41.32.661 E018.28.26.376 N054.41.48.508 E018.28.21.096 
N054.41.48.508 E018.28.21.096 N054.42.23.349 E018.26.44.993 
N054.42.23.349 E018.26.44.993 N054.43.00.318 E018.26.02.750 
N054.43.00.318 E018.26.02.750 N054.43.29.885 E018.25.03.609 
N054.43.29.885 E018.25.03.609 N054.43.28.827 E018.24.41.431 
N054.43.28.827 E018.24.41.431 N054.43.28.827 E018.24.29.813 
N054.43.28.827 E018.24.29.813 N054.43.44.675 E018.23.50.736 
N054.43.44.675 E018.23.50.736 N054.44.30.090 E018.23.50.736 
N054.44.30.090 E018.23.50.736 N054.45.30.281 E018.24.15.029 
N054.45.30.281 E018.24.15.029 N054.46.14.638 E018.25.15.228 
N054.46.14.638 E018.25.15.228 N054.47.11.657 E018.25.20.501 
N054.47.11.657 E018.25.20.501 N054.47.10.600 E018.25.41.622 
N054.47.10.600 E018.25.41.622 N054.47.01.097 E018.25.54.298 
N054.47.01.097 E018.25.54.298 N054.46.46.320 E018.26.59.776 
N054.46.46.320 E018.26.59.776 N054.46.31.530 E018.27.24.063 
N054.46.31.530 E018.27.24.063 N054.46.16.740 E018.28.30.599 
N054.46.16.740 E018.28.30.599 N054.45.58.791 E018.29.00.166 
N054.45.58.791 E018.29.00.166 N054.45.46.115 E018.29.42.408 
N054.45.46.115 E018.29.42.408 N054.45.24.994 E018.30.23.600 
N054.45.24.994 E018.30.23.600 N054.45.19.720 E018.31.12.173 
N054.45.19.720 E018.31.12.173 N054.44.55.427 E018.31.41.747 
N054.44.55.427 E018.31.41.747 N054.44.55.427 E018.32.06.034 
N054.44.55.427 E018.32.06.034 N054.44.46.981 E018.32.35.608 
N054.44.46.981 E018.32.35.608 N054.44.27.975 E018.33.17.850 
N054.44.27.975 E018.33.17.850 N054.44.10.012 E018.34.29.666 
N054.44.10.012 E018.34.29.666 N054.43.48.891 E018.35.11.909 
N054.43.48.891 E018.35.11.909 N054.43.22.496 E018.36.54.342 
N054.43.22.496 E018.36.54.342 N054.42.42.355 E018.38.20.942 
N054.42.42.355 E018.38.20.942 N054.42.01.184 E018.39.11.637 
N054.42.01.184 E018.39.11.637 N054.41.58.011 E018.40.00.217 
N054.41.58.011 E018.40.00.217 N054.41.36.890 E018.40.23.447 
N054.41.36.890 E018.40.23.447 N054.41.36.890 E018.41.17.307 
N054.41.36.890 E018.41.17.307 N054.41.18.928 E018.42.05.887 
N054.41.18.928 E018.42.05.887 N054.40.20.851 E018.43.27.207 
N054.40.20.851 E018.43.27.207 N054.39.53.385 E018.43.50.443 
N054.39.53.385 E018.43.50.443 N054.39.23.818 E018.44.32.685 
N054.39.23.818 E018.44.32.685 N054.38.59.539 E018.44.50.634 
N054.38.59.539 E018.44.50.634 N054.38.08.837 E018.45.57.170 
N054.38.08.837 E018.45.57.170 N054.36.52.798 E018.46.54.196 
N054.36.52.798 E018.46.54.196 N054.36.49.639 E018.47.17.432 
N054.36.49.639 E018.47.17.432 N054.36.32.734 E018.47.51.229 
N054.36.32.734 E018.47.51.229 N054.35.56.822 E018.48.20.796 
N054.35.56.822 E018.48.20.796 N054.35.31.485 E018.48.29.241 
N054.35.31.485 E018.48.29.241 N054.35.31.485 E018.48.41.917 
N054.35.31.485 E018.48.41.917 N054.35.48.376 E018.49.14.656 
N054.35.48.376 E018.49.14.656 N054.36.08.440 E018.49.38.943 
N054.36.08.440 E018.49.38.943 N054.36.29.561 E018.49.50.561 
N054.36.29.561 E018.49.50.561 N054.37.08.645 E018.49.45.281 
N054.37.08.645 E018.49.45.281 N054.37.36.097 E018.49.26.274 
N054.37.36.097 E018.49.26.274 N054.39.12.200 E018.47.20.598 
N054.39.12.200 E018.47.20.598 N054.40.02.902 E018.45.32.877 
N054.40.02.902 E018.45.32.877 N054.41.07.310 E018.43.35.652 
N054.41.07.310 E018.43.35.652 N054.42.01.184 E018.41.29.983 
N054.42.01.184 E018.41.29.983 N054.42.52.929 E018.39.24.313 
N054.42.52.929 E018.39.24.313 N054.43.55.236 E018.36.05.769 
N054.43.55.236 E018.36.05.769 N054.44.29.032 E018.34.36.004 
N054.44.29.032 E018.34.36.004 N054.44.34.306 E018.34.06.430 
N054.44.34.306 E018.34.06.430 N054.44.58.599 E018.32.59.901 
N054.44.58.599 E018.32.59.901 N054.45.22.879 E018.32.12.378 
N054.45.22.879 E018.32.12.378 N054.45.49.287 E018.30.36.269 
N054.45.49.287 E018.30.36.269 N054.47.01.097 E018.27.35.681 
N054.47.01.097 E018.27.35.681 N054.47.33.836 E018.25.47.967 
N054.47.33.836 E018.25.47.967 N054.47.54.957 E018.25.05.717 
N054.47.54.957 E018.25.05.717 N054.47.54.957 E018.24.54.106 
N054.47.54.957 E018.24.54.106 N054.48.07.633 E018.24.47.762 
N054.48.07.633 E018.24.47.762 N054.48.07.633 E018.24.29.813 
N054.48.07.633 E018.24.29.813 N054.48.34.041 E018.23.05.328 
N054.48.34.041 E018.23.05.328 N054.49.23.672 E018.21.09.161 
N054.49.23.672 E018.21.09.161 N054.49.41.621 E018.20.56.486 
N054.49.41.621 E018.20.56.486 N054.50.01.685 E018.20.17.409 
N054.50.01.685 E018.20.17.409 N054.50.13.303 E018.19.00.319 
N054.50.13.303 E018.19.00.319 N054.50.10.144 E018.18.47.644 
N054.50.10.144 E018.18.47.644 N054.50.13.303 E018.16.47.254 
N054.50.13.303 E018.16.47.254 N054.50.01.685 E018.14.12.010 
N054.50.01.685 E018.14.12.010 N054.50.06.972 E018.09.59.606 
N054.50.06.972 E018.09.59.606 N054.50.01.685 E018.05.41.922 
N054.50.01.685 E018.05.41.922 N054.50.06.972 E018.03.29.914 
N054.50.06.972 E018.03.29.914 N054.49.58.526 E017.59.59.753 
N054.49.58.526 E017.59.59.753 N054.49.58.526 E017.59.23.848 
N054.49.58.526 E017.59.23.848 N054.49.55.354 E017.59.17.510 
N054.49.55.354 E017.59.17.510 N054.49.55.354 E017.56.53.885 
N054.49.55.354 E017.56.53.885 N054.49.49.023 E017.56.29.598 
N054.49.49.023 E017.56.29.598 N054.49.43.736 E017.55.17.782 
N054.49.43.736 E017.55.17.782 N054.49.40.563 E017.55.12.502 
N054.49.40.563 E017.55.12.502 N054.49.40.563 E017.54.48.215 
N054.49.40.563 E017.54.48.215 N054.49.37.405 E017.54.41.877 
N054.49.37.405 E017.54.41.877 N054.49.37.405 E017.54.17.584 
N054.49.37.405 E017.54.17.584 N054.49.13.111 E017.52.05.576 
N054.49.13.111 E017.52.05.576 N054.49.13.111 E017.51.42.340 
N054.49.13.111 E017.51.42.340 N054.49.07.838 E017.51.05.385 
N054.49.07.838 E017.51.05.385 N054.48.55.162 E017.50.24.193 
N054.48.55.162 E017.50.24.193 N054.48.37.200 E017.48.35.414 
N054.48.37.200 E017.48.35.414 N054.48.30.869 E017.48.17.466 
N054.48.30.869 E017.48.17.466 N054.48.31.926 E017.47.59.510 
N054.48.31.926 E017.47.59.510 N054.48.28.754 E017.47.54.229 
N054.48.28.754 E017.47.54.229 N054.48.25.595 E017.46.54.031 
N054.48.25.595 E017.46.54.031 N054.48.12.920 E017.46.05.458 
N054.48.12.920 E017.46.05.458 N054.48.13.977 E017.45.35.884 
N054.48.13.977 E017.45.35.884 N054.48.07.633 E017.45.11.597 
N054.48.07.633 E017.45.11.597 N054.48.07.633 E017.44.53.642 
N054.48.07.633 E017.44.53.642 N054.47.58.130 E017.44.24.075 
N054.47.58.130 E017.44.24.075 N054.47.52.856 E017.43.35.495 
N054.47.52.856 E017.43.35.495 N054.47.37.008 E017.42.12.060 
N054.47.37.008 E017.42.12.060 N054.47.13.772 E017.40.53.913 
N054.47.13.772 E017.40.53.913 N054.47.07.441 E017.39.53.715 
N054.47.07.441 E017.39.53.715 N054.46.49.479 E017.38.30.287 
N054.46.49.479 E017.38.30.287 N054.46.49.479 E017.37.59.663 
N054.46.49.479 E017.37.59.663 N054.46.39.976 E017.37.30.089 
N054.46.39.976 E017.37.30.089 N054.46.37.861 E017.36.41.509 
N054.46.37.861 E017.36.41.509 N054.46.34.702 E017.36.36.229 
N054.46.34.702 E017.36.36.229 N054.46.28.358 E017.35.29.700 
N054.46.28.358 E017.35.29.700 N054.46.16.740 E017.34.24.221 
N054.46.16.740 E017.34.24.221 N054.46.10.409 E017.32.53.399 
N054.46.10.409 E017.32.53.399 N054.45.55.618 E017.31.29.964 
N054.45.55.618 E017.31.29.964 N054.45.52.460 E017.30.47.722 
N054.45.52.460 E017.30.47.722 N054.45.46.115 E017.30.18.155 
N054.45.46.115 E017.30.18.155 N054.45.40.842 E017.29.06.339 
N054.45.40.842 E017.29.06.339 N054.45.31.339 E017.28.29.383 
N054.45.31.339 E017.28.29.383 N054.45.31.339 E017.28.06.147 
N054.45.31.339 E017.28.06.147 N054.45.22.879 E017.27.17.567 
N054.45.22.879 E017.27.17.567 N054.45.19.720 E017.24.53.941 
N054.45.19.720 E017.24.53.941 N054.45.13.376 E017.24.24.375 
N054.45.13.376 E017.24.24.375 N054.45.13.376 E017.22.23.978 
N054.45.13.376 E017.22.23.978 N054.45.01.758 E017.21.23.780 
N054.45.01.758 E017.21.23.780 N054.45.01.758 E017.20.59.493 
N054.45.01.758 E017.20.59.493 N054.44.58.599 E017.20.54.213 
N054.44.58.599 E017.20.54.213 N054.44.55.427 E017.20.11.971 
N054.44.55.427 E017.20.11.971 N054.44.27.975 E017.18.24.250 
N054.44.27.975 E017.18.24.250 N054.44.25.860 E017.17.48.345 
N054.44.25.860 E017.17.48.345 N054.44.19.515 E017.17.24.051 
N054.44.19.515 E017.17.24.051 N054.44.19.515 E017.16.41.809 
N054.44.19.515 E017.16.41.809 N054.44.16.357 E017.16.23.853 
N054.44.16.357 E017.16.23.853 N054.43.40.445 E017.13.42.279 
N054.43.40.445 E017.13.42.279 N054.43.12.993 E017.12.35.743 
N054.43.12.993 E017.12.35.743 N054.43.10.878 E017.12.17.794 
N054.43.10.878 E017.12.17.794 N054.42.52.929 E017.11.48.220 
N054.42.52.929 E017.11.48.220 N054.42.22.305 E017.10.12.117 
N054.42.22.305 E017.10.12.117 N054.41.55.897 E017.08.18.058 
N054.41.55.897 E017.08.18.058 N054.41.25.272 E017.07.05.191 
N054.41.25.272 E017.07.05.191 N054.41.18.928 E017.06.35.625 
N054.41.18.928 E017.06.35.625 N054.40.52.533 E017.05.05.859 
N054.40.52.533 E017.05.05.859 N054.40.28.239 E017.04.05.661 
N054.40.28.239 E017.04.05.661 N054.40.13.449 E017.03.00.183 
N054.40.13.449 E017.03.00.183 N054.39.44.940 E017.02.08.430 
N054.39.44.940 E017.02.08.430 N054.39.02.697 E017.01.20.907 
N054.39.02.697 E017.01.20.907 N054.38.19.397 E016.59.59.595 



;- NOAA object 122
N054.04.49.682 E015.00.00.323 N054.05.07.645 E015.01.17.419 
N054.05.07.645 E015.01.17.419 N054.05.46.715 E015.03.24.147 
N054.05.46.715 E015.03.24.147 N054.05.55.161 E015.04.35.963 
N054.05.55.161 E015.04.35.963 N054.06.01.505 E015.05.00.249 
N054.06.01.505 E015.05.00.249 N054.06.04.664 E015.05.54.110 
N054.06.04.664 E015.05.54.110 N054.06.25.785 E015.06.59.588 
N054.06.25.785 E015.06.59.588 N054.06.37.403 E015.08.06.118 
N054.06.37.403 E015.08.06.118 N054.06.55.366 E015.08.53.644 
N054.06.55.366 E015.08.53.644 N054.06.55.366 E015.09.11.596 
N054.06.55.366 E015.09.11.596 N054.07.13.315 E015.10.29.743 
N054.07.13.315 E015.10.29.743 N054.07.19.645 E015.11.18.327 
N054.07.19.645 E015.11.18.327 N054.07.46.054 E015.12.41.758 
N054.07.46.054 E015.12.41.758 N054.07.46.054 E015.12.59.710 
N054.07.46.054 E015.12.59.710 N054.07.55.557 E015.13.48.287 
N054.07.55.557 E015.13.48.287 N054.08.16.678 E015.15.05.383 
N054.08.16.678 E015.15.05.383 N054.08.58.921 E015.17.59.633 
N054.08.58.921 E015.17.59.633 N054.09.04.208 E015.19.24.122 
N054.09.04.208 E015.19.24.122 N054.09.16.870 E015.20.23.259 
N054.09.16.870 E015.20.23.259 N054.09.22.157 E015.21.54.082 
N054.09.22.157 E015.21.54.082 N054.09.36.933 E015.23.05.894 
N054.09.36.933 E015.23.05.894 N054.09.36.933 E015.23.23.850 
N054.09.36.933 E015.23.23.850 N054.09.58.055 E015.25.24.240 
N054.09.58.055 E015.25.24.240 N054.09.58.055 E015.27.36.251 
N054.09.58.055 E015.27.36.251 N054.10.01.227 E015.27.41.535 
N054.10.01.227 E015.27.41.535 N054.09.58.055 E015.28.54.401 
N054.09.58.055 E015.28.54.401 N054.10.01.227 E015.28.59.682 
N054.10.01.227 E015.28.59.682 N054.10.01.227 E015.29.17.634 
N054.10.01.227 E015.29.17.634 N054.10.10.730 E015.29.48.262 
N054.10.10.730 E015.29.48.262 N054.10.10.730 E015.30.06.214 
N054.10.10.730 E015.30.06.214 N054.10.19.176 E015.30.42.119 
N054.10.19.176 E015.30.42.119 N054.10.28.693 E015.31.00.075 
N054.10.28.693 E015.31.00.075 N054.10.43.469 E015.32.00.269 
N054.10.43.469 E015.32.00.269 N054.11.08.820 E015.32.50.961 
N054.11.08.820 E015.32.50.961 N054.11.16.208 E015.33.05.744 
N054.11.16.208 E015.33.05.744 N054.11.16.208 E015.33.59.605 
N054.11.16.208 E015.33.59.605 N054.11.13.036 E015.34.05.946 
N054.11.13.036 E015.34.05.946 N054.11.13.036 E015.34.35.513 
N054.11.13.036 E015.34.35.513 N054.11.25.712 E015.35.35.711 
N054.11.25.712 E015.35.35.711 N054.11.28.884 E015.36.35.906 
N054.11.28.884 E015.36.35.906 N054.11.46.833 E015.37.47.719 
N054.11.46.833 E015.37.47.719 N054.11.45.775 E015.37.59.337 
N054.11.45.775 E015.37.59.337 N054.11.48.948 E015.38.05.671 
N054.11.48.948 E015.38.05.671 N054.11.52.120 E015.38.54.251 
N054.11.52.120 E015.38.54.251 N054.12.04.796 E015.39.53.392 
N054.12.04.796 E015.39.53.392 N054.12.04.796 E015.40.12.402 
N054.12.04.796 E015.40.12.402 N054.12.13.241 E015.40.59.925 
N054.12.13.241 E015.40.59.925 N054.12.19.572 E015.41.17.877 
N054.12.19.572 E015.41.17.877 N054.12.19.572 E015.41.35.833 
N054.12.19.572 E015.41.35.833 N054.12.31.190 E015.42.41.308 
N054.12.31.190 E015.42.41.308 N054.12.43.866 E015.43.18.270 
N054.12.43.866 E015.43.18.270 N054.12.55.484 E015.44.41.701 
N054.12.55.484 E015.44.41.701 N054.13.43.013 E015.47.35.951 
N054.13.43.013 E015.47.35.951 N054.14.04.135 E015.48.29.811 
N054.14.04.135 E015.48.29.811 N054.14.07.293 E015.48.59.382 
N054.14.07.293 E015.48.59.382 N054.14.16.796 E015.49.30.010 
N054.14.16.796 E015.49.30.010 N054.14.40.032 E015.51.30.403 
N054.14.40.032 E015.51.30.403 N054.14.40.032 E015.52.17.925 
N054.14.40.032 E015.52.17.925 N054.14.49.536 E015.53.11.786 
N054.14.49.536 E015.53.11.786 N054.14.49.536 E015.54.18.318 
N054.14.49.536 E015.54.18.318 N054.14.52.708 E015.54.23.599 
N054.14.52.708 E015.54.23.599 N054.14.52.708 E015.55.30.131 
N054.14.52.708 E015.55.30.131 N054.14.57.981 E015.55.59.702 
N054.14.57.981 E015.55.59.702 N054.14.57.981 E015.56.48.282 
N054.14.57.981 E015.56.48.282 N054.15.01.154 E015.56.53.559 
N054.15.01.154 E015.56.53.559 N054.15.01.154 E015.57.17.852 
N054.15.01.154 E015.57.17.852 N054.15.07.498 E015.57.35.804 
N054.15.07.498 E015.57.35.804 N054.15.10.657 E015.58.24.385 
N054.15.10.657 E015.58.24.385 N054.15.15.944 E015.58.42.337 
N054.15.15.944 E015.58.42.337 N054.15.19.102 E015.59.41.478 
N054.15.19.102 E015.59.41.478 N054.15.25.447 E016.00.00.488 
N054.15.25.447 E016.00.00.488 N054.15.25.447 E016.00.30.054 
N054.15.25.447 E016.00.30.054 N054.15.31.778 E016.00.59.628 
N054.15.31.778 E016.00.59.628 N054.15.31.778 E016.01.48.208 
N054.15.31.778 E016.01.48.208 N054.15.52.899 E016.03.06.356 
N054.15.52.899 E016.03.06.356 N054.15.58.186 E016.03.53.878 
N054.15.58.186 E016.03.53.878 N054.17.01.550 E016.07.41.989 
N054.17.01.550 E016.07.41.989 N054.17.04.709 E016.07.48.327 
N054.17.04.709 E016.07.48.327 N054.17.01.550 E016.08.06.282 
N054.17.01.550 E016.08.06.282 N054.16.41.486 E016.08.14.728 
N054.16.41.486 E016.08.14.728 N054.16.41.486 E016.07.50.441 
N054.16.41.486 E016.07.50.441 N054.16.49.932 E016.07.48.327 
N054.16.49.932 E016.07.48.327 N054.16.47.817 E016.07.38.823 
N054.16.47.817 E016.07.38.823 N054.16.23.537 E016.07.09.256 
N054.16.23.537 E016.07.09.256 N054.16.07.690 E016.06.30.179 
N054.16.07.690 E016.06.30.179 N054.15.58.186 E016.05.17.313 
N054.15.58.186 E016.05.17.313 N054.15.40.224 E016.04.36.121 
N054.15.40.224 E016.04.36.121 N054.15.38.123 E016.04.00.216 
N054.15.38.123 E016.04.00.216 N054.15.32.835 E016.03.50.713 
N054.15.32.835 E016.03.50.713 N054.15.19.102 E016.04.18.172 
N054.15.19.102 E016.04.18.172 N054.15.07.498 E016.05.18.363 
N054.15.07.498 E016.05.18.363 N054.15.34.950 E016.06.05.893 
N054.15.34.950 E016.06.05.893 N054.15.37.065 E016.06.30.179 
N054.15.37.065 E016.06.30.179 N054.15.15.944 E016.07.41.989 
N054.15.15.944 E016.07.41.989 N054.15.13.829 E016.08.11.563 
N054.15.13.829 E016.08.11.563 N054.15.04.326 E016.08.29.518 
N054.15.04.326 E016.08.29.518 N054.15.14.886 E016.08.56.971 
N054.15.14.886 E016.08.56.971 N054.15.26.505 E016.09.08.589 
N054.15.26.505 E016.09.08.589 N054.15.38.123 E016.09.29.710 
N054.15.38.123 E016.09.29.710 N054.15.44.453 E016.10.08.787 
N054.15.44.453 E016.10.08.787 N054.16.00.301 E016.10.21.462 
N054.16.00.301 E016.10.21.462 N054.16.34.084 E016.10.17.233 
N054.16.34.084 E016.10.17.233 N054.16.37.256 E016.10.54.202 
N054.16.37.256 E016.10.54.202 N054.16.28.811 E016.11.35.387 
N054.16.28.811 E016.11.35.387 N054.16.28.811 E016.12.17.629 
N054.16.28.811 E016.12.17.629 N054.16.25.638 E016.12.23.967 
N054.16.25.638 E016.12.23.967 N054.16.29.868 E016.12.51.426 
N054.16.29.868 E016.12.51.426 N054.16.39.371 E016.12.51.426 
N054.16.39.371 E016.12.51.426 N054.16.57.320 E016.12.27.132 
N054.16.57.320 E016.12.27.132 N054.17.30.060 E016.12.32.412 
N054.17.30.060 E016.12.32.412 N054.17.57.525 E016.12.20.794 
N054.17.57.525 E016.12.20.794 N054.18.19.704 E016.11.53.335 
N054.18.19.704 E016.11.53.335 N054.18.16.532 E016.11.35.387 
N054.18.16.532 E016.11.35.387 N054.17.13.168 E016.09.24.429 
N054.17.13.168 E016.09.24.429 N054.17.01.550 E016.08.42.187 
N054.17.01.550 E016.08.42.187 N054.17.01.550 E016.08.17.900 
N054.17.01.550 E016.08.17.900 N054.17.08.938 E016.08.03.110 
N054.17.08.938 E016.08.03.110 N054.17.52.238 E016.10.05.614 
N054.17.52.238 E016.10.05.614 N054.18.20.748 E016.11.02.647 
N054.18.20.748 E016.11.02.647 N054.19.24.111 E016.13.03.037 
N054.19.24.111 E016.13.03.037 N054.21.16.062 E016.16.05.739 
N054.21.16.062 E016.16.05.739 N054.21.11.832 E016.16.26.861 
N054.21.11.832 E016.16.26.861 N054.21.04.444 E016.16.23.695 
N054.21.04.444 E016.16.23.695 N054.20.39.093 E016.15.26.662 
N054.20.39.093 E016.15.26.662 N054.20.14.813 E016.14.57.095 
N054.20.14.813 E016.14.57.095 N054.19.35.729 E016.13.38.948 
N054.19.35.729 E016.13.38.948 N054.19.14.608 E016.13.38.948 
N054.19.14.608 E016.13.38.948 N054.19.13.564 E016.13.53.732 
N054.19.13.564 E016.13.53.732 N054.19.16.723 E016.14.06.400 
N054.19.16.723 E016.14.06.400 N054.19.04.048 E016.14.47.592 
N054.19.04.048 E016.14.47.592 N054.19.04.048 E016.15.05.541 
N054.19.04.048 E016.15.05.541 N054.19.11.450 E016.15.26.662 
N054.19.11.450 E016.15.26.662 N054.19.27.284 E016.15.33.000 
N054.19.27.284 E016.15.33.000 N054.20.00.023 E016.15.33.000 
N054.20.00.023 E016.15.33.000 N054.20.01.080 E016.15.47.784 
N054.20.01.080 E016.15.47.784 N054.19.57.908 E016.16.00.459 
N054.19.57.908 E016.16.00.459 N054.20.07.425 E016.16.35.313 
N054.20.07.425 E016.16.35.313 N054.20.07.425 E016.17.12.269 
N054.20.07.425 E016.17.12.269 N054.20.15.871 E016.17.41.842 
N054.20.15.871 E016.17.41.842 N054.20.36.992 E016.18.17.747 
N054.20.36.992 E016.18.17.747 N054.20.40.150 E016.19.06.327 
N054.20.40.150 E016.19.06.327 N054.20.49.667 E016.19.48.570 
N054.20.49.667 E016.19.48.570 N054.21.08.674 E016.20.02.303 
N054.21.08.674 E016.20.02.303 N054.21.36.126 E016.20.03.360 
N054.21.36.126 E016.20.03.360 N054.22.34.216 E016.18.59.996 
N054.22.34.216 E016.18.59.996 N054.21.50.916 E016.17.20.721 
N054.21.50.916 E016.17.20.721 N054.21.36.126 E016.17.02.765 
N054.21.36.126 E016.17.02.765 N054.21.26.623 E016.17.02.765 
N054.21.26.623 E016.17.02.765 N054.21.13.947 E016.16.41.644 
N054.21.13.947 E016.16.41.644 N054.21.24.508 E016.16.20.523 
N054.21.24.508 E016.16.20.523 N054.22.47.949 E016.18.20.919 
N054.22.47.949 E016.18.20.919 N054.23.05.898 E016.18.56.824 
N054.23.05.898 E016.18.56.824 N054.24.02.917 E016.20.08.640 
N054.24.02.917 E016.20.08.640 N054.25.39.020 E016.21.57.412 
N054.25.39.020 E016.21.57.412 N054.26.24.435 E016.22.33.316 
N054.26.24.435 E016.22.33.316 N054.26.57.174 E016.23.38.795 
N054.26.57.174 E016.23.38.795 N054.27.18.295 E016.24.03.089 
N054.27.18.295 E016.24.03.089 N054.28.51.226 E016.25.21.236 
N054.28.51.226 E016.25.21.236 N054.29.13.404 E016.25.53.975 
N054.29.13.404 E016.25.53.975 N054.29.09.188 E016.26.08.758 
N054.29.09.188 E016.26.08.758 N054.28.59.685 E016.26.02.421 
N054.28.59.685 E016.26.02.421 N054.28.51.226 E016.25.44.472 
N054.28.51.226 E016.25.44.472 N054.28.33.277 E016.25.39.191 
N054.28.33.277 E016.25.39.191 N054.28.08.983 E016.25.14.898 
N054.28.08.983 E016.25.14.898 N054.27.54.207 E016.25.14.898 
N054.27.54.207 E016.25.14.898 N054.27.52.092 E016.25.23.351 
N054.27.52.092 E016.25.23.351 N054.28.01.595 E016.26.05.593 
N054.28.01.595 E016.26.05.593 N054.28.13.213 E016.26.29.880 
N054.28.13.213 E016.26.29.880 N054.28.16.385 E016.27.12.122 
N054.28.16.385 E016.27.12.122 N054.28.40.665 E016.27.41.696 
N054.28.40.665 E016.27.41.696 N054.28.41.722 E016.28.02.817 
N054.28.41.722 E016.28.02.817 N054.28.56.513 E016.28.02.817 
N054.28.56.513 E016.28.02.817 N054.29.19.749 E016.28.35.556 
N054.29.19.749 E016.28.35.556 N054.29.30.309 E016.28.50.340 
N054.29.30.309 E016.28.50.340 N054.29.48.258 E016.28.50.340 
N054.29.48.258 E016.28.50.340 N054.30.04.106 E016.28.30.276 
N054.30.04.106 E016.28.30.276 N054.30.04.106 E016.28.17.601 
N054.30.04.106 E016.28.17.601 N054.29.40.870 E016.27.35.358 
N054.29.40.870 E016.27.35.358 N054.29.31.367 E016.26.47.835 
N054.29.31.367 E016.26.47.835 N054.29.23.965 E016.26.26.714 
N054.29.23.965 E016.26.26.714 N054.29.15.519 E016.26.20.376 
N054.29.15.519 E016.26.20.376 N054.29.14.462 E016.26.08.758 
N054.29.14.462 E016.26.08.758 N054.29.30.309 E016.26.08.758 
N054.29.30.309 E016.26.08.758 N054.31.10.628 E016.28.48.225 
N054.31.10.628 E016.28.48.225 N054.31.10.628 E016.28.59.843 
N054.31.10.628 E016.28.59.843 N054.31.22.246 E016.29.29.417 
N054.31.22.246 E016.29.29.417 N054.32.31.955 E016.31.47.762 
N054.32.31.955 E016.31.47.762 N054.32.43.573 E016.32.30.005 
N054.32.43.573 E016.32.30.005 N054.32.43.573 E016.32.59.572 
N054.32.43.573 E016.32.59.572 N054.32.55.177 E016.33.48.152 
N054.32.55.177 E016.33.48.152 N054.33.04.694 E016.34.11.388 
N054.33.04.694 E016.34.11.388 N054.33.43.764 E016.37.05.638 
N054.33.43.764 E016.37.05.638 N054.33.45.879 E016.37.54.218 
N054.33.45.879 E016.37.54.218 N054.34.01.713 E016.39.23.983 
N054.34.01.713 E016.39.23.983 N054.34.01.713 E016.40.06.232 
N054.34.01.713 E016.40.06.232 N054.34.16.503 E016.41.05.366 
N054.34.16.503 E016.41.05.366 N054.34.16.503 E016.41.53.947 
N054.34.16.503 E016.41.53.947 N054.34.10.159 E016.42.41.469 
N054.34.10.159 E016.42.41.469 N054.34.13.331 E016.43.05.763 
N054.34.13.331 E016.43.05.763 N054.34.10.159 E016.45.17.770 
N054.34.10.159 E016.45.17.770 N054.34.49.243 E016.48.12.027 
N054.34.49.243 E016.48.12.027 N054.34.52.415 E016.49.23.837 
N054.34.52.415 E016.49.23.837 N054.35.01.918 E016.49.41.792 
N054.35.01.918 E016.49.41.792 N054.35.04.033 E016.50.06.079 
N054.35.04.033 E016.50.06.079 N054.35.23.039 E016.51.06.277 
N054.35.23.039 E016.51.06.277 N054.35.31.485 E016.52.41.323 
N054.35.31.485 E016.52.41.323 N054.35.39.931 E016.53.29.903 
N054.35.39.931 E016.53.29.903 N054.36.13.727 E016.55.12.344 
N054.36.13.727 E016.55.12.344 N054.36.19.015 E016.55.41.911 
N054.36.19.015 E016.55.41.911 N054.36.52.798 E016.57.18.013 
N054.36.52.798 E016.57.18.013 N054.38.05.678 E016.59.44.811 
N054.38.05.678 E016.59.44.811 N054.38.19.397 E016.59.59.595 

 
;- NOAA object 115
N054.04.49.682 E015.00.00.323 N054.04.37.007 E014.59.11.746 
N054.04.37.007 E014.59.11.746 N054.04.34.905 E014.58.42.176 
N054.04.34.905 E014.58.42.176 N054.04.19.058 E014.57.53.595 
N054.04.19.058 E014.57.53.595 N054.04.10.612 E014.56.59.735 
N054.04.10.612 E014.56.59.735 N054.03.49.491 E014.55.54.260 
N054.03.49.491 E014.55.54.260 N054.03.46.318 E014.55.23.632 
N054.03.46.318 E014.55.23.632 N054.03.25.197 E014.54.05.481 
N054.03.25.197 E014.54.05.481 N054.03.10.421 E014.51.59.812 
N054.03.10.421 E014.51.59.812 N054.02.49.299 E014.50.36.381 
N054.02.49.299 E014.50.36.381 N054.02.37.681 E014.48.53.940 
N054.02.37.681 E014.48.53.940 N054.02.19.719 E014.47.53.742 
N054.02.19.719 E014.47.53.742 N054.02.10.215 E014.46.41.929 
N054.02.10.215 E014.46.41.929 N054.01.55.439 E014.45.48.072 
N054.01.55.439 E014.45.48.072 N054.01.55.439 E014.45.30.116 
N054.01.55.439 E014.45.30.116 N054.01.37.476 E014.44.36.259 
N054.01.37.476 E014.44.36.259 N054.01.34.318 E014.43.54.017 
N054.01.34.318 E014.43.54.017 N054.01.22.700 E014.43.41.345 
N054.01.22.700 E014.43.41.345 N054.01.19.527 E014.44.36.259 
N054.01.19.527 E014.44.36.259 N054.01.40.648 E014.45.30.116 
N054.01.40.648 E014.45.30.116 N054.01.37.476 E014.46.17.642 
N054.01.37.476 E014.46.17.642 N054.01.46.979 E014.46.30.314 
N054.01.46.979 E014.46.30.314 N054.02.01.770 E014.47.17.837 
N054.02.01.770 E014.47.17.837 N054.02.01.770 E014.47.42.127 
N054.02.01.770 E014.47.42.127 N054.01.54.381 E014.48.08.529 
N054.01.54.381 E014.48.08.529 N054.00.57.349 E014.47.56.911 
N054.00.57.349 E014.47.56.911 N054.00.41.515 E014.47.45.293 
N054.00.41.515 E014.47.45.293 N054.00.40.457 E014.47.30.509 
N054.00.40.457 E014.47.30.509 N054.00.37.285 E014.47.06.219 
N054.00.37.285 E014.47.06.219 N054.00.40.457 E014.46.41.929 
N054.00.40.457 E014.46.41.929 N054.00.29.897 E014.46.14.474 
N054.00.29.897 E014.46.14.474 N054.00.11.948 E014.45.56.521 
N054.00.11.948 E014.45.56.521 N054.00.00.330 E014.46.02.856

;- NOAA object 85
N053.41.55.732 E014.16.10.697 N053.41.58.904 E014.18.05.806 
N053.41.58.904 E014.18.05.806 N053.42.17.910 E014.18.26.927 
N053.42.17.910 E014.18.26.927 N053.42.45.363 E014.18.20.593 
N053.42.45.363 E014.18.20.593 N053.43.07.541 E014.17.59.472 
N053.43.07.541 E014.17.59.472 N053.43.16.001 E014.16.59.274 
N053.43.16.001 E014.16.59.274 N053.43.27.605 E014.16.38.153 
N053.43.27.605 E014.16.38.153 N053.43.37.122 E014.16.47.659 
N053.43.37.122 E014.16.47.659 N053.43.31.835 E014.17.29.902 
N053.43.31.835 E014.17.29.902 N053.43.39.223 E014.18.02.637 
N053.43.39.223 E014.18.02.637 N053.44.05.631 E014.17.56.303 
N053.44.05.631 E014.17.56.303 N053.44.11.962 E014.18.08.975 
N053.44.11.962 E014.18.08.975 N053.44.26.753 E014.17.08.780 
N053.44.26.753 E014.17.08.780 N053.44.36.256 E014.17.08.780 
N053.44.36.256 E014.17.08.780 N053.44.25.695 E014.18.53.329 
N053.44.25.695 E014.18.53.329 N053.44.03.517 E014.20.08.311 
N053.44.03.517 E014.20.08.311 N053.42.50.650 E014.20.38.939 
N053.42.50.650 E014.20.38.939 N053.40.49.196 E014.24.29.164 
N053.40.49.196 E014.24.29.164 N053.40.22.801 E014.28.47.902 
N053.40.22.801 E014.28.47.902 N053.39.58.508 E014.30.24.005 
N053.39.58.508 E014.30.24.005 N053.39.28.941 E014.31.35.818 
N053.39.28.941 E014.31.35.818 N053.38.41.411 E014.32.50.800 
N053.38.41.411 E014.32.50.800 N053.37.21.156 E014.33.38.322 
N053.37.21.156 E014.33.38.322 N053.36.27.296 E014.34.26.903 
N053.36.27.296 E014.34.26.903 N053.36.07.232 E014.34.29.014 
N053.36.07.232 E014.34.29.014 N053.36.06.174 E014.35.28.155 
N053.36.06.174 E014.35.28.155 N053.36.11.448 E014.35.45.053 
N053.36.11.448 E014.35.45.053 N053.36.38.914 E014.35.32.378 
N053.36.38.914 E014.35.32.378 N053.37.17.984 E014.35.32.378 
N053.37.17.984 E014.35.32.378 N053.37.32.774 E014.35.45.053 
N053.37.32.774 E014.35.45.053 N053.37.39.105 E014.36.27.296 
N053.37.39.105 E014.36.27.296 N053.37.58.111 E014.36.29.407 
N053.37.58.111 E014.36.29.407 N053.37.53.895 E014.37.02.146 
N053.37.53.895 E014.37.02.146 N053.38.18.189 E014.36.44.194 
N053.38.18.189 E014.36.44.194 N053.38.32.965 E014.36.56.866 
N053.38.32.965 E014.36.56.866 N053.38.34.023 E014.37.11.649 
N053.38.34.023 E014.37.11.649 N053.38.39.310 E014.37.21.156 
N053.38.39.310 E014.37.21.156 N053.38.57.259 E014.37.14.818 
N053.38.57.259 E014.37.14.818 N053.39.01.475 E014.36.53.697 
N053.39.01.475 E014.36.53.697 N053.38.55.144 E014.36.24.127 
N053.38.55.144 E014.36.24.127 N053.39.19.438 E014.36.24.127 
N053.39.19.438 E014.36.24.127 N053.39.19.438 E014.35.23.932 
N053.39.19.438 E014.35.23.932 N053.39.09.934 E014.35.05.980 
N053.39.09.934 E014.35.05.980 N053.39.36.329 E014.34.08.947 
N053.39.36.329 E014.34.08.947 N053.39.51.119 E014.34.15.288 
N053.39.51.119 E014.34.15.288 N053.39.58.508 E014.33.35.154 
N053.39.58.508 E014.33.35.154 N053.40.30.190 E014.32.44.462 
N053.40.30.190 E014.32.44.462 N053.41.06.101 E014.32.50.800 
N053.41.06.101 E014.32.50.800 N053.41.41.999 E014.32.39.182 
N053.41.41.999 E014.32.39.182 N053.41.53.617 E014.32.26.510 
N053.41.53.617 E014.32.26.510 N053.42.17.910 E014.32.26.510 
N053.42.17.910 E014.32.26.510 N053.42.35.859 E014.32.50.800 
N053.42.35.859 E014.32.50.800 N053.43.18.102 E014.33.08.752 
N053.43.18.102 E014.33.08.752 N053.44.18.307 E014.33.14.032 
N053.44.18.307 E014.33.14.032 N053.44.47.874 E014.33.33.042 
N053.44.47.874 E014.33.33.042 N053.45.23.772 E014.33.31.985 
N053.45.23.772 E014.33.31.985 N053.45.20.613 E014.34.02.612 
N053.45.20.613 E014.34.02.612 N053.45.39.619 E014.33.49.940 
N053.45.39.619 E014.33.49.940 N053.45.52.295 E014.34.12.119 
N053.45.52.295 E014.34.12.119 N053.45.19.556 E014.34.48.024 
N053.45.19.556 E014.34.48.024 N053.45.26.944 E014.35.14.425 
N053.45.26.944 E014.35.14.425 N053.45.44.907 E014.35.27.101 
N053.45.44.907 E014.35.27.101 N053.45.52.295 E014.36.47.363 
N053.45.52.295 E014.36.47.363 N053.45.56.511 E014.36.56.866 
N053.45.56.511 E014.36.56.866 N053.46.23.977 E014.36.56.866 
N053.46.23.977 E014.36.56.866 N053.46.59.888 E014.36.56.866 
N053.46.59.888 E014.36.56.866 N053.47.11.506 E014.36.38.914 
N053.47.11.506 E014.36.38.914 N053.48.35.991 E014.36.44.194 
N053.48.35.991 E014.36.44.194 N053.49.18.234 E014.36.26.242 
N053.49.18.234 E014.36.26.242 N053.49.50.973 E014.37.14.818 
N053.49.50.973 E014.37.14.818 N053.50.36.374 E014.37.21.156 
N053.50.36.374 E014.37.21.156 N053.51.05.941 E014.37.44.389 
N053.51.05.941 E014.37.44.389 N053.51.27.062 E014.37.44.389 
N053.51.27.062 E014.37.44.389 N053.52.20.923 E014.38.26.631 
N053.52.20.923 E014.38.26.631 N053.52.53.662 E014.38.26.631 
N053.52.53.662 E014.38.26.631 N053.53.39.077 E014.38.56.201 
N053.53.39.077 E014.38.56.201 N053.54.01.255 E014.39.29.995 
N053.54.01.255 E014.39.29.995 N053.54.14.988 E014.40.20.686 
N053.54.14.988 E014.40.20.686 N053.54.45.612 E014.40.43.922 
N053.54.45.612 E014.40.43.922 N053.55.07.791 E014.41.17.716 
N053.55.07.791 E014.41.17.716 N053.55.05.676 E014.41.56.789 
N053.55.05.676 E014.41.56.789 N053.55.36.301 E014.41.56.789 
N053.55.36.301 E014.41.56.789 N053.56.09.040 E014.43.20.220 
N053.56.09.040 E014.43.20.220 N053.56.15.385 E014.43.14.940 
N053.56.15.385 E014.43.14.940 N053.56.20.658 E014.43.26.558 
N053.56.20.658 E014.43.26.558 N053.56.23.830 E014.43.08.605 
N053.56.23.830 E014.43.08.605 N053.56.34.391 E014.43.11.774 
N053.56.34.391 E014.43.11.774 N053.56.20.658 E014.44.38.371 
N053.56.20.658 E014.44.38.371 N053.55.44.746 E014.45.08.995 
N053.55.44.746 E014.45.08.995 N053.55.26.797 E014.45.02.661 
N053.55.26.797 E014.45.02.661 N053.55.13.065 E014.45.17.444 
N053.55.13.065 E014.45.17.444 N053.55.18.352 E014.45.32.231 
N053.55.18.352 E014.45.32.231 N053.58.21.054 E014.45.56.521 
N053.58.21.054 E014.45.56.521 N053.58.32.672 E014.47.14.668 
N053.58.32.672 E014.47.14.668 N053.58.50.621 E014.46.02.856 
N053.58.50.621 E014.46.02.856 N053.59.18.073 E014.46.02.856 
N053.59.18.073 E014.46.02.856 N053.59.24.418 E014.45.50.183 
N053.59.24.418 E014.45.50.183 N054.00.00.330 E014.46.02.856 



;- NOAA object 59
;C
N049.59.59.670 E017.58.06.752 N050.00.21.849 E017.58.32.103 
N050.00.21.849 E017.58.32.103 N050.00.50.359 E017.59.11.180 
N050.00.50.359 E017.59.11.180 N050.00.58.818 E017.59.43.912 
N050.00.58.818 E017.59.43.912 N050.00.55.646 E017.59.59.753 
N050.00.55.646 E017.59.59.753 N050.00.55.646 E017.59.59.753 
;- NOAA object 60
N050.00.55.646 E017.59.59.753 N050.00.22.906 E018.03.21.469 
N050.00.22.906 E018.03.21.469 N050.02.46.539 E018.00.16.651 
N050.02.46.539 E018.00.16.651 N050.03.23.494 E018.03.40.475 
N050.03.23.494 E018.03.40.475 N049.59.59.670 E018.06.41.063 
;- NOAA object 61
N049.59.59.670 E018.10.33.403 N050.00.23.964 E018.11.16.696 
N050.00.23.964 E018.11.16.696 N050.00.25.021 E018.12.26.404 
N050.00.25.021 E018.12.26.404 N050.00.19.734 E018.12.35.907 
N050.00.19.734 E018.12.35.907 N049.59.59.670 E018.12.50.691 


;- NOAA object 76
N053.46.01.826 E014.00.00.000 N053.46.01.798 E014.00.00.161
;- NOAA object 77
N053.51.16.515 E014.00.00.161 N053.51.16.474 E014.00.00.000
;- NOAA object 78
N053.57.39.911 E014.00.00.000 N053.57.39.869 E014.00.00.161
;- NOAA object 79
N053.51.16.515 E014.00.00.161 N053.52.23.037 E014.02.17.453 
N053.52.23.037 E014.02.17.453 N053.52.01.916 E014.03.59.890 
N053.52.01.916 E014.03.59.890 N053.52.07.203 E014.04.29.460 
N053.52.07.203 E014.04.29.460 N053.52.25.152 E014.05.18.040 
N053.52.25.152 E014.05.18.040 N053.52.16.707 E014.05.53.949 
N053.52.16.707 E014.05.53.949 N053.52.10.376 E014.06.23.519 
N053.52.10.376 E014.06.23.519 N053.52.10.376 E014.07.23.714 
N053.52.10.376 E014.07.23.714 N053.52.16.707 E014.07.59.622 
N053.52.16.707 E014.07.59.622 N053.52.10.376 E014.08.23.909 
N053.52.10.376 E014.08.23.909 N053.52.19.879 E014.10.23.248 
N053.52.19.879 E014.10.23.248 N053.52.19.879 E014.11.41.395 
N053.52.19.879 E014.11.41.395 N053.52.09.318 E014.12.08.854 
N053.52.09.318 E014.12.08.854 N053.51.58.758 E014.12.31.032 
;- NOAA object 80
N054.00.00.330 E014.43.02.264 N053.59.55.042 E014.42.53.819 
N053.59.55.042 E014.42.53.819 N053.59.55.042 E014.42.47.481 
N053.59.55.042 E014.42.47.481 N053.59.59.272 E014.42.40.089 
N053.59.59.272 E014.42.40.089 N054.00.00.330 E014.42.39.035 
;- NOAA object 81
N053.55.40.530 E014.13.53.406 N053.55.19.409 E014.15.29.509 
N053.55.19.409 E014.15.29.509 N053.55.19.409 E014.16.18.089 
N053.55.19.409 E014.16.18.089 N053.55.23.625 E014.16.57.162 
N053.55.23.625 E014.16.57.162 N053.55.03.561 E014.16.56.108 
N053.55.03.561 E014.16.56.108 N053.54.46.670 E014.16.42.375 
N053.54.46.670 E014.16.42.375 N053.54.11.816 E014.15.26.340 
N053.54.11.816 E014.15.26.340 N053.53.53.867 E014.15.14.725 
N053.53.53.867 E014.15.14.725 N053.53.32.746 E014.15.21.059 
N053.53.32.746 E014.15.21.059 N053.52.56.834 E014.16.08.582 
N053.52.56.834 E014.16.08.582 N053.52.45.216 E014.16.08.582 
N053.52.45.216 E014.16.08.582 N053.52.27.267 E014.15.50.630 
N053.52.27.267 E014.15.50.630 N053.52.24.095 E014.15.56.968 
N053.52.24.095 E014.15.56.968 N053.52.02.974 E014.15.56.968 
N053.52.02.974 E014.15.56.968 N053.52.38.885 E014.16.08.582 
N053.52.38.885 E014.16.08.582 N053.52.35.713 E014.16.26.538 
N053.52.35.713 E014.16.26.538 N053.52.20.923 E014.16.26.538 
N053.52.20.923 E014.16.26.538 N053.52.09.318 E014.16.39.210 
N053.52.09.318 E014.16.39.210 N053.51.09.113 E014.16.57.162 
N053.51.09.113 E014.16.57.162 N053.50.41.661 E014.17.15.115 
N053.50.41.661 E014.17.15.115 N053.50.18.425 E014.17.56.303 
N053.50.18.425 E014.17.56.303 N053.48.29.647 E014.20.14.652 
N053.48.29.647 E014.20.14.652 N053.48.28.589 E014.20.05.142 
N053.48.28.589 E014.20.05.142 N053.49.10.832 E014.18.53.329 
N053.49.10.832 E014.18.53.329 N053.49.19.277 E014.17.59.472 
N053.49.19.277 E014.17.59.472 N053.49.16.119 E014.17.29.902 
N053.49.16.119 E014.17.29.902 N053.49.31.953 E014.16.47.659 
N053.49.31.953 E014.16.47.659 N053.49.50.973 E014.16.08.582 
N053.49.50.973 E014.16.08.582 N053.51.09.113 E014.14.38.817 
N053.51.09.113 E014.14.38.817 N053.51.41.852 E014.13.44.957 
N053.51.41.852 E014.13.44.957 N053.51.58.758 E014.12.53.207 
N053.51.58.758 E014.12.53.207 N053.51.58.758 E014.12.31.032 
;- NOAA object 82
N053.55.40.530 E014.13.53.406 N053.54.21.319 E014.11.24.500 
N053.54.21.319 E014.11.24.500 N053.51.58.758 E014.12.31.032 
;- NOAA object 83
N054.00.00.330 E014.02.38.574 N053.59.45.539 E014.02.50.189 
N053.59.45.539 E014.02.50.189 N053.58.32.672 E014.02.51.246 
N053.58.32.672 E014.02.51.246 N053.56.56.570 E014.01.56.331 
N053.56.56.570 E014.01.56.331 N053.56.51.282 E014.02.32.236 
N053.56.51.282 E014.02.32.236 N053.56.30.161 E014.02.33.290 
N053.56.30.161 E014.02.33.290 N053.56.37.563 E014.01.29.927 
N053.56.37.563 E014.01.29.927 N053.57.02.900 E014.00.39.235 
N053.57.02.900 E014.00.39.235 N053.57.22.964 E014.00.59.302 
N053.57.22.964 E014.00.59.302 N053.57.27.194 E014.01.26.761 
N053.57.27.194 E014.01.26.761 N053.57.30.352 E014.01.02.471 
N053.57.30.352 E014.01.02.471 N053.57.35.640 E014.01.26.761 
N053.57.35.640 E014.01.26.761 N053.57.44.085 E014.01.18.312 
N053.57.44.085 E014.01.18.312 N053.57.39.869 E014.00.00.161 
;- NOAA object 84
N054.00.00.330 E014.38.50.921 N053.59.22.303 E014.35.59.837 
N053.59.22.303 E014.35.59.837 N053.58.07.321 E014.31.47.436 
N053.58.07.321 E014.31.47.436 N053.58.00.991 E014.31.17.866 
N053.58.00.991 E014.31.17.866 N053.57.58.876 E014.30.24.005 
N053.57.58.876 E014.30.24.005 N053.57.49.373 E014.29.53.381 
N053.57.49.373 E014.29.53.381 N053.56.38.607 E014.28.08.829 
N053.56.38.607 E014.28.08.829 N053.55.55.307 E014.26.42.229 
N053.55.55.307 E014.26.42.229 N053.55.13.065 E014.24.48.170 
N053.55.13.065 E014.24.48.170 N053.54.55.116 E014.23.30.023 
N053.54.55.116 E014.23.30.023 N053.54.46.670 E014.22.11.873 
N053.54.46.670 E014.22.11.873 N053.54.37.167 E014.21.29.630 
N053.54.37.167 E014.21.29.630 N053.54.35.052 E014.20.11.480 
N053.54.35.052 E014.20.11.480 N053.55.16.237 E014.17.11.946 
N053.55.16.237 E014.17.11.946 N053.55.08.849 E014.17.02.443 
N053.55.08.849 E014.17.02.443 N053.54.50.900 E014.17.02.443 
N053.54.50.900 E014.17.02.443 N053.54.11.816 E014.15.44.296 
N053.54.11.816 E014.15.44.296 N053.53.57.039 E014.15.32.677 
N053.53.57.039 E014.15.32.677 N053.53.42.249 E014.15.39.012 
N053.53.42.249 E014.15.39.012 N053.53.12.682 E014.16.50.825 
N053.53.12.682 E014.16.50.825 N053.52.51.561 E014.17.02.443 
N053.52.51.561 E014.17.02.443 N053.51.38.680 E014.17.08.780 
N053.51.38.680 E014.17.08.780 N053.51.31.292 E014.17.23.564 
N053.51.31.292 E014.17.23.564 N053.51.31.292 E014.17.41.516 
N053.51.31.292 E014.17.41.516 N053.51.41.852 E014.17.56.303 
N053.51.41.852 E014.17.56.303 N053.51.48.183 E014.17.57.357 
N053.51.48.183 E014.17.57.357 N053.52.19.879 E014.19.06.001 
N053.52.19.879 E014.19.06.001 N053.52.21.980 E014.20.06.203 
N053.52.21.980 E014.20.06.203 N053.52.28.325 E014.20.17.817 
N053.52.28.325 E014.20.17.817 N053.52.21.980 E014.20.24.155 
N053.52.21.980 E014.20.24.155 N053.52.12.477 E014.21.02.171 
N053.52.12.477 E014.21.02.171 N053.51.33.407 E014.21.26.465 
N053.51.33.407 E014.21.26.465 N053.51.22.846 E014.21.47.586 
N053.51.22.846 E014.21.47.586 N053.51.19.674 E014.22.18.210 
N053.51.19.674 E014.22.18.210 N053.51.23.904 E014.22.32.994 
N053.51.23.904 E014.22.32.994 N053.51.38.680 E014.22.38.278 
N053.51.38.680 E014.22.38.278 N053.52.02.974 E014.23.26.854 
N053.52.02.974 E014.23.26.854 N053.52.09.318 E014.23.26.854 
N053.52.09.318 E014.23.26.854 N053.52.17.764 E014.23.08.902 
N053.52.17.764 E014.23.08.902 N053.52.27.267 E014.23.08.902 
N053.52.27.267 E014.23.08.902 N053.52.31.497 E014.22.59.399 
N053.52.31.497 E014.22.59.399 N053.52.28.325 E014.22.47.781 
N053.52.28.325 E014.22.47.781 N053.52.31.497 E014.22.36.163 
N053.52.31.497 E014.22.36.163 N053.52.21.980 E014.21.59.201 
N053.52.21.980 E014.21.59.201 N053.52.30.439 E014.21.44.417 
N053.52.30.439 E014.21.44.417 N053.52.41.000 E014.21.47.586 
N053.52.41.000 E014.21.47.586 N053.52.48.388 E014.22.21.379 
N053.52.48.388 E014.22.21.379 N053.53.21.128 E014.22.32.994 
N053.53.21.128 E014.22.32.994 N053.53.34.861 E014.23.17.351 
N053.53.34.861 E014.23.17.351 N053.53.36.962 E014.24.23.884 
N053.53.36.962 E014.24.23.884 N053.53.07.395 E014.25.23.024 
N053.53.07.395 E014.25.23.024 N053.53.22.185 E014.25.42.031 
N053.53.22.185 E014.25.42.031 N053.53.12.682 E014.25.45.200 
N053.53.12.682 E014.25.45.200 N053.52.45.216 E014.25.26.190 
N053.52.45.216 E014.25.26.190 N053.52.02.974 E014.25.26.190 
N053.52.02.974 E014.25.26.190 N053.51.55.585 E014.25.29.359 
N053.51.55.585 E014.25.29.359 N053.51.43.967 E014.26.11.601 
N053.51.43.967 E014.26.11.601 N053.51.46.082 E014.27.17.080 
N053.51.46.082 E014.27.17.080 N053.51.52.413 E014.27.54.042 
N053.51.52.413 E014.27.54.042 N053.51.49.254 E014.28.41.568 
N053.51.49.254 E014.28.41.568 N053.51.19.674 E014.31.11.528 
N053.51.19.674 E014.31.11.528 N053.51.28.133 E014.31.59.051 
N053.51.28.133 E014.31.59.051 N053.50.52.222 E014.34.30.071 
N053.50.52.222 E014.34.30.071 N053.50.44.820 E014.34.44.858 
N053.50.44.820 E014.34.44.858 N053.50.05.750 E014.35.08.088 
N053.50.05.750 E014.35.08.088 N053.49.46.743 E014.34.48.024 
N053.49.46.743 E014.34.48.024 N053.49.44.628 E014.34.08.947 
N053.49.44.628 E014.34.08.947 N053.49.33.010 E014.34.20.565 
N053.49.33.010 E014.34.20.565 N053.48.57.112 E014.34.20.565 
N053.48.57.112 E014.34.20.565 N053.48.50.768 E014.34.38.517 
N053.48.50.768 E014.34.38.517 N053.48.32.819 E014.34.44.858 
N053.48.32.819 E014.34.44.858 N053.48.18.029 E014.35.02.811 
N053.48.18.029 E014.35.02.811 N053.48.13.813 E014.35.23.932 
N053.48.13.813 E014.35.23.932 N053.48.29.647 E014.35.50.333 
N053.48.29.647 E014.35.50.333 N053.48.42.322 E014.35.50.333 
N053.48.42.322 E014.35.50.333 N053.48.57.112 E014.35.27.101 
N053.48.57.112 E014.35.27.101 N053.49.36.183 E014.35.50.333 
N053.49.36.183 E014.35.50.333 N053.49.49.915 E014.36.47.363 
N053.49.49.915 E014.36.47.363 N053.50.05.750 E014.37.08.484 
N053.50.05.750 E014.37.08.484 N053.50.38.489 E014.37.14.818 
N053.50.38.489 E014.37.14.818 N053.51.05.941 E014.37.32.771 
N053.51.05.941 E014.37.32.771 N053.51.35.522 E014.37.08.484 
N053.51.35.522 E014.37.08.484 N053.52.12.477 E014.37.08.484 
N053.52.12.477 E014.37.08.484 N053.52.56.834 E014.37.57.061 
N053.52.56.834 E014.37.57.061 N053.53.57.039 E014.38.26.631 
N053.53.57.039 E014.38.26.631 N053.54.13.931 E014.38.54.090 
N053.54.13.931 E014.38.54.090 N053.54.22.376 E014.39.23.660 
N053.54.22.376 E014.39.23.660 N053.54.22.376 E014.39.41.613 
N053.54.22.376 E014.39.41.613 N053.54.32.937 E014.40.02.734 
N053.54.32.937 E014.40.02.734 N053.55.00.403 E014.40.02.734 
N053.55.00.403 E014.40.02.734 N053.55.15.179 E014.40.32.304 
N053.55.15.179 E014.40.32.304 N053.56.12.212 E014.41.45.175 
N053.56.12.212 E014.41.45.175 N053.56.30.161 E014.41.50.452 
N053.56.30.161 E014.41.50.452 N053.57.06.073 E014.41.26.165 
N053.57.06.073 E014.41.26.165 N053.57.09.231 E014.41.20.881 
N053.57.09.231 E014.41.20.881 N053.57.38.812 E014.41.50.452 
N053.57.38.812 E014.41.50.452 N053.58.03.092 E014.41.50.452 
N053.58.03.092 E014.41.50.452 N053.58.17.882 E014.42.08.407 
N053.58.17.882 E014.42.08.407 N053.59.14.915 E014.42.08.407 
N053.59.14.915 E014.42.08.407 N053.59.42.367 E014.41.44.117 
N053.59.42.367 E014.41.44.117 N054.00.00.330 E014.42.03.127 

;- NOAA object 86
N054.00.00.330 E014.06.26.688 N053.58.50.621 E014.08.26.023 
N053.58.50.621 E014.08.26.023 N053.58.17.882 E014.09.02.986 
N053.58.17.882 E014.09.02.986 N053.57.45.143 E014.10.02.126 
N053.57.45.143 E014.10.02.126 N053.57.17.691 E014.10.26.413 
N053.57.17.691 E014.10.26.413 N053.56.57.627 E014.10.57.041 
N053.56.57.627 E014.10.57.041 N053.56.04.824 E014.12.41.589 
N053.56.04.824 E014.12.41.589 N053.55.40.530 E014.13.53.406 
 
;- NOAA object 88
N053.52.17.764 E014.23.32.135 N053.52.24.095 E014.23.32.135 
N053.52.24.095 E014.23.32.135 N053.52.25.152 E014.23.35.303 
N053.52.25.152 E014.23.35.303 N053.52.25.152 E014.23.41.641 
N053.52.25.152 E014.23.41.641 N053.52.24.095 E014.23.44.807 
N053.52.24.095 E014.23.44.807 N053.52.17.764 E014.23.44.807 
N053.52.17.764 E014.23.44.807 N053.52.16.707 E014.23.41.641 
N053.52.16.707 E014.23.41.641 N053.52.16.707 E014.23.35.303 
N053.52.16.707 E014.23.35.303 N053.52.17.764 E014.23.32.135 
;- NOAA object 89
N053.45.12.167 E014.03.32.431 N053.45.15.326 E014.03.32.431 
N053.45.15.326 E014.03.32.431 N053.45.16.383 E014.03.35.600 
N053.45.16.383 E014.03.35.600 N053.45.16.383 E014.03.41.938 
N053.45.16.383 E014.03.41.938 N053.45.15.326 E014.03.45.103 
N053.45.15.326 E014.03.45.103 N053.45.12.167 E014.03.45.103 
N053.45.12.167 E014.03.45.103 N053.45.11.110 E014.03.41.938 
N053.45.11.110 E014.03.41.938 N053.45.11.110 E014.03.35.600 
N053.45.11.110 E014.03.35.600 N053.45.12.167 E014.03.32.431 
;- NOAA object 90
N053.42.12.623 E014.15.03.107 N053.42.31.643 E014.15.11.556 
N053.42.31.643 E014.15.11.556 N053.42.35.859 E014.16.14.920 
N053.42.35.859 E014.16.14.920 N053.42.17.910 E014.16.21.254 
N053.42.17.910 E014.16.21.254 N053.42.04.178 E014.15.17.891 
N053.42.04.178 E014.15.17.891 N053.42.12.623 E014.15.03.107 
;- NOAA object 91
N053.51.35.522 E014.18.02.637 N053.51.48.183 E014.18.02.637 
N053.51.48.183 E014.18.02.637 N053.51.49.254 E014.18.05.806 
N053.51.49.254 E014.18.05.806 N053.51.49.254 E014.18.30.096 
N053.51.49.254 E014.18.30.096 N053.51.48.183 E014.18.32.208 
N053.51.48.183 E014.18.32.208 N053.51.45.025 E014.18.33.265 
N053.51.45.025 E014.18.33.265 N053.51.41.852 E014.18.26.927 
N053.51.41.852 E014.18.26.927 N053.51.38.680 E014.18.26.927 
N053.51.38.680 E014.18.26.927 N053.51.34.464 E014.18.17.424 
N053.51.34.464 E014.18.17.424 N053.51.34.464 E014.18.05.806 
N053.51.34.464 E014.18.05.806 N053.51.35.522 E014.18.02.637 
;- NOAA object 92
N053.49.50.973 E014.20.50.557 N053.49.54.131 E014.20.50.557 
N053.49.54.131 E014.20.50.557 N053.49.55.189 E014.20.53.725 
N053.49.55.189 E014.20.53.725 N053.49.55.189 E014.21.00.060 
N053.49.55.189 E014.21.00.060 N053.49.54.131 E014.21.02.171 
N053.49.54.131 E014.21.02.171 N053.49.50.973 E014.21.02.171 
N053.49.50.973 E014.21.02.171 N053.49.49.915 E014.20.59.002 
N053.49.49.915 E014.20.59.002 N053.49.49.915 E014.20.53.725 
N053.49.49.915 E014.20.53.725 N053.49.50.973 E014.20.50.557 
;- NOAA object 93
N053.52.17.764 E014.23.14.182 N053.52.20.923 E014.23.15.236 
N053.52.20.923 E014.23.15.236 N053.52.21.980 E014.23.17.351 
N053.52.21.980 E014.23.17.351 N053.52.23.037 E014.23.23.685 
N053.52.23.037 E014.23.23.685 N053.52.20.923 E014.23.26.854 
N053.52.20.923 E014.23.26.854 N053.52.17.764 E014.23.26.854 
N053.52.17.764 E014.23.26.854 N053.52.16.707 E014.23.23.685 
N053.52.16.707 E014.23.23.685 N053.52.16.707 E014.23.17.351 
N053.52.16.707 E014.23.17.351 N053.52.17.764 E014.23.14.182 
;- NOAA object 94
N053.52.09.318 E014.23.44.807 N053.52.13.534 E014.23.53.256 
N053.52.13.534 E014.23.53.256 N053.52.12.477 E014.23.56.425 
N053.52.12.477 E014.23.56.425 N053.52.09.318 E014.23.56.425 
N053.52.09.318 E014.23.56.425 N053.52.07.203 E014.23.53.256 
N053.52.07.203 E014.23.53.256 N053.52.07.203 E014.23.47.975 
N053.52.07.203 E014.23.47.975 N053.52.09.318 E014.23.44.807 
;- NOAA object 95
N053.38.05.513 E014.35.32.378 N053.38.15.016 E014.35.32.378 
N053.38.15.016 E014.35.32.378 N053.38.16.074 E014.35.35.550 
N053.38.16.074 E014.35.35.550 N053.38.16.074 E014.35.48.222 
N053.38.16.074 E014.35.48.222 N053.38.15.016 E014.35.50.333 
N053.38.15.016 E014.35.50.333 N053.38.05.513 E014.35.50.333 
N053.38.05.513 E014.35.50.333 N053.38.04.456 E014.35.48.222 
N053.38.04.456 E014.35.48.222 N053.38.04.456 E014.35.35.550 
N053.38.04.456 E014.35.35.550 N053.38.05.513 E014.35.32.378 
;- NOAA object 96
N053.40.20.686 E014.31.32.649 N053.40.23.859 E014.31.32.649 
N053.40.23.859 E014.31.32.649 N053.40.24.916 E014.31.35.818 
N053.40.24.916 E014.31.35.818 N053.40.25.974 E014.32.05.388 
N053.40.25.974 E014.32.05.388 N053.40.23.859 E014.32.08.557 
N053.40.23.859 E014.32.08.557 N053.40.15.399 E014.32.08.557 
N053.40.15.399 E014.32.08.557 N053.40.10.126 E014.32.00.108 
N053.40.10.126 E014.32.00.108 N053.40.13.298 E014.31.53.770 
N053.40.13.298 E014.31.53.770 N053.40.13.298 E014.31.41.098 
N053.40.13.298 E014.31.41.098 N053.40.15.399 E014.31.38.987 
N053.40.15.399 E014.31.38.987 N053.40.17.514 E014.31.38.987 
N053.40.17.514 E014.31.38.987 N053.40.20.686 E014.31.32.649 
;- NOAA object 97
N053.56.57.627 E014.01.20.423 N053.57.05.015 E014.01.29.927 
N053.57.05.015 E014.01.29.927 N053.57.05.015 E014.01.35.210 
N053.57.05.015 E014.01.35.210 N053.56.54.455 E014.01.51.048 
N053.56.54.455 E014.01.51.048 N053.56.47.066 E014.01.41.545 
N053.56.47.066 E014.01.41.545 N053.56.51.282 E014.01.26.761 
N053.56.51.282 E014.01.26.761 N053.56.54.455 E014.01.26.761 
N053.56.54.455 E014.01.26.761 N053.56.57.627 E014.01.20.423 
;- NOAA object 98
N053.52.06.146 E014.19.14.450 N053.52.09.318 E014.19.14.450 
N053.52.09.318 E014.19.14.450 N053.52.10.376 E014.19.17.619 
N053.52.10.376 E014.19.17.619 N053.52.10.376 E014.19.23.960 
N053.52.10.376 E014.19.23.960 N053.52.09.318 E014.19.27.126 
N053.52.09.318 E014.19.27.126 N053.52.06.146 E014.19.27.126 
N053.52.06.146 E014.19.27.126 N053.52.05.089 E014.19.23.960 
N053.52.05.089 E014.19.23.960 N053.52.05.089 E014.19.17.619 
N053.52.05.089 E014.19.17.619 N053.52.06.146 E014.19.14.450 
;- NOAA object 99
N053.51.23.904 E014.22.38.278 N053.51.52.413 E014.23.23.685 
N053.51.52.413 E014.23.23.685 N053.51.55.585 E014.24.17.546 
N053.51.55.585 E014.24.17.546 N053.51.45.025 E014.24.56.619 
N053.51.45.025 E014.24.56.619 N053.51.09.113 E014.25.08.237 
N053.51.09.113 E014.25.08.237 N053.50.36.374 E014.24.51.339 
N053.50.36.374 E014.24.51.339 N053.50.04.692 E014.23.17.351 
N053.50.04.692 E014.23.17.351 N053.50.15.253 E014.23.02.564 
N053.50.15.253 E014.23.02.564 N053.50.41.661 E014.23.32.135 
N053.50.41.661 E014.23.32.135 N053.50.59.610 E014.23.33.192 
N053.50.59.610 E014.23.33.192 N053.51.20.731 E014.23.20.520 
N053.51.20.731 E014.23.20.520 N053.51.43.967 E014.24.04.874 
N053.51.43.967 E014.24.04.874 N053.51.22.846 E014.22.41.443 
N053.51.22.846 E014.22.41.443 N053.51.23.904 E014.22.38.278 
;- NOAA object 100
N053.51.12.285 E014.17.02.443 N053.51.26.018 E014.17.05.611 
N053.51.26.018 E014.17.05.611 N053.51.19.674 E014.17.11.946 
N053.51.19.674 E014.17.11.946 N053.51.31.292 E014.18.23.759 
N053.51.31.292 E014.18.23.759 N053.52.04.031 E014.18.59.667 
N053.52.04.031 E014.18.59.667 N053.51.59.801 E014.19.14.450 
N053.51.59.801 E014.19.14.450 N053.51.51.356 E014.19.02.836 
N053.51.51.356 E014.19.02.836 N053.51.46.082 E014.19.17.619 
N053.51.46.082 E014.19.17.619 N053.51.59.801 E014.19.20.788 
N053.51.59.801 E014.19.20.788 N053.52.10.376 E014.19.53.527 
N053.52.10.376 E014.19.53.527 N053.52.09.318 E014.20.20.986 
N053.52.09.318 E014.20.20.986 N053.51.45.025 E014.20.38.939 
N053.51.45.025 E014.20.38.939 N053.51.19.674 E014.21.23.296 
N053.51.19.674 E014.21.23.296 N053.51.11.228 E014.22.05.538 
N053.51.11.228 E014.22.05.538 N053.51.13.343 E014.23.12.071 
N053.51.13.343 E014.23.12.071 N053.50.30.043 E014.23.14.182 
N053.50.30.043 E014.23.14.182 N053.50.13.152 E014.22.41.443 
N053.50.13.152 E014.22.41.443 N053.50.22.655 E014.22.11.873 
N053.50.22.655 E014.22.11.873 N053.50.09.979 E014.22.05.538 
N053.50.09.979 E014.22.05.538 N053.50.13.152 E014.21.41.248 
N053.50.13.152 E014.21.41.248 N053.49.58.361 E014.20.53.725 
N053.49.58.361 E014.20.53.725 N053.49.33.010 E014.20.27.324 
N053.49.33.010 E014.20.27.324 N053.48.35.991 E014.20.44.219 
N053.48.35.991 E014.20.44.219 N053.48.28.589 E014.20.35.773 
N053.48.28.589 E014.20.35.773 N053.50.41.661 E014.17.26.733 
N053.50.41.661 E014.17.26.733 N053.51.09.113 E014.17.08.780 
N053.51.09.113 E014.17.08.780 N053.51.12.285 E014.17.02.443 
;- NOAA object 101
N053.56.41.779 E014.01.44.713 N053.56.46.009 E014.01.54.217 
N053.56.46.009 E014.01.54.217 N053.56.47.066 E014.02.05.835 
N053.56.47.066 E014.02.05.835 N053.56.44.951 E014.02.09.004 
N053.56.44.951 E014.02.09.004 N053.56.38.607 E014.02.09.004 
N053.56.38.607 E014.02.09.004 N053.56.37.563 E014.02.05.835 
N053.56.37.563 E014.02.05.835 N053.56.37.563 E014.01.54.217 
N053.56.37.563 E014.01.54.217 N053.56.41.779 E014.01.44.713 
;- NOAA object 102
N053.53.30.631 E014.15.32.677 N053.53.16.898 E014.16.18.089 
N053.53.16.898 E014.16.18.089 N053.53.00.006 E014.16.44.490 
N053.53.00.006 E014.16.44.490 N053.52.06.146 E014.17.02.443 
N053.52.06.146 E014.17.02.443 N053.51.59.801 E014.16.44.490 
N053.51.59.801 E014.16.44.490 N053.52.48.388 E014.16.26.538 
N053.52.48.388 E014.16.26.538 N053.53.27.458 E014.15.39.012 
N053.53.27.458 E014.15.39.012 N053.53.30.631 E014.15.32.677 
;- NOAA object 103
N053.39.41.616 E014.31.02.025 N053.39.54.278 E014.31.03.079 
N053.39.54.278 E014.31.03.079 N053.39.55.335 E014.31.05.194 
N053.39.55.335 E014.31.05.194 N053.39.55.335 E014.31.11.528 
N053.39.55.335 E014.31.11.528 N053.39.54.278 E014.31.14.697 
N053.39.54.278 E014.31.14.697 N053.39.51.119 E014.31.14.697 
N053.39.51.119 E014.31.14.697 N053.39.41.616 E014.31.32.649 
N053.39.41.616 E014.31.32.649 N053.39.39.501 E014.31.32.649 
N053.39.39.501 E014.31.32.649 N053.39.37.386 E014.31.29.480 
N053.39.37.386 E014.31.29.480 N053.39.37.386 E014.31.24.200 
N053.39.37.386 E014.31.24.200 N053.39.40.559 E014.31.17.866 
N053.39.40.559 E014.31.17.866 N053.39.40.559 E014.31.05.194 
N053.39.40.559 E014.31.05.194 N053.39.41.616 E014.31.02.025 
;- NOAA object 104
N053.44.18.307 E014.16.44.490 N053.44.26.753 E014.16.44.490 
N053.44.26.753 E014.16.44.490 N053.44.28.867 E014.16.47.659 
N053.44.28.867 E014.16.47.659 N053.44.28.867 E014.16.53.993 
N053.44.28.867 E014.16.53.993 N053.44.21.479 E014.17.08.780 
N053.44.21.479 E014.17.08.780 N053.44.18.307 E014.17.08.780 
N053.44.18.307 E014.17.08.780 N053.44.16.192 E014.17.05.611 
N053.44.16.192 E014.17.05.611 N053.44.16.192 E014.16.47.659 
N053.44.16.192 E014.16.47.659 N053.44.18.307 E014.16.44.490 
;- NOAA object 105
N053.45.21.671 E014.02.09.004 N053.45.22.728 E014.02.11.115 
N053.45.22.728 E014.02.11.115 N053.45.22.728 E014.02.30.125 
N053.45.22.728 E014.02.30.125 N053.45.21.671 E014.02.32.236 
N053.45.21.671 E014.02.32.236 N053.45.18.498 E014.02.33.290 
N053.45.18.498 E014.02.33.290 N053.45.16.383 E014.02.30.125 
N053.45.16.383 E014.02.30.125 N053.45.16.383 E014.02.17.453 
N053.45.16.383 E014.02.17.453 N053.45.21.671 E014.02.09.004 
;- NOAA object 106
N053.56.59.728 E014.42.14.742 N053.57.53.589 E014.42.32.697 
N053.57.53.589 E014.42.32.697 N053.58.11.551 E014.43.02.264 
N053.58.11.551 E014.43.02.264 N053.58.48.506 E014.42.44.312 
N053.58.48.506 E014.42.44.312 N053.58.52.736 E014.43.36.061 
N053.58.52.736 E014.43.36.061 N053.58.27.385 E014.45.26.951 
N053.58.27.385 E014.45.26.951 N053.57.56.761 E014.45.26.951 
N053.57.56.761 E014.45.26.951 N053.57.41.971 E014.45.44.903 
N053.57.41.971 E014.45.44.903 N053.57.27.194 E014.45.44.903 
N053.57.27.194 E014.45.44.903 N053.57.12.404 E014.45.38.565 
N053.57.12.404 E014.45.38.565 N053.57.03.958 E014.45.11.110 
N053.57.03.958 E014.45.11.110 N053.57.16.633 E014.44.47.874 
N053.57.16.633 E014.44.47.874 N053.56.47.066 E014.42.53.819 
N053.56.47.066 E014.42.53.819 N053.56.56.570 E014.42.21.083 
N053.56.56.570 E014.42.21.083 N053.56.59.728 E014.42.14.742 
;- NOAA object 107
N053.52.09.318 E014.24.09.097 N053.52.20.923 E014.24.09.097 
N053.52.20.923 E014.24.09.097 N053.52.23.037 E014.24.12.266 
N053.52.23.037 E014.24.12.266 N053.52.21.980 E014.24.17.546 
N053.52.21.980 E014.24.17.546 N053.52.17.764 E014.24.27.049 
N053.52.17.764 E014.24.27.049 N053.52.09.318 E014.24.27.049 
N053.52.09.318 E014.24.27.049 N053.52.07.203 E014.24.23.884 
N053.52.07.203 E014.24.23.884 N053.52.07.203 E014.24.11.212 
N053.52.07.203 E014.24.11.212 N053.52.09.318 E014.24.09.097 



;- NOAA object 112
N054.03.39.987 E014.00.00.000 N054.03.39.987 E014.00.00.161 
;- NOAA object 113
N054.01.45.936 E014.00.00.161 N054.01.45.936 E014.00.00.000 
;- NOAA object 114
N054.03.39.987 E014.00.00.161 N054.03.17.809 E014.01.03.525 
N054.03.17.809 E014.01.03.525 N054.02.48.242 E014.01.39.433 
N054.02.48.242 E014.01.39.433 N054.02.09.158 E014.02.44.908 
N054.02.09.158 E014.02.44.908 N054.01.59.655 E014.02.51.246 
N054.01.59.655 E014.02.51.246 N054.00.57.349 E014.04.38.967 
N054.00.57.349 E014.04.38.967 N054.00.39.400 E014.04.56.919 
N054.00.39.400 E014.04.56.919 N054.00.21.451 E014.05.39.162 
N054.00.21.451 E014.05.39.162 N054.00.16.164 E014.05.42.331 
N054.00.16.164 E014.05.42.331 N054.00.00.330 E014.06.26.688 

;- NOAA object 116
N054.00.00.330 E014.42.03.127 N054.00.01.373 E014.42.06.296 
N054.00.01.373 E014.42.06.296 N054.00.01.373 E014.42.11.573 
N054.00.01.373 E014.42.11.573 N054.00.04.546 E014.42.17.914 
N054.00.04.546 E014.42.17.914 N054.00.04.546 E014.42.29.529 
N054.00.04.546 E014.42.29.529 N054.00.00.330 E014.42.39.035 
;- NOAA object 117
N054.00.00.330 E014.38.50.921 N054.00.12.991 E014.39.05.705 
N054.00.12.991 E014.39.05.705 N054.00.37.285 E014.41.06.098 
N054.00.37.285 E014.41.06.098 N054.01.07.909 E014.42.11.573 
N054.01.07.909 E014.42.11.573 N054.01.22.700 E014.43.29.727 
N054.01.22.700 E014.43.29.727 N054.01.13.196 E014.44.23.587 
N054.01.13.196 E014.44.23.587 N054.01.37.476 E014.45.41.734 
N054.01.37.476 E014.45.41.734 N054.01.30.088 E014.45.57.575 
N054.01.30.088 E014.45.57.575 N054.00.57.349 E014.45.56.521 
N054.00.57.349 E014.45.56.521 N054.00.40.457 E014.45.30.116 
N054.00.40.457 E014.45.30.116 N054.00.30.954 E014.43.54.017 
N054.00.30.954 E014.43.54.017 N054.00.00.330 E014.43.02.264 
;- NOAA object 118
N054.00.00.330 E014.02.38.574 N054.00.08.775 E014.02.20.618 
N054.00.08.775 E014.02.20.618 N054.00.57.349 E014.02.20.618 
N054.00.57.349 E014.02.20.618 N054.01.19.527 E014.01.00.356 
N054.01.19.527 E014.01.00.356 N054.00.44.673 E014.00.44.519 
N054.00.44.673 E014.00.44.519 N054.00.43.616 E014.00.23.397 
N054.00.43.616 E014.00.23.397 N054.01.45.936 E014.00.00.161 
;- NOAA object 119
N054.59.55.207 E014.59.58.211 N055.00.00.000 E014.59.45.752 
;- NOAA object 120
N054.59.55.207 E014.59.58.211 N054.59.55.207 E014.59.59.269 
N054.59.55.207 E014.59.59.269 N054.59.55.207 E015.00.00.323 


;- NOAA object 126
N054.38.08.837 E018.28.08.420 N054.38.07.779 E018.28.11.592 
N054.38.07.779 E018.28.11.592 N054.38.07.779 E018.28.17.923 
N054.38.07.779 E018.28.17.923 N054.38.08.837 E018.28.21.096 
N054.38.08.837 E018.28.21.096 N054.38.12.009 E018.28.21.096 
N054.38.12.009 E018.28.21.096 N054.38.13.066 E018.28.17.923 
N054.38.13.066 E018.28.17.923 N054.38.08.837 E018.28.08.420 
;- NOAA object 127
N054.21.21.335 E018.57.26.789 N054.21.19.234 E018.57.29.954 
N054.21.19.234 E018.57.29.954 N054.21.19.234 E018.57.36.292 
N054.21.19.234 E018.57.36.292 N054.21.23.450 E018.57.44.738 
N054.21.23.450 E018.57.44.738 N054.21.26.623 E018.57.44.738 
N054.21.26.623 E018.57.44.738 N054.21.28.737 E018.57.41.572 
N054.21.28.737 E018.57.41.572 N054.21.28.737 E018.57.29.954 
N054.21.28.737 E018.57.29.954 N054.21.26.623 E018.57.26.789 
N054.21.26.623 E018.57.26.789 N054.21.21.335 E018.57.26.789 
;- NOAA object 128
N054.21.54.075 E018.46.33.075 N054.21.50.916 E018.46.39.413 
N054.21.50.916 E018.46.39.413 N054.21.47.744 E018.46.39.413 
N054.21.47.744 E018.46.39.413 N054.21.46.686 E018.46.41.521 
N054.21.46.686 E018.46.41.521 N054.21.46.686 E018.46.47.858 
N054.21.46.686 E018.46.47.858 N054.21.47.744 E018.46.51.031 
N054.21.47.744 E018.46.51.031 N054.21.50.916 E018.46.51.031 
N054.21.50.916 E018.46.51.031 N054.21.54.075 E018.46.44.693 
N054.21.54.075 E018.46.44.693 N054.21.57.247 E018.46.44.693 
N054.21.57.247 E018.46.44.693 N054.21.58.304 E018.46.41.521 
N054.21.58.304 E018.46.41.521 N054.21.58.304 E018.46.35.190 
N054.21.58.304 E018.46.35.190 N054.21.57.247 E018.46.33.075 
N054.21.57.247 E018.46.33.075 N054.21.54.075 E018.46.33.075 
 
 


[VOR]

CZE 114.50  N052.07.50.160 E016.43.37.560 ;CZEMPIN
DAR 114.20  N054.24.36.720 E016.23.17.160 ;DARLOWO
GRU 114.60  N053.31.18.479 E018.46.49.799 ;GRUDA (GRUDZIADZ)
JAB 116.40  N049.28.58.440 E019.40.42.959 ;JABLONKA
JED 115.60  N050.38.50.280 E020.15.04.320 ;JEDOW (JEDRZEJOW)
KMI 116.80  N054.12.04.680 E019.08.42.359 ;KMIECIN
KRN 117.80  N051.56.46.319 E020.26.40.560 ;KARNICE
KRT 113.20  N054.17.58.920 E018.12.28.799 ;KARTUZY
LAW 115.80  N052.25.20.510 E016.49.48.610 ;POZNAN
LDZ 112.40  N051.48.04.320 E019.39.22.319 ;LODZ
LIN 113.10  N051.55.58.439 E021.09.30.600 ;LININ
MRA 117.30  N053.47.05.660 E021.07.58.240 ;MRAGOWO
OKX 000.00  N050.54.10.000 E015.01.55.000 ;FRYDLANT
RUD 115.10  N052.49.49.930 E023.42.25.690 ;SKUPOWO
RZE 116.20  N050.06.28.720 E022.01.08.080 ;RZESZOW
SIE 114.70  N052.09.19.440 E022.12.02.880 ;SIEDLCE
SUI 116.70  N052.22.47.639 E014.35.08.159 ;SUBI (SLUBICE)
SUW 117.70  N054.04.05.880 E022.53.48.479 ;SUWALKI
TRZ 113.60  N051.18.29.519 E017.06.51.480 ;TREBNI (TRZEBNICA)
WAR 114.90  N052.15.33.340 E020.39.25.780 ;ZABOROWEK
OKC 113.45  N052.10.11.130 E020.57.36.190 ;OKECIE


[NDB]
BBM	390.0	N052.08.25.460 E015.47.46.220 ;BABIMOST
CHO	375.0   N053.28.31.999 E015.19.58.800 ;CHOCIWEL
GDB 383.0	N054.22.03.900 E018.30.21.200 ;LOCATOR GDANSK
GDN	322.0   N054.20.43.000 E018.35.46.000 ;GDANSK
H	255.0   N051.05.42.630 E016.54.37.000 ;WROCLAW
HG	525.0   N051.04.56.920 E016.57.05.700 ;WROCLAW
WRW	525.0   N051.04.56.920 E016.57.05.700 ;WROCLAW
WRC 255.0 	N051.05.42.600 E016.54.37.000 ;WROCLAW
KRA	379.0	N050.04.54.760 E019.48.52.580 ;LOCATOR KRAKOW
KRW	353.0   N050.05.44.520 E019.54.46.000 ;KRAKOW
OL	590.0   N053.33.17.999 E014.57.36.720 ;SZCZECIN
PT	285.0   N050.28.26.759 E019.09.01.000 ;KATOWICE
KTC	285.0   N050.28.26.759 E019.09.01.000 ;KATOWICE
RZ	474.0   N050.06.31.420 E022.08.02.550 ;RZESZOW
BDG	388.0   N053.06.11.159 E018.03.11.160 ;BYDGOSZCZ
PNO	330.0   N052.03.12.240 E021.03.45.719 ;PIASECZNO
BIA	474.0 	N050.06.31.420 E022.08.02.550 ;RZESZOW
JAS	341.5 	N050.06.33.950 E022.03.12.760 ;LOCATOR RZESZOW
AR	290.0	N052.16.40.840 E020.50.31.940 ;NDB WARSZAWA/BABICE


[FIXES]
ABAKU N051.40.37.000 E019.04.53.000
ABAPA N052.00.36.000 E021.11.40.000 ;STAR EPWA
ABERO N052.13.40.000 E023.12.32.999
ABEXA N051.36.17.000 E020.55.18.000
ABIGO N054.16.33.000 E017.57.45.000
ABSEL N051.55.36.000 E020.31.32.000 ;SID EPWA
ADADO N050.12.34.000 E017.44.53.000 ;M992
ADIKA N051.32.18.000 E021.19.46.000
ADINI N052.00.33.000 E021.15.23.000 ;STAR EPWA
ADOKI N049.56.09.000 E020.38.45.000
ADRUT N052.00.16.000 E016.34.28.000
AGALU N051.28.17.000 E017.23.08.000 ;EPWR ARRIVALS, N869
AGAVA N051.34.53.000 E019.57.39.000 ;UQ277
AGESI N052.19.53.000 E020.42.06.000 ;STAR EPWA
AGNOP N051.54.28.000 E016.37.00.000
AKAPI N051.55.12.000 E016.28.22.000
ALUKA N052.53.57.000 E014.18.24.000
AMLAS N052.09.46.000 E020.39.01.000 ;STAR EPWA
AMPAK N055.12.07.999 E017.07.15.999 
AMROR N054.53.24.152 E015.05.49.999
AMSOS N051.33.40.000 E020.41.44.000 ;STAR EPWA
AMTEK N050.00.11.998 E017.57.24.998
AMUTO N052.19.59.998 E018.56.44.998
APTAS N050.54.41.000 E017.41.45.000
ARBIR N052.12.00.000 E017.09.18.000
ARMEX N051.29.44.000 E017.07.26.000
ARPEL N054.10.57.000 E016.09.00.000
ARSAP N052.13.41.000 E014.42.45.000
ARSOG N049.59.26.000 E022.41.59.000
ASDAG N052.13.38.000 E020.42.08.000
ASLUX N052.19.14.000 E022.09.38.000
ASTEX N052.08.28.000 E021.05.14.000
ATLOK N050.12.19.000 E016.53.32.000 ;UM993
BABEN N054.23.17.000 E015.14.31.000
BABKO N049.36.42.000 E019.28.10.000
BADNO N051.45.00.000 E017.40.41.998
BADUP N052.03.33.200 E017.25.15.999
BAGAP N051.36.00.000 E019.45.42.000 ;N133
BAKOM N049.56.25.000 E019.51.58.000
BALBA N050.51.42.199 E023.01.23.998
BALOS N050.16.32.600 E019.39.29.998
BAMSO N052.20.09.000 E021.54.35.000
BANET N050.21.59.000 E018.55.45.000
BANUN N051.10.41.000 E016.25.36.000
BAPAS N052.10.42.999 E015.31.10.999
BAREP N052.16.16.000 E015.33.52.000
BAREX N050.53.40.000 E018.44.18.000
BARNA N051.48.47.000 E021.07.13.000 ;STAR EPWA
BASEK N052.10.46.000 E020.35.24.000 ;STAR EPWA
BAVIM N052.32.04.000 E017.35.45.000
BAVOK N050.00.10.000 E018.11.43.000
BAXIS N051.48.31.000 E018.51.50.000 ;STAR EPWA
BEBAL N053.15.55.000 E018.19.59.000
BEDAM N053.44.22.999 E015.11.31.999 ;EPSC ARRIVALS, Z491
BEDUN N050.31.04.000 E018.24.05.000
BEMRA N051.49.51.000 E020.57.59.000 ;STAR EPWA
BESOT N052.55.18.199 E022.56.39.998
BESTO N051.43.47.999 E017.23.56.000
BEXON N052.07.23.000 E021.09.28.000 ;STAR EPWA
BIBKA N053.11.27.999 E018.57.15.998
BIMPA N052.22.28.000 E019.46.29.000 ;STAR EPWA UP150,UP851
BINKA N053.45.34.000 E014.16.32.000
BODLA N053.16.33.000 E014.24.36.000
BOKSU N054.18.27.000 E023.03.33.000
BUDIR N051.22.29.000 E016.56.44.000
BULEP N052.46.15.999 E022.25.08.000
BUNIX N051.52.54.998 E017.21.11.599
BURAN N054.10.49.000 E017.01.47.000
DEKUT N053.06.58.000 E017.02.07.000
DELIR N053.04.50.000 E017.06.49.000
DEMIN N050.00.06.199 E021.30.39.999
DEMUR N054.04.48.000 E015.00.28.000
DENKO N052.49.01.000 E015.49.57.000
DERAM N051.50.49.000 E019.16.51.000
DESEN N050.16.12.126 E017.31.00.998
DETOR N052.01.55.000 E021.36.59.000
DEVAK N050.52.31.000 E017.30.00.000 ;STAR EPWR, L617
DEVEL N054.43.51.000 E015.44.53.000
DEXIR N054.13.27.000 E017.26.56.000
DIBED N049.53.17.998 E023.03.29.998
DIBLO N052.07.47.000 E019.20.39.000
DIMEX N051.37.50.000 E016.07.43.000
DINOV N050.55.43.000 E016.05.08.000
DINRI N052.26.02.000 E020.34.19.000 ;STAR EPWA
DINVA N052.13.47.200 E021.03.53.700 ;STAR EPWA
DIPKI N052.12.10.000 E017.27.46.000
DODAN N053.21.10.000 E015.25.37.999
DODER N051.12.13.000 E016.33.32.000
DOMAG N054.58.27.998 E017.41.08.599
DOSAL N053.23.55.000 E015.23.32.000
DOSIX N052.20.53.000 E019.13.39.000
EBOGU N053.22.44.000 E018.08.58.999
EDAXU N050.00.48.000 E022.34.08.000
EGLON N051.25.00.000 E021.59.05.000
EKRIV N052.09.01.000 E017.01.51.000
EKRON N054.35.01.000 E014.42.34.000
EKSEK N051.07.42.000 E015.36.39.000
EKVAT N049.50.26.000 E020.17.29.000
ELDEV N052.21.21.000 E016.26.15.000
ELGAD N052.29.57.000 E020.33.38.000 ;STAR EPWA
ELGEL N052.26.22.000 E020.52.51.000 ;STAR EPWA
ELKAR N053.41.54.000 E020.30.00.000
ELKIR N051.34.26.000 E020.15.14.000 ;STAR EPWA
ELNUD N052.19.52.000 E016.21.57.000
ELPOL N054.36.23.000 E015.38.02.000
ELRAB N052.03.01.000 E017.30.26.000
ELSUP N052.32.24.000 E015.24.41.000
ELTAL N052.35.58.000 E016.07.12.000
ELVOT N050.36.42.000 E016.24.33.000
EMBIK N050.12.29.000 E018.06.11.000 ;M992
EMGOV N052.01.39.000 E016.32.55.000
EMKEN N051.58.15.100 E021.19.54.500
EMPIM N052.17.22.000 E016.33.19.000
ENIMO N051.55.34.100 E021.29.17.000 ;STAR EPWA
ENOBI N053.35.34.000 E023.37.46.999
ENORU N050.20.25.000 E016.22.13.000
EREDA N051.50.54.000 E020.38.04.000 ;SID EPWA
ERGON N052.54.22.000 E014.09.24.000
ERNAP N050.26.28.000 E020.08.52.000
ERNOX N052.01.36.000 E016.01.14.000
ERTIM N052.24.04.000 E017.24.37.000
ESINI N051.40.19.000 E020.48.23.000 ;STAR EPWA
ETUBO N052.28.09.000 E022.57.45.000
EVDEX N051.56.47.000 E020.26.41.000 ;SID EPWA
EVINA N051.23.16.000 E020.21.36.000 ;(SID EPWA) UM66, UM985, UN744
EVODO N053.17.39.200 E022.55.45.199
GAGRO N051.19.50.998 E017.13.28.999
GAMRO N049.56.12.998 E020.46.23.998
GAVLO N053.52.08.000 E018.46.16.000
GERVI N052.09.19.000 E022.12.03.000 ;UM857, UM863, UM866, UP139, UP851 (STAR EPWA)
GIGAL N051.04.42.999 E016.29.30.998
GILAL N052.01.37.000 E020.32.52.000 ;SID EPWA
GILAS N052.37.54.200 E014.31.32.998
GIMKU N052.29.53.000 E020.49.45.000 ;STAR EPWA
GINOK N052.31.35.000 E016.28.44.999
GIPOS N051.41.54.000 E019.42.36.000
GIPUL N051.39.26.000 E020.57.34.000 ;STAR EPWA
GIRLU N050.33.30.000 E019.40.39.000
GITOV N054.22.06.000 E020.41.54.000 ;UN5
GIXOL N049.49.45.000 E019.21.07.000 ;Z121
GODLO N051.00.14.000 E016.30.15.000
GOGUS N051.34.48.000 E019.37.59.000
GOKAR N054.12.31.000 E018.45.39.000
GOLAD N054.20.00.000 E022.10.50.000
GOLTO N052.18.29.000 E020.51.43.000 ;STAR EPWA, VOR 15
GOMED N054.27.11.998 E019.39.29.998
GOMEX N053.44.04.000 E015.14.34.000 ;EPSC ARRIVALS
GOMOR N051.11.00.000 E017.37.02.000
GOMSA N052.17.23.000 E020.18.48.000 ;STAR EPWA
GONAL N051.47.38.000 E016.56.20.000
GONTU N053.29.44.000 E019.19.07.000
GORAT N053.10.41.599 E023.53.39.199
GORPI N054.55.00.000 E015.39.18.000
GOSAK N050.33.28.000 E020.18.16.000
GOSIT N052.14.16.000 E020.42.34.000
GOSOT N054.48.42.998 E014.51.20.600
GOTIX N050.01.18.200 E023.12.42.998
GOVEN N052.03.29.998 E014.45.20.600
GUBNU N052.05.09.000 E017.50.27.000
GUDON N050.54.35.000 E014.51.24.000
IBEKA N050.01.40.000 E018.56.30.000
IDEXU N052.41.50.000 E017.02.10.000
IDLIS N052.27.54.000 E016.32.09.000
IDMAV N052.19.05.000 E016.27.59.000
INDIG N051.59.48.000 E018.00.00.000
INLUT N052.23.09.000 E020.30.12.000 ;STAR EPWA
INPAL N052.02.57.000 E021.41.45.000 ;STAR EPWA
INRAS N052.29.56.000 E020.47.32.000 ;SID EPWA
INREN N052.15.35.000 E020.17.53.000 ;STAR EPWA
INSEX N051.37.49.000 E020.56.24.000 ;STAR EPWA
INSON N052.29.49.000 E020.57.29.000 ;SID EPWA
IPLIT N054.38.16.000 E019.21.20.000
IPLOR N052.17.18.000 E020.11.38.000 ;STAR EPWA
IPSIM N052.10.03.000 E021.28.18.000 ;STAR EPWA
IRGET N053.40.11.000 E014.36.53.000 ;EPSC ARRIVALS
IRKAP N052.08.19.000 E017.14.36.000
IVDIT N052.04.02.000 E017.20.47.000
IXIDO N052.11.46.000 E016.38.36.000
IXUSU N052.17.33.000 E016.10.21.000
KELEL N049.18.49.000 E020.10.31.000
KELOD N052.14.02.000 E015.53.00.000
KEMUM N054.29.05.000 E017.28.23.000
KODUL N052.19.51.000 E020.07.37.000
KOLOB N054.49.31.999 E014.56.00.999
KOPIS N054.25.59.000 E018.06.26.000
KORUP N051.34.59.599 E014.44.17.600
KOTEK N052.04.03.000 E020.37.01.000
KRASI N051.01.48.092 E022.01.18.998
KUBUK N050.16.13.999 E022.13.53.000
KUKAM N050.48.22.000 E020.03.38.000
KUKOP N052.08.52.000 E020.24.38.000 ;N869, N871 + U
KULEK N053.33.10.000 E020.30.00.000
KULUV N051.38.52.000 E016.20.21.199
KUMUT N051.57.15.000 E021.23.24.000 ;STAR EPWA
KUNER N055.15.30.999 E018.26.53.600
KURON N050.37.26.000 E020.08.53.000
KUSUL N051.02.47.000 E017.04.09.000 ;EPWR RW 29
KUTEV N052.12.53.000 E020.55.28.000 ;ILS 33
KUVAM N051.43.49.000 E020.56.29.000 ;STAR EPWA
LAGAR N050.47.42.989 E015.22.01.520
LAMID N052.18.39.000 E020.43.04.000
LANPA N052.18.05.000 E021.12.34.000 ;SID EPWA
LARMA N055.16.27.998 E016.30.06.998
LASGU N053.12.47.998 E019.11.52.999
LASIS N051.24.25.000 E014.57.42.000
LATAG N051.43.18.199 E015.44.48.200
LATMI N055.26.55.000 E018.10.02.000
LAVMO N052.12.58.000 E020.46.02.000 ;STAR EPWA
LEMBU N051.53.29.000 E021.21.27.000 ;STAR EPWA
LENOV N049.20.10.539 E021.00.36.928
LETKI N052.11.17.000 E023.24.16.000
LIMKO N054.02.30.000 E021.30.00.000
LIMVI N051.44.42.000 E021.41.08.000 ;STAR EPWA UN191,UN195
LITVO N052.00.29.000 E021.06.16.000 ;STAR EPWA, ILS 33
LODNI N053.44.12.998 E018.37.27.998
LOGDA N051.17.04.000 E020.41.38.000 ;STAR EPWA, UM866
LOLKA N049.13.11.999 E020.06.00.095
LOLKO N051.41.33.151 E015.56.06.737
LOLSI N052.10.39.000 E019.52.17.000 ;UZ71, SID EPWA
LUBEN N051.13.27.200 E019.57.26.999
LUGEL N052.12.25.000 E020.29.28.000 ;STAR EPWA
LUGOL N049.12.20.000 E022.44.17.000
LUKOR N050.35.12.000 E020.12.16.000
LUPUX N050.20.10.000 E019.01.18.000 ;Z126
LURAD N050.11.31.000 E018.34.28.000
LUSID N054.55.00.199 E015.17.45.999
LUXAR N049.55.48.000 E021.10.31.000 ;VOR 09 EPRZ
LUXIB N052.21.37.000 E020.38.30.000 ;STAR EPWA
MAGAN N052.51.00.000 E017.37.00.000
MAKOV N051.08.57.199 E019.06.42.998
MAKUS N052.09.10.000 E020.30.03.000 ;SID EPWA
MAMAB N052.24.47.000 E020.24.14.000 ;STAR EPWA
MAPEX N053.42.22.000 E017.00.13.000
MAPIK N050.31.34.000 E018.14.51.000
MAPIX N051.58.56.000 E021.17.33.000 ;STAR EPWA
MARUP N052.18.06.000 E020.41.37.000 ;STAR EPWA
MASIV N052.00.45.000 E017.51.24.000
MASOV N052.12.45.000 E020.55.04.000 ;EPWA VOR 33
MASUN N053.38.12.000 E015.16.36.000 ;EPSC ARRIVALS
MAVOT N051.49.48.000 E017.13.52.000
MATEM N052.05.10.000 E020.39.49.000 ;SID EPWA
MAXAM N049.58.24.999 E021.22.44.000 ;EPRZ ARRIVALS
MEBAN N049.27.18.000 E019.38.48.000
MEDUR N052.16.32.000 E020.59.03.000
MIGVI N052.24.22.000 E020.53.47.000 ;STAR EPWA
MIRVO N053.23.17.000 E015.55.15.000
MISKA N051.11.08.998 E016.56.03.998
MIXAT N051.29.18.000 E018.00.29.000
MOKOS N050.30.25.999 E019.21.21.999
MOLIL N052.35.31.999 E018.00.00.000
MOSIR N050.12.25.000 E022.46.30.000
MOTAD N055.12.34.000 E017.30.20.000
MYSKO N050.32.11.000 E019.16.46.000
NAKER N051.29.49.000 E021.34.49.000
NANOM N052.25.08.000 E020.35.23.000 ;STAR EPWA
NAPIS N052.08.18.000 E021.03.12.000
NAROX N051.12.11.000 E015.00.38.000
NASOK N053.05.30.998 E019.00.23.999
NATIX N049.55.36.200 E021.23.00.999
NAVUR N051.00.47.000 E019.54.40.000
NAXAR N049.45.38.000 E019.48.45.000
NEDNA N052.10.30.000 E021.06.46.000 ;STAR EPWA
NEGEN N051.52.19.000 E021.04.11.000 ;STAR EPWA
NEPOX N052.09.33.000 E021.59.57.000 ;STAR EPWA
NEREK N053.08.41.000 E018.28.20.000 ;EPBY ARRIVALS
NETIR N049.41.41.000 E018.42.32.000 ;Z122
NETOP N053.32.55.000 E015.30.16.000 ;EPSC ARRIVALS
NEVAP N050.47.13.000 E022.33.58.000 ;P866, UP866
NILPU N051.57.10.000 E017.10.30.000
NIDAS N051.41.45.000 E020.58.10.000
NIMIS N052.15.30.000 E020.57.45.000 ;STAR EPWA
NIPUS N051.39.11.000 E020.24.00.000 ;SID EPWA
NISKA N052.01.09.000 E020.48.48.000
NITKI N051.56.56.000 E020.34.20.000 ;SID EPWA
NOMIX N049.56.23.000 E018.55.23.000
NOSKU N051.10.07.000 E015.52.17.000
NUBLI N051.21.31.000 E019.53.16.000
NUDRO N051.09.55.000 E017.19.32.000
NUMBA N050.22.32.000 E018.06.31.000
NUTSO N051.49.58.000 E021.24.29.000 ;STAR EPWA
OBALU N050.42.38.998 E020.06.33.998
OBOKU N052.15.07.999 E018.00.00.000
OBOLA N052.11.40.000 E016.12.41.000
ODERA N050.54.16.000 E014.59.34.000
ODLOT N053.29.46.000 E017.24.14.000
ODMEK N052.09.04.000 E021.20.36.000 ;STAR EPWA
ODRAP N049.44.31.000 E021.50.28.000
ODRIM N052.09.40.000 E021.18.27.000 ;STAR EPWA
OGRES N054.00.38.000 E017.00.55.000 ;u/N195
OKENO N051.34.11.000 E018.35.38.000 ;N871, Q277, UN871, UQ277
OKLON N049.56.26.000 E019.48.49.000
OKTOR N050.35.31.000 E019.53.29.000
OLBIL N052.08.01.000 E021.04.55.000
OLDOX N052.18.32.000 E017.38.11.000
OLGER N052.30.40.000 E020.23.34.000 ;STAR EPWA
OLILA N052.42.16.000 E020.19.42.000 ;UN 191 (SID EPWA)
OLKIN N053.46.09.200 E020.30.00.000
OLOKU N052.01.01.000 E020.58.25.000 ;STAR EPWA
OLPAD N050.11.54.000 E016.33.46.000 ;UM993
OLUMA N051.53.48.000 E015.45.22.000
OMAVA N051.23.02.000 E021.41.17.599
ORSOX N050.19.11.000 E018.32.14.000
OSKEX N051.05.22.000 E017.34.11.000
OSKUD N053.43.03.000 E019.45.43.000
OSMAT N050.14.34.000 E023.02.44.000
OSTET N051.50.49.000 E020.56.34.000 ;STAR EPWA
OTMUL N051.55.51.000 E021.01.07.000 ;STAR EPWA
PADKA N049.56.01.978 E018.16.59.768
PEKOT N050.23.18.000 E017.26.36.000
PENEX N052.33.47.000 E019.16.38.000
PENOR N055.38.11.500 E017.09.46.101
PESEL N053.30.28.000 E014.19.33.000
PETEL N051.51.35.000 E020.40.21.000
PEVUM N052.18.34.000 E018.39.27.000
PIBAR N052.14.02.000 E020.23.33.000 ;STAR EPWA
PIGAT N050.16.28.000 E021.40.25.000
PISEN N052.10.03.000 E021.17.34.000 ;STAR EPWA
PIVET N054.52.27.998 E015.50.22.999
PIVIP N051.59.33.000 E020.44.50.000 ;STAR EPWA
PIXOR N053.17.19.000 E015.28.35.000
PIXUN N051.05.08.000 E016.34.32.000
POBOK N050.34.59.599 E020.13.08.000
PODAN N049.24.39.999 E021.26.12.998
POKEN N054.49.10.999 E014.33.51.199
RANOK N054.54.46.000 E018.57.29.998
RASAN N051.00.50.000 E015.05.41.000
RASUT N051.08.44.000 E016.15.33.000
REBSO N052.16.16.000 E021.01.44.000 ;STAR EPWA
REDMO N053.06.39.000 E017.32.14.000
REDSA N052.15.40.000 E020.17.35.000 ;STAR EPWA
REGLI N050.01.49.000 E017.59.44.600
REGVA N051.56.14.000 E019.26.46.000
REMDI N052.17.57.000 E020.49.01.000 ;STAR EPWA
RIKNO N052.06.19.000 E021.30.13.000 ;STAR EPWA
RILAB N050.45.55.000 E021.48.12.000
RILET N051.54.22.000 E021.38.49.000 ;STAR EPWA
RILSU N052.15.27.000 E020.43.58.000 ;STAR EPWA
RINAM N049.59.39.000 E019.21.07.000 ;Z127
RIPOT N053.28.02.000 E015.07.46.000
ROBOV N054.15.45.000 E015.03.21.000
RODAK N050.36.23.000 E020.09.46.000
ROGAL N050.59.13.000 E019.29.08.000
ROLKA N050.24.15.200 E023.49.32.599
ROLOM N054.28.22.000 E018.04.33.000
RONEX N052.55.20.999 E016.13.31.999
RONIR N052.28.38.000 E020.32.15.000 ;STAR EPWA
ROPIK N051.27.02.000 E016.10.36.000
ROPUX N052.13.31.000 E021.36.56.000 ;STAR EPWA
ROTOL N050.57.57.000 E016.17.27.000
ROVEK N053.22.44.000 E014.52.54.000
RUDKA N052.51.05.999 E023.55.18.998
RUMAR N055.02.01.000 E016.04.15.000
RUNIN N052.26.18.000 E020.46.51.000 ;STAR EPWA
RUTUK N051.35.08.000 E022.07.28.000
SABAB N050.46.13.999 E017.53.57.199
SISLU N051.57.01.000 E021.18.26.000 ;STAR EPWA
SKAVI N049.56.25.999 E019.53.59.999
SOMBO N052.00.01.000 E021.28.06.000
SOMOR N053.13.36.998 E019.21.01.999
SOMOX N051.28.05.000 E022.26.35.000 ;UM70, UN191
SONUS N050.20.21.000 E020.05.50.000
SOPAM N052.28.00.000 E020.40.43.000 ;STAR EPWA
SOPAV N049.55.51.000 E018.03.09.000
SOPEL N052.01.30.000 E020.50.48.000
SOPIK N054.18.11.000 E018.45.29.000
SORIX N052.41.43.000 E019.49.12.000 ;UL621,UN195 (STAR EPWA)
SOROT N051.56.48.000 E020.56.38.000 ;STAR EPWA
SOSIK N052.09.35.000 E016.29.42.000
SOSIN N052.07.24.000 E020.47.32.000 ;STAR EPWA
SOTET N053.49.46.999 E023.33.11.600
SOVAM N051.26.25.000 E016.42.52.000
SOXER N052.02.38.000 E019.56.06.000 ;UN869 (SID EPWA)
SUBAX N051.51.57.000 E019.07.30.000
SUBEG N052.22.51.000 E020.55.57.000 ;STAR EPWA
SUDOL N050.39.12.000 E018.24.42.000
SUPAK N049.18.13.000 E019.47.59.000
SUPID N052.13.24.000 E021.44.40.000 ;STAR EPWA
SUPUT N050.59.36.000 E017.14.24.000
SURIM N052.00.55.000 E020.31.41.000 ;SID EPWA
SUROD N054.37.25.000 E016.54.16.000
SUVEK N050.19.05.000 E022.40.30.000
TABET N052.21.31.000 E020.36.09.000 ;STAR EPWA
TADAK N053.16.57.000 E016.53.56.000
TELDU N050.14.53.599 E022.44.16.999
TENVO N052.13.54.000 E017.46.27.000
TEPNA N049.30.17.000 E022.39.22.000
TIGTU N052.08.00.000 E021.24.20.000 ;STAR EPWA
TILAV N054.24.59.000 E015.00.00.000
TINBU N052.17.32.000 E020.58.13.000 ;STAR EPWA
TIPOX N054.26.42.000 E018.11.26.000
TISTA N051.44.56.000 E021.08.50.500
TOLPA N051.18.10.000 E023.38.44.998
TOMKO N053.41.45.000 E015.50.34.000
TOMTI N050.57.11.000 E015.17.36.000
TOSLU N052.00.31.000 E021.11.58.000 ;STAR EPWA
TOSPO N052.00.59.999 E023.39.52.999
TOXAR N052.36.48.000 E022.32.20.000
TUGLU N054.07.59.000 E018.45.48.000
TUNOP N051.46.53.000 E019.35.57.000 ;SID EPLL
TUROL N053.51.31.000 E020.30.00.000
TUSIN N049.50.50.978 E018.34.22.209
TUTOM N052.06.21.000 E021.04.14.000 ;STAR EPWA
UBOMI N052.31.11.000 E015.40.17.000 ;SID EPPO
UMIRO N052.29.27.000 E016.21.16.000
UMTIX N052.03.05.000 E020.54.49.000 ;STAR EPWA
UNDES N052.13.42.000 E021.24.06.000 ;STAR EPWA
UNDUK N053.34.33.999 E017.58.35.000
UNELO N052.57.33.000 E019.29.31.000 ;L/UL621
UNRIL N052.04.46.000 E017.13.52.000
UNTIT N052.28.42.000 E016.26.29.000
UPUMO N052.08.56.000 E016.38.05.000
UREKO N050.37.46.000 E022.42.31.000
USTIL N050.49.59.998 E024.06.00.095
UTOLU N051.53.49.000 E018.52.03.000
UVITO N052.30.24.000 E016.14.29.000
UXALA N052.11.07.000 E016.17.12.000
UXOSA N052.08.30.000 E016.46.41.000
VABAT N052.32.36.000 E016.11.37.000
VABER N054.11.39.998 E023.24.24.998
VABKI N054.13.14.000 E017.53.40.000
VAGSA N051.19.59.599 E017.33.20.998
VAKAD N049.56.28.000 E019.23.03.000
VALUD N052.00.43.000 E019.33.08.000
VAPOS N054.47.43.000 E017.49.36.200
VAREN N049.53.57.998 E022.40.05.998
VAVEK N052.41.23.999 E019.12.46.000
VAVEL N050.03.59.000 E019.57.42.998
VELAB N051.28.11.000 E016.44.56.000
VELAX N050.29.20.000 E022.31.14.000 ;EPRZ ARRIVALS
VEMAL N052.27.06.000 E019.10.18.000
VENES N051.08.58.000 E021.54.38.000
VIBAT N052.05.44.000 E021.10.49.000 ;STAR EPWA, VOR 29
VIBUL N054.20.30.000 E015.16.28.000
XALUR N051.51.03.000 E019.59.43.000
XATOG N052.27.35.000 E021.19.56.000
XELBO N052.00.14.000 E021.07.24.000 ;VOR 33 EPWA
XELET N050.50.15.000 E017.07.33.000
XELOL N054.16.39.000 E014.53.42.000
XEMOL N050.00.20.000 E020.44.25.000
XEMRO N051.51.49.100 E020.49.01.900
XENOM N051.45.58.000 E020.44.55.000 ;SID EPWA
XESNA N052.25.33.000 E022.17.45.000
XETED N052.10.20.000 E016.43.53.000
XIDNA N051.42.00.000 E016.59.51.000
XIGRI N052.30.39.000 E014.36.49.000
XIMBA N051.39.21.000 E021.25.40.000 ;SID EPWA
XIMPU N052.08.00.000 E021.04.53.000 ;STAR EPWA

;LODZ
LL711 N051.47.31.000 E019.27.20.000 ;sid epll

;GDANSK
GD321 N054.27.25.000 E017.35.05.000
;WROCLAW
WR361 N051.13.22.600 E017.16.10.600
WR362 N051.07.47.300 E017.26.17.500
WR363 N051.02.27.600 E017.05.10.800
WR364 N051.02.42.500 E017.04.21.300
WR366 N051.07.20.200 E016.43.34.100
WR367 N051.06.29.000 E016.43.20.900


WA411 N052.15.19.300 E020.38.44.300
WA412 N052.16.57.700 E020.32.48.000
WA413 N052.18.35.800 E020.26.51.300
WA414 N052.20.13.600 E020.20.54.200
WA416 N052.21.51.100 E020.14.56.600
WA442 N051.53.18.600 E021.27.40.900
WA443 N052.35.25.100 E020.08.53.100
WA444 N052.27.52.900 E020.04.46.000
WA448 N052.13.57.200 E020.23.51.200
WA452 N051.59.02.200 E020.58.20.600
WA468 N052.04.04.600 E021.13.40.400
WA507 N052.14.50.900 E020.34.30.600
WA508 N052.22.43.000 E020.43.40.600
WA511 N051.54.17.400 E021.42.18.200
WA512 N052.03.47.300 E021.43.28.400
WA531 N052.03.27.500 E021.01.33.900
WA532 N052.07.22.300 E020.46.28.800
WA533 N051.58.11.500 E021.08.15.100
WA534 N051.54.40.100 E021.11.17.800
WA536 N051.51.08.500 E021.14.20.000
WA537 N051.47.36.900 E021.17.21.800
WA564 N051.44.47.800 E020.52.44.300
WA572 N052.21.38.200 E021.28.59.400
WA573 N052.09.39.900 E021.53.28.100
WA593 N051.33.17.800 E020.53.09.700
WA594 N052.09.57.300 E021.35.01.700
WA601 N052.08.45.300 E021.12.08.200
WA604 N051.59.54.400 E021.05.43.400
WA606 N052.02.13.900 E020.55.55.800
WA614 N052.20.28.900 E020.48.46.200
WA616 N052.23.59.800 E020.45.20.200
WA617 N052.27.30.600 E020.42.33.400
WA618 N052.31.01.300 E020.39.26.200
WA651 N052.05.52.200 E021.10.11.300
WA653 N052.02.08.800 E020.55.28.400
WA656 N052.01.13.200 E021.04.47.700
WA657 N052.11.14.200 E021.14.51.900
WA663 N052.36.27.700 E020.37.26.200
WA698 N052.15.12.900 E021.41.42.600
WA701 N052.09.34.900 E020.43.52.900
WA703 N052.11.33.700 E020.43.18.800
WA709 N052.13.24.700 E020.43.19.200
WA704 N052.13.17.000 E021.51.50.300
WA706 N052.16.06.100 E020.47.14.900
WA729 N052.05.08.400 E021.15.03.100
WA731 N052.03.27.800 E021.20.56.100
WA732 N052.01.46.900 E021.26.48.700
WA733 N052.00.05.400 E021.32.41.700
WA751 N052.16.08.500 E020.47.10.700
WA753 N052.10.22.300 E020.42.10.700
WA791 N052.20.48.400 E020.46.26.000
WA798 N052.20.50.000 E020.53.08.000

FAF11 N052.13.38.600 E020.44.47.300
FAF15 N052.17.06.300 E020.52.41.200
FAF29 N052.06.27.600 E021.08.41.100
FAF33 N052.01.48.100 E021.05.07.300

[AIRPORT]
EPBA    .    N049.48.17.999 E019.00.07.199 E ;Aleksandrowice 
EPBC    .    N052.16.00.000 E020.55.00.000 E ;Warszawa/Babice
EPBK    .    N053.06.05.999 E023.10.14.520 E ;Krywlany 
EPBP    .    N052.00.24.840 E023.08.56.760 E ;Biala Podlaska 
EPBY    .    N053.05.48.480 E017.58.39.719 E ;Szwederowo 
EPCH    .    N050.53.05.999 E019.12.16.919 E ;Rudniki 
EPDE    .    N051.33.05.000 E021.53.36.959 E ;Deblin Mil 
EPEL    .    N054.08.27.240 E019.25.24.240 E ;Elblag 
EPGD    .    N054.22.39.360 E018.27.58.320 E ;Rebiechowo 
EPGI    .    N053.31.27.839 E018.50.57.479 E ;Lisie Katy 
EPGL    .    N050.16.09.839 E018.40.22.999 E ;Gliwice 
EPIN    .    N052.48.22.680 E018.17.08.879 E ;Inowroclaw 
EPIW    .    N049.39.28.439 E021.49.02.639 E ;Iwonicz 
EPJG    .    N050.53.55.680 E015.47.07.800 E ;Jelenia Gora 
EPKA    .    N050.53.48.479 E020.43.53.760 E ;Maslow 
EPKK    .    N050.04.39.720 E019.47.05.280 E ;Balice Jps Intl 
EPKM    .    N050.14.17.880 E019.02.02.399 E ;Muchowiec 
EPKO    .    N054.02.32.999 E016.15.56.159 E ;Zegrze Pomorskie Mil 
EPKP    .    N050.05.22.920 E020.12.06.119 E ;Pobiednik Wielki 
EPKR    .    N049.40.59.160 E021.44.00.959 E ;Krosno 
EPKS    .    N052.19.50.520 E016.58.07.319 E ;Krzesiny 
EPKT    .    N050.28.27.120 E019.04.47.999 E ;Pyrzowice 
EPLB    .    N054.24.59.000 E017.45.55.999 E ;Cewice 
EPLE    .    N051.10.58.799 E016.10.45.840 E ;Legnica 
EPLL    .    N051.43.18.839 E019.23.53.159 E ;Lublinek 
EPLR    .    N051.13.18.480 E022.23.40.560 E ;Radawiec 
EPLS    .    N051.50.06.936 E016.31.18.479 E ;Leszno 
EPLU    .    N051.25.22.800 E016.11.46.320 E ;Lubin 
EPMB    .    N054.01.36.839 E019.08.03.119 E ;Malbork Mil 
EPML    .    N050.19.20.279 E021.27.43.559 E ;Mielec 
EPMO    .    N052.27.03.959 E020.39.02.160 E ;Modlin Mil 
EPNL    .    N049.44.43.799 E020.37.24.599 E ;Lososina Dolna 
EPNT    .    N049.27.45.360 E020.03.01.000 E ;Nowy Targ 
EPOD    .    N053.46.22.439 E020.24.53.999 E ;Dajtki 
EPOM    .    N051.42.09.206 E017.50.48.480 E ;Michalkow 
EPOP    .    N050.37.59.520 E017.46.54.120 E ;Polska Nowa Wies 
EPPI    .    N053.10.12.172 E016.42.44.999 E ;Pila 
EPPK    .    N052.26.02.000 E017.02.38.400 E ;Kobylnica 
EPPL    .    N052.33.43.919 E019.43.16.679 E ;Plock 
EPPO    .    N052.25.15.599 E016.49.34.679 E ;Lawica 
EPPR    .    N054.14.53.160 E018.40.23.880 E ;Pruszcz Gdanski Mil 
EPPT    .    N051.22.59.159 E019.41.18.240 E ;Piotrkow Trybunalski 
EPRG    .    N050.04.15.240 E018.37.42.239 E ;Gotartowice 
EPRJ    .    N050.06.19.999 E022.03.00.547 E ;Rzeszow 
EPRP    .    N051.28.44.399 E021.06.35.999 E ;Piastow 
EPRZ    .    N050.06.35.640 E022.01.08.399 E ;Jasionka 
EPSC    .    N053.35.04.919 E014.54.07.920 E ;Goleniow 
EPSD    .    N053.23.31.559 E014.38.01.680 E ;Dabie 
EPSK    .    N054.28.44.000 E017.06.27.117 E ;Redzikowo Mil 
EPSN    .    N053.47.26.159 E015.49.41.159 E ;Swidwin 
EPSO    .    N052.11.54.959 E020.17.34.999 E ;Sochaczew 
EPSU    .    N054.04.21.719 E022.53.56.760 E ;Suwalki 
EPSW    .    N051.13.55.199 E022.41.25.080 E ;Swidnik 
EPSY    .    N053.28.54.840 E020.56.15.719 E ;Szymany 
EPTO    .    N053.01.45.120 E018.32.45.239 E ;Torun 
EPWA    .    N052.09.56.520 E020.58.01.559 E ;Okecie 
EPWK    .    N052.35.04.560 E019.00.55.799 E ;Kruszyn 
EPWR    .    N051.06.09.719 E016.53.08.879 E ;Strachowice 
EPZA    .    N050.42.06.479 E023.12.15.479 E ;Mokre 
EPZG    .    N052.08.18.600 E015.47.54.960 E ;Babimost 
EPZP    .    N051.58.44.000 E015.27.49.680 E ;Przylep 
EPZR    .    N049.46.15.600 E019.13.04.799 E ;Zar 
Z24N    .    N054.12.02.519 E015.41.13.199 E ;Kolobrzeg 
Z24O    .    N052.32.03.839 E017.13.07.680 E ;Bednary 
Z24P    .    N053.45.39.959 E015.17.25.000 E ;Ploty 
Z24Q    .    N054.34.46.920 E018.31.01.919 E ;Babie Doly 
Z24S    .    N051.35.02.999 E020.05.47.399 E ;Spala Glinnik Nowy 

LKPR	.	N050.06.03.000 E014.15.36.000 E ;PRAHA RUZYNE
EDDB	.	N052.22.42.750 E013.31.14.230 E ;Berlin Schonefeld
EYVI	.	N054.38.13.470 E025.17.16.090 E ;Vilnius Tarptautinis
UKLL	.	N049.48.44.380 E023.57.16.140 E ;Lwow

[RUNWAY]
08  26  079 259 N053.05.42.847 E017.57.32.977 N053.05.54.112 E017.59.46.462 EPBY Szwederowo
11  29  109 289 N054.22.52.015 E018.27.07.208 N054.22.16.609 E018.29.30.471 EPGD Lech Walesa
07  25  075 255 N050.04.31.001 E019.46.05.002 N050.04.49.001 E019.48.10.001 EPKK Balice
09  27  087 267 N050.28.27.451 E019.03.37.991 N050.28.27.188 E019.05.38.648 EPKT Pyrzowice
09  27  090 270 N050.06.36.680 E022.00.05.558 N050.06.35.010 E022.02.11.461 EPRZ Jasionka
06  24  000 000 N052.08.01.496 E015.46.55.198 N052.08.35.703 E015.48.54.721 EPZG Babimost 
11  29  114 294 N051.06.31.781 E016.51.56.910 N051.05.56.298 E016.53.52.769 EPWR Strachowice 
13  31  130 310 N053.35.31.600 E014.53.16.333 N053.34.38.387 E014.54.59.632 EPSC Goleniow 
11  29  000 000 N052.10.17.475 E020.56.48.467 N052.09.39.164 E020.59.02.412 EPWA Chopin
15  33  000 000 N052.10.43.141 E020.57.21.602 N052.08.57.658 E020.58.53.737 EPWA Chopin
10  28  105 285 N052.25.30.226 E016.48.21.686 N052.25.05.293 E016.50.27.513 EPPO Lawica
07  25  068 248 N051.42.58.165 E019.22.19.548 N051.43.25.081 E019.24.22.654 EPLL Lublinek 

[STAR]
;EPPO by WB
-EPPO 28 N001.39.20.999 E021.25.40.001 N001.41.44.999 E020.58.09.998 
                          N052.12.00.000 e017.09.18.000 N052.11.49.920 E017.09.02.412
                          N052.11.49.920 E017.09.02.412 N052.11.37.752 E017.08.39.011
                          N052.11.37.752 E017.08.39.011 N052.11.25.836 E017.08.15.323
                          N052.11.25.836 E017.08.15.323 N052.11.14.171 E017.07.51.240
                          N052.11.14.171 E017.07.51.240 N052.11.02.760 E017.07.26.868
                          N052.11.02.760 E017.07.26.868 N052.10.51.599 E017.07.02.172
                          N052.10.51.599 E017.07.02.172 N052.10.40.727 E017.06.37.115
                          N052.10.40.727 E017.06.37.115 N052.10.30.107 E017.06.11.808
                          N052.10.30.107 E017.06.11.808 N052.10.19.775 E017.05.46.176
                          N052.10.19.775 E017.05.46.176 N052.10.09.695 E017.05.20.256
                          N052.10.09.695 E017.05.20.256 N052.09.59.904 E017.04.54.047
                          N052.09.59.904 E017.04.54.047 N052.09.50.400 E017.04.27.552
                          N052.09.50.400 E017.04.27.552 N052.09.41.148 E017.04.00.804
                          N052.09.41.148 E017.04.00.804 N052.09.32.219 E017.03.33.804
                          N052.09.32.219 E017.03.33.804 N052.09.23.543 E017.03.06.515
                          N052.09.23.543 E017.03.06.515 N052.09.15.192 E017.02.39.012
                          N052.09.15.192 E017.02.39.012 N052.09.07.128 E017.02.11.292
                          N052.09.07.128 E017.02.11.292 N052.08.59.351 E017.01.43.320
                          N052.08.59.351 E017.01.43.320 N052.08.51.863 E017.01.15.131
                          N052.08.51.863 E017.01.15.131 N052.08.44.699 E017.00.46.727
                          N052.08.44.699 E017.00.46.727 N052.08.37.823 E017.00.18.108
                          N052.08.37.823 E017.00.18.108 N052.08.31.272 E016.59.49.343
                          N052.08.31.272 E016.59.49.343 N052.08.25.007 E016.59.20.364
                          N052.08.25.007 E016.59.20.364 N052.08.19.067 E016.58.51.203
                          N052.08.19.067 E016.58.51.203 N052.08.13.415 E016.58.21.900
                          N052.08.13.415 E016.58.21.900 N052.08.08.087 E016.57.52.415
                          N052.08.08.087 E016.57.52.415 N052.08.03.083 E016.57.22.788
                          N052.08.03.083 E016.57.22.788 N052.07.58.404 E016.56.53.052
                          N052.07.58.404 E016.56.53.052 N052.07.54.011 E016.56.23.171
                          N052.07.54.011 E016.56.23.171 N052.07.49.979 E016.55.53.147
                          N052.07.49.979 E016.55.53.147 N052.07.46.236 E016.55.23.015
                          N052.07.46.236 E016.55.23.015 N052.07.42.816 E016.54.52.812
                          N052.07.42.816 E016.54.52.812 N052.07.39.719 E016.54.22.500
                          N052.07.39.719 E016.54.22.500 N052.07.36.948 E016.53.52.080
                          N052.07.36.948 E016.53.52.080 N052.07.34.499 E016.53.21.624
                          N052.07.34.499 E016.53.21.624 N052.07.32.376 E016.52.51.095
                          N052.07.32.376 E016.52.51.095 N052.07.30.576 E016.52.20.496
                          N052.07.30.576 E016.52.20.496 N052.07.29.099 E016.51.49.823
                          N052.07.29.099 E016.51.49.823 N052.07.27.983 E016.51.19.151
                          N052.07.27.983 E016.51.19.151 N052.07.27.155 E016.50.48.443
                          N052.07.27.155 E016.50.48.443 N052.07.26.652 E016.50.17.735
                          N052.07.26.652 E016.50.17.735 N052.07.26.507 E016.49.46.991
                          N052.07.26.507 E016.49.46.991 N052.07.26.652 E016.49.16.247
                          N052.07.26.652 E016.49.16.247 N052.07.27.155 E016.48.45.540
                          N052.07.27.155 E016.48.45.540 N052.07.27.983 E016.48.14.832
                          N052.07.27.983 E016.48.14.832 N052.07.29.099 E016.47.44.124
                          N052.07.29.099 E016.47.44.124 N052.07.30.576 E016.47.13.487
                          N052.07.30.576 E016.47.13.487 N052.07.32.376 E016.46.42.888
                          N052.07.32.376 E016.46.42.888 N052.07.34.499 E016.46.12.359
                          N052.07.34.499 E016.46.12.359 N052.07.36.948 E016.45.41.903
                          N052.07.36.948 E016.45.41.903 N052.07.39.719 E016.45.11.484
                          N052.07.39.719 E016.45.11.484 N052.07.42.816 E016.44.41.171
                          N052.07.42.816 E016.44.41.171 N052.07.46.236 E016.44.10.968
                          N052.07.46.236 E016.44.10.968 N052.07.50.160 E016.43.37.560
                          N052.49.01.000 E015.49.57.000 N052.32.36.000 E016.11.37.000
                          N052.32.36.000 E016.11.37.000 N052.21.21.000 E016.26.15.000
                          N052.21.21.000 E016.26.15.000 N052.11.46.000 E016.38.36.000
                          N052.11.46.000 E016.38.36.000 N052.07.50.160 E016.43.37.560
                          N052.14.02.999 E015.52.59.998 N052.11.44.000 E016.12.11.000
                          N052.11.44.000 E016.12.11.000 N052.11.07.000 E016.17.12.000
                          N052.11.07.000 E016.17.12.000 N052.07.50.160 E016.43.37.560
                          N051.55.12.000 E016.28.22.000 N052.00.16.000 E016.34.28.000
                          N052.00.16.000 E016.34.28.000 N052.07.50.160 E016.43.37.560 
                          NILPU NILPU EKRIV EKRIV
                          N052.00.45.000 E017.51.24.000 N052.04.02.000 E017.20.47.000
                          N052.04.02.000 E017.20.47.000 N052.08.19.000 E017.14.36.000
                          N052.08.19.000 E017.14.36.000 N052.12.00.000 E017.09.18.000

-EPPO 10 N001.39.20.999 E021.25.40.001 N001.41.44.999 E020.58.09.998 
                          N052.07.50.160 E016.43.37.560 N052.07.59.255 E016.42.43.307
                          N052.07.59.255 E016.42.43.307 N052.08.04.235 E016.42.13.607
                          N052.08.04.235 E016.42.13.607 N052.08.09.239 E016.41.44.016
                          N052.08.09.239 E016.41.44.016 N052.08.14.568 E016.41.14.568
                          N052.08.14.568 E016.41.14.568 N052.08.20.220 E016.40.45.299
                          N052.08.20.220 E016.40.45.299 N052.08.26.159 E016.40.16.176
                          N052.08.26.159 E016.40.16.176 N052.08.32.388 E016.39.47.231
                          N052.08.32.388 E016.39.47.231 N052.08.38.940 E016.39.18.467
                          N052.08.38.940 E016.39.18.467 N052.08.45.815 E016.38.49.920
                          N052.08.45.815 E016.38.49.920 N052.08.52.979 E016.38.21.552
                          N052.08.52.979 E016.38.21.552 N052.09.00.432 E016.37.53.399
                          N052.09.00.432 E016.37.53.399 N052.09.08.207 E016.37.25.427
                          N052.09.08.207 E016.37.25.427 N052.09.16.271 E016.36.57.744
                          N052.09.16.271 E016.36.57.744 N052.09.24.624 E016.36.30.239
                          N052.09.24.624 E016.36.30.239 N052.09.33.263 E016.36.03.024
                          N052.09.33.263 E016.36.03.024 N052.09.42.192 E016.35.36.024
                          N052.09.42.192 E016.35.36.024 N052.09.51.407 E016.35.09.312
                          N052.09.51.407 E016.35.09.312 N052.10.00.911 E016.34.42.851
                          N052.10.00.911 E016.34.42.851 N052.10.10.704 E016.34.16.680
                          N052.10.10.704 E016.34.16.680 N052.10.20.784 E016.33.50.795
                          N052.10.20.784 E016.33.50.795 N052.10.31.116 E016.33.25.199
                          N052.10.31.116 E016.33.25.199 N052.10.41.699 E016.32.59.891
                          N052.10.41.699 E016.32.59.891 N052.10.52.571 E016.32.34.871
                          N052.10.52.571 E016.32.34.871 N052.11.03.732 E016.32.10.211
                          N052.11.03.732 E016.32.10.211 N052.11.15.108 E016.31.45.839
                          N052.11.15.108 E016.31.45.839 N052.11.26.772 E016.31.21.827
                          N052.11.26.772 E016.31.21.827 N052.11.38.687 E016.30.58.139
                          N052.11.38.687 E016.30.58.139 N052.11.50.855 E016.30.34.776
                          N052.11.50.855 E016.30.34.776 N052.12.03.239 E016.30.11.772
                          N052.12.03.239 E016.30.11.772 N052.12.15.911 E016.29.49.164
                          N052.12.15.911 E016.29.49.164 N052.12.28.799 E016.29.26.880
                          N052.12.28.799 E016.29.26.880 N052.12.41.904 E016.29.04.991
                          N052.12.41.904 E016.29.04.991 N052.12.55.260 E016.28.43.463
                          N052.12.55.260 E016.28.43.463 N052.13.08.831 E016.28.22.332
                          N052.13.08.831 E016.28.22.332 N052.13.22.656 E016.28.01.596
                          N052.13.22.656 E016.28.01.596 N052.13.36.659 E016.27.41.255
                          N052.13.36.659 E016.27.41.255 N052.13.50.915 E016.27.21.311
                          N052.13.50.915 E016.27.21.311 N052.14.05.351 E016.27.01.763
                          N052.14.05.351 E016.27.01.763 N052.14.20.003 E016.26.42.648
                          N052.14.20.003 E016.26.42.648 N052.14.34.872 E016.26.23.964
                          N052.14.34.872 E016.26.23.964 N052.14.49.919 E016.26.05.712
                          N052.14.49.919 E016.26.05.712 N052.15.05.147 E016.25.47.892
                          N052.15.05.147 E016.25.47.892 N052.15.20.591 E016.25.30.503
                          N052.15.20.591 E016.25.30.503 N052.15.36.216 E016.25.13.547
                          N052.15.36.216 E016.25.13.547 N052.15.51.984 E016.24.57.059
                          N052.15.51.984 E016.24.57.059 N052.16.07.968 E016.24.41.004
                          N052.16.07.968 E016.24.41.004 N052.16.24.095 E016.24.25.416
                          N052.16.24.095 E016.24.25.416 N052.16.40.403 E016.24.10.296
                          N052.16.40.403 E016.24.10.296 N052.16.56.856 E016.23.55.644
                          N052.16.56.856 E016.23.55.644 N052.17.13.451 E016.23.41.460
                          N052.17.13.451 E016.23.41.460 N052.17.30.228 E016.23.27.779
                          N052.17.30.228 E016.23.27.779 N052.17.47.111 E016.23.14.568
                          N052.17.47.111 E016.23.14.568 N052.18.04.139 E016.23.01.823
                          N052.18.04.139 E016.23.01.823 N052.18.21.312 E016.22.49.584
                          N052.18.21.312 E016.22.49.584 N052.18.38.627 E016.22.37.847
                          N052.18.38.627 E016.22.37.847 N052.18.56.052 E016.22.26.580
                          N052.18.56.052 E016.22.26.580 N052.19.13.583 E016.22.15.815
                          N052.19.13.583 E016.22.15.815 N052.19.31.223 E016.22.05.592
                          N052.19.31.223 E016.22.05.592 N052.19.48.971 E016.21.55.836
                          N052.19.48.971 E016.21.55.836 N052.20.06.828 E016.21.46.620
                          N052.20.06.828 E016.21.46.620 N052.20.24.792 E016.21.37.872
                          N052.20.24.792 E016.21.37.872 N052.20.42.828 E016.21.29.663
                          N052.20.42.828 E016.21.29.663 N052.21.00.972 E016.21.21.996
                          N052.21.00.972 E016.21.21.996 N052.21.19.188 E016.21.14.832
                          N052.21.19.188 E016.21.14.832 N052.21.37.439 E016.21.08.172
                          N052.21.37.439 E016.21.08.172 N052.21.55.799 E016.21.02.052
                          N052.21.55.799 E016.21.02.052 N052.22.14.195 E016.20.56.471
                          N052.22.14.195 E016.20.56.471 N052.22.32.664 E016.20.51.395
                          N052.22.32.664 E016.20.51.395 N052.22.51.204 E016.20.46.860
                          N052.22.51.204 E016.20.46.860 N052.23.09.744 E016.20.42.864
                          N052.23.09.744 E016.20.42.864 N052.23.28.356 E016.20.39.372
                          N052.23.28.356 E016.20.39.372 N052.23.47.003 E016.20.36.420
                          N052.23.47.003 E016.20.36.420 N052.24.05.651 E016.20.34.008
                          N052.24.05.651 E016.20.34.008 N052.24.24.335 E016.20.32.135
                          N052.24.24.335 E016.20.32.135 N052.24.43.056 E016.20.30.803
                          N052.24.43.056 E016.20.30.803 N052.25.01.776 E016.20.30.012
                          N052.25.01.776 E016.20.30.012 N052.25.20.495 E016.20.29.724
                          N052.25.20.495 E016.20.29.724 N052.25.39.215 E016.20.30.012
                          N052.25.39.215 E016.20.30.012 N052.25.57.936 E016.20.30.803
                          N052.25.57.936 E016.20.30.803 N052.26.16.655 E016.20.32.135
                          N052.26.16.655 E016.20.32.135 N052.26.35.340 E016.20.34.008
                          N052.26.35.340 E016.20.34.008 N052.26.53.987 E016.20.36.420
                          N052.26.53.987 E016.20.36.420 N052.27.12.636 E016.20.39.372
                          N052.27.12.636 E016.20.39.372 N052.27.31.248 E016.20.42.864
                          N052.27.31.248 E016.20.42.864 N052.27.49.788 E016.20.46.860
                          N052.27.49.788 E016.20.46.860 N052.28.08.328 E016.20.51.395
                          N052.28.08.328 E016.20.51.395 N052.28.26.796 E016.20.56.471
                          N052.28.26.796 E016.20.56.471 N052.28.45.191 E016.21.02.052
                          N052.28.45.191 E016.21.02.052 N052.29.03.551 E016.21.08.172
                          N052.29.03.551 E016.21.08.172 N052.29.27.000 E016.21.16.000
                          N052.49.01.000 E015.49.57.000 N052.35.58.000 E016.07.12.000
                          N052.35.58.000 E016.07.12.000 N052.32.36.000 E016.11.37.000
                          N052.32.36.000 E016.11.37.000 N052.30.24.000 E016.14.29.000
                          N052.30.24.000 E016.14.29.000 N052.29.27.000 E016.21.16.000
                          N052.29.27.000 E016.21.16.000 N052.28.42.000 E016.26.29.000
                          N052.28.42.000 E016.26.29.000 N052.27.54.000 E016.32.09.000
                          N052.14.02.000 E015.53.00.000 N052.17.33.000 E016.10.21.000
                          N052.17.33.000 E016.10.21.000 N052.19.52.000 E016.21.57.000
                          N051.55.12.000 E016.28.22.000 N052.01.39.000 E016.32.55.000
                          N052.01.39.000 E016.32.55.000 N052.08.56.000 E016.38.05.000
                          NILPU NILPU GUBNU GUBNU
                          GUBNU GUBNU CZE CZE
                          N052.00.45.000 E017.51.24.000 N052.03.01.000 E017.30.26.000
                          N052.03.01.000 E017.30.26.000 N052.04.46.000 E017.13.52.000
                          N052.04.46.000 E017.13.52.000 N052.07.50.160 E016.43.37.560 


-EPWR 29/11 WHISKEY VELAB VELAB BUDIR BUDIR
            BUDIR BUDIR TRZ TRZ
			TRZ TRZ WRC WRC
            ROTOL ROTOL PIXUN PIXUN
            PIXUN PIXUN WRC WRC
            DEVAK DEVAK WRC WRC
            AGALU AGALU TRZ TRZ

-EPWR 29 VICTOR VELAB VELAB BUDIR BUDIR
		BUDIR BUDIR TRZ TRZ
            TRZ TRZ WRW WRW
            AGALU AGALU TRZ TRZ
            ROTOL ROTOL PIXUN PIXUN
            PIXUN PIXUN WRW WRW
            DEVAK DEVAK WRW WRW

-EPKK 25/07	POBOK POBOK ERNAP ERNAP
			ERNAP ERNAP SONUS SONUS
			SONUS SONUS KRA KRA
			SONUS SONUS KRW KRW

			JAB JAB NAXAR NAXAR
			NAXAR NAXAR BAKOM BAKOM
			BAKOM BAKOM KRW KRW

			NAXAR NAXAR OKLON OKLON
			OKLON OKLON KRA KRA


-EPGD 11		VAPOS VAPOS ROLOM ROLOM
			DEXIR DEXIR ABIGO ABIGO
			LODNI LODNI KRT KRT
			KMI KMI KRT KRT
			
;DEXIR
N054.16.34.932 E017.25.57.863 N054.16.36.408 E017.26.26.231  ;
N054.16.36.408 E017.26.26.231 N054.16.34.932 E017.26.54.599  ;
N054.16.34.932 E017.26.54.599 N054.16.30.647 E017.27.22.140  ;
N054.16.30.647 E017.27.22.140 N054.16.23.592 E017.27.47.951  ;
N054.16.23.592 E017.27.47.951 N054.16.14.051 E017.28.11.279  ;
N054.16.14.051 E017.28.11.279 N054.16.02.279 E017.28.31.440  ;
N054.16.02.279 E017.28.31.440 N054.15.48.635 E017.28.47.783  ;
N054.15.48.635 E017.28.47.783 N054.15.33.552 E017.28.59.808  ;
N054.15.33.552 E017.28.59.808 N054.15.17.496 E017.29.07.188  ;
N054.15.17.496 E017.29.07.188 N054.15.00.900 E017.29.09.671  ;
N054.15.00.900 E017.29.09.671 N054.14.44.304 E017.29.07.188  ;
N054.14.44.304 E017.29.07.188 N054.14.28.247 E017.28.59.808  ;
N054.14.28.247 E017.28.59.808 N054.14.13.163 E017.28.47.783  ;
N054.14.13.163 E017.28.47.783 N054.13.59.519 E017.28.31.440  ;
N054.13.59.519 E017.28.31.440 N054.13.47.748 E017.28.11.279  ;
N054.13.47.748 E017.28.11.279 N054.13.38.208 E017.27.47.951  ;
N054.13.38.208 E017.27.47.951 N054.13.31.152 E017.27.22.140  ;
N054.12.32.472 E017.18.32.507 N054.12.30.743 E017.18.04.175  ;
N054.12.30.743 E017.18.04.175 N054.12.31.896 E017.17.35.771  ;
N054.12.31.896 E017.17.35.771 N054.12.35.928 E017.17.08.123  ;
N054.12.35.928 E017.17.08.123 N054.12.42.696 E017.16.42.131  ;
N054.12.42.696 E017.16.42.131 N054.12.52.019 E017.16.18.515  ;
N054.12.52.019 E017.16.18.515 N054.13.03.576 E017.15.58.032  ;
N054.13.03.576 E017.15.58.032 N054.13.17.040 E017.15.41.291  ;
N054.13.17.040 E017.15.41.291 N054.13.31.979 E017.15.28.799  ;
N054.13.31.979 E017.15.28.799 N054.13.47.999 E017.15.20.951  ;
N054.13.47.999 E017.15.20.951 N054.14.04.560 E017.15.17.963  ;
N054.14.04.560 E017.15.17.963 N054.14.21.155 E017.15.19.943  ;
N054.14.21.155 E017.15.19.943 N054.14.37.319 E017.15.26.855  ;
N054.14.37.319 E017.15.26.855 N054.14.52.512 E017.15.38.448  ;
N054.14.52.512 E017.15.38.448 N054.15.06.300 E017.15.54.360  ;
N054.15.06.300 E017.15.54.360 N054.15.18.287 E017.16.14.123  ;
N054.15.18.287 E017.16.14.123 N054.15.28.080 E017.16.37.200  ;
N054.15.28.080 E017.16.37.200 N054.15.35.351 E017.17.02.795  ;
N054.15.35.351 E017.17.02.795 N054.15.39.959 E017.17.30.155  ;
N054.16.34.788 E017.25.56.459 N054.15.40.103 E017.17.31.560  ;Connecting line
N054.12.32.327 E017.18.31.104 N054.13.27.012 E017.26.56.003  ;Connecting line

;VAPOS
N054.49.02.963 E017.54.36.900 N054.48.47.340 E017.54.46.800  ;
N054.48.47.340 E017.54.46.800 N054.48.30.924 E017.54.51.804  ;
N054.48.30.924 E017.54.51.804 N054.48.14.291 E017.54.51.804  ;
N054.48.14.291 E017.54.51.804 N054.47.57.876 E017.54.46.800  ;
N054.47.57.876 E017.54.46.800 N054.47.42.252 E017.54.36.900  ;
N054.47.42.252 E017.54.36.900 N054.47.27.851 E017.54.22.464  ;
N054.47.27.851 E017.54.22.464 N054.47.15.072 E017.54.03.888  ;
N054.47.15.072 E017.54.03.888 N054.47.04.380 E017.53.41.783  ;
N054.47.04.380 E017.53.41.783 N054.46.56.064 E017.53.16.763  ;
N054.46.56.064 E017.53.16.763 N054.46.50.375 E017.52.49.619  ;
N054.46.50.375 E017.52.49.619 N054.46.47.495 E017.52.21.180  ;
N054.46.47.495 E017.52.21.180 N054.46.47.495 E017.51.52.307  ;
N054.46.47.495 E017.51.52.307 N054.46.50.375 E017.51.23.867  ;
N054.46.50.375 E017.51.23.867 N054.46.56.064 E017.50.56.724  ;
N054.46.56.064 E017.50.56.724 N054.47.04.380 E017.50.31.704  ;
N054.47.04.380 E017.50.31.704 N054.47.15.072 E017.50.09.599  ;
N054.47.15.072 E017.50.09.599 N054.47.27.851 E017.49.51.023  ;
N054.47.27.851 E017.49.51.023 N054.47.42.252 E017.49.36.588  ;
N054.52.15.239 E017.46.00.444 N054.52.30.863 E017.45.50.544  ;
N054.52.30.863 E017.45.50.544 N054.52.47.280 E017.45.45.504  ;
N054.52.47.280 E017.45.45.504 N054.53.03.911 E017.45.45.504  ;
N054.53.03.911 E017.45.45.504 N054.53.20.327 E017.45.50.544  ;
N054.53.20.327 E017.45.50.544 N054.53.35.952 E017.46.00.444  ;
N054.53.35.952 E017.46.00.444 N054.53.50.352 E017.46.14.916  ;
N054.53.50.352 E017.46.14.916 N054.54.03.131 E017.46.33.492  ;
N054.54.03.131 E017.46.33.492 N054.54.13.824 E017.46.55.667  ;
N054.54.13.824 E017.46.55.667 N054.54.22.139 E017.47.20.724  ;
N054.54.22.139 E017.47.20.724 N054.54.27.828 E017.47.47.939  ;
N054.54.27.828 E017.47.47.939 N054.54.30.707 E017.48.16.415  ;
N054.54.30.707 E017.48.16.415 N054.54.30.707 E017.48.45.359  ;
N054.54.30.707 E017.48.45.359 N054.54.27.828 E017.49.13.835  ;
N054.54.27.828 E017.49.13.835 N054.54.22.139 E017.49.41.052  ;
N054.54.22.139 E017.49.41.052 N054.54.13.824 E017.50.06.107  ;
N054.54.13.824 E017.50.06.107 N054.54.03.131 E017.50.28.284  ;
N054.54.03.131 E017.50.28.284 N054.53.50.352 E017.50.46.860  ;
N054.53.50.352 E017.50.46.860 N054.53.35.952 E017.51.01.332  ;
N054.49.02.207 E017.54.37.511 N054.53.35.196 E017.51.01.943  ;Connecting line
N054.52.15.996 E017.45.59.831 N054.47.43.007 E017.49.35.976  ;Connecting line

;KRT
N054.17.58.235 E018.12.29.304 N054.18.13.967 E018.12.20.015  ;
N054.18.13.967 E018.12.20.015 N054.18.30.420 E018.12.15.551  ;
N054.18.30.420 E018.12.15.551 N054.18.47.052 E018.12.16.056  ;
N054.18.47.052 E018.12.16.056 N054.19.03.396 E018.12.21.492  ;
N054.19.03.396 E018.12.21.492 N054.19.18.948 E018.12.31.715  ;
N054.19.18.948 E018.12.31.715 N054.19.33.204 E018.12.46.440  ;
N054.19.33.204 E018.12.46.440 N054.19.45.768 E018.13.05.159  ;
N054.19.45.768 E018.13.05.159 N054.19.56.244 E018.13.27.300  ;
N054.19.56.244 E018.13.27.300 N054.20.04.308 E018.13.52.284  ;
N054.20.04.308 E018.13.52.284 N054.20.09.743 E018.14.19.247  ;
N054.20.09.743 E018.14.19.247 N054.20.12.335 E018.14.47.436  ;
N054.20.12.335 E018.14.47.436 N054.20.12.048 E018.15.15.947  ;
N054.20.12.048 E018.15.15.947 N054.20.08.879 E018.15.43.955  ;
N054.20.08.879 E018.15.43.955 N054.20.02.903 E018.16.10.596  ;
N054.20.02.903 E018.16.10.596 N054.19.54.336 E018.16.35.075  ;
N054.19.54.336 E018.16.35.075 N054.19.43.428 E018.16.56.603  ;
N054.19.43.428 E018.16.56.603 N054.19.30.468 E018.17.14.531  ;
N054.19.30.468 E018.17.14.531 N054.19.15.923 E018.17.28.391  ;
N054.14.40.811 E018.20.53.159 N054.14.25.079 E018.21.02.448  ;
N054.14.25.079 E018.21.02.448 N054.14.08.627 E018.21.06.876  ;
N054.14.08.627 E018.21.06.876 N054.13.51.996 E018.21.06.408  ;
N054.13.51.996 E018.21.06.408 N054.13.35.652 E018.21.00.971  ;
N054.13.35.652 E018.21.00.971 N054.13.20.100 E018.20.50.747  ;
N054.13.20.100 E018.20.50.747 N054.13.05.844 E018.20.36.096  ;
N054.13.05.844 E018.20.36.096 N054.12.53.279 E018.20.17.412  ;
N054.12.53.279 E018.20.17.412 N054.12.42.803 E018.19.55.271  ;
N054.12.42.803 E018.19.55.271 N054.12.34.740 E018.19.30.359  ;
N054.12.34.740 E018.19.30.359 N054.12.29.304 E018.19.03.432  ;
N054.12.29.304 E018.19.03.432 N054.12.26.711 E018.18.35.315  ;
N054.12.26.711 E018.18.35.315 N054.12.27.000 E018.18.06.839  ;
N054.12.27.000 E018.18.06.839 N054.12.30.167 E018.17.38.867  ;
N054.12.30.167 E018.17.38.867 N054.12.36.143 E018.17.12.264  ;
N054.12.36.143 E018.17.12.264 N054.12.44.712 E018.16.47.855  ;
N054.12.44.712 E018.16.47.855 N054.12.55.619 E018.16.26.364  ;
N054.12.55.619 E018.16.26.364 N054.13.08.580 E018.16.08.472  ;
N054.13.08.580 E018.16.08.472 N054.13.23.123 E018.15.54.648  ;
N054.17.58.992 E018.12.28.727 N054.13.23.880 E018.15.54.071  ;Connecting line
N054.14.40.055 E018.20.53.735 N054.19.15.168 E018.17.28.968  ;Connecting line

-EPGD 29 PAPA	VAPOS VAPOS GDN GDN
			DEXIR DEXIR VABKI VABKI
			VABKI VABKI GOKAR GOKAR
			GOKAR GOKAR SOPIK SOPIK
			SOPIK SOPIK GDN GDN
			LODNI LODNI GAVLO GAVLO
			GAVLO GAVLO TUGLU TUGLU
			TUGLU TUGLU GOKAR GOKAR
			KMI KMI SOPIK SOPIK

;VAPOS
N054.49.02.963 E017.54.36.900 N054.48.47.340 E017.54.46.800  ;
N054.48.47.340 E017.54.46.800 N054.48.30.924 E017.54.51.804  ;
N054.48.30.924 E017.54.51.804 N054.48.14.291 E017.54.51.804  ;
N054.48.14.291 E017.54.51.804 N054.47.57.876 E017.54.46.800  ;
N054.47.57.876 E017.54.46.800 N054.47.42.252 E017.54.36.900  ;
N054.47.42.252 E017.54.36.900 N054.47.27.851 E017.54.22.464  ;
N054.47.27.851 E017.54.22.464 N054.47.15.072 E017.54.03.888  ;
N054.47.15.072 E017.54.03.888 N054.47.04.380 E017.53.41.783  ;
N054.47.04.380 E017.53.41.783 N054.46.56.064 E017.53.16.763  ;
N054.46.56.064 E017.53.16.763 N054.46.50.375 E017.52.49.619  ;
N054.46.50.375 E017.52.49.619 N054.46.47.495 E017.52.21.180  ;
N054.46.47.495 E017.52.21.180 N054.46.47.495 E017.51.52.307  ;
N054.46.47.495 E017.51.52.307 N054.46.50.375 E017.51.23.867  ;
N054.46.50.375 E017.51.23.867 N054.46.56.064 E017.50.56.724  ;
N054.46.56.064 E017.50.56.724 N054.47.04.380 E017.50.31.704  ;
N054.47.04.380 E017.50.31.704 N054.47.15.072 E017.50.09.599  ;
N054.47.15.072 E017.50.09.599 N054.47.27.851 E017.49.51.023  ;
N054.47.27.851 E017.49.51.023 N054.47.42.252 E017.49.36.588  ;
N054.52.15.239 E017.46.00.444 N054.52.30.863 E017.45.50.544  ;
N054.52.30.863 E017.45.50.544 N054.52.47.280 E017.45.45.504  ;
N054.52.47.280 E017.45.45.504 N054.53.03.911 E017.45.45.504  ;
N054.53.03.911 E017.45.45.504 N054.53.20.327 E017.45.50.544  ;
N054.53.20.327 E017.45.50.544 N054.53.35.952 E017.46.00.444  ;
N054.53.35.952 E017.46.00.444 N054.53.50.352 E017.46.14.916  ;
N054.53.50.352 E017.46.14.916 N054.54.03.131 E017.46.33.492  ;
N054.54.03.131 E017.46.33.492 N054.54.13.824 E017.46.55.667  ;
N054.54.13.824 E017.46.55.667 N054.54.22.139 E017.47.20.724  ;
N054.54.22.139 E017.47.20.724 N054.54.27.828 E017.47.47.939  ;
N054.54.27.828 E017.47.47.939 N054.54.30.707 E017.48.16.415  ;
N054.54.30.707 E017.48.16.415 N054.54.30.707 E017.48.45.359  ;
N054.54.30.707 E017.48.45.359 N054.54.27.828 E017.49.13.835  ;
N054.54.27.828 E017.49.13.835 N054.54.22.139 E017.49.41.052  ;
N054.54.22.139 E017.49.41.052 N054.54.13.824 E017.50.06.107  ;
N054.54.13.824 E017.50.06.107 N054.54.03.131 E017.50.28.284  ;
N054.54.03.131 E017.50.28.284 N054.53.50.352 E017.50.46.860  ;
N054.53.50.352 E017.50.46.860 N054.53.35.952 E017.51.01.332  ;
N054.49.02.207 E017.54.37.511 N054.53.35.196 E017.51.01.943  ;Connecting line
N054.52.15.996 E017.45.59.831 N054.47.43.007 E017.49.35.976  ;Connecting line

;VABKI
N054.13.14.052 E017.53.38.544 N054.13.12.575 E017.54.06.876  ;
N054.13.12.575 E017.54.06.876 N054.13.08.291 E017.54.34.379  ;
N054.13.08.291 E017.54.34.379 N054.13.01.236 E017.55.00.155  ;
N054.13.01.236 E017.55.00.155 N054.12.51.695 E017.55.23.447  ;
N054.12.51.695 E017.55.23.447 N054.12.39.923 E017.55.43.572  ;
N054.12.39.923 E017.55.43.572 N054.12.26.279 E017.55.59.915  ;
N054.12.26.279 E017.55.59.915 N054.12.11.196 E017.56.11.940  ;
N054.12.11.196 E017.56.11.940 N054.11.55.140 E017.56.19.284  ;
N054.11.55.140 E017.56.19.284 N054.11.38.544 E017.56.21.767  ;
N054.11.38.544 E017.56.21.767 N054.11.21.948 E017.56.19.284  ;
N054.11.21.948 E017.56.19.284 N054.11.05.891 E017.56.11.940  ;
N054.11.05.891 E017.56.11.940 N054.10.50.807 E017.55.59.915  ;
N054.10.50.807 E017.55.59.915 N054.10.37.164 E017.55.43.572  ;
N054.10.37.164 E017.55.43.572 N054.10.25.392 E017.55.23.447  ;
N054.10.25.392 E017.55.23.447 N054.10.15.852 E017.55.00.155  ;
N054.10.15.852 E017.55.00.155 N054.10.08.796 E017.54.34.379  ;
N054.10.08.796 E017.54.34.379 N054.10.04.512 E017.54.06.876  ;
N054.10.04.512 E017.54.06.876 N054.10.03.036 E017.53.38.544  ;
N054.10.05.663 E017.45.05.795 N054.10.07.139 E017.44.37.463  ;
N054.10.07.139 E017.44.37.463 N054.10.11.424 E017.44.09.960  ;
N054.10.11.424 E017.44.09.960 N054.10.18.479 E017.43.44.184  ;
N054.10.18.479 E017.43.44.184 N054.10.28.020 E017.43.20.892  ;
N054.10.28.020 E017.43.20.892 N054.10.39.792 E017.43.00.767  ;
N054.10.39.792 E017.43.00.767 N054.10.53.436 E017.42.44.424  ;
N054.10.53.436 E017.42.44.424 N054.11.08.519 E017.42.32.399  ;
N054.11.08.519 E017.42.32.399 N054.11.24.575 E017.42.25.055  ;
N054.11.24.575 E017.42.25.055 N054.11.41.171 E017.42.22.571  ;
N054.11.41.171 E017.42.22.571 N054.11.57.767 E017.42.25.055  ;
N054.11.57.767 E017.42.25.055 N054.12.13.823 E017.42.32.399  ;
N054.12.13.823 E017.42.32.399 N054.12.28.908 E017.42.44.424  ;
N054.12.28.908 E017.42.44.424 N054.12.42.552 E017.43.00.767  ;
N054.12.42.552 E017.43.00.767 N054.12.54.323 E017.43.20.892  ;
N054.12.54.323 E017.43.20.892 N054.13.03.863 E017.43.44.184  ;
N054.13.03.863 E017.43.44.184 N054.13.10.920 E017.44.09.960  ;
N054.13.10.920 E017.44.09.960 N054.13.15.203 E017.44.37.463  ;
N054.13.15.203 E017.44.37.463 N054.13.16.679 E017.45.05.795  ;
N054.13.14.015 E017.53.39.983 N054.13.16.644 E017.45.07.235  ;Connecting line
N054.10.05.700 E017.45.04.356 N054.10.03.072 E017.53.37.104  ;Connecting line

;GDA
N054.17.47.076 E018.33.36.540 N054.17.54.888 E018.33.11.339  ;
N054.17.54.888 E018.33.11.339 N054.18.05.148 E018.32.48.840  ;
N054.18.05.148 E018.32.48.840 N054.18.17.532 E018.32.29.759  ;
N054.18.17.532 E018.32.29.759 N054.18.31.644 E018.32.14.640  ;
N054.18.31.644 E018.32.14.640 N054.18.47.052 E018.32.03.948  ;
N054.18.47.052 E018.32.03.948 N054.19.03.359 E018.31.58.007  ;
N054.19.03.359 E018.31.58.007 N054.19.19.992 E018.31.56.999  ;
N054.19.19.992 E018.31.56.999 N054.19.36.479 E018.32.00.995  ;
N054.19.36.479 E018.32.00.995 N054.19.52.283 E018.32.09.815  ;
N054.19.52.283 E018.32.09.815 N054.20.07.007 E018.32.23.208  ;
N054.20.07.007 E018.32.23.208 N054.20.20.112 E018.32.40.776  ;
N054.20.20.112 E018.32.40.776 N054.20.31.236 E018.33.01.980  ;
N054.20.31.236 E018.33.01.980 N054.20.40.055 E018.33.26.171  ;
N054.20.40.055 E018.33.26.171 N054.20.46.320 E018.33.52.632  ;
N054.20.46.320 E018.33.52.632 N054.20.49.776 E018.34.20.567  ;
N054.20.49.776 E018.34.20.567 N054.20.50.352 E018.34.49.080  ;
N054.20.50.352 E018.34.49.080 N054.20.48.047 E018.35.17.339  ;
N054.20.48.047 E018.35.17.339 N054.20.42.900 E018.35.44.484  ;
N054.18.43.271 E018.43.36.156 N054.18.35.459 E018.44.01.319  ;
N054.18.35.459 E018.44.01.319 N054.18.25.200 E018.44.23.784  ;
N054.18.25.200 E018.44.23.784 N054.18.12.815 E018.44.42.863  ;
N054.18.12.815 E018.44.42.863 N054.17.58.703 E018.44.57.983  ;
N054.17.58.703 E018.44.57.983 N054.17.43.296 E018.45.08.676  ;
N054.17.43.296 E018.45.08.676 N054.17.26.987 E018.45.14.579  ;
N054.17.26.987 E018.45.14.579 N054.17.10.355 E018.45.15.587  ;
N054.17.10.355 E018.45.15.587 N054.16.53.867 E018.45.11.627  ;
N054.16.53.867 E018.45.11.627 N054.16.38.063 E018.45.02.807  ;
N054.16.38.063 E018.45.02.807 N054.16.23.340 E018.44.49.416  ;
N054.16.23.340 E018.44.49.416 N054.16.10.235 E018.44.31.848  ;
N054.16.10.235 E018.44.31.848 N054.15.59.111 E018.44.10.679  ;
N054.15.59.111 E018.44.10.679 N054.15.50.292 E018.43.46.487  ;
N054.15.50.292 E018.43.46.487 N054.15.44.028 E018.43.20.063  ;
N054.15.44.028 E018.43.20.063 N054.15.40.572 E018.42.52.164  ;
N054.15.40.572 E018.42.52.164 N054.15.39.996 E018.42.23.651  ;
N054.15.39.996 E018.42.23.651 N054.15.42.299 E018.41.55.428  ;
N054.15.42.299 E018.41.55.428 N054.15.47.447 E018.41.28.283  ;
N054.17.47.400 E018.33.35.207 N054.15.47.771 E018.41.26.987  ;Connecting line
N054.18.42.947 E018.43.37.452 N054.20.42.575 E018.35.45.816  ;Connecting line

-EPGD 29 ROMEO	VAPOS VAPOS KRT KRT
			DEXIR DEXIR KRT KRT
			LODNI LODNI KRT KRT
			
;DEXIR
N054.16.34.932 E017.25.57.863 N054.16.36.408 E017.26.26.231  ;
N054.16.36.408 E017.26.26.231 N054.16.34.932 E017.26.54.599  ;
N054.16.34.932 E017.26.54.599 N054.16.30.647 E017.27.22.140  ;
N054.16.30.647 E017.27.22.140 N054.16.23.592 E017.27.47.951  ;
N054.16.23.592 E017.27.47.951 N054.16.14.051 E017.28.11.279  ;
N054.16.14.051 E017.28.11.279 N054.16.02.279 E017.28.31.440  ;
N054.16.02.279 E017.28.31.440 N054.15.48.635 E017.28.47.783  ;
N054.15.48.635 E017.28.47.783 N054.15.33.552 E017.28.59.808  ;
N054.15.33.552 E017.28.59.808 N054.15.17.496 E017.29.07.188  ;
N054.15.17.496 E017.29.07.188 N054.15.00.900 E017.29.09.671  ;
N054.15.00.900 E017.29.09.671 N054.14.44.304 E017.29.07.188  ;
N054.14.44.304 E017.29.07.188 N054.14.28.247 E017.28.59.808  ;
N054.14.28.247 E017.28.59.808 N054.14.13.163 E017.28.47.783  ;
N054.14.13.163 E017.28.47.783 N054.13.59.519 E017.28.31.440  ;
N054.13.59.519 E017.28.31.440 N054.13.47.748 E017.28.11.279  ;
N054.13.47.748 E017.28.11.279 N054.13.38.208 E017.27.47.951  ;
N054.13.38.208 E017.27.47.951 N054.13.31.152 E017.27.22.140  ;
N054.12.32.472 E017.18.32.507 N054.12.30.743 E017.18.04.175  ;
N054.12.30.743 E017.18.04.175 N054.12.31.896 E017.17.35.771  ;
N054.12.31.896 E017.17.35.771 N054.12.35.928 E017.17.08.123  ;
N054.12.35.928 E017.17.08.123 N054.12.42.696 E017.16.42.131  ;
N054.12.42.696 E017.16.42.131 N054.12.52.019 E017.16.18.515  ;
N054.12.52.019 E017.16.18.515 N054.13.03.576 E017.15.58.032  ;
N054.13.03.576 E017.15.58.032 N054.13.17.040 E017.15.41.291  ;
N054.13.17.040 E017.15.41.291 N054.13.31.979 E017.15.28.799  ;
N054.13.31.979 E017.15.28.799 N054.13.47.999 E017.15.20.951  ;
N054.13.47.999 E017.15.20.951 N054.14.04.560 E017.15.17.963  ;
N054.14.04.560 E017.15.17.963 N054.14.21.155 E017.15.19.943  ;
N054.14.21.155 E017.15.19.943 N054.14.37.319 E017.15.26.855  ;
N054.14.37.319 E017.15.26.855 N054.14.52.512 E017.15.38.448  ;
N054.14.52.512 E017.15.38.448 N054.15.06.300 E017.15.54.360  ;
N054.15.06.300 E017.15.54.360 N054.15.18.287 E017.16.14.123  ;
N054.15.18.287 E017.16.14.123 N054.15.28.080 E017.16.37.200  ;
N054.15.28.080 E017.16.37.200 N054.15.35.351 E017.17.02.795  ;
N054.15.35.351 E017.17.02.795 N054.15.39.959 E017.17.30.155  ;
N054.16.34.788 E017.25.56.459 N054.15.40.103 E017.17.31.560  ;Connecting line
N054.12.32.327 E017.18.31.104 N054.13.27.012 E017.26.56.003  ;Connecting line

;VAPOS
N054.49.02.963 E017.54.36.900 N054.48.47.340 E017.54.46.800  ;
N054.48.47.340 E017.54.46.800 N054.48.30.924 E017.54.51.804  ;
N054.48.30.924 E017.54.51.804 N054.48.14.291 E017.54.51.804  ;
N054.48.14.291 E017.54.51.804 N054.47.57.876 E017.54.46.800  ;
N054.47.57.876 E017.54.46.800 N054.47.42.252 E017.54.36.900  ;
N054.47.42.252 E017.54.36.900 N054.47.27.851 E017.54.22.464  ;
N054.47.27.851 E017.54.22.464 N054.47.15.072 E017.54.03.888  ;
N054.47.15.072 E017.54.03.888 N054.47.04.380 E017.53.41.783  ;
N054.47.04.380 E017.53.41.783 N054.46.56.064 E017.53.16.763  ;
N054.46.56.064 E017.53.16.763 N054.46.50.375 E017.52.49.619  ;
N054.46.50.375 E017.52.49.619 N054.46.47.495 E017.52.21.180  ;
N054.46.47.495 E017.52.21.180 N054.46.47.495 E017.51.52.307  ;
N054.46.47.495 E017.51.52.307 N054.46.50.375 E017.51.23.867  ;
N054.46.50.375 E017.51.23.867 N054.46.56.064 E017.50.56.724  ;
N054.46.56.064 E017.50.56.724 N054.47.04.380 E017.50.31.704  ;
N054.47.04.380 E017.50.31.704 N054.47.15.072 E017.50.09.599  ;
N054.47.15.072 E017.50.09.599 N054.47.27.851 E017.49.51.023  ;
N054.47.27.851 E017.49.51.023 N054.47.42.252 E017.49.36.588  ;
N054.52.15.239 E017.46.00.444 N054.52.30.863 E017.45.50.544  ;
N054.52.30.863 E017.45.50.544 N054.52.47.280 E017.45.45.504  ;
N054.52.47.280 E017.45.45.504 N054.53.03.911 E017.45.45.504  ;
N054.53.03.911 E017.45.45.504 N054.53.20.327 E017.45.50.544  ;
N054.53.20.327 E017.45.50.544 N054.53.35.952 E017.46.00.444  ;
N054.53.35.952 E017.46.00.444 N054.53.50.352 E017.46.14.916  ;
N054.53.50.352 E017.46.14.916 N054.54.03.131 E017.46.33.492  ;
N054.54.03.131 E017.46.33.492 N054.54.13.824 E017.46.55.667  ;
N054.54.13.824 E017.46.55.667 N054.54.22.139 E017.47.20.724  ;
N054.54.22.139 E017.47.20.724 N054.54.27.828 E017.47.47.939  ;
N054.54.27.828 E017.47.47.939 N054.54.30.707 E017.48.16.415  ;
N054.54.30.707 E017.48.16.415 N054.54.30.707 E017.48.45.359  ;
N054.54.30.707 E017.48.45.359 N054.54.27.828 E017.49.13.835  ;
N054.54.27.828 E017.49.13.835 N054.54.22.139 E017.49.41.052  ;
N054.54.22.139 E017.49.41.052 N054.54.13.824 E017.50.06.107  ;
N054.54.13.824 E017.50.06.107 N054.54.03.131 E017.50.28.284  ;
N054.54.03.131 E017.50.28.284 N054.53.50.352 E017.50.46.860  ;
N054.53.50.352 E017.50.46.860 N054.53.35.952 E017.51.01.332  ;
N054.49.02.207 E017.54.37.511 N054.53.35.196 E017.51.01.943  ;Connecting line
N054.52.15.996 E017.45.59.831 N054.47.43.007 E017.49.35.976  ;Connecting line

;KRT
N054.17.58.235 E018.12.29.304 N054.18.13.967 E018.12.20.015  ;
N054.18.13.967 E018.12.20.015 N054.18.30.420 E018.12.15.551  ;
N054.18.30.420 E018.12.15.551 N054.18.47.052 E018.12.16.056  ;
N054.18.47.052 E018.12.16.056 N054.19.03.396 E018.12.21.492  ;
N054.19.03.396 E018.12.21.492 N054.19.18.948 E018.12.31.715  ;
N054.19.18.948 E018.12.31.715 N054.19.33.204 E018.12.46.440  ;
N054.19.33.204 E018.12.46.440 N054.19.45.768 E018.13.05.159  ;
N054.19.45.768 E018.13.05.159 N054.19.56.244 E018.13.27.300  ;
N054.19.56.244 E018.13.27.300 N054.20.04.308 E018.13.52.284  ;
N054.20.04.308 E018.13.52.284 N054.20.09.743 E018.14.19.247  ;
N054.20.09.743 E018.14.19.247 N054.20.12.335 E018.14.47.436  ;
N054.20.12.335 E018.14.47.436 N054.20.12.048 E018.15.15.947  ;
N054.20.12.048 E018.15.15.947 N054.20.08.879 E018.15.43.955  ;
N054.20.08.879 E018.15.43.955 N054.20.02.903 E018.16.10.596  ;
N054.20.02.903 E018.16.10.596 N054.19.54.336 E018.16.35.075  ;
N054.19.54.336 E018.16.35.075 N054.19.43.428 E018.16.56.603  ;
N054.19.43.428 E018.16.56.603 N054.19.30.468 E018.17.14.531  ;
N054.19.30.468 E018.17.14.531 N054.19.15.923 E018.17.28.391  ;
N054.14.40.811 E018.20.53.159 N054.14.25.079 E018.21.02.448  ;
N054.14.25.079 E018.21.02.448 N054.14.08.627 E018.21.06.876  ;
N054.14.08.627 E018.21.06.876 N054.13.51.996 E018.21.06.408  ;
N054.13.51.996 E018.21.06.408 N054.13.35.652 E018.21.00.971  ;
N054.13.35.652 E018.21.00.971 N054.13.20.100 E018.20.50.747  ;
N054.13.20.100 E018.20.50.747 N054.13.05.844 E018.20.36.096  ;
N054.13.05.844 E018.20.36.096 N054.12.53.279 E018.20.17.412  ;
N054.12.53.279 E018.20.17.412 N054.12.42.803 E018.19.55.271  ;
N054.12.42.803 E018.19.55.271 N054.12.34.740 E018.19.30.359  ;
N054.12.34.740 E018.19.30.359 N054.12.29.304 E018.19.03.432  ;
N054.12.29.304 E018.19.03.432 N054.12.26.711 E018.18.35.315  ;
N054.12.26.711 E018.18.35.315 N054.12.27.000 E018.18.06.839  ;
N054.12.27.000 E018.18.06.839 N054.12.30.167 E018.17.38.867  ;
N054.12.30.167 E018.17.38.867 N054.12.36.143 E018.17.12.264  ;
N054.12.36.143 E018.17.12.264 N054.12.44.712 E018.16.47.855  ;
N054.12.44.712 E018.16.47.855 N054.12.55.619 E018.16.26.364  ;
N054.12.55.619 E018.16.26.364 N054.13.08.580 E018.16.08.472  ;
N054.13.08.580 E018.16.08.472 N054.13.23.123 E018.15.54.648  ;
N054.17.58.992 E018.12.28.727 N054.13.23.880 E018.15.54.071  ;Connecting line
N054.14.40.055 E018.20.53.735 N054.19.15.168 E018.17.28.968  ;Connecting line

-EPWA 11 N052.17.56.066 E020.49.00.984 N052.18.42.710 E020.46.15.875

N052.41.42.295 E019.49.11.803 N052.35.24.590 E020.08.52.131
N052.35.24.590 E020.08.52.131 N052.30.39.344 E020.23.33.443

N052.09.32.459 E021.59.56.066 N052.02.56.066 E021.41.44.262
N052.02.56.066 E021.41.44.262 N052.01.54.098 E021.36.58.033
N052.01.54.098 E021.36.58.033 N051.58.14.754 E021.19.53.115
N051.58.14.754 E021.19.53.115 N052.00.30.492 E021.11.57.049
N052.00.30.492 E021.11.57.049 N052.07.60.000 E021.04.52.131
N052.07.60.000 E021.04.52.131 N052.15.29.508 E020.57.44.262
N052.15.29.508 E020.57.44.262 N052.17.56.066 E020.49.00.984

N051.44.41.311 E021.41.07.869 N051.53.17.705 E021.27.39.344
N051.53.17.705 E021.27.39.344 N051.58.14.754 E021.19.53.115

N051.17.03.934 E020.41.37.377 N051.39.25.574 E020.57.33.443
N051.39.25.574 E020.57.33.443 N051.49.50.164 E020.57.58.033
N051.49.50.164 E020.57.58.033 N052.01.00.984 E020.58.24.590
N052.01.00.984 E020.58.24.590 N052.07.23.607 E020.47.31.475
N052.07.23.607 E020.47.31.475 N052.10.45.246 E020.35.23.607
N052.10.45.246 E020.35.23.607 N052.12.24.590 E020.29.27.541
N052.12.24.590 E020.29.27.541 N052.14.01.967 E020.23.32.459
N052.14.01.967 E020.23.32.459 N052.15.39.344 E020.17.34.426
N052.15.39.344 E020.17.34.426 N052.16.28.622 E020.14.35.737
N052.16.28.622 E020.14.35.737 N052.16.32.681 E020.14.22.092
N052.16.32.681 E020.14.22.092 N052.16.36.871 E020.14.08.862
N052.16.36.871 E020.14.08.862 N052.16.44.898 E020.13.49.057
N052.16.44.898 E020.13.49.057 N052.16.51.099 E020.13.35.683
N052.16.51.099 E020.13.35.683 N052.16.56.665 E020.13.26.937
N052.16.56.665 E020.13.26.937 N052.17.07.353 E020.13.12.448
N052.17.07.353 E020.13.12.448 N052.17.16.904 E020.13.01.788
N052.17.16.904 E020.13.01.788 N052.17.25.669 E020.12.54.384
N052.17.25.669 E020.12.54.384 N052.17.35.677 E020.12.47.587
N052.17.35.677 E020.12.47.587 N052.17.44.499 E020.12.42.270
N052.17.44.499 E020.12.42.270 N052.17.56.032 E020.12.38.452
N052.17.56.032 E020.12.38.452 N052.18.09.894 E020.12.36.388
N052.18.09.894 E020.12.36.388 N052.18.25.699 E020.12.36.806
N052.18.25.699 E020.12.36.806 N052.18.34.679 E020.12.39.023
N052.18.34.679 E020.12.39.023 N052.18.44.876 E020.12.43.399
N052.18.44.876 E020.12.43.399 N052.18.54.888 E020.12.49.247
N052.18.54.888 E020.12.49.247 N052.19.09.143 E020.12.58.149
N052.19.09.143 E020.12.58.149 N052.19.19.403 E020.13.05.592
N052.19.19.403 E020.13.05.592 N052.20.07.847 E020.13.40.749
N052.20.07.847 E020.13.40.749 N052.20.16.831 E020.13.49.614
N052.20.16.831 E020.13.49.614 N052.20.25.811 E020.13.59.059
N052.20.25.811 E020.13.59.059 N052.20.32.737 E020.14.08.602
N052.20.32.737 E020.14.08.602 N052.20.40.136 E020.14.20.077
N052.20.40.136 E020.14.20.077 N052.20.47.276 E020.14.33.746
N052.20.47.276 E020.14.33.746 N052.20.53.851 E020.14.48.248
N052.20.53.851 E020.14.48.248 N052.20.59.458 E020.15.03.740
N052.20.59.458 E020.15.03.740 N052.21.03.629 E020.15.19.030
N052.21.03.629 E020.15.19.030 N052.21.07.483 E020.15.36.667
N052.21.07.483 E020.15.36.667 N052.21.09.712 E020.15.50.029
N052.21.09.712 E020.15.50.029 N052.21.11.680 E020.16.09.222
N052.21.11.680 E020.16.09.222 N052.21.12.467 E020.16.24.145
N052.21.12.467 E020.16.24.145 N052.21.12.530 E020.16.40.138
N052.21.12.530 E020.16.40.138 N052.21.11.893 E020.16.55.263
N052.21.11.893 E020.16.55.263 N052.21.09.651 E020.17.15.937
N052.21.09.651 E020.17.15.937 N052.21.07.301 E020.17.29.912
N052.21.07.301 E020.17.29.912 N052.21.01.289 E020.17.54.975
N052.21.01.289 E020.17.54.975 N052.20.12.787 E020.20.53.115

N051.34.52.131 E019.57.38.361 N051.34.25.574 E020.15.13.770
N051.34.25.574 E020.15.13.770 N051.33.45.223 E020.38.32.059
N051.33.45.223 E020.38.32.059 N051.33.44.752 E020.38.47.485
N051.33.44.752 E020.38.47.485 N051.33.44.764 E020.39.11.163
N051.33.44.764 E020.39.11.163 N051.33.45.448 E020.39.30.393
N051.33.45.448 E020.39.30.393 N051.33.46.969 E020.39.49.059
N051.33.46.969 E020.39.49.059 N051.33.49.484 E020.40.09.941
N051.33.49.484 E020.40.09.941 N051.33.53.748 E020.40.35.291
N051.33.53.748 E020.40.35.291 N051.34.00.552 E020.41.03.682
N051.34.00.552 E020.41.03.682 N051.34.08.853 E020.41.29.415
N051.34.08.853 E020.41.29.415 N051.34.19.038 E020.41.55.146
N051.34.19.038 E020.41.55.146 N051.34.32.734 E020.42.22.603
N051.34.32.734 E020.42.22.603 N051.34.45.623 E020.42.43.144
N051.34.45.623 E020.42.43.144 N051.34.57.669 E020.42.58.903
N051.34.57.669 E020.42.58.903 N051.35.05.819 E020.43.08.434
N051.35.05.819 E020.43.08.434 N051.35.21.244 E020.43.24.954
N051.35.21.244 E020.43.24.954 N051.40.18.689 E020.48.22.623
N051.40.18.689 E020.48.22.623 N051.49.50.164 E020.57.58.033

N052.20.12.787 E020.20.53.115 N052.19.29.881 E020.23.31.822

N052.22.27.541 E019.46.28.525 N052.27.51.148 E020.04.45.246
N052.27.51.148 E020.04.45.246 N052.30.39.344 E020.23.33.443
N052.30.39.344 E020.23.33.443 N052.29.56.066 E020.33.37.377
N052.29.56.066 E020.33.37.377 N052.28.00.000 E020.40.42.295
N052.28.00.000 E020.40.42.295 N052.26.17.705 E020.46.50.164
N052.26.17.705 E020.46.50.164 N052.25.16.543 E020.50.29.668
N052.25.16.543 E020.50.29.668 N052.25.05.126 E020.51.01.553
N052.25.05.126 E020.51.01.553 N052.24.56.594 E020.51.20.967
N052.24.56.594 E020.51.20.967 N052.24.45.566 E020.51.39.811
N052.24.45.566 E020.51.39.811 N052.24.31.805 E020.51.58.116
N052.24.31.805 E020.51.58.116 N052.24.19.248 E020.52.10.713
N052.24.19.248 E020.52.10.713 N052.24.06.465 E020.52.20.730
N052.24.06.465 E020.52.20.730 N052.23.50.547 E020.52.29.521
N052.23.50.547 E020.52.29.521 N052.23.36.731 E020.52.34.291
N052.23.36.731 E020.52.34.291 N052.23.23.601 E020.52.36.537
N052.23.23.601 E020.52.36.537 N052.23.07.344 E020.52.36.332
N052.23.07.344 E020.52.36.332 N052.22.53.459 E020.52.33.533
N052.22.53.459 E020.52.33.533 N052.22.38.086 E020.52.27.492
N052.22.38.086 E020.52.27.492 N052.22.27.478 E020.52.21.611
N052.22.27.478 E020.52.21.611 N052.22.11.796 E020.52.09.998
N052.22.11.796 E020.52.09.998 N052.19.38.844 E020.50.16.867
N052.19.38.844 E020.50.16.867 N052.19.30.348 E020.50.08.750
N052.19.30.348 E020.50.08.750 N052.19.22.021 E020.50.00.160
N052.19.22.021 E020.50.00.160 N052.19.14.275 E020.49.50.099
N052.19.14.275 E020.49.50.099 N052.19.06.457 E020.49.37.953
N052.19.06.457 E020.49.37.953 N052.18.58.608 E020.49.23.678
N052.18.58.608 E020.49.23.678 N052.18.52.254 E020.49.08.466
N052.18.52.254 E020.49.08.466 N052.18.46.196 E020.48.51.450
N052.18.46.196 E020.48.51.450 N052.18.41.696 E020.48.35.743
N052.18.41.696 E020.48.35.743 N052.18.38.209 E020.48.17.308
N052.18.38.209 E020.48.17.308 N052.18.35.478 E020.47.55.885
N052.18.35.478 E020.47.55.885 N052.18.34.033 E020.47.32.433
N052.18.34.033 E020.47.32.433 N052.18.34.299 E020.47.12.892
N052.18.34.299 E020.47.12.892 N052.18.36.051 E020.46.51.875
N052.18.36.051 E020.46.51.875 N052.18.38.984 E020.46.32.035
N052.18.38.984 E020.46.32.035 N052.18.42.710 E020.46.15.875
N052.18.42.710 E020.46.15.875 N052.18.47.887 E020.45.55.908
N052.18.47.887 E020.45.55.908 N052.19.52.131 E020.42.05.902
N052.19.52.131 E020.42.05.902 N052.21.30.492 E020.36.08.852
N052.21.30.492 E020.36.08.852 N052.23.08.852 E020.30.11.803
N052.23.08.852 E020.30.11.803 N052.23.58.522 E020.27.09.374
N052.23.58.522 E020.27.09.374 N052.24.05.351 E020.26.40.604
N052.24.05.351 E020.26.40.604 N052.24.08.645 E020.26.14.927
N052.24.08.645 E020.26.14.927 N052.24.09.822 E020.25.53.487
N052.24.09.822 E020.25.53.487 N052.24.09.442 E020.25.30.208
N052.24.09.442 E020.25.30.208 N052.24.07.591 E020.25.08.917
N052.24.07.591 E020.25.08.917 N052.24.03.739 E020.24.46.633
N052.24.03.739 E020.24.46.633 N052.23.59.229 E020.24.28.594
N052.23.59.229 E020.24.28.594 N052.23.53.926 E020.24.12.113
N052.23.53.926 E020.24.12.113 N052.23.47.409 E020.23.56.195
N052.23.47.409 E020.23.56.195 N052.23.41.026 E020.23.43.548
N052.23.41.026 E020.23.43.548 N052.23.35.417 E020.23.34.195
N052.23.35.417 E020.23.34.195 N052.23.28.538 E020.23.23.707
N052.23.28.538 E020.23.23.707 N052.23.19.896 E020.23.13.658
N052.23.19.896 E020.23.13.658 N052.23.14.079 E020.23.07.485
N052.23.14.079 E020.23.07.485 N052.23.04.350 E020.22.58.920
N052.23.04.350 E020.22.58.920 N052.22.02.824 E020.22.13.769
N052.22.02.824 E020.22.13.769 N052.21.53.752 E020.22.07.114
N052.21.53.752 E020.22.07.114 N052.21.45.523 E020.22.02.424
N052.21.45.523 E020.22.02.424 N052.21.36.059 E020.21.57.922
N052.21.36.059 E020.21.57.922 N052.21.26.206 E020.21.54.830
N052.21.26.206 E020.21.54.830 N052.21.13.985 E020.21.52.853
N052.21.13.985 E020.21.52.853 N052.21.05.867 E020.21.53.349
N052.21.05.867 E020.21.53.349 N052.20.54.540 E020.21.54.713
N052.20.54.540 E020.21.54.713 N052.20.44.059 E020.21.57.986
N052.20.44.059 E020.21.57.986 N052.20.34.682 E020.22.02.379
N052.20.34.682 E020.22.02.379 N052.20.24.196 E020.22.08.570
N052.20.24.196 E020.22.08.570 N052.20.15.518 E020.22.15.995
N052.20.15.518 E020.22.15.995 N052.20.06.934 E020.22.23.787
N052.20.06.934 E020.22.23.787 N052.19.59.728 E020.22.33.278
N052.19.59.728 E020.22.33.278 N052.19.52.010 E020.22.43.442
N052.19.52.010 E020.22.43.442 N052.19.47.766 E020.22.50.811
N052.19.47.766 E020.22.50.811 N052.19.40.895 E020.23.03.915
N052.19.40.895 E020.23.03.915 N052.19.34.597 E020.23.18.348
N052.19.34.597 E020.23.18.348 N052.19.29.881 E020.23.31.822
N052.19.29.881 E020.23.31.822 N052.19.23.180 E020.23.53.377
N052.19.23.180 E020.23.53.377 N052.18.34.426 E020.26.50.164
N052.18.34.426 E020.26.50.164 N052.16.56.066 E020.32.47.213
N052.16.56.066 E020.32.47.213 N052.15.18.689 E020.38.43.279
N052.15.18.689 E020.38.43.279 N052.14.14.754 E020.42.35.410
N052.14.14.754 E020.42.35.410 N052.13.37.377 E020.44.48.197

N052.24.21.639 E020.53.46.230 N052.25.16.543 E020.50.29.668 stargray

N052.17.56.066 E020.49.00.984 N052.19.38.844 E020.50.16.867 stargray

N051.33.45.223 E020.38.32.059 N051.33.39.344 E020.41.43.279 stargray
N051.33.39.344 E020.41.43.279 N051.35.05.819 E020.43.08.434 stargray

N052.24.05.351 E020.26.40.604 N052.24.46.230 E020.24.13.770 stargray
N052.24.46.230 E020.24.13.770 N052.23.14.079 E020.23.07.485 stargray

N052.20.12.787 E020.20.53.115 N052.21.45.523 E020.22.02.424 stargray

N052.21.50.164 E020.14.55.082 N052.21.01.289 E020.17.54.975 stargray

N052.21.50.164 E020.14.55.082 N052.20.07.847 E020.13.40.749 stargray

N052.17.17.705 E020.11.37.377 N052.18.49.161 E020.12.45.902 stargray

N052.17.17.705 E020.11.37.377 N052.16.35.177 E020.14.14.211 stargray

N052.24.21.639 E020.53.46.230 N052.22.27.478 E020.52.21.611 stargray


                  
;;;;;;;;;;;;;;;;; HOLDINGS FOR STAR 11 ;;;;;;;;;;;;;;;;;;;
;Holding SORIX
N052.46.07.103 E019.50.21.047 N052.46.01.451 E019.50.58.416  ;
N052.46.01.451 E019.50.58.416 N052.45.51.984 E019.51.33.552  ;
N052.45.51.984 E019.51.33.552 N052.45.38.952 E019.52.05.447  ;
N052.45.38.952 E019.52.05.447 N052.45.22.752 E019.52.33.131  ;
N052.45.22.752 E019.52.33.131 N052.45.03.923 E019.52.55.775  ;
N052.45.03.923 E019.52.55.775 N052.44.42.971 E019.53.12.623  ;
N052.44.42.971 E019.53.12.623 N052.44.20.579 E019.53.23.244  ;
N052.44.20.579 E019.53.23.244 N052.43.57.396 E019.53.27.276  ;
N052.43.57.396 E019.53.27.276 N052.43.34.139 E019.53.24.576  ;
N052.43.34.139 E019.53.24.576 N052.43.11.532 E019.53.15.287  ;
N052.43.11.532 E019.53.15.287 N052.42.50.256 E019.52.59.628  ;
N052.42.50.256 E019.52.59.628 N052.42.30.924 E019.52.38.100  ;
N052.42.30.924 E019.52.38.100 N052.42.14.147 E019.52.11.352  ;
N052.42.14.147 E019.52.11.352 N052.42.00.468 E019.51.40.248  ;
N052.42.00.468 E019.51.40.248 N052.41.50.244 E019.51.05.651  ;
N052.41.50.244 E019.51.05.651 N052.41.43.835 E019.50.28.644  ;
N052.41.43.835 E019.50.28.644 N052.41.41.388 E019.49.50.376  ;
N052.41.41.388 E019.49.50.376 N052.41.43.007 E019.49.12.000  ;
N052.42.48.707 E019.37.46.919 N052.42.54.359 E019.37.09.588  ;
N052.42.54.359 E019.37.09.588 N052.43.03.828 E019.36.34.415  ;
N052.43.03.828 E019.36.34.415 N052.43.16.860 E019.36.02.484  ;
N052.43.16.860 E019.36.02.484 N052.43.33.060 E019.35.34.799  ;
N052.43.33.060 E019.35.34.799 N052.43.51.887 E019.35.12.156  ;
N052.43.51.887 E019.35.12.156 N052.44.12.839 E019.34.55.271  ;
N052.44.12.839 E019.34.55.271 N052.44.35.231 E019.34.44.652  ;
N052.44.35.231 E019.34.44.652 N052.44.58.416 E019.34.40.656  ;
N052.44.58.416 E019.34.40.656 N052.45.21.671 E019.34.43.320  ;
N052.45.21.671 E019.34.43.320 N052.45.44.280 E019.34.52.643  ;
N052.45.44.280 E019.34.52.643 N052.46.05.556 E019.35.08.304  ;
N052.46.05.556 E019.35.08.304 N052.46.24.888 E019.35.29.831  ;
N052.46.24.888 E019.35.29.831 N052.46.41.663 E019.35.56.579  ;
N052.46.41.663 E019.35.56.579 N052.46.55.344 E019.36.27.720  ;
N052.46.55.344 E019.36.27.720 N052.47.05.568 E019.37.02.315  ;
N052.47.05.568 E019.37.02.315 N052.47.11.975 E019.37.39.324  ;
N052.47.11.975 E019.37.39.324 N052.47.14.424 E019.38.17.628  ;
N052.47.14.424 E019.38.17.628 N052.47.12.803 E019.38.56.040  ;
N052.46.07.103 E019.50.21.047 N052.47.12.803 E019.38.56.040  ;Connecting line
N052.42.48.707 E019.37.46.919 N052.41.43.007 E019.49.12.000  ;Connecting line

;Holding BIMPA
N052.26.55.140 E019.46.21.360 N052.26.53.519 E019.46.59.448  ;
N052.26.53.519 E019.46.59.448 N052.26.47.867 E019.47.36.527  ;
N052.26.47.867 E019.47.36.527 N052.26.38.400 E019.48.11.448  ;
N052.26.38.400 E019.48.11.448 N052.26.25.367 E019.48.43.091  ;
N052.26.25.367 E019.48.43.091 N052.26.09.167 E019.49.10.596  ;
N052.26.09.167 E019.49.10.596 N052.25.50.339 E019.49.33.023  ;
N052.25.50.339 E019.49.33.023 N052.25.29.388 E019.49.49.800  ;
N052.25.29.388 E019.49.49.800 N052.25.06.996 E019.50.00.312  ;
N052.25.06.996 E019.50.00.312 N052.24.43.812 E019.50.04.308  ;
N052.24.43.812 E019.50.04.308 N052.24.20.555 E019.50.01.644  ;
N052.24.20.555 E019.50.01.644 N052.23.57.948 E019.49.52.391  ;
N052.23.57.948 E019.49.52.391 N052.23.36.672 E019.49.36.876  ;
N052.23.36.672 E019.49.36.876 N052.23.17.340 E019.49.15.491  ;
N052.23.17.340 E019.49.15.491 N052.23.00.564 E019.48.48.960  ;
N052.23.00.564 E019.48.48.960 N052.22.46.883 E019.48.18.071  ;
N052.22.46.883 E019.48.18.071 N052.22.36.659 E019.47.43.728  ;
N052.22.36.659 E019.47.43.728 N052.22.30.252 E019.47.07.008  ;
N052.22.30.252 E019.47.07.008 N052.22.27.803 E019.46.28.991  ;
N052.22.20.459 E019.35.00.564 N052.22.22.079 E019.34.22.476  ;
N052.22.22.079 E019.34.22.476 N052.22.27.731 E019.33.45.395  ;
N052.22.27.731 E019.33.45.395 N052.22.37.200 E019.33.10.512  ;
N052.22.37.200 E019.33.10.512 N052.22.50.232 E019.32.38.831  ;
N052.22.50.232 E019.32.38.831 N052.23.06.432 E019.32.11.364  ;
N052.23.06.432 E019.32.11.364 N052.23.25.259 E019.31.48.899  ;
N052.23.25.259 E019.31.48.899 N052.23.46.211 E019.31.32.160  ;
N052.23.46.211 E019.31.32.160 N052.24.08.603 E019.31.21.612  ;
N052.24.08.603 E019.31.21.612 N052.24.31.788 E019.31.17.616  ;
N052.24.31.788 E019.31.17.616 N052.24.55.043 E019.31.20.280  ;
N052.24.55.043 E019.31.20.280 N052.25.17.652 E019.31.29.531  ;
N052.25.17.652 E019.31.29.531 N052.25.38.928 E019.31.45.083  ;
N052.25.38.928 E019.31.45.083 N052.25.58.260 E019.32.06.431  ;
N052.25.58.260 E019.32.06.431 N052.26.15.036 E019.32.32.964  ;
N052.26.15.036 E019.32.32.964 N052.26.28.716 E019.33.03.887  ;
N052.26.28.716 E019.33.03.887 N052.26.38.940 E019.33.38.196  ;
N052.26.38.940 E019.33.38.196 N052.26.45.347 E019.34.14.916  ;
N052.26.45.347 E019.34.14.916 N052.26.47.795 E019.34.52.931  ;
N052.26.55.140 E019.46.21.360 N052.26.47.795 E019.34.52.931  ;Connecting line
N052.22.20.459 E019.35.00.564 N052.22.27.803 E019.46.28.991  ;Connecting line

;Holding OLGER
N052.33.50.867 E020.23.44.952 N052.33.48.851 E020.24.12.131  ;
N052.33.48.851 E020.24.12.131 N052.33.43.956 E020.24.38.304  ;
N052.33.43.956 E020.24.38.304 N052.33.36.431 E020.25.02.676  ;
N052.33.36.431 E020.25.02.676 N052.33.26.388 E020.25.24.528  ;
N052.33.26.388 E020.25.24.528 N052.33.14.220 E020.25.43.212  ;
N052.33.14.220 E020.25.43.212 N052.33.00.251 E020.25.58.115  ;
N052.33.00.251 E020.25.58.115 N052.32.44.951 E020.26.08.808  ;
N052.32.44.951 E020.26.08.808 N052.32.28.716 E020.26.14.964  ;
N052.32.28.716 E020.26.14.964 N052.32.12.084 E020.26.16.367  ;
N052.32.12.084 E020.26.16.367 N052.31.55.559 E020.26.13.055  ;
N052.31.55.559 E020.26.13.055 N052.31.39.647 E020.26.05.064  ;
N052.31.39.647 E020.26.05.064 N052.31.24.816 E020.25.52.608  ;
N052.31.24.816 E020.25.52.608 N052.31.11.531 E020.25.36.155  ;
N052.31.11.531 E020.25.36.155 N052.31.00.191 E020.25.16.140  ;
N052.31.00.191 E020.25.16.140 N052.30.51.120 E020.24.53.172  ;
N052.30.51.120 E020.24.53.172 N052.30.44.604 E020.24.28.007  ;
N052.30.44.604 E020.24.28.007 N052.30.40.860 E020.24.01.331  ;
N052.30.40.860 E020.24.01.331 N052.30.39.996 E020.23.34.007  ;
N052.30.50.472 E020.15.21.095 N052.30.52.488 E020.14.53.916  ;
N052.30.52.488 E020.14.53.916 N052.30.57.384 E020.14.27.744  ;
N052.30.57.384 E020.14.27.744 N052.31.04.908 E020.14.03.371  ;
N052.31.04.908 E020.14.03.371 N052.31.14.952 E020.13.41.520  ;
N052.31.14.952 E020.13.41.520 N052.31.27.120 E020.13.22.835  ;
N052.31.27.120 E020.13.22.835 N052.31.41.088 E020.13.07.931  ;
N052.31.41.088 E020.13.07.931 N052.31.56.388 E020.12.57.240  ;
N052.31.56.388 E020.12.57.240 N052.32.12.623 E020.12.51.083  ;
N052.32.12.623 E020.12.51.083 N052.32.29.256 E020.12.49.643  ;
N052.32.29.256 E020.12.49.643 N052.32.45.780 E020.12.52.991  ;
N052.32.45.780 E020.12.52.991 N052.33.01.691 E020.13.00.984  ;
N052.33.01.691 E020.13.00.984 N052.33.16.523 E020.13.13.403  ;
N052.33.16.523 E020.13.13.403 N052.33.29.808 E020.13.29.891  ;
N052.33.29.808 E020.13.29.891 N052.33.41.148 E020.13.49.908  ;
N052.33.41.148 E020.13.49.908 N052.33.50.219 E020.14.12.839  ;
N052.33.50.219 E020.14.12.839 N052.33.56.735 E020.14.38.040  ;
N052.33.56.735 E020.14.38.040 N052.34.00.480 E020.15.04.716  ;
N052.34.00.480 E020.15.04.716 N052.34.01.343 E020.15.32.040  ;
N052.33.50.867 E020.23.44.952 N052.34.01.343 E020.15.32.040  ;Connecting line
N052.30.50.472 E020.15.21.095 N052.30.39.996 E020.23.34.007  ;Connecting line


;Holding BEMRA
N051.49.50.700 E020.52.49.584 N051.50.07.296 E020.52.51.924  ;
N051.50.07.296 E020.52.51.924 N051.50.23.352 E020.52.58.908  ;
N051.50.23.352 E020.52.58.908 N051.50.38.435 E020.53.10.283  ;
N051.50.38.435 E020.53.10.283 N051.50.52.079 E020.53.25.728  ;
N051.50.52.079 E020.53.25.728 N051.51.03.851 E020.53.44.771  ;
N051.51.03.851 E020.53.44.771 N051.51.13.392 E020.54.06.840  ;
N051.51.13.392 E020.54.06.840 N051.51.20.447 E020.54.31.248  ;
N051.51.20.447 E020.54.31.248 N051.51.24.732 E020.54.57.276  ;
N051.51.24.732 E020.54.57.276 N051.51.26.208 E020.55.24.095  ;
N051.51.26.208 E020.55.24.095 N051.51.24.732 E020.55.50.916  ;
N051.51.24.732 E020.55.50.916 N051.51.20.447 E020.56.16.944  ;
N051.51.20.447 E020.56.16.944 N051.51.13.392 E020.56.41.351  ;
N051.51.13.392 E020.56.41.351 N051.51.03.851 E020.57.03.419  ;
N051.51.03.851 E020.57.03.419 N051.50.52.079 E020.57.22.464  ;
N051.50.52.079 E020.57.22.464 N051.50.38.435 E020.57.37.907  ;
N051.50.38.435 E020.57.37.907 N051.50.23.352 E020.57.49.283  ;
N051.50.23.352 E020.57.49.283 N051.50.07.296 E020.57.56.268  ;
N051.50.07.296 E020.57.56.268 N051.49.50.700 E020.57.58.608  ;
N051.44.50.711 E020.57.58.320 N051.44.34.115 E020.57.55.980  ;
N051.44.34.115 E020.57.55.980 N051.44.18.059 E020.57.49.031  ;
N051.44.18.059 E020.57.49.031 N051.44.02.976 E020.57.37.656  ;
N051.44.02.976 E020.57.37.656 N051.43.49.332 E020.57.22.247  ;
N051.43.49.332 E020.57.22.247 N051.43.37.560 E020.57.03.240  ;
N051.43.37.560 E020.57.03.240 N051.43.28.019 E020.56.41.208  ;
N051.43.28.019 E020.56.41.208 N051.43.20.964 E020.56.16.835  ;
N051.43.20.964 E020.56.16.835 N051.43.16.679 E020.55.50.880  ;
N051.43.16.679 E020.55.50.880 N051.43.15.203 E020.55.24.095  ;
N051.43.15.203 E020.55.24.095 N051.43.16.679 E020.54.57.311  ;
N051.43.16.679 E020.54.57.311 N051.43.20.964 E020.54.31.355  ;
N051.43.20.964 E020.54.31.355 N051.43.28.019 E020.54.06.983  ;
N051.43.28.019 E020.54.06.983 N051.43.37.560 E020.53.44.952  ;
N051.43.37.560 E020.53.44.952 N051.43.49.332 E020.53.25.944  ;
N051.43.49.332 E020.53.25.944 N051.44.02.976 E020.53.10.536  ;
N051.44.02.976 E020.53.10.536 N051.44.18.059 E020.52.59.159  ;
N051.44.18.059 E020.52.59.159 N051.44.34.115 E020.52.52.212  ;
N051.44.34.115 E020.52.52.212 N051.44.50.711 E020.52.49.872  ;
N051.49.50.700 E020.52.49.584 N051.44.50.711 E020.52.49.872  ;Connecting line
N051.44.50.711 E020.57.58.320 N051.49.50.700 E020.57.58.608  ;Connecting line

;Holding AGAVA
N051.39.20.447 E019.57.46.188 N051.39.18.000 E019.58.23.519  ;
N051.39.18.000 E019.58.23.519 N051.39.11.591 E019.58.59.591  ;
N051.39.11.591 E019.58.59.591 N051.39.01.367 E019.59.33.323  ;
N051.39.01.367 E019.59.33.323 N051.38.47.688 E020.00.03.708  ;
N051.38.47.688 E020.00.03.708 N051.38.30.911 E020.00.29.771  ;
N051.38.30.911 E020.00.29.771 N051.38.11.579 E020.00.50.759  ;
N051.38.11.579 E020.00.50.759 N051.37.50.303 E020.01.06.023  ;
N051.37.50.303 E020.01.06.023 N051.37.27.696 E020.01.15.095  ;
N051.37.27.696 E020.01.15.095 N051.37.04.439 E020.01.17.723  ;
N051.37.04.439 E020.01.17.723 N051.36.41.256 E020.01.13.799  ;
N051.36.41.256 E020.01.13.799 N051.36.18.864 E020.01.03.468  ;
N051.36.18.864 E020.01.03.468 N051.35.57.912 E020.00.47.015  ;
N051.35.57.912 E020.00.47.015 N051.35.39.083 E020.00.24.948  ;
N051.35.39.083 E020.00.24.948 N051.35.22.883 E019.59.57.948  ;
N051.35.22.883 E019.59.57.948 N051.35.09.851 E019.59.26.844  ;
N051.35.09.851 E019.59.26.844 N051.35.00.384 E019.58.52.535  ;
N051.35.00.384 E019.58.52.535 N051.34.54.732 E019.58.16.140  ;
N051.34.54.732 E019.58.16.140 N051.34.53.112 E019.57.38.700  ;
N051.35.00.456 E019.46.22.368 N051.35.02.903 E019.45.45.035  ;
N051.35.02.903 E019.45.45.035 N051.35.09.312 E019.45.08.927  ;
N051.35.09.312 E019.45.08.927 N051.35.19.536 E019.44.35.196  ;
N051.35.19.536 E019.44.35.196 N051.35.33.215 E019.44.04.848  ;
N051.35.33.215 E019.44.04.848 N051.35.49.992 E019.43.38.784  ;
N051.35.49.992 E019.43.38.784 N051.36.09.323 E019.43.17.795  ;
N051.36.09.323 E019.43.17.795 N051.36.30.599 E019.43.02.531  ;
N051.36.30.599 E019.43.02.531 N051.36.53.208 E019.42.53.423  ;
N051.36.53.208 E019.42.53.423 N051.37.16.464 E019.42.50.832  ;
N051.37.16.464 E019.42.50.832 N051.37.39.647 E019.42.54.755  ;
N051.37.39.647 E019.42.54.755 N051.38.02.039 E019.43.05.088  ;
N051.38.02.039 E019.43.05.088 N051.38.22.991 E019.43.21.540  ;
N051.38.22.991 E019.43.21.540 N051.38.41.820 E019.43.43.608  ;
N051.38.41.820 E019.43.43.608 N051.38.58.020 E019.44.10.608  ;
N051.38.58.020 E019.44.10.608 N051.39.11.051 E019.44.41.712  ;
N051.39.11.051 E019.44.41.712 N051.39.20.520 E019.45.16.019  ;
N051.39.20.520 E019.45.16.019 N051.39.26.171 E019.45.52.415  ;
N051.39.26.171 E019.45.52.415 N051.39.27.791 E019.46.29.856  ;
N051.39.20.447 E019.57.46.188 N051.39.27.791 E019.46.29.856  ;Connecting line
N051.35.00.456 E019.46.22.368 N051.34.53.112 E019.57.38.700  ;Connecting line


;Holding LOGDA
N051.17.03.983 E020.41.38.039 N051.17.24.576 E020.41.55.536  ;
N051.17.24.576 E020.41.55.536 N051.17.42.935 E020.42.18.468  ;
N051.17.42.935 E020.42.18.468 N051.17.58.524 E020.42.46.152  ;
N051.17.58.524 E020.42.46.152 N051.18.10.871 E020.43.17.723  ;
N051.18.10.871 E020.43.17.723 N051.18.19.583 E020.43.52.284  ;
N051.18.19.583 E020.43.52.284 N051.18.24.443 E020.44.28.715  ;
N051.18.24.443 E020.44.28.715 N051.18.25.272 E020.45.05.940  ;
N051.18.25.272 E020.45.05.940 N051.18.21.995 E020.45.42.804  ;
N051.18.21.995 E020.45.42.804 N051.18.14.796 E020.46.18.228  ;
N051.18.14.796 E020.46.18.228 N051.18.03.852 E020.46.51.132  ;
N051.18.03.852 E020.46.51.132 N051.17.49.523 E020.47.20.472  ;
N051.17.49.523 E020.47.20.472 N051.17.32.207 E020.47.45.384  ;
N051.17.32.207 E020.47.45.384 N051.17.12.444 E020.48.05.147  ;
N051.17.12.444 E020.48.05.147 N051.16.50.844 E020.48.19.079  ;
N051.16.50.844 E020.48.19.079 N051.16.28.055 E020.48.26.819  ;
N051.16.28.055 E020.48.26.819 N051.16.04.763 E020.48.28.115  ;
N051.16.04.763 E020.48.28.115 N051.15.41.688 E020.48.22.932  ;
N051.15.41.688 E020.48.22.932 N051.15.19.512 E020.48.11.448  ;
N051.08.52.907 E020.43.48.684 N051.08.32.316 E020.43.31.223  ;
N051.08.32.316 E020.43.31.223 N051.08.13.956 E020.43.08.364  ;
N051.08.13.956 E020.43.08.364 N051.07.58.368 E020.42.40.752  ;
N051.07.58.368 E020.42.40.752 N051.07.46.019 E020.42.09.215  ;
N051.07.46.019 E020.42.09.215 N051.07.37.307 E020.41.34.764  ;
N051.07.37.307 E020.41.34.764 N051.07.32.448 E020.40.58.440  ;
N051.07.32.448 E020.40.58.440 N051.07.31.620 E020.40.21.287  ;
N051.07.31.620 E020.40.21.287 N051.07.34.895 E020.39.44.495  ;
N051.07.34.895 E020.39.44.495 N051.07.42.096 E020.39.09.143  ;
N051.07.42.096 E020.39.09.143 N051.07.53.039 E020.38.36.347  ;
N051.07.53.039 E020.38.36.347 N051.08.07.367 E020.38.07.044  ;
N051.08.07.367 E020.38.07.044 N051.08.24.683 E020.37.42.203  ;
N051.08.24.683 E020.37.42.203 N051.08.44.447 E020.37.22.512  ;
N051.08.44.447 E020.37.22.512 N051.09.06.047 E020.37.08.580  ;
N051.09.06.047 E020.37.08.580 N051.09.28.835 E020.37.00.840  ;
N051.09.28.835 E020.37.00.840 N051.09.52.127 E020.36.59.544  ;
N051.09.52.127 E020.36.59.544 N051.10.15.203 E020.37.04.727  ;
N051.10.15.203 E020.37.04.727 N051.10.37.380 E020.37.16.211  ;
N051.17.03.983 E020.41.38.039 N051.10.37.380 E020.37.16.211  ;Connecting line
N051.08.52.907 E020.43.48.684 N051.15.19.512 E020.48.11.448  ;Connecting line

;Holding EMKEN
N051.58.15.096 E021.19.54.516 N051.58.22.151 E021.19.29.999  ;
N051.58.22.151 E021.19.29.999 N051.58.31.692 E021.19.07.860  ;
N051.58.31.692 E021.19.07.860 N051.58.43.464 E021.18.48.743  ;
N051.58.43.464 E021.18.48.743 N051.58.57.107 E021.18.33.227  ;
N051.58.57.107 E021.18.33.227 N051.59.12.191 E021.18.21.815  ;
N051.59.12.191 E021.18.21.815 N051.59.28.247 E021.18.14.796  ;
N051.59.28.247 E021.18.14.796 N051.59.44.843 E021.18.12.456  ;
N051.59.44.843 E021.18.12.456 N052.00.01.439 E021.18.14.796  ;
N052.00.01.439 E021.18.14.796 N052.00.17.496 E021.18.21.815  ;
N052.00.17.496 E021.18.21.815 N052.00.32.580 E021.18.33.227  ;
N052.00.32.580 E021.18.33.227 N052.00.46.223 E021.18.48.743  ;
N052.00.46.223 E021.18.48.743 N052.00.57.995 E021.19.07.860  ;
N052.00.57.995 E021.19.07.860 N052.01.07.536 E021.19.29.999  ;
N052.01.07.536 E021.19.29.999 N052.01.14.591 E021.19.54.516  ;
N052.01.14.591 E021.19.54.516 N052.01.18.875 E021.20.20.615  ;
N052.01.18.875 E021.20.20.615 N052.01.20.352 E021.20.47.544  ;
N052.01.20.352 E021.20.47.544 N052.01.18.875 E021.21.14.471  ;
N052.01.18.875 E021.21.14.471 N052.01.14.591 E021.21.40.572  ;
N051.59.31.992 E021.29.18.420 N051.59.24.935 E021.29.42.899  ;
N051.59.24.935 E021.29.42.899 N051.59.15.395 E021.30.05.004  ;
N051.59.15.395 E021.30.05.004 N051.59.03.624 E021.30.24.119  ;
N051.59.03.624 E021.30.24.119 N051.58.49.980 E021.30.39.635  ;
N051.58.49.980 E021.30.39.635 N051.58.34.895 E021.30.51.047  ;
N051.58.34.895 E021.30.51.047 N051.58.18.839 E021.30.58.032  ;
N051.58.18.839 E021.30.58.032 N051.58.02.243 E021.31.00.372  ;
N051.58.02.243 E021.31.00.372 N051.57.45.647 E021.30.58.032  ;
N051.57.45.647 E021.30.58.032 N051.57.29.591 E021.30.51.047  ;
N051.57.29.591 E021.30.51.047 N051.57.14.508 E021.30.39.635  ;
N051.57.14.508 E021.30.39.635 N051.57.00.864 E021.30.24.119  ;
N051.57.00.864 E021.30.24.119 N051.56.49.092 E021.30.05.004  ;
N051.56.49.092 E021.30.05.004 N051.56.39.551 E021.29.42.899  ;
N051.56.39.551 E021.29.42.899 N051.56.32.496 E021.29.18.420  ;
N051.56.32.496 E021.29.18.420 N051.56.28.211 E021.28.52.320  ;
N051.56.28.211 E021.28.52.320 N051.56.26.735 E021.28.25.392  ;
N051.56.26.735 E021.28.25.392 N051.56.28.211 E021.27.58.463  ;
N051.56.28.211 E021.27.58.463 N051.56.32.496 E021.27.32.364  ;
N051.58.15.096 E021.19.54.516 N051.56.32.496 E021.27.32.364  ;Connecting line
N051.59.31.992 E021.29.18.420 N052.01.14.591 E021.21.40.572  ;Connecting line


;Holding LIMVI 
N051.44.41.999 E021.41.07.943 N051.45.02.196 E021.40.49.115  ;
N051.45.02.196 E021.40.49.115 N051.45.24.083 E021.40.36.227  ;
N051.45.24.083 E021.40.36.227 N051.45.47.016 E021.40.29.676  ;
N051.45.47.016 E021.40.29.676 N051.46.10.343 E021.40.29.676  ;
N051.46.10.343 E021.40.29.676 N051.46.33.276 E021.40.36.227  ;
N051.46.33.276 E021.40.36.227 N051.46.55.164 E021.40.49.115  ;
N051.46.55.164 E021.40.49.115 N051.47.15.359 E021.41.07.943  ;
N051.47.15.359 E021.41.07.943 N051.47.33.216 E021.41.32.136  ;
N051.47.33.216 E021.41.32.136 N051.47.48.192 E021.42.00.971  ;
N051.47.48.192 E021.42.00.971 N051.47.59.855 E021.42.33.588  ;
N051.47.59.855 E021.42.33.588 N051.48.07.811 E021.43.08.975  ;
N051.48.07.811 E021.43.08.975 N051.48.11.843 E021.43.46.055  ;
N051.48.11.843 E021.43.46.055 N051.48.11.843 E021.44.23.712  ;
N051.48.11.843 E021.44.23.712 N051.48.07.811 E021.45.00.791  ;
N051.48.07.811 E021.45.00.791 N051.47.59.855 E021.45.36.179  ;
N051.47.59.855 E021.45.36.179 N051.47.48.192 E021.46.08.796  ;
N051.47.48.192 E021.46.08.796 N051.47.33.216 E021.46.37.632  ;
N051.47.33.216 E021.46.37.632 N051.47.15.359 E021.47.01.824  ;
N051.41.31.308 E021.53.30.732 N051.41.11.111 E021.53.49.523  ;
N051.41.11.111 E021.53.49.523 N051.40.49.224 E021.54.02.375  ;
N051.40.49.224 E021.54.02.375 N051.40.26.291 E021.54.08.892  ;
N051.40.26.291 E021.54.08.892 N051.40.02.964 E021.54.08.892  ;
N051.40.02.964 E021.54.08.892 N051.39.40.031 E021.54.02.375  ;
N051.39.40.031 E021.54.02.375 N051.39.18.143 E021.53.49.523  ;
N051.39.18.143 E021.53.49.523 N051.38.57.948 E021.53.30.732  ;
N051.38.57.948 E021.53.30.732 N051.38.40.091 E021.53.06.575  ;
N051.38.40.091 E021.53.06.575 N051.38.25.115 E021.52.37.811  ;
N051.38.25.115 E021.52.37.811 N051.38.13.452 E021.52.05.268  ;
N051.38.13.452 E021.52.05.268 N051.38.05.496 E021.51.29.951  ;
N051.38.05.496 E021.51.29.951 N051.38.01.464 E021.50.52.944  ;
N051.38.01.464 E021.50.52.944 N051.38.01.464 E021.50.15.359  ;
N051.38.01.464 E021.50.15.359 N051.38.05.496 E021.49.38.352  ;
N051.38.05.496 E021.49.38.352 N051.38.13.452 E021.49.03.035  ;
N051.38.13.452 E021.49.03.035 N051.38.25.115 E021.48.30.491  ;
N051.38.25.115 E021.48.30.491 N051.38.40.091 E021.48.01.728  ;
N051.38.40.091 E021.48.01.728 N051.38.57.948 E021.47.37.571  ;
N051.44.41.999 E021.41.07.943 N051.38.57.948 E021.47.37.571  ;Connecting line
N051.41.31.308 E021.53.30.732 N051.47.15.359 E021.47.01.824  ;Connecting line                       

-EPWA 15 N052.15.26.557 E020.43.57.049 N052.18.05.902 E020.41.36.393 stargray

N052.10.59.997 E020.34.32.457 N052.09.45.246 E020.39.00.984 stargray
N052.09.45.246 E020.39.00.984 N052.12.27.676 E020.41.19.738 stargray

N052.15.26.557 E020.43.57.049 N052.13.46.847 E020.42.29.658 stargray

N052.26.59.091 E020.33.42.958 N052.28.37.377 E020.32.14.754 stargray
N052.28.37.377 E020.32.14.754 N052.29.25.290 E020.34.38.259 stargray

N052.30.03.535 E020.36.33.221 N052.31.00.984 E020.39.25.574 stargray
N052.31.00.984 E020.39.25.574 N052.29.20.514 E020.40.53.664 stargray

N052.27.29.508 E020.42.32.459 N052.28.24.376 E020.45.18.618 stargray

N052.28.54.717 E020.46.50.182 N052.29.52.131 E020.49.44.262 stargray
N052.29.52.131 E020.49.44.262 N052.28.05.838 E020.51.18.208 stargray

N052.10.29.508 E021.06.45.246 N052.08.27.541 E021.05.13.770 stargray

N051.33.49.300 E020.36.17.771 N051.33.39.344 E020.41.43.279 stargray
N051.33.39.344 E020.41.43.279 N051.36.03.296 E020.44.05.800 stargray

N051.58.14.754 E021.19.53.115 N051.59.15.215 E021.24.26.375 stargray

N051.58.14.754 E021.19.53.115 N052.01.04.005 E021.16.52.077

N052.22.27.541 E019.46.28.525 N052.15.34.426 E020.17.52.131
N052.15.34.426 E020.17.52.131 N052.13.56.066 E020.23.50.164
N052.13.56.066 E020.23.50.164 N052.12.24.590 E020.29.27.541
N052.12.24.590 E020.29.27.541 N052.11.06.342 E020.34.09.628
N052.11.06.342 E020.34.09.628 N052.10.57.646 E020.34.40.916
N052.10.57.646 E020.34.40.916 N052.10.51.615 E020.35.24.728
N052.10.51.615 E020.35.24.728 N052.10.48.331 E020.36.04.147
N052.10.48.331 E020.36.04.147 N052.10.47.898 E020.36.44.300
N052.10.47.898 E020.36.44.300 N052.10.50.391 E020.37.24.484
N052.10.50.391 E020.37.24.484 N052.10.56.531 E020.38.08.059
N052.10.56.531 E020.38.08.059 N052.11.07.881 E020.38.56.173
N052.11.07.881 E020.38.56.173 N052.11.21.425 E020.39.35.714
N052.11.21.425 E020.39.35.714 N052.11.38.951 E020.40.13.667
N052.11.38.951 E020.40.13.667 N052.12.00.065 E020.40.48.035
N052.12.00.065 E020.40.48.035 N052.12.10.436 E020.41.01.751
N052.12.10.436 E020.41.01.751 N052.12.38.803 E020.41.31.350
N052.12.38.803 E020.41.31.350 N052.13.36.021 E020.42.21.005
N052.13.36.021 E020.42.21.005 N052.13.54.011 E020.42.35.385
N052.13.54.011 E020.42.35.385 N052.14.11.340 E020.42.46.410
N052.14.11.340 E020.42.46.410 N052.14.31.204 E020.42.55.939
N052.14.31.204 E020.42.55.939 N052.14.53.056 E020.43.02.872
N052.14.53.056 E020.43.02.872 N052.15.14.413 E020.43.06.246
N052.15.14.413 E020.43.06.246 N052.15.39.241 E020.43.06.057
N052.15.39.241 E020.43.06.057 N052.16.00.199 E020.43.02.451
N052.16.00.199 E020.43.02.451 N052.16.20.404 E020.42.55.897
N052.16.20.404 E020.42.55.897 N052.16.38.175 E020.42.47.501
N052.16.38.175 E020.42.47.501 N052.16.52.946 E020.42.38.516
N052.16.52.946 E020.42.38.516 N052.17.17.648 E020.42.19.021
N052.17.17.648 E020.42.19.021 N052.18.05.902 E020.41.36.393
N052.18.05.902 E020.41.36.393 N052.21.36.393 E020.38.29.508
N052.21.36.393 E020.38.29.508 N052.25.07.869 E020.35.22.623
N052.25.07.869 E020.35.22.623 N052.26.59.091 E020.33.42.958
N052.26.59.091 E020.33.42.958 N052.27.13.420 E020.33.32.180
N052.27.13.420 E020.33.32.180 N052.27.29.233 E020.33.24.548
N052.27.29.233 E020.33.24.548 N052.27.44.161 E020.33.20.964
N052.27.44.161 E020.33.20.964 N052.27.59.521 E020.33.20.723
N052.27.59.521 E020.33.20.723 N052.28.12.719 E020.33.23.294
N052.28.12.719 E020.33.23.294 N052.28.27.690 E020.33.29.471
N052.28.27.690 E020.33.29.471 N052.28.40.396 E020.33.37.707
N052.28.40.396 E020.33.37.707 N052.28.54.350 E020.33.50.472
N052.28.54.350 E020.33.50.472 N052.29.07.517 E020.34.07.041
N052.29.07.517 E020.34.07.041 N052.29.16.336 E020.34.21.479
N052.29.16.336 E020.34.21.479 N052.29.25.290 E020.34.38.259
N052.29.25.290 E020.34.38.259 N052.29.34.037 E020.35.04.484
N052.29.34.037 E020.35.04.484 N052.29.54.955 E020.36.07.228
N052.29.54.955 E020.36.07.228 N052.30.03.535 E020.36.33.221
N052.30.03.535 E020.36.33.221 N052.30.08.253 E020.36.50.589
N052.30.08.253 E020.36.50.589 N052.30.11.471 E020.37.05.904
N052.30.11.471 E020.37.05.904 N052.30.13.922 E020.37.21.517
N052.30.13.922 E020.37.21.517 N052.30.15.847 E020.37.40.556
N052.30.15.847 E020.37.40.556 N052.30.16.608 E020.37.57.021
N052.30.16.608 E020.37.57.021 N052.30.16.396 E020.38.17.847
N052.30.16.396 E020.38.17.847 N052.30.15.204 E020.38.35.286
N052.30.15.204 E020.38.35.286 N052.30.12.859 E020.38.54.025
N052.30.12.859 E020.38.54.025 N052.30.09.482 E020.39.12.146
N052.30.09.482 E020.39.12.146 N052.30.03.854 E020.39.33.861
N052.30.03.854 E020.39.33.861 N052.29.57.171 E020.39.53.213
N052.29.57.171 E020.39.53.213 N052.29.49.609 E020.40.10.479
N052.29.49.609 E020.40.10.479 N052.29.41.515 E020.40.25.463
N052.29.41.515 E020.40.25.463 N052.29.34.999 E020.40.35.617
N052.29.34.999 E020.40.35.617 N052.29.27.622 E020.40.45.498
N052.29.27.622 E020.40.45.498 N052.29.20.514 E020.40.53.664
N052.29.20.514 E020.40.53.664 N052.29.06.417 E020.41.06.889
N052.29.06.417 E020.41.06.889 N052.27.29.508 E020.42.32.459
N052.27.29.508 E020.42.32.459 N052.23.58.033 E020.45.19.672
N052.23.58.033 E020.45.19.672 N052.20.27.541 E020.48.45.246
N052.20.27.541 E020.48.45.246 N052.18.28.525 E020.51.42.295
N052.18.28.525 E020.51.42.295 N052.17.05.902 E020.52.40.328

N052.28.54.717 E020.46.50.182 N052.28.55.655 E020.46.52.846
N052.28.55.655 E020.46.52.846 N052.28.56.566 E020.46.55.521
N052.28.56.566 E020.46.55.521 N052.28.57.449 E020.46.58.204
N052.28.57.449 E020.46.58.204 N052.28.58.303 E020.47.00.897
N052.28.58.303 E020.47.00.897 N052.28.59.130 E020.47.03.598
N052.28.59.130 E020.47.03.598 N052.28.59.929 E020.47.06.308
N052.28.59.929 E020.47.06.308 N052.29.00.700 E020.47.09.026
N052.29.00.700 E020.47.09.026 N052.29.01.442 E020.47.11.752
N052.29.01.442 E020.47.11.752 N052.29.02.156 E020.47.14.485
N052.29.02.156 E020.47.14.485 N052.29.02.842 E020.47.17.226
N052.29.02.842 E020.47.17.226 N052.29.03.499 E020.47.19.973
N052.29.03.499 E020.47.19.973 N052.29.04.127 E020.47.22.727
N052.29.04.127 E020.47.22.727 N052.29.04.727 E020.47.25.488
N052.29.04.727 E020.47.25.488 N052.29.05.299 E020.47.28.255
N052.29.05.299 E020.47.28.255 N052.29.05.841 E020.47.31.027
N052.29.05.841 E020.47.31.027 N052.29.06.355 E020.47.33.805
N052.29.06.355 E020.47.33.805 N052.29.06.840 E020.47.36.588
N052.29.06.840 E020.47.36.588 N052.29.07.296 E020.47.39.376
N052.29.07.296 E020.47.39.376 N052.29.07.723 E020.47.42.169
N052.29.07.723 E020.47.42.169 N052.29.08.121 E020.47.44.966
N052.29.08.121 E020.47.44.966 N052.29.08.490 E020.47.47.767
N052.29.08.490 E020.47.47.767 N052.29.08.829 E020.47.50.571
N052.29.08.829 E020.47.50.571 N052.29.09.140 E020.47.53.379
N052.29.09.140 E020.47.53.379 N052.29.09.422 E020.47.56.190
N052.29.09.422 E020.47.56.190 N052.29.09.674 E020.47.59.004
N052.29.09.674 E020.47.59.004 N052.29.09.897 E020.48.01.820
N052.29.09.897 E020.48.01.820 N052.29.10.091 E020.48.04.639
N052.29.10.091 E020.48.04.639 N052.29.10.256 E020.48.07.459
N052.29.10.256 E020.48.07.459 N052.29.10.391 E020.48.10.281
N052.29.10.391 E020.48.10.281 N052.29.10.497 E020.48.13.104
N052.29.10.497 E020.48.13.104 N052.29.10.574 E020.48.15.928
N052.29.10.574 E020.48.15.928 N052.29.10.622 E020.48.18.752
N052.29.10.622 E020.48.18.752 N052.29.10.640 E020.48.21.577
N052.29.10.640 E020.48.21.577 N052.29.10.629 E020.48.24.402
N052.29.10.629 E020.48.24.402 N052.29.10.588 E020.48.27.227
N052.29.10.588 E020.48.27.227 N052.29.10.518 E020.48.30.051
N052.29.10.518 E020.48.30.051 N052.29.10.419 E020.48.32.875
N052.29.10.419 E020.48.32.875 N052.29.10.291 E020.48.35.697
N052.29.10.291 E020.48.35.697 N052.29.10.133 E020.48.38.517
N052.29.10.133 E020.48.38.517 N052.29.09.946 E020.48.41.336
N052.29.09.946 E020.48.41.336 N052.29.09.730 E020.48.44.153
N052.29.09.730 E020.48.44.153 N052.29.09.485 E020.48.46.967
N052.29.09.485 E020.48.46.967 N052.29.09.210 E020.48.49.779
N052.29.09.210 E020.48.49.779 N052.29.08.906 E020.48.52.588
N052.29.08.906 E020.48.52.588 N052.29.08.573 E020.48.55.393
N052.29.08.573 E020.48.55.393 N052.29.08.211 E020.48.58.195
N052.29.08.211 E020.48.58.195 N052.29.07.820 E020.49.00.993
N052.29.07.820 E020.49.00.993 N052.29.07.400 E020.49.03.787
N052.29.07.400 E020.49.03.787 N052.29.06.951 E020.49.06.576
N052.29.06.951 E020.49.06.576 N052.29.06.473 E020.49.09.360
N052.29.06.473 E020.49.09.360 N052.29.05.966 E020.49.12.139
N052.29.05.966 E020.49.12.139 N052.29.05.431 E020.49.14.913
N052.29.05.431 E020.49.14.913 N052.29.04.866 E020.49.17.681
N052.29.04.866 E020.49.17.681 N052.29.04.273 E020.49.20.443
N052.29.04.273 E020.49.20.443 N052.29.03.651 E020.49.23.199
N052.29.03.651 E020.49.23.199 N052.29.03.001 E020.49.25.948
N052.29.03.001 E020.49.25.948 N052.29.02.322 E020.49.28.691
N052.29.02.322 E020.49.28.691 N052.29.01.615 E020.49.31.426
N052.29.01.615 E020.49.31.426 N052.29.00.879 E020.49.34.153
N052.29.00.879 E020.49.34.153 N052.29.00.116 E020.49.36.873
N052.29.00.116 E020.49.36.873 N052.28.59.324 E020.49.39.585
N052.28.59.324 E020.49.39.585 N052.28.58.503 E020.49.42.288
N052.28.58.503 E020.49.42.288 N052.28.57.655 E020.49.44.983
N052.28.57.655 E020.49.44.983 N052.28.56.779 E020.49.47.669
N052.28.56.779 E020.49.47.669 N052.28.55.875 E020.49.50.345
N052.28.55.875 E020.49.50.345 N052.28.54.944 E020.49.53.012
N052.28.54.944 E020.49.53.012 N052.28.53.984 E020.49.55.670
N052.28.53.984 E020.49.55.670 N052.28.52.998 E020.49.58.317
N052.28.52.998 E020.49.58.317 N052.28.51.983 E020.50.00.953
N052.28.51.983 E020.50.00.953 N052.28.50.942 E020.50.03.579
N052.28.50.942 E020.50.03.579 N052.28.49.873 E020.50.06.195
N052.28.49.873 E020.50.06.195 N052.28.48.777 E020.50.08.798
N052.28.48.777 E020.50.08.798 N052.28.47.655 E020.50.11.391
N052.28.47.655 E020.50.11.391 N052.28.46.505 E020.50.13.971
N052.28.46.505 E020.50.13.971 N052.28.45.329 E020.50.16.540
N052.28.45.329 E020.50.16.540 N052.28.44.126 E020.50.19.096
N052.28.44.126 E020.50.19.096 N052.28.42.896 E020.50.21.640
N052.28.42.896 E020.50.21.640 N052.28.41.641 E020.50.24.170
N052.28.41.641 E020.50.24.170 N052.28.40.359 E020.50.26.688
N052.28.40.359 E020.50.26.688 N052.28.39.051 E020.50.29.192
N052.28.39.051 E020.50.29.192 N052.28.37.717 E020.50.31.682
N052.28.37.717 E020.50.31.682 N052.28.36.357 E020.50.34.158
N052.28.36.357 E020.50.34.158 N052.28.34.972 E020.50.36.620
N052.28.34.972 E020.50.36.620 N052.28.33.561 E020.50.39.068
N052.28.33.561 E020.50.39.068 N052.28.32.125 E020.50.41.501
N052.28.32.125 E020.50.41.501 N052.28.30.664 E020.50.43.919
N052.28.30.664 E020.50.43.919 N052.28.29.178 E020.50.46.321
N052.28.29.178 E020.50.46.321 N052.28.27.666 E020.50.48.708
N052.28.27.666 E020.50.48.708 N052.28.26.131 E020.50.51.079
N052.28.26.131 E020.50.51.079 N052.28.24.570 E020.50.53.434
N052.28.24.570 E020.50.53.434 N052.28.22.985 E020.50.55.773
N052.28.22.985 E020.50.55.773 N052.28.21.377 E020.50.58.095
N052.28.21.377 E020.50.58.095 N052.28.19.744 E020.51.00.400
N052.28.19.744 E020.51.00.400 N052.28.18.087 E020.51.02.689
N052.28.18.087 E020.51.02.689 N052.28.16.407 E020.51.04.960
N052.28.16.407 E020.51.04.960 N052.28.14.703 E020.51.07.213
N052.28.14.703 E020.51.07.213 N052.28.12.975 E020.51.09.449
N052.28.12.975 E020.51.09.449 N052.28.11.225 E020.51.11.666
N052.28.11.225 E020.51.11.666 N052.28.09.452 E020.51.13.865
N052.28.09.452 E020.51.13.865 N052.28.07.656 E020.51.16.046
N052.28.07.656 E020.51.16.046 N052.28.05.838 E020.51.18.208

N051.34.52.131 E019.57.38.361 N051.34.25.574 E020.15.13.770
N051.34.25.574 E020.15.13.770 N051.33.49.300 E020.36.17.771
N051.33.49.300 E020.36.17.771 N051.33.48.283 E020.37.14.393
N051.33.48.283 E020.37.14.393 N051.33.49.665 E020.37.54.106
N051.33.49.665 E020.37.54.106 N051.33.52.247 E020.38.26.745
N051.33.52.247 E020.38.26.745 N051.33.57.563 E020.39.08.861
N051.33.57.563 E020.39.08.861 N051.34.03.915 E020.39.44.632
N051.34.03.915 E020.39.44.632 N051.34.14.673 E020.40.30.357
N051.34.14.673 E020.40.30.357 N051.34.23.933 E020.41.01.752
N051.34.23.933 E020.41.01.752 N051.34.36.653 E020.41.37.749
N051.34.36.653 E020.41.37.749 N051.34.49.008 E020.42.07.332
N051.34.49.008 E020.42.07.332 N051.35.01.293 E020.42.32.929
N051.35.01.293 E020.42.32.929 N051.35.14.713 E020.42.57.521
N051.35.14.713 E020.42.57.521 N051.35.30.177 E020.43.22.359
N051.35.30.177 E020.43.22.359 N051.35.49.802 E020.43.49.511
N051.35.49.802 E020.43.49.511 N051.36.03.296 E020.44.05.800
N051.36.03.296 E020.44.05.800 N051.36.24.638 E020.44.28.286
N051.36.24.638 E020.44.28.286 N051.40.18.689 E020.48.22.623
N051.40.18.689 E020.48.22.623 N051.49.50.164 E020.57.58.033

N051.17.03.934 E020.41.37.377 N051.39.25.574 E020.57.33.443
N051.39.25.574 E020.57.33.443 N051.49.50.164 E020.57.58.033
N051.49.50.164 E020.57.58.033 N051.59.01.967 E020.58.19.672
N051.59.01.967 E020.58.19.672 N052.08.28.078 E021.05.15.599
N052.08.28.078 E021.05.15.599 N052.08.50.869 E021.05.31.359
N052.08.50.869 E021.05.31.359 N052.09.12.950 E021.05.42.955
N052.09.12.950 E021.05.42.955 N052.09.33.561 E021.05.50.639
N052.09.33.561 E021.05.50.639 N052.09.52.607 E021.05.55.195
N052.09.52.607 E021.05.55.195 N052.10.12.338 E021.05.57.427
N052.10.12.338 E021.05.57.427 N052.10.29.346 E021.05.57.350
N052.10.29.346 E021.05.57.350 N052.10.49.001 E021.05.54.951
N052.10.49.001 E021.05.54.951 N052.11.08.401 E021.05.50.110
N052.11.08.401 E021.05.50.110 N052.11.24.938 E021.05.43.979
N052.11.24.938 E021.05.43.979 N052.11.43.916 E021.05.34.550
N052.11.43.916 E021.05.34.550 N052.11.56.588 E021.05.26.741
N052.11.56.588 E021.05.26.741 N052.12.31.571 E021.04.58.643
N052.12.31.571 E021.04.58.643 N052.12.43.446 E021.04.48.262

N051.44.41.311 E021.41.07.869 N051.53.17.705 E021.27.39.344
N051.53.17.705 E021.27.39.344 N051.58.14.754 E021.19.53.115

N052.09.32.361 E021.59.56.059 N052.02.55.968 E021.41.44.256
N052.02.55.968 E021.41.44.256 N052.01.54.001 E021.36.58.027
N052.01.54.001 E021.36.58.027 N051.59.27.153 E021.25.30.262
N051.59.27.153 E021.25.30.262 N051.59.12.636 E021.24.12.583
N051.59.12.636 E021.24.12.583 N051.59.09.112 E021.23.39.242
N051.59.09.112 E021.23.39.242 N051.59.07.241 E021.23.05.420
N051.59.07.241 E021.23.05.420 N051.59.07.073 E021.22.30.477
N051.59.07.073 E021.22.30.477 N051.59.09.386 E021.21.46.780
N051.59.09.386 E021.21.46.780 N051.59.14.697 E021.21.02.306
N051.59.14.697 E021.21.02.306 N051.59.24.020 E021.20.14.234
N051.59.24.020 E021.20.14.234 N051.59.34.351 E021.19.36.079
N051.59.34.351 E021.19.36.079 N051.59.46.225 E021.19.01.637
N051.59.46.225 E021.19.01.637 N051.59.58.009 E021.18.33.510
N051.59.58.009 E021.18.33.510 N052.00.12.034 E021.18.05.372
N052.00.12.034 E021.18.05.372 N052.00.28.239 E021.17.38.127
N052.00.28.239 E021.17.38.127 N052.00.44.811 E021.17.14.720
N052.00.44.811 E021.17.14.720 N052.01.04.005 E021.16.52.077
N052.01.04.005 E021.16.52.077 N052.01.16.406 E021.16.38.804
N052.01.16.406 E021.16.38.804 N052.04.03.837 E021.13.39.339
N052.04.03.837 E021.13.39.339 N052.10.29.411 E021.06.45.241
N052.10.29.411 E021.06.45.241 N052.22.50.066 E020.55.56.061
N052.22.50.066 E020.55.56.061 N052.26.21.542 E020.52.50.160
N052.26.21.542 E020.52.50.160 N052.28.03.190 E020.51.20.456
N052.28.03.190 E020.51.20.456 N052.28.13.675 E020.51.10.649
N052.28.13.675 E020.51.10.649 N052.28.20.060 E020.51.03.463
N052.28.20.060 E020.51.03.463 N052.28.26.019 E020.50.55.802
N052.28.26.019 E020.50.55.802 N052.28.33.558 E020.50.44.547
N052.28.33.558 E020.50.44.547 N052.28.40.773 E020.50.31.742
N052.28.40.773 E020.50.31.742 N052.28.46.537 E020.50.19.634
N052.28.46.537 E020.50.19.634 N052.28.51.987 E020.50.06.082
N052.28.51.987 E020.50.06.082 N052.28.57.162 E020.49.50.428
N052.28.57.162 E020.49.50.428 N052.29.01.882 E020.49.32.202
N052.29.01.882 E020.49.32.202 N052.29.05.678 E020.49.11.918
N052.29.05.678 E020.49.11.918 N052.29.07.857 E020.48.54.107
N052.29.07.857 E020.48.54.107 N052.29.09.070 E020.48.34.844
N052.29.09.070 E020.48.34.844 N052.29.09.096 E020.48.14.433
N052.29.09.096 E020.48.14.433 N052.29.07.845 E020.47.54.198
N052.29.07.845 E020.47.54.198 N052.29.06.055 E020.47.39.064
N052.29.06.055 E020.47.39.064 N052.29.03.019 E020.47.21.540
N052.29.03.019 E020.47.21.540 N052.28.59.467 E020.47.06.266
N052.28.59.467 E020.47.06.266 N052.28.52.949 E020.46.45.117
N052.28.52.949 E020.46.45.117 N052.28.24.376 E020.45.18.618
N052.28.24.376 E020.45.18.618 N052.28.14.810 E020.44.54.154
N052.28.14.810 E020.44.54.154 N052.28.04.167 E020.44.33.906
N052.28.04.167 E020.44.33.906 N052.27.53.795 E020.44.18.563
N052.27.53.795 E020.44.18.563 N052.27.44.133 E020.44.07.093
N052.27.44.133 E020.44.07.093 N052.27.32.863 E020.43.56.428
N052.27.32.863 E020.43.56.428 N052.27.22.332 E020.43.48.680
N052.27.22.332 E020.43.48.680 N052.27.11.160 E020.43.42.502
N052.27.11.160 E020.43.42.502 N052.26.59.474 E020.43.38.078
N052.26.59.474 E020.43.38.078 N052.26.46.493 E020.43.35.440
N052.26.46.493 E020.43.35.440 N052.26.33.238 E020.43.35.124
N052.26.33.238 E020.43.35.124 N052.26.20.901 E020.43.36.979
N052.26.20.901 E020.43.36.979 N052.26.08.015 E020.43.41.192
N052.26.08.015 E020.43.41.192 N052.25.58.000 E020.43.46.170
N052.25.58.000 E020.43.46.170 N052.25.39.419 E020.43.59.486
N052.25.39.419 E020.43.59.486 N052.25.37.043 E020.44.01.365

N052.41.42.295 E019.49.11.803 N052.15.34.426 E020.17.52.131

N052.08.34.847 E021.05.20.592 N052.08.36.773 E021.05.22.101
N052.08.36.773 E021.05.22.101 N052.08.38.721 E021.05.23.581
N052.08.38.721 E021.05.23.581 N052.08.40.689 E021.05.25.034
N052.08.40.689 E021.05.25.034 N052.08.42.678 E021.05.26.458
N052.08.42.678 E021.05.26.458 N052.08.44.688 E021.05.27.853
N052.08.44.688 E021.05.27.853 N052.08.46.717 E021.05.29.220
N052.08.46.717 E021.05.29.220 N052.08.48.765 E021.05.30.557
N052.08.48.765 E021.05.30.557 N052.08.50.833 E021.05.31.864
N052.08.50.833 E021.05.31.864 N052.08.52.919 E021.05.33.142
N052.08.52.919 E021.05.33.142 N052.08.55.024 E021.05.34.389
N052.08.55.024 E021.05.34.389 N052.08.57.146 E021.05.35.606
N052.08.57.146 E021.05.35.606 N052.08.59.285 E021.05.36.793
N052.08.59.285 E021.05.36.793 N052.09.01.441 E021.05.37.948
N052.09.01.441 E021.05.37.948 N052.09.03.614 E021.05.39.073
N052.09.03.614 E021.05.39.073 N052.09.05.802 E021.05.40.166
N052.09.05.802 E021.05.40.166 N052.09.08.006 E021.05.41.228
N052.09.08.006 E021.05.41.228 N052.09.10.225 E021.05.42.258
N052.09.10.225 E021.05.42.258 N052.09.12.458 E021.05.43.256
N052.09.12.458 E021.05.43.256 N052.09.14.706 E021.05.44.221
N052.09.14.706 E021.05.44.221 N052.09.16.967 E021.05.45.155
N052.09.16.967 E021.05.45.155 N052.09.19.242 E021.05.46.055
N052.09.19.242 E021.05.46.055 N052.09.21.529 E021.05.46.923
N052.09.21.529 E021.05.46.923 N052.09.23.828 E021.05.47.759
N052.09.23.828 E021.05.47.759 N052.09.26.140 E021.05.48.560
N052.09.26.140 E021.05.48.560 N052.09.28.462 E021.05.49.329
N052.09.28.462 E021.05.49.329 N052.09.30.795 E021.05.50.064
N052.09.30.795 E021.05.50.064 N052.09.33.139 E021.05.50.766
N052.09.33.139 E021.05.50.766 N052.09.35.492 E021.05.51.434
N052.09.35.492 E021.05.51.434 N052.09.37.855 E021.05.52.068
N052.09.37.855 E021.05.52.068 N052.09.40.226 E021.05.52.668
N052.09.40.226 E021.05.52.668 N052.09.42.606 E021.05.53.233
N052.09.42.606 E021.05.53.233 N052.09.44.994 E021.05.53.765
N052.09.44.994 E021.05.53.765 N052.09.47.390 E021.05.54.262
N052.09.47.390 E021.05.54.262 N052.09.49.792 E021.05.54.725
N052.09.49.792 E021.05.54.725 N052.09.52.200 E021.05.55.153
N052.09.52.200 E021.05.55.153 N052.09.54.615 E021.05.55.547
N052.09.54.615 E021.05.55.547 N052.09.57.035 E021.05.55.905
N052.09.57.035 E021.05.55.905 N052.09.59.459 E021.05.56.229
N052.09.59.459 E021.05.56.229 N052.10.01.889 E021.05.56.518
N052.10.01.889 E021.05.56.518 N052.10.04.322 E021.05.56.773
N052.10.04.322 E021.05.56.773 N052.10.06.758 E021.05.56.992
N052.10.06.758 E021.05.56.992 N052.10.09.197 E021.05.57.176
N052.10.09.197 E021.05.57.176 N052.10.11.639 E021.05.57.325
N052.10.11.639 E021.05.57.325 N052.10.14.083 E021.05.57.439
N052.10.14.083 E021.05.57.439 N052.10.16.528 E021.05.57.518
N052.10.16.528 E021.05.57.518 N052.10.18.974 E021.05.57.562
N052.10.18.974 E021.05.57.562 N052.10.21.420 E021.05.57.570
N052.10.21.420 E021.05.57.570 N052.10.23.866 E021.05.57.544
N052.10.23.866 E021.05.57.544 N052.10.26.312 E021.05.57.482
N052.10.26.312 E021.05.57.482 N052.10.28.756 E021.05.57.385
N052.10.28.756 E021.05.57.385 N052.10.31.199 E021.05.57.254
N052.10.31.199 E021.05.57.254 N052.10.33.640 E021.05.57.087
N052.10.33.640 E021.05.57.087 N052.10.36.078 E021.05.56.884
N052.10.36.078 E021.05.56.884 N052.10.38.512 E021.05.56.647
N052.10.38.512 E021.05.56.647 N052.10.40.944 E021.05.56.375
N052.10.40.944 E021.05.56.375 N052.10.43.371 E021.05.56.069
N052.10.43.371 E021.05.56.069 N052.10.45.793 E021.05.55.727
N052.10.45.793 E021.05.55.727 N052.10.48.210 E021.05.55.350
N052.10.48.210 E021.05.55.350 N052.10.50.622 E021.05.54.939
N052.10.50.622 E021.05.54.939 N052.10.53.027 E021.05.54.493
N052.10.53.027 E021.05.54.493 N052.10.55.426 E021.05.54.013
N052.10.55.426 E021.05.54.013 N052.10.57.817 E021.05.53.498
N052.10.57.817 E021.05.53.498 N052.11.00.201 E021.05.52.949
N052.11.00.201 E021.05.52.949 N052.11.02.577 E021.05.52.366
N052.11.02.577 E021.05.52.366 N052.11.04.944 E021.05.51.749
N052.11.04.944 E021.05.51.749 N052.11.07.302 E021.05.51.097
N052.11.07.302 E021.05.51.097 N052.11.09.650 E021.05.50.412
N052.11.09.650 E021.05.50.412 N052.11.11.989 E021.05.49.694
N052.11.11.989 E021.05.49.694 N052.11.14.317 E021.05.48.941
N052.11.14.317 E021.05.48.941 N052.11.16.633 E021.05.48.156
N052.11.16.633 E021.05.48.156 N052.11.18.939 E021.05.47.337
N052.11.18.939 E021.05.47.337 N052.11.21.232 E021.05.46.485
N052.11.21.232 E021.05.46.485 N052.11.23.513 E021.05.45.600
N052.11.23.513 E021.05.45.600 N052.11.25.780 E021.05.44.683
N052.11.25.780 E021.05.44.683 N052.11.28.035 E021.05.43.733
N052.11.28.035 E021.05.43.733 N052.11.30.275 E021.05.42.751
N052.11.30.275 E021.05.42.751 N052.11.32.501 E021.05.41.737
N052.11.32.501 E021.05.41.737 N052.11.34.713 E021.05.40.691
N052.11.34.713 E021.05.40.691 N052.11.36.909 E021.05.39.613
N052.11.36.909 E021.05.39.613 N052.11.39.089 E021.05.38.504
N052.11.39.089 E021.05.38.504 N052.11.41.253 E021.05.37.363
N052.11.41.253 E021.05.37.363 N052.11.43.401 E021.05.36.192
N052.11.43.401 E021.05.36.192 N052.11.45.532 E021.05.34.990
N052.11.45.532 E021.05.34.990 N052.11.47.645 E021.05.33.757
N052.11.47.645 E021.05.33.757 N052.11.49.740 E021.05.32.494
N052.11.49.740 E021.05.32.494 N052.11.51.817 E021.05.31.201
N052.11.51.817 E021.05.31.201 N052.11.53.875 E021.05.29.879
N052.11.53.875 E021.05.29.879 N052.11.55.913 E021.05.28.527
N052.11.55.913 E021.05.28.527 N052.11.57.933 E021.05.27.146
N052.11.57.933 E021.05.27.146 N052.11.59.932 E021.05.25.736
N052.11.59.932 E021.05.25.736 N052.12.01.910 E021.05.24.297
N052.12.01.910 E021.05.24.297 N052.12.03.868 E021.05.22.830
N052.12.03.868 E021.05.22.830 N052.12.05.804 E021.05.21.335
N052.12.05.804 E021.05.21.335 N052.12.07.719 E021.05.19.813
N052.12.07.719 E021.05.19.813 N052.12.09.612 E021.05.18.263
N052.12.09.612 E021.05.18.263 N052.12.11.482 E021.05.16.686
N052.12.11.482 E021.05.16.686 N052.12.13.330 E021.05.15.083
N052.12.13.330 E021.05.15.083 N052.12.15.154 E021.05.13.453
N052.12.15.154 E021.05.13.453 N052.12.16.954 E021.05.11.797
N052.12.16.954 E021.05.11.797 N052.12.18.731 E021.05.10.115
N052.12.18.731 E021.05.10.115 N052.12.20.483 E021.05.08.408




;;;;;;;;;;;;;;;;; HOLDINGS FOR STAR 15 ;;;;;;;;;;;;;;;;;;;
;Holding SORIX
N052.46.07.103 E019.50.21.047 N052.46.01.451 E019.50.58.416  ;
N052.46.01.451 E019.50.58.416 N052.45.51.984 E019.51.33.552  ;
N052.45.51.984 E019.51.33.552 N052.45.38.952 E019.52.05.447  ;
N052.45.38.952 E019.52.05.447 N052.45.22.752 E019.52.33.131  ;
N052.45.22.752 E019.52.33.131 N052.45.03.923 E019.52.55.775  ;
N052.45.03.923 E019.52.55.775 N052.44.42.971 E019.53.12.623  ;
N052.44.42.971 E019.53.12.623 N052.44.20.579 E019.53.23.244  ;
N052.44.20.579 E019.53.23.244 N052.43.57.396 E019.53.27.276  ;
N052.43.57.396 E019.53.27.276 N052.43.34.139 E019.53.24.576  ;
N052.43.34.139 E019.53.24.576 N052.43.11.532 E019.53.15.287  ;
N052.43.11.532 E019.53.15.287 N052.42.50.256 E019.52.59.628  ;
N052.42.50.256 E019.52.59.628 N052.42.30.924 E019.52.38.100  ;
N052.42.30.924 E019.52.38.100 N052.42.14.147 E019.52.11.352  ;
N052.42.14.147 E019.52.11.352 N052.42.00.468 E019.51.40.248  ;
N052.42.00.468 E019.51.40.248 N052.41.50.244 E019.51.05.651  ;
N052.41.50.244 E019.51.05.651 N052.41.43.835 E019.50.28.644  ;
N052.41.43.835 E019.50.28.644 N052.41.41.388 E019.49.50.376  ;
N052.41.41.388 E019.49.50.376 N052.41.43.007 E019.49.12.000  ;
N052.42.48.707 E019.37.46.919 N052.42.54.359 E019.37.09.588  ;
N052.42.54.359 E019.37.09.588 N052.43.03.828 E019.36.34.415  ;
N052.43.03.828 E019.36.34.415 N052.43.16.860 E019.36.02.484  ;
N052.43.16.860 E019.36.02.484 N052.43.33.060 E019.35.34.799  ;
N052.43.33.060 E019.35.34.799 N052.43.51.887 E019.35.12.156  ;
N052.43.51.887 E019.35.12.156 N052.44.12.839 E019.34.55.271  ;
N052.44.12.839 E019.34.55.271 N052.44.35.231 E019.34.44.652  ;
N052.44.35.231 E019.34.44.652 N052.44.58.416 E019.34.40.656  ;
N052.44.58.416 E019.34.40.656 N052.45.21.671 E019.34.43.320  ;
N052.45.21.671 E019.34.43.320 N052.45.44.280 E019.34.52.643  ;
N052.45.44.280 E019.34.52.643 N052.46.05.556 E019.35.08.304  ;
N052.46.05.556 E019.35.08.304 N052.46.24.888 E019.35.29.831  ;
N052.46.24.888 E019.35.29.831 N052.46.41.663 E019.35.56.579  ;
N052.46.41.663 E019.35.56.579 N052.46.55.344 E019.36.27.720  ;
N052.46.55.344 E019.36.27.720 N052.47.05.568 E019.37.02.315  ;
N052.47.05.568 E019.37.02.315 N052.47.11.975 E019.37.39.324  ;
N052.47.11.975 E019.37.39.324 N052.47.14.424 E019.38.17.628  ;
N052.47.14.424 E019.38.17.628 N052.47.12.803 E019.38.56.040  ;
N052.46.07.103 E019.50.21.047 N052.47.12.803 E019.38.56.040  ;Connecting line
N052.42.48.707 E019.37.46.919 N052.41.43.007 E019.49.12.000  ;Connecting line

;Holding BIMPA
N052.26.55.140 E019.46.21.360 N052.26.53.519 E019.46.59.448  ;
N052.26.53.519 E019.46.59.448 N052.26.47.867 E019.47.36.527  ;
N052.26.47.867 E019.47.36.527 N052.26.38.400 E019.48.11.448  ;
N052.26.38.400 E019.48.11.448 N052.26.25.367 E019.48.43.091  ;
N052.26.25.367 E019.48.43.091 N052.26.09.167 E019.49.10.596  ;
N052.26.09.167 E019.49.10.596 N052.25.50.339 E019.49.33.023  ;
N052.25.50.339 E019.49.33.023 N052.25.29.388 E019.49.49.800  ;
N052.25.29.388 E019.49.49.800 N052.25.06.996 E019.50.00.312  ;
N052.25.06.996 E019.50.00.312 N052.24.43.812 E019.50.04.308  ;
N052.24.43.812 E019.50.04.308 N052.24.20.555 E019.50.01.644  ;
N052.24.20.555 E019.50.01.644 N052.23.57.948 E019.49.52.391  ;
N052.23.57.948 E019.49.52.391 N052.23.36.672 E019.49.36.876  ;
N052.23.36.672 E019.49.36.876 N052.23.17.340 E019.49.15.491  ;
N052.23.17.340 E019.49.15.491 N052.23.00.564 E019.48.48.960  ;
N052.23.00.564 E019.48.48.960 N052.22.46.883 E019.48.18.071  ;
N052.22.46.883 E019.48.18.071 N052.22.36.659 E019.47.43.728  ;
N052.22.36.659 E019.47.43.728 N052.22.30.252 E019.47.07.008  ;
N052.22.30.252 E019.47.07.008 N052.22.27.803 E019.46.28.991  ;
N052.22.20.459 E019.35.00.564 N052.22.22.079 E019.34.22.476  ;
N052.22.22.079 E019.34.22.476 N052.22.27.731 E019.33.45.395  ;
N052.22.27.731 E019.33.45.395 N052.22.37.200 E019.33.10.512  ;
N052.22.37.200 E019.33.10.512 N052.22.50.232 E019.32.38.831  ;
N052.22.50.232 E019.32.38.831 N052.23.06.432 E019.32.11.364  ;
N052.23.06.432 E019.32.11.364 N052.23.25.259 E019.31.48.899  ;
N052.23.25.259 E019.31.48.899 N052.23.46.211 E019.31.32.160  ;
N052.23.46.211 E019.31.32.160 N052.24.08.603 E019.31.21.612  ;
N052.24.08.603 E019.31.21.612 N052.24.31.788 E019.31.17.616  ;
N052.24.31.788 E019.31.17.616 N052.24.55.043 E019.31.20.280  ;
N052.24.55.043 E019.31.20.280 N052.25.17.652 E019.31.29.531  ;
N052.25.17.652 E019.31.29.531 N052.25.38.928 E019.31.45.083  ;
N052.25.38.928 E019.31.45.083 N052.25.58.260 E019.32.06.431  ;
N052.25.58.260 E019.32.06.431 N052.26.15.036 E019.32.32.964  ;
N052.26.15.036 E019.32.32.964 N052.26.28.716 E019.33.03.887  ;
N052.26.28.716 E019.33.03.887 N052.26.38.940 E019.33.38.196  ;
N052.26.38.940 E019.33.38.196 N052.26.45.347 E019.34.14.916  ;
N052.26.45.347 E019.34.14.916 N052.26.47.795 E019.34.52.931  ;
N052.26.55.140 E019.46.21.360 N052.26.47.795 E019.34.52.931  ;Connecting line
N052.22.20.459 E019.35.00.564 N052.22.27.803 E019.46.28.991  ;Connecting line

;Holding BEMRA
N051.49.50.700 E020.52.49.584 N051.50.07.296 E020.52.51.924  ;
N051.50.07.296 E020.52.51.924 N051.50.23.352 E020.52.58.908  ;
N051.50.23.352 E020.52.58.908 N051.50.38.435 E020.53.10.283  ;
N051.50.38.435 E020.53.10.283 N051.50.52.079 E020.53.25.728  ;
N051.50.52.079 E020.53.25.728 N051.51.03.851 E020.53.44.771  ;
N051.51.03.851 E020.53.44.771 N051.51.13.392 E020.54.06.840  ;
N051.51.13.392 E020.54.06.840 N051.51.20.447 E020.54.31.248  ;
N051.51.20.447 E020.54.31.248 N051.51.24.732 E020.54.57.276  ;
N051.51.24.732 E020.54.57.276 N051.51.26.208 E020.55.24.095  ;
N051.51.26.208 E020.55.24.095 N051.51.24.732 E020.55.50.916  ;
N051.51.24.732 E020.55.50.916 N051.51.20.447 E020.56.16.944  ;
N051.51.20.447 E020.56.16.944 N051.51.13.392 E020.56.41.351  ;
N051.51.13.392 E020.56.41.351 N051.51.03.851 E020.57.03.419  ;
N051.51.03.851 E020.57.03.419 N051.50.52.079 E020.57.22.464  ;
N051.50.52.079 E020.57.22.464 N051.50.38.435 E020.57.37.907  ;
N051.50.38.435 E020.57.37.907 N051.50.23.352 E020.57.49.283  ;
N051.50.23.352 E020.57.49.283 N051.50.07.296 E020.57.56.268  ;
N051.50.07.296 E020.57.56.268 N051.49.50.700 E020.57.58.608  ;
N051.44.50.711 E020.57.58.320 N051.44.34.115 E020.57.55.980  ;
N051.44.34.115 E020.57.55.980 N051.44.18.059 E020.57.49.031  ;
N051.44.18.059 E020.57.49.031 N051.44.02.976 E020.57.37.656  ;
N051.44.02.976 E020.57.37.656 N051.43.49.332 E020.57.22.247  ;
N051.43.49.332 E020.57.22.247 N051.43.37.560 E020.57.03.240  ;
N051.43.37.560 E020.57.03.240 N051.43.28.019 E020.56.41.208  ;
N051.43.28.019 E020.56.41.208 N051.43.20.964 E020.56.16.835  ;
N051.43.20.964 E020.56.16.835 N051.43.16.679 E020.55.50.880  ;
N051.43.16.679 E020.55.50.880 N051.43.15.203 E020.55.24.095  ;
N051.43.15.203 E020.55.24.095 N051.43.16.679 E020.54.57.311  ;
N051.43.16.679 E020.54.57.311 N051.43.20.964 E020.54.31.355  ;
N051.43.20.964 E020.54.31.355 N051.43.28.019 E020.54.06.983  ;
N051.43.28.019 E020.54.06.983 N051.43.37.560 E020.53.44.952  ;
N051.43.37.560 E020.53.44.952 N051.43.49.332 E020.53.25.944  ;
N051.43.49.332 E020.53.25.944 N051.44.02.976 E020.53.10.536  ;
N051.44.02.976 E020.53.10.536 N051.44.18.059 E020.52.59.159  ;
N051.44.18.059 E020.52.59.159 N051.44.34.115 E020.52.52.212  ;
N051.44.34.115 E020.52.52.212 N051.44.50.711 E020.52.49.872  ;
N051.49.50.700 E020.52.49.584 N051.44.50.711 E020.52.49.872  ;Connecting line
N051.44.50.711 E020.57.58.320 N051.49.50.700 E020.57.58.608  ;Connecting line

;Holding AGAVA
N051.39.20.447 E019.57.46.188 N051.39.18.000 E019.58.23.519  ;
N051.39.18.000 E019.58.23.519 N051.39.11.591 E019.58.59.591  ;
N051.39.11.591 E019.58.59.591 N051.39.01.367 E019.59.33.323  ;
N051.39.01.367 E019.59.33.323 N051.38.47.688 E020.00.03.708  ;
N051.38.47.688 E020.00.03.708 N051.38.30.911 E020.00.29.771  ;
N051.38.30.911 E020.00.29.771 N051.38.11.579 E020.00.50.759  ;
N051.38.11.579 E020.00.50.759 N051.37.50.303 E020.01.06.023  ;
N051.37.50.303 E020.01.06.023 N051.37.27.696 E020.01.15.095  ;
N051.37.27.696 E020.01.15.095 N051.37.04.439 E020.01.17.723  ;
N051.37.04.439 E020.01.17.723 N051.36.41.256 E020.01.13.799  ;
N051.36.41.256 E020.01.13.799 N051.36.18.864 E020.01.03.468  ;
N051.36.18.864 E020.01.03.468 N051.35.57.912 E020.00.47.015  ;
N051.35.57.912 E020.00.47.015 N051.35.39.083 E020.00.24.948  ;
N051.35.39.083 E020.00.24.948 N051.35.22.883 E019.59.57.948  ;
N051.35.22.883 E019.59.57.948 N051.35.09.851 E019.59.26.844  ;
N051.35.09.851 E019.59.26.844 N051.35.00.384 E019.58.52.535  ;
N051.35.00.384 E019.58.52.535 N051.34.54.732 E019.58.16.140  ;
N051.34.54.732 E019.58.16.140 N051.34.53.112 E019.57.38.700  ;
N051.35.00.456 E019.46.22.368 N051.35.02.903 E019.45.45.035  ;
N051.35.02.903 E019.45.45.035 N051.35.09.312 E019.45.08.927  ;
N051.35.09.312 E019.45.08.927 N051.35.19.536 E019.44.35.196  ;
N051.35.19.536 E019.44.35.196 N051.35.33.215 E019.44.04.848  ;
N051.35.33.215 E019.44.04.848 N051.35.49.992 E019.43.38.784  ;
N051.35.49.992 E019.43.38.784 N051.36.09.323 E019.43.17.795  ;
N051.36.09.323 E019.43.17.795 N051.36.30.599 E019.43.02.531  ;
N051.36.30.599 E019.43.02.531 N051.36.53.208 E019.42.53.423  ;
N051.36.53.208 E019.42.53.423 N051.37.16.464 E019.42.50.832  ;
N051.37.16.464 E019.42.50.832 N051.37.39.647 E019.42.54.755  ;
N051.37.39.647 E019.42.54.755 N051.38.02.039 E019.43.05.088  ;
N051.38.02.039 E019.43.05.088 N051.38.22.991 E019.43.21.540  ;
N051.38.22.991 E019.43.21.540 N051.38.41.820 E019.43.43.608  ;
N051.38.41.820 E019.43.43.608 N051.38.58.020 E019.44.10.608  ;
N051.38.58.020 E019.44.10.608 N051.39.11.051 E019.44.41.712  ;
N051.39.11.051 E019.44.41.712 N051.39.20.520 E019.45.16.019  ;
N051.39.20.520 E019.45.16.019 N051.39.26.171 E019.45.52.415  ;
N051.39.26.171 E019.45.52.415 N051.39.27.791 E019.46.29.856  ;
N051.39.20.447 E019.57.46.188 N051.39.27.791 E019.46.29.856  ;Connecting line
N051.35.00.456 E019.46.22.368 N051.34.53.112 E019.57.38.700  ;Connecting line

;Holding LOGDA
N051.17.03.983 E020.41.38.039 N051.17.24.576 E020.41.55.536  ;
N051.17.24.576 E020.41.55.536 N051.17.42.935 E020.42.18.468  ;
N051.17.42.935 E020.42.18.468 N051.17.58.524 E020.42.46.152  ;
N051.17.58.524 E020.42.46.152 N051.18.10.871 E020.43.17.723  ;
N051.18.10.871 E020.43.17.723 N051.18.19.583 E020.43.52.284  ;
N051.18.19.583 E020.43.52.284 N051.18.24.443 E020.44.28.715  ;
N051.18.24.443 E020.44.28.715 N051.18.25.272 E020.45.05.940  ;
N051.18.25.272 E020.45.05.940 N051.18.21.995 E020.45.42.804  ;
N051.18.21.995 E020.45.42.804 N051.18.14.796 E020.46.18.228  ;
N051.18.14.796 E020.46.18.228 N051.18.03.852 E020.46.51.132  ;
N051.18.03.852 E020.46.51.132 N051.17.49.523 E020.47.20.472  ;
N051.17.49.523 E020.47.20.472 N051.17.32.207 E020.47.45.384  ;
N051.17.32.207 E020.47.45.384 N051.17.12.444 E020.48.05.147  ;
N051.17.12.444 E020.48.05.147 N051.16.50.844 E020.48.19.079  ;
N051.16.50.844 E020.48.19.079 N051.16.28.055 E020.48.26.819  ;
N051.16.28.055 E020.48.26.819 N051.16.04.763 E020.48.28.115  ;
N051.16.04.763 E020.48.28.115 N051.15.41.688 E020.48.22.932  ;
N051.15.41.688 E020.48.22.932 N051.15.19.512 E020.48.11.448  ;
N051.08.52.907 E020.43.48.684 N051.08.32.316 E020.43.31.223  ;
N051.08.32.316 E020.43.31.223 N051.08.13.956 E020.43.08.364  ;
N051.08.13.956 E020.43.08.364 N051.07.58.368 E020.42.40.752  ;
N051.07.58.368 E020.42.40.752 N051.07.46.019 E020.42.09.215  ;
N051.07.46.019 E020.42.09.215 N051.07.37.307 E020.41.34.764  ;
N051.07.37.307 E020.41.34.764 N051.07.32.448 E020.40.58.440  ;
N051.07.32.448 E020.40.58.440 N051.07.31.620 E020.40.21.287  ;
N051.07.31.620 E020.40.21.287 N051.07.34.895 E020.39.44.495  ;
N051.07.34.895 E020.39.44.495 N051.07.42.096 E020.39.09.143  ;
N051.07.42.096 E020.39.09.143 N051.07.53.039 E020.38.36.347  ;
N051.07.53.039 E020.38.36.347 N051.08.07.367 E020.38.07.044  ;
N051.08.07.367 E020.38.07.044 N051.08.24.683 E020.37.42.203  ;
N051.08.24.683 E020.37.42.203 N051.08.44.447 E020.37.22.512  ;
N051.08.44.447 E020.37.22.512 N051.09.06.047 E020.37.08.580  ;
N051.09.06.047 E020.37.08.580 N051.09.28.835 E020.37.00.840  ;
N051.09.28.835 E020.37.00.840 N051.09.52.127 E020.36.59.544  ;
N051.09.52.127 E020.36.59.544 N051.10.15.203 E020.37.04.727  ;
N051.10.15.203 E020.37.04.727 N051.10.37.380 E020.37.16.211  ;
N051.17.03.983 E020.41.38.039 N051.10.37.380 E020.37.16.211  ;Connecting line
N051.08.52.907 E020.43.48.684 N051.15.19.512 E020.48.11.448  ;Connecting line

;Holding EMKEN
N051.58.15.096 E021.19.54.516 N051.58.22.151 E021.19.29.999  ;
N051.58.22.151 E021.19.29.999 N051.58.31.692 E021.19.07.860  ;
N051.58.31.692 E021.19.07.860 N051.58.43.464 E021.18.48.743  ;
N051.58.43.464 E021.18.48.743 N051.58.57.107 E021.18.33.227  ;
N051.58.57.107 E021.18.33.227 N051.59.12.191 E021.18.21.815  ;
N051.59.12.191 E021.18.21.815 N051.59.28.247 E021.18.14.796  ;
N051.59.28.247 E021.18.14.796 N051.59.44.843 E021.18.12.456  ;
N051.59.44.843 E021.18.12.456 N052.00.01.439 E021.18.14.796  ;
N052.00.01.439 E021.18.14.796 N052.00.17.496 E021.18.21.815  ;
N052.00.17.496 E021.18.21.815 N052.00.32.580 E021.18.33.227  ;
N052.00.32.580 E021.18.33.227 N052.00.46.223 E021.18.48.743  ;
N052.00.46.223 E021.18.48.743 N052.00.57.995 E021.19.07.860  ;
N052.00.57.995 E021.19.07.860 N052.01.07.536 E021.19.29.999  ;
N052.01.07.536 E021.19.29.999 N052.01.14.591 E021.19.54.516  ;
N052.01.14.591 E021.19.54.516 N052.01.18.875 E021.20.20.615  ;
N052.01.18.875 E021.20.20.615 N052.01.20.352 E021.20.47.544  ;
N052.01.20.352 E021.20.47.544 N052.01.18.875 E021.21.14.471  ;
N052.01.18.875 E021.21.14.471 N052.01.14.591 E021.21.40.572  ;
N051.59.31.992 E021.29.18.420 N051.59.24.935 E021.29.42.899  ;
N051.59.24.935 E021.29.42.899 N051.59.15.395 E021.30.05.004  ;
N051.59.15.395 E021.30.05.004 N051.59.03.624 E021.30.24.119  ;
N051.59.03.624 E021.30.24.119 N051.58.49.980 E021.30.39.635  ;
N051.58.49.980 E021.30.39.635 N051.58.34.895 E021.30.51.047  ;
N051.58.34.895 E021.30.51.047 N051.58.18.839 E021.30.58.032  ;
N051.58.18.839 E021.30.58.032 N051.58.02.243 E021.31.00.372  ;
N051.58.02.243 E021.31.00.372 N051.57.45.647 E021.30.58.032  ;
N051.57.45.647 E021.30.58.032 N051.57.29.591 E021.30.51.047  ;
N051.57.29.591 E021.30.51.047 N051.57.14.508 E021.30.39.635  ;
N051.57.14.508 E021.30.39.635 N051.57.00.864 E021.30.24.119  ;
N051.57.00.864 E021.30.24.119 N051.56.49.092 E021.30.05.004  ;
N051.56.49.092 E021.30.05.004 N051.56.39.551 E021.29.42.899  ;
N051.56.39.551 E021.29.42.899 N051.56.32.496 E021.29.18.420  ;
N051.56.32.496 E021.29.18.420 N051.56.28.211 E021.28.52.320  ;
N051.56.28.211 E021.28.52.320 N051.56.26.735 E021.28.25.392  ;
N051.56.26.735 E021.28.25.392 N051.56.28.211 E021.27.58.463  ;
N051.56.28.211 E021.27.58.463 N051.56.32.496 E021.27.32.364  ;
N051.58.15.096 E021.19.54.516 N051.56.32.496 E021.27.32.364  ;Connecting line
N051.59.31.992 E021.29.18.420 N052.01.14.591 E021.21.40.572  ;Connecting line


;Holding LIMVI 
N051.44.41.999 E021.41.07.943 N051.45.02.196 E021.40.49.115  ;
N051.45.02.196 E021.40.49.115 N051.45.24.083 E021.40.36.227  ;
N051.45.24.083 E021.40.36.227 N051.45.47.016 E021.40.29.676  ;
N051.45.47.016 E021.40.29.676 N051.46.10.343 E021.40.29.676  ;
N051.46.10.343 E021.40.29.676 N051.46.33.276 E021.40.36.227  ;
N051.46.33.276 E021.40.36.227 N051.46.55.164 E021.40.49.115  ;
N051.46.55.164 E021.40.49.115 N051.47.15.359 E021.41.07.943  ;
N051.47.15.359 E021.41.07.943 N051.47.33.216 E021.41.32.136  ;
N051.47.33.216 E021.41.32.136 N051.47.48.192 E021.42.00.971  ;
N051.47.48.192 E021.42.00.971 N051.47.59.855 E021.42.33.588  ;
N051.47.59.855 E021.42.33.588 N051.48.07.811 E021.43.08.975  ;
N051.48.07.811 E021.43.08.975 N051.48.11.843 E021.43.46.055  ;
N051.48.11.843 E021.43.46.055 N051.48.11.843 E021.44.23.712  ;
N051.48.11.843 E021.44.23.712 N051.48.07.811 E021.45.00.791  ;
N051.48.07.811 E021.45.00.791 N051.47.59.855 E021.45.36.179  ;
N051.47.59.855 E021.45.36.179 N051.47.48.192 E021.46.08.796  ;
N051.47.48.192 E021.46.08.796 N051.47.33.216 E021.46.37.632  ;
N051.47.33.216 E021.46.37.632 N051.47.15.359 E021.47.01.824  ;
N051.41.31.308 E021.53.30.732 N051.41.11.111 E021.53.49.523  ;
N051.41.11.111 E021.53.49.523 N051.40.49.224 E021.54.02.375  ;
N051.40.49.224 E021.54.02.375 N051.40.26.291 E021.54.08.892  ;
N051.40.26.291 E021.54.08.892 N051.40.02.964 E021.54.08.892  ;
N051.40.02.964 E021.54.08.892 N051.39.40.031 E021.54.02.375  ;
N051.39.40.031 E021.54.02.375 N051.39.18.143 E021.53.49.523  ;
N051.39.18.143 E021.53.49.523 N051.38.57.948 E021.53.30.732  ;
N051.38.57.948 E021.53.30.732 N051.38.40.091 E021.53.06.575  ;
N051.38.40.091 E021.53.06.575 N051.38.25.115 E021.52.37.811  ;
N051.38.25.115 E021.52.37.811 N051.38.13.452 E021.52.05.268  ;
N051.38.13.452 E021.52.05.268 N051.38.05.496 E021.51.29.951  ;
N051.38.05.496 E021.51.29.951 N051.38.01.464 E021.50.52.944  ;
N051.38.01.464 E021.50.52.944 N051.38.01.464 E021.50.15.359  ;
N051.38.01.464 E021.50.15.359 N051.38.05.496 E021.49.38.352  ;
N051.38.05.496 E021.49.38.352 N051.38.13.452 E021.49.03.035  ;
N051.38.13.452 E021.49.03.035 N051.38.25.115 E021.48.30.491  ;
N051.38.25.115 E021.48.30.491 N051.38.40.091 E021.48.01.728  ;
N051.38.40.091 E021.48.01.728 N051.38.57.948 E021.47.37.571  ;
N051.44.41.999 E021.41.07.943 N051.38.57.948 E021.47.37.571  ;Connecting line
N051.41.31.308 E021.53.30.732 N051.47.15.359 E021.47.01.824  ;Connecting line    

;Holding INREN
N052.18.22.247 E020.20.24.504 N052.18.12.923 E020.20.47.075  ;
N052.18.12.923 E020.20.47.075 N052.18.01.367 E020.21.06.623  ;
N052.18.01.367 E020.21.06.623 N052.17.47.903 E020.21.22.644  ;
N052.17.47.903 E020.21.22.644 N052.17.32.964 E020.21.34.560  ;
N052.17.32.964 E020.21.34.560 N052.17.16.944 E020.21.42.047  ;
N052.17.16.944 E020.21.42.047 N052.17.00.383 E020.21.44.891  ;
N052.17.00.383 E020.21.44.891 N052.16.43.787 E020.21.43.020  ;
N052.16.43.787 E020.21.43.020 N052.16.27.624 E020.21.36.431  ;
N052.16.27.624 E020.21.36.431 N052.16.12.431 E020.21.25.344  ;
N052.16.12.431 E020.21.25.344 N052.15.58.643 E020.21.10.152  ;
N052.15.58.643 E020.21.10.152 N052.15.46.655 E020.20.51.252  ;
N052.15.46.655 E020.20.51.252 N052.15.36.864 E020.20.29.219  ;
N052.15.36.864 E020.20.29.219 N052.15.29.592 E020.20.04.775  ;
N052.15.29.592 E020.20.04.775 N052.15.24.984 E020.19.38.604  ;
N052.15.24.984 E020.19.38.604 N052.15.23.255 E020.19.11.568  ;
N052.15.23.255 E020.19.11.568 N052.15.24.407 E020.18.44.423  ;
N052.15.24.407 E020.18.44.423 N052.15.28.439 E020.18.17.999  ;
N052.15.28.439 E020.18.17.999 N052.15.35.207 E020.17.53.160  ;
N052.18.00.647 E020.10.44.184 N052.18.09.972 E020.10.21.612  ;
N052.18.09.972 E020.10.21.612 N052.18.21.527 E020.10.02.027  ;
N052.18.21.527 E020.10.02.027 N052.18.34.991 E020.09.46.008  ;
N052.18.34.991 E020.09.46.008 N052.18.49.932 E020.09.34.055  ;
N052.18.49.932 E020.09.34.055 N052.19.05.951 E020.09.26.567  ;
N052.19.05.951 E020.09.26.567 N052.19.22.512 E020.09.23.724  ;
N052.19.22.512 E020.09.23.724 N052.19.39.108 E020.09.25.631  ;
N052.19.39.108 E020.09.25.631 N052.19.55.271 E020.09.32.220  ;
N052.19.55.271 E020.09.32.220 N052.20.10.463 E020.09.43.271  ;
N052.20.10.463 E020.09.43.271 N052.20.24.251 E020.09.58.500  ;
N052.20.24.251 E020.09.58.500 N052.20.36.240 E020.10.17.436  ;
N052.20.36.240 E020.10.17.436 N052.20.46.031 E020.10.39.468  ;
N052.20.46.031 E020.10.39.468 N052.20.53.304 E020.11.03.947  ;
N052.20.53.304 E020.11.03.947 N052.20.57.912 E020.11.30.120  ;
N052.20.57.912 E020.11.30.120 N052.20.59.639 E020.11.57.192  ;
N052.20.59.639 E020.11.57.192 N052.20.58.488 E020.12.24.371  ;
N052.20.58.488 E020.12.24.371 N052.20.54.456 E020.12.50.796  ;
N052.20.54.456 E020.12.50.796 N052.20.47.688 E020.13.15.671  ;
N052.18.22.247 E020.20.24.504 N052.20.47.688 E020.13.15.671  ;Connecting line
N052.18.00.647 E020.10.44.184 N052.15.35.207 E020.17.53.160  ;Connecting line 

-EPWA 29 N052.41.42.295 E019.49.11.803 N052.26.01.967 E020.34.18.689
N052.26.01.967 E020.34.18.689 N052.22.42.295 E020.43.39.344
N052.22.42.295 E020.43.39.344 N052.17.31.475 E020.58.12.787
N052.17.31.475 E020.58.12.787 N052.16.15.738 E021.01.43.279
N052.16.15.738 E021.01.43.279 N052.13.46.230 E021.03.52.131
N052.13.46.230 E021.03.52.131 N052.09.39.344 E021.18.26.557
N052.09.39.344 E021.18.26.557 N052.09.03.934 E021.20.35.410
N052.09.03.934 E021.20.35.410 N052.07.60.000 E021.24.19.672
N052.07.60.000 E021.24.19.672 N052.07.11.008 E021.27.10.612
N052.07.11.008 E021.27.10.612 N052.07.05.679 E021.27.26.016
N052.07.05.679 E021.27.26.016 N052.06.59.041 E021.27.42.948
N052.06.59.041 E021.27.42.948 N052.06.51.019 E021.27.59.570
N052.06.51.019 E021.27.59.570 N052.06.40.672 E021.28.16.190
N052.06.40.672 E021.28.16.190 N052.06.29.319 E021.28.30.497
N052.06.29.319 E021.28.30.497 N052.06.18.230 E021.28.41.511
N052.06.18.230 E021.28.41.511 N052.06.00.777 E021.28.54.447
N052.06.00.777 E021.28.54.447 N052.05.48.969 E021.29.00.440
N052.05.48.969 E021.29.00.440 N052.05.36.007 E021.29.04.742
N052.05.36.007 E021.29.04.742 N052.05.20.082 E021.29.06.560
N052.05.20.082 E021.29.06.560 N052.05.07.992 E021.29.05.745
N052.05.07.992 E021.29.05.745 N052.04.56.085 E021.29.03.460
N052.04.56.085 E021.29.03.460 N052.04.40.731 E021.28.56.399
N052.04.40.731 E021.28.56.399 N052.04.26.406 E021.28.48.277
N052.04.26.406 E021.28.48.277 N052.03.31.974 E021.28.07.230
N052.03.31.974 E021.28.07.230 N052.03.17.325 E021.27.52.719
N052.03.17.325 E021.27.52.719 N052.03.04.060 E021.27.35.111
N052.03.04.060 E021.27.35.111 N052.02.55.424 E021.27.20.835
N052.02.55.424 E021.27.20.835 N052.02.48.574 E021.27.06.888
N052.02.48.574 E021.27.06.888 N052.02.40.828 E021.26.47.171
N052.02.40.828 E021.26.47.171 N052.02.32.370 E021.26.16.802
N052.02.32.370 E021.26.16.802 N052.02.27.670 E021.25.47.750
N052.02.27.670 E021.25.47.750 N052.02.25.381 E021.25.14.065
N052.02.25.381 E021.25.14.065 N052.02.26.258 E021.24.49.789
N052.02.26.258 E021.24.49.789 N052.02.29.730 E021.24.19.310
N052.02.29.730 E021.24.19.310 N052.02.35.435 E021.23.53.112
N052.02.35.435 E021.23.53.112 N052.02.40.224 E021.23.36.304
N052.02.40.224 E021.23.36.304 N052.03.26.557 E021.20.55.082

N052.09.32.459 E021.59.56.066 N052.12.06.426 E021.54.22.070
N052.12.06.426 E021.54.22.070 N052.12.20.251 E021.53.52.021
N052.12.20.251 E021.53.52.021 N052.12.29.106 E021.53.29.768
N052.12.29.106 E021.53.29.768 N052.12.40.303 E021.52.58.451
N052.12.40.303 E021.52.58.451 N052.12.51.713 E021.52.20.373
N052.12.51.713 E021.52.20.373 N052.13.00.737 E021.51.43.294
N052.13.00.737 E021.51.43.294 N052.13.08.365 E021.51.03.299
N052.13.08.365 E021.51.03.299 N052.13.12.383 E021.50.36.094
N052.13.12.383 E021.50.36.094 N052.13.15.674 E021.50.07.054
N052.13.15.674 E021.50.07.054 N052.13.18.083 E021.49.36.055
N052.13.18.083 E021.49.36.055 N052.13.19.384 E021.49.06.153
N052.13.19.384 E021.49.06.153 N052.13.19.761 E021.48.42.740
N052.13.19.761 E021.48.42.740 N052.13.23.607 E021.44.39.344
N052.13.23.607 E021.44.39.344 N052.13.30.492 E021.36.55.082
N052.13.30.492 E021.36.55.082 N052.13.39.827 E021.25.57.582
N052.13.39.827 E021.25.57.582 N052.13.40.013 E021.25.43.683
N052.13.40.013 E021.25.43.683 N052.13.39.561 E021.25.28.900
N052.13.39.561 E021.25.28.900 N052.13.38.616 E021.25.13.762
N052.13.38.616 E021.25.13.762 N052.13.37.012 E021.25.02.789
N052.13.37.012 E021.25.02.789 N052.13.34.130 E021.24.48.498
N052.13.34.130 E021.24.48.498 N052.13.31.037 E021.24.35.467
N052.13.31.037 E021.24.35.467 N052.13.27.555 E021.24.25.610
N052.13.27.555 E021.24.25.610 N052.13.24.184 E021.24.16.068
N052.13.24.184 E021.24.16.068 N052.13.20.212 E021.24.07.920
N052.13.20.212 E021.24.07.920 N052.13.15.773 E021.23.58.813
N052.13.15.773 E021.23.58.813 N052.13.10.205 E021.23.50.390
N052.13.10.205 E021.23.50.390 N052.13.05.391 E021.23.43.108
N052.13.05.391 E021.23.43.108 N052.12.59.686 E021.23.36.679
N052.12.59.686 E021.23.36.679 N052.12.55.264 E021.23.31.695
N052.12.55.264 E021.23.31.695 N052.12.49.423 E021.23.26.462
N052.12.49.423 E021.23.26.462 N052.10.55.692 E021.22.00.119
N052.10.55.692 E021.22.00.119 N052.10.45.192 E021.21.53.167
N052.10.45.192 E021.21.53.167 N052.10.34.747 E021.21.47.287
N052.10.34.747 E021.21.47.287 N052.10.25.546 E021.21.42.771
N052.10.25.546 E021.21.42.771 N052.10.16.991 E021.21.40.737
N052.10.16.991 E021.21.40.737 N052.10.06.703 E021.21.38.617
N052.10.06.703 E021.21.38.617 N052.09.51.853 E021.21.39.019
N052.09.51.853 E021.21.39.019 N052.09.35.613 E021.21.42.902
N052.09.35.613 E021.21.42.902 N052.09.22.921 E021.21.48.931
N052.09.22.921 E021.21.48.931 N052.09.11.723 E021.21.56.366
N052.09.11.723 E021.21.56.366 N052.09.01.244 E021.22.04.943
N052.09.01.244 E021.22.04.943 N052.08.50.499 E021.22.16.437
N052.08.50.499 E021.22.16.437 N052.08.41.444 E021.22.29.072
N052.08.41.444 E021.22.29.072 N052.08.33.828 E021.22.41.638
N052.08.33.828 E021.22.41.638 N052.08.27.850 E021.22.53.366
N052.08.27.850 E021.22.53.366 N052.08.17.262 E021.23.19.179
N052.08.17.262 E021.23.19.179 N052.07.60.000 E021.24.19.672

N051.44.41.311 E021.41.07.869 N051.54.16.721 E021.42.17.705
N051.54.16.721 E021.42.17.705 N052.03.46.230 E021.43.27.541
N052.03.46.230 E021.43.27.541 N052.08.42.598 E021.44.04.323
N052.08.42.598 E021.44.04.323 N052.09.06.558 E021.44.04.347
N052.09.06.558 E021.44.04.347 N052.09.23.119 E021.44.04.363
N052.09.23.119 E021.44.04.363 N052.09.46.483 E021.43.58.841
N052.09.46.483 E021.43.58.841 N052.10.06.463 E021.43.52.611
N052.10.06.463 E021.43.52.611 N052.10.31.979 E021.43.40.847
N052.10.31.979 E021.43.40.847 N052.10.54.555 E021.43.24.993
N052.10.54.555 E021.43.24.993 N052.11.18.800 E021.43.04.464
N052.11.18.800 E021.43.04.464 N052.11.40.083 E021.42.41.941
N052.11.40.083 E021.42.41.941 N052.12.00.622 E021.42.15.881
N052.12.00.622 E021.42.15.881 N052.12.16.400 E021.41.49.859
N052.12.16.400 E021.41.49.859 N052.12.34.845 E021.41.14.414
N052.12.34.845 E021.41.14.414 N052.12.51.469 E021.40.35.812
N052.12.51.469 E021.40.35.812 N052.13.07.718 E021.39.44.608
N052.13.07.718 E021.39.44.608 N052.13.17.387 E021.39.04.996
N052.13.17.387 E021.39.04.996 N052.13.24.024 E021.38.23.885
N052.13.24.024 E021.38.23.885 N052.13.28.083 E021.37.32.100
N052.13.28.083 E021.37.32.100 N052.13.30.492 E021.36.55.082

N051.17.03.934 E020.41.37.377 N051.33.16.721 E020.53.08.852
N051.33.16.721 E020.53.08.852 N051.37.48.197 E020.56.23.607
N051.37.48.197 E020.56.23.607 N051.43.48.197 E020.56.28.525
N051.43.48.197 E020.56.28.525 N051.50.48.197 E020.56.33.443
N051.50.48.197 E020.56.33.443 N051.56.47.213 E020.56.37.377
N051.56.47.213 E020.56.37.377 N052.00.11.373 E020.59.08.028
N052.00.11.373 E020.59.08.028 N052.00.41.586 E020.59.31.282
N052.00.41.586 E020.59.31.282 N052.01.16.185 E021.00.06.867
N052.01.16.185 E021.00.06.867 N052.01.41.321 E021.00.45.901
N052.01.41.321 E021.00.45.901 N052.01.55.430 E021.01.16.489
N052.01.55.430 E021.01.16.489 N052.02.08.009 E021.01.52.953
N052.02.08.009 E021.01.52.953 N052.02.16.988 E021.02.29.907
N052.02.16.988 E021.02.29.907 N052.02.22.985 E021.03.09.150
N052.02.22.985 E021.03.09.150 N052.02.25.762 E021.03.51.732
N052.02.25.762 E021.03.51.732 N052.02.25.236 E021.04.27.232
N052.02.25.236 E021.04.27.232 N052.02.20.484 E021.05.11.004
N052.02.20.484 E021.05.11.004 N052.02.14.939 E021.05.40.973
N052.02.14.939 E021.05.40.973 N052.02.02.816 E021.06.29.946
N052.02.02.816 E021.06.29.946 N052.01.24.138 E021.08.46.998

N051.34.52.131 E019.57.38.361 N051.34.25.574 E020.15.13.770
N051.34.25.574 E020.15.13.770 N051.33.39.344 E020.41.43.279
N051.33.39.344 E020.41.43.279 N051.33.29.052 E020.46.59.400
N051.33.29.052 E020.46.59.400 N051.33.28.039 E020.47.30.100
N051.33.28.039 E020.47.30.100 N051.33.28.168 E020.48.16.256
N051.33.28.168 E020.48.16.256 N051.33.29.488 E020.49.12.216
N051.33.29.488 E020.49.12.216 N051.33.37.878 E020.50.17.104
N051.33.37.878 E020.50.17.104 N051.33.50.925 E020.51.16.687
N051.33.50.925 E020.51.16.687 N051.34.10.788 E020.52.17.852
N051.34.10.788 E020.52.17.852 N051.34.35.540 E020.53.13.682
N051.34.35.540 E020.53.13.682 N051.35.04.195 E020.54.00.396
N051.35.04.195 E020.54.00.396 N051.35.33.107 E020.54.37.093
N051.35.33.107 E020.54.37.093 N051.35.58.597 E020.55.04.893
N051.35.58.597 E020.55.04.893 N051.36.27.664 E020.55.25.757
N051.36.27.664 E020.55.25.757 N051.37.48.197 E020.56.23.607

N052.10.50.372 E021.21.56.083 N052.10.27.585 E021.21.43.256
N052.10.27.585 E021.21.43.256 N052.10.07.930 E021.21.38.583
N052.10.07.930 E021.21.38.583 N052.09.49.938 E021.21.39.070
N052.09.49.938 E021.21.39.070 N052.09.33.880 E021.21.43.366
N052.09.33.880 E021.21.43.366 N052.09.18.201 E021.21.51.328
N052.09.18.201 E021.21.51.328 N052.09.02.703 E021.22.03.383
N052.09.02.703 E021.22.03.383 N052.08.50.499 E021.22.16.437
N052.08.50.499 E021.22.16.437 N052.08.38.949 E021.22.32.553
N052.08.38.949 E021.22.32.553 N052.08.30.288 E021.22.47.917
N052.08.30.288 E021.22.47.917 N052.08.18.959 E021.23.13.231

N052.22.27.541 E019.46.28.525 N052.17.22.623 E020.18.47.213
N052.17.22.623 E020.18.47.213 N052.14.49.180 E020.34.29.508
N052.14.49.180 E020.34.29.508 N052.13.21.455 E020.43.12.633
N052.13.21.455 E020.43.12.633 N052.07.22.498 E020.46.26.892
N052.07.22.498 E020.46.26.892 N052.07.21.639 E020.46.27.541
N052.07.21.639 E020.46.27.541 N052.03.26.557 E021.01.32.459
N052.03.26.557 E021.01.32.459 N052.00.35.410 E021.11.39.344
N052.00.35.410 E021.11.39.344 N051.58.14.754 E021.19.53.115
N051.58.14.754 E021.19.53.115 N051.57.14.754 E021.23.23.607
N051.57.14.754 E021.23.23.607 N051.56.26.407 E021.26.12.300
N051.56.26.407 E021.26.12.300 N051.56.24.091 E021.26.20.373
N051.56.24.091 E021.26.20.373 N051.56.19.952 E021.26.39.213
N051.56.19.952 E021.26.39.213 N051.56.14.583 E021.27.11.005
N051.56.14.583 E021.27.11.005 N051.56.13.328 E021.27.32.197
N051.56.13.328 E021.27.32.197 N051.56.13.390 E021.27.54.160
N051.56.13.390 E021.27.54.160 N051.56.15.612 E021.28.22.119
N051.56.15.612 E021.28.22.119 N051.56.21.231 E021.28.53.149
N051.56.21.231 E021.28.53.149 N051.56.29.775 E021.29.20.986
N051.56.29.775 E021.29.20.986 N051.56.40.625 E021.29.45.710
N051.56.40.625 E021.29.45.710 N051.56.50.494 E021.30.02.897
N051.56.50.494 E021.30.02.897 N051.57.00.551 E021.30.16.253
N051.57.00.551 E021.30.16.253 N051.57.14.609 E021.30.32.505
N051.57.14.609 E021.30.32.505 N051.57.19.268 E021.30.35.998
N051.57.19.268 E021.30.35.998 N051.58.19.783 E021.31.21.384
N051.58.19.783 E021.31.21.384 N051.58.35.189 E021.31.30.163
N051.58.35.189 E021.31.30.163 N051.58.50.057 E021.31.35.840
N051.58.50.057 E021.31.35.840 N051.59.04.565 E021.31.37.927
N051.59.04.565 E021.31.37.927 N051.59.18.128 E021.31.37.969
N051.59.18.128 E021.31.37.969 N051.59.35.925 E021.31.33.237
N051.59.35.925 E021.31.33.237 N051.59.50.313 E021.31.25.878
N051.59.50.313 E021.31.25.878 N052.00.02.416 E021.31.16.728
N052.00.02.416 E021.31.16.728 N052.00.13.232 E021.31.05.684
N052.00.13.232 E021.31.05.684 N052.00.24.833 E021.30.51.360
N052.00.24.833 E021.30.51.360 N052.00.35.441 E021.30.33.943
N052.00.35.441 E021.30.33.943 N052.00.44.720 E021.30.13.534
N052.00.44.720 E021.30.13.534 N052.00.50.706 E021.29.57.161
N052.00.50.706 E021.29.57.161 N052.00.56.522 E021.29.38.886
N052.00.56.522 E021.29.38.886 N052.01.45.246 E021.26.47.213
N052.01.45.246 E021.26.47.213 N052.03.26.557 E021.20.55.082
N052.03.26.557 E021.20.55.082 N052.05.07.869 E021.15.02.951
N052.05.07.869 E021.15.02.951 N052.05.43.279 E021.10.48.197
N052.05.43.279 E021.10.48.197 N052.06.26.557 E021.08.40.328

N052.00.50.706 E021.29.57.161 N052.00.04.918 E021.32.40.328 stargray
N052.00.04.918 E021.32.40.328 N051.58.35.189 E021.31.30.163 stargray

N052.03.26.557 E021.01.32.459 N052.00.41.586 E020.59.31.282 stargray

N052.12.13.811 E021.54.06.020 N052.13.16.721 E021.51.49.180 stargray
N052.13.16.721 E021.51.49.180 N052.13.19.761 E021.48.42.740 stargray

N051.56.24.091 E021.26.20.373 N051.55.33.443 E021.29.16.721 stargray
N051.55.33.443 E021.29.16.721 N051.57.19.268 E021.30.35.998 stargray

N052.09.06.558 E021.44.04.347 N052.13.23.607 E021.44.39.344 stargray

N052.13.41.311 E021.24.05.902 N052.13.39.827 E021.25.57.582 stargray

N052.13.41.311 E021.24.05.902 N052.12.49.423 E021.23.26.462 stargray

N052.07.11.008 E021.27.10.612 N052.06.18.689 E021.30.12.787 stargray
N052.06.18.689 E021.30.12.787 N052.04.40.731 E021.28.56.399 stargray

N052.01.45.246 E021.26.47.213 N052.03.31.974 E021.28.07.230 stargray

N052.09.03.934 E021.20.35.410 N052.10.50.372 E021.21.56.083 stargray

N051.33.16.721 E020.53.08.852 N051.33.27.477 E020.47.47.123 stargray

                  
;;;;;;;;;;;;;;;;; HOLDINGS FOR STAR 29 ;;;;;;;;;;;;;;;;;;;
;Holding SORIX
N052.46.07.103 E019.50.21.047 N052.46.01.451 E019.50.58.416  ;
N052.46.01.451 E019.50.58.416 N052.45.51.984 E019.51.33.552  ;
N052.45.51.984 E019.51.33.552 N052.45.38.952 E019.52.05.447  ;
N052.45.38.952 E019.52.05.447 N052.45.22.752 E019.52.33.131  ;
N052.45.22.752 E019.52.33.131 N052.45.03.923 E019.52.55.775  ;
N052.45.03.923 E019.52.55.775 N052.44.42.971 E019.53.12.623  ;
N052.44.42.971 E019.53.12.623 N052.44.20.579 E019.53.23.244  ;
N052.44.20.579 E019.53.23.244 N052.43.57.396 E019.53.27.276  ;
N052.43.57.396 E019.53.27.276 N052.43.34.139 E019.53.24.576  ;
N052.43.34.139 E019.53.24.576 N052.43.11.532 E019.53.15.287  ;
N052.43.11.532 E019.53.15.287 N052.42.50.256 E019.52.59.628  ;
N052.42.50.256 E019.52.59.628 N052.42.30.924 E019.52.38.100  ;
N052.42.30.924 E019.52.38.100 N052.42.14.147 E019.52.11.352  ;
N052.42.14.147 E019.52.11.352 N052.42.00.468 E019.51.40.248  ;
N052.42.00.468 E019.51.40.248 N052.41.50.244 E019.51.05.651  ;
N052.41.50.244 E019.51.05.651 N052.41.43.835 E019.50.28.644  ;
N052.41.43.835 E019.50.28.644 N052.41.41.388 E019.49.50.376  ;
N052.41.41.388 E019.49.50.376 N052.41.43.007 E019.49.12.000  ;
N052.42.48.707 E019.37.46.919 N052.42.54.359 E019.37.09.588  ;
N052.42.54.359 E019.37.09.588 N052.43.03.828 E019.36.34.415  ;
N052.43.03.828 E019.36.34.415 N052.43.16.860 E019.36.02.484  ;
N052.43.16.860 E019.36.02.484 N052.43.33.060 E019.35.34.799  ;
N052.43.33.060 E019.35.34.799 N052.43.51.887 E019.35.12.156  ;
N052.43.51.887 E019.35.12.156 N052.44.12.839 E019.34.55.271  ;
N052.44.12.839 E019.34.55.271 N052.44.35.231 E019.34.44.652  ;
N052.44.35.231 E019.34.44.652 N052.44.58.416 E019.34.40.656  ;
N052.44.58.416 E019.34.40.656 N052.45.21.671 E019.34.43.320  ;
N052.45.21.671 E019.34.43.320 N052.45.44.280 E019.34.52.643  ;
N052.45.44.280 E019.34.52.643 N052.46.05.556 E019.35.08.304  ;
N052.46.05.556 E019.35.08.304 N052.46.24.888 E019.35.29.831  ;
N052.46.24.888 E019.35.29.831 N052.46.41.663 E019.35.56.579  ;
N052.46.41.663 E019.35.56.579 N052.46.55.344 E019.36.27.720  ;
N052.46.55.344 E019.36.27.720 N052.47.05.568 E019.37.02.315  ;
N052.47.05.568 E019.37.02.315 N052.47.11.975 E019.37.39.324  ;
N052.47.11.975 E019.37.39.324 N052.47.14.424 E019.38.17.628  ;
N052.47.14.424 E019.38.17.628 N052.47.12.803 E019.38.56.040  ;
N052.46.07.103 E019.50.21.047 N052.47.12.803 E019.38.56.040  ;Connecting line
N052.42.48.707 E019.37.46.919 N052.41.43.007 E019.49.12.000  ;Connecting line

;Holding BIMPA
N052.26.55.140 E019.46.21.360 N052.26.53.519 E019.46.59.448  ;
N052.26.53.519 E019.46.59.448 N052.26.47.867 E019.47.36.527  ;
N052.26.47.867 E019.47.36.527 N052.26.38.400 E019.48.11.448  ;
N052.26.38.400 E019.48.11.448 N052.26.25.367 E019.48.43.091  ;
N052.26.25.367 E019.48.43.091 N052.26.09.167 E019.49.10.596  ;
N052.26.09.167 E019.49.10.596 N052.25.50.339 E019.49.33.023  ;
N052.25.50.339 E019.49.33.023 N052.25.29.388 E019.49.49.800  ;
N052.25.29.388 E019.49.49.800 N052.25.06.996 E019.50.00.312  ;
N052.25.06.996 E019.50.00.312 N052.24.43.812 E019.50.04.308  ;
N052.24.43.812 E019.50.04.308 N052.24.20.555 E019.50.01.644  ;
N052.24.20.555 E019.50.01.644 N052.23.57.948 E019.49.52.391  ;
N052.23.57.948 E019.49.52.391 N052.23.36.672 E019.49.36.876  ;
N052.23.36.672 E019.49.36.876 N052.23.17.340 E019.49.15.491  ;
N052.23.17.340 E019.49.15.491 N052.23.00.564 E019.48.48.960  ;
N052.23.00.564 E019.48.48.960 N052.22.46.883 E019.48.18.071  ;
N052.22.46.883 E019.48.18.071 N052.22.36.659 E019.47.43.728  ;
N052.22.36.659 E019.47.43.728 N052.22.30.252 E019.47.07.008  ;
N052.22.30.252 E019.47.07.008 N052.22.27.803 E019.46.28.991  ;
N052.22.20.459 E019.35.00.564 N052.22.22.079 E019.34.22.476  ;
N052.22.22.079 E019.34.22.476 N052.22.27.731 E019.33.45.395  ;
N052.22.27.731 E019.33.45.395 N052.22.37.200 E019.33.10.512  ;
N052.22.37.200 E019.33.10.512 N052.22.50.232 E019.32.38.831  ;
N052.22.50.232 E019.32.38.831 N052.23.06.432 E019.32.11.364  ;
N052.23.06.432 E019.32.11.364 N052.23.25.259 E019.31.48.899  ;
N052.23.25.259 E019.31.48.899 N052.23.46.211 E019.31.32.160  ;
N052.23.46.211 E019.31.32.160 N052.24.08.603 E019.31.21.612  ;
N052.24.08.603 E019.31.21.612 N052.24.31.788 E019.31.17.616  ;
N052.24.31.788 E019.31.17.616 N052.24.55.043 E019.31.20.280  ;
N052.24.55.043 E019.31.20.280 N052.25.17.652 E019.31.29.531  ;
N052.25.17.652 E019.31.29.531 N052.25.38.928 E019.31.45.083  ;
N052.25.38.928 E019.31.45.083 N052.25.58.260 E019.32.06.431  ;
N052.25.58.260 E019.32.06.431 N052.26.15.036 E019.32.32.964  ;
N052.26.15.036 E019.32.32.964 N052.26.28.716 E019.33.03.887  ;
N052.26.28.716 E019.33.03.887 N052.26.38.940 E019.33.38.196  ;
N052.26.38.940 E019.33.38.196 N052.26.45.347 E019.34.14.916  ;
N052.26.45.347 E019.34.14.916 N052.26.47.795 E019.34.52.931  ;
N052.26.55.140 E019.46.21.360 N052.26.47.795 E019.34.52.931  ;Connecting line
N052.22.20.459 E019.35.00.564 N052.22.27.803 E019.46.28.991  ;Connecting line

;Holding AGAVA
N051.39.20.447 E019.57.46.188 N051.39.18.000 E019.58.23.519  ;
N051.39.18.000 E019.58.23.519 N051.39.11.591 E019.58.59.591  ;
N051.39.11.591 E019.58.59.591 N051.39.01.367 E019.59.33.323  ;
N051.39.01.367 E019.59.33.323 N051.38.47.688 E020.00.03.708  ;
N051.38.47.688 E020.00.03.708 N051.38.30.911 E020.00.29.771  ;
N051.38.30.911 E020.00.29.771 N051.38.11.579 E020.00.50.759  ;
N051.38.11.579 E020.00.50.759 N051.37.50.303 E020.01.06.023  ;
N051.37.50.303 E020.01.06.023 N051.37.27.696 E020.01.15.095  ;
N051.37.27.696 E020.01.15.095 N051.37.04.439 E020.01.17.723  ;
N051.37.04.439 E020.01.17.723 N051.36.41.256 E020.01.13.799  ;
N051.36.41.256 E020.01.13.799 N051.36.18.864 E020.01.03.468  ;
N051.36.18.864 E020.01.03.468 N051.35.57.912 E020.00.47.015  ;
N051.35.57.912 E020.00.47.015 N051.35.39.083 E020.00.24.948  ;
N051.35.39.083 E020.00.24.948 N051.35.22.883 E019.59.57.948  ;
N051.35.22.883 E019.59.57.948 N051.35.09.851 E019.59.26.844  ;
N051.35.09.851 E019.59.26.844 N051.35.00.384 E019.58.52.535  ;
N051.35.00.384 E019.58.52.535 N051.34.54.732 E019.58.16.140  ;
N051.34.54.732 E019.58.16.140 N051.34.53.112 E019.57.38.700  ;
N051.35.00.456 E019.46.22.368 N051.35.02.903 E019.45.45.035  ;
N051.35.02.903 E019.45.45.035 N051.35.09.312 E019.45.08.927  ;
N051.35.09.312 E019.45.08.927 N051.35.19.536 E019.44.35.196  ;
N051.35.19.536 E019.44.35.196 N051.35.33.215 E019.44.04.848  ;
N051.35.33.215 E019.44.04.848 N051.35.49.992 E019.43.38.784  ;
N051.35.49.992 E019.43.38.784 N051.36.09.323 E019.43.17.795  ;
N051.36.09.323 E019.43.17.795 N051.36.30.599 E019.43.02.531  ;
N051.36.30.599 E019.43.02.531 N051.36.53.208 E019.42.53.423  ;
N051.36.53.208 E019.42.53.423 N051.37.16.464 E019.42.50.832  ;
N051.37.16.464 E019.42.50.832 N051.37.39.647 E019.42.54.755  ;
N051.37.39.647 E019.42.54.755 N051.38.02.039 E019.43.05.088  ;
N051.38.02.039 E019.43.05.088 N051.38.22.991 E019.43.21.540  ;
N051.38.22.991 E019.43.21.540 N051.38.41.820 E019.43.43.608  ;
N051.38.41.820 E019.43.43.608 N051.38.58.020 E019.44.10.608  ;
N051.38.58.020 E019.44.10.608 N051.39.11.051 E019.44.41.712  ;
N051.39.11.051 E019.44.41.712 N051.39.20.520 E019.45.16.019  ;
N051.39.20.520 E019.45.16.019 N051.39.26.171 E019.45.52.415  ;
N051.39.26.171 E019.45.52.415 N051.39.27.791 E019.46.29.856  ;
N051.39.20.447 E019.57.46.188 N051.39.27.791 E019.46.29.856  ;Connecting line
N051.35.00.456 E019.46.22.368 N051.34.53.112 E019.57.38.700  ;Connecting line

;Holding LOGDA
N051.17.03.983 E020.41.38.039 N051.17.24.576 E020.41.55.536  ;
N051.17.24.576 E020.41.55.536 N051.17.42.935 E020.42.18.468  ;
N051.17.42.935 E020.42.18.468 N051.17.58.524 E020.42.46.152  ;
N051.17.58.524 E020.42.46.152 N051.18.10.871 E020.43.17.723  ;
N051.18.10.871 E020.43.17.723 N051.18.19.583 E020.43.52.284  ;
N051.18.19.583 E020.43.52.284 N051.18.24.443 E020.44.28.715  ;
N051.18.24.443 E020.44.28.715 N051.18.25.272 E020.45.05.940  ;
N051.18.25.272 E020.45.05.940 N051.18.21.995 E020.45.42.804  ;
N051.18.21.995 E020.45.42.804 N051.18.14.796 E020.46.18.228  ;
N051.18.14.796 E020.46.18.228 N051.18.03.852 E020.46.51.132  ;
N051.18.03.852 E020.46.51.132 N051.17.49.523 E020.47.20.472  ;
N051.17.49.523 E020.47.20.472 N051.17.32.207 E020.47.45.384  ;
N051.17.32.207 E020.47.45.384 N051.17.12.444 E020.48.05.147  ;
N051.17.12.444 E020.48.05.147 N051.16.50.844 E020.48.19.079  ;
N051.16.50.844 E020.48.19.079 N051.16.28.055 E020.48.26.819  ;
N051.16.28.055 E020.48.26.819 N051.16.04.763 E020.48.28.115  ;
N051.16.04.763 E020.48.28.115 N051.15.41.688 E020.48.22.932  ;
N051.15.41.688 E020.48.22.932 N051.15.19.512 E020.48.11.448  ;
N051.08.52.907 E020.43.48.684 N051.08.32.316 E020.43.31.223  ;
N051.08.32.316 E020.43.31.223 N051.08.13.956 E020.43.08.364  ;
N051.08.13.956 E020.43.08.364 N051.07.58.368 E020.42.40.752  ;
N051.07.58.368 E020.42.40.752 N051.07.46.019 E020.42.09.215  ;
N051.07.46.019 E020.42.09.215 N051.07.37.307 E020.41.34.764  ;
N051.07.37.307 E020.41.34.764 N051.07.32.448 E020.40.58.440  ;
N051.07.32.448 E020.40.58.440 N051.07.31.620 E020.40.21.287  ;
N051.07.31.620 E020.40.21.287 N051.07.34.895 E020.39.44.495  ;
N051.07.34.895 E020.39.44.495 N051.07.42.096 E020.39.09.143  ;
N051.07.42.096 E020.39.09.143 N051.07.53.039 E020.38.36.347  ;
N051.07.53.039 E020.38.36.347 N051.08.07.367 E020.38.07.044  ;
N051.08.07.367 E020.38.07.044 N051.08.24.683 E020.37.42.203  ;
N051.08.24.683 E020.37.42.203 N051.08.44.447 E020.37.22.512  ;
N051.08.44.447 E020.37.22.512 N051.09.06.047 E020.37.08.580  ;
N051.09.06.047 E020.37.08.580 N051.09.28.835 E020.37.00.840  ;
N051.09.28.835 E020.37.00.840 N051.09.52.127 E020.36.59.544  ;
N051.09.52.127 E020.36.59.544 N051.10.15.203 E020.37.04.727  ;
N051.10.15.203 E020.37.04.727 N051.10.37.380 E020.37.16.211  ;
N051.17.03.983 E020.41.38.039 N051.10.37.380 E020.37.16.211  ;Connecting line
N051.08.52.907 E020.43.48.684 N051.15.19.512 E020.48.11.448  ;Connecting line

;LIMVI 
N051.44.41.999 E021.41.07.943 N051.45.02.196 E021.40.49.115  ;
N051.45.02.196 E021.40.49.115 N051.45.24.083 E021.40.36.227  ;
N051.45.24.083 E021.40.36.227 N051.45.47.016 E021.40.29.676  ;
N051.45.47.016 E021.40.29.676 N051.46.10.343 E021.40.29.676  ;
N051.46.10.343 E021.40.29.676 N051.46.33.276 E021.40.36.227  ;
N051.46.33.276 E021.40.36.227 N051.46.55.164 E021.40.49.115  ;
N051.46.55.164 E021.40.49.115 N051.47.15.359 E021.41.07.943  ;
N051.47.15.359 E021.41.07.943 N051.47.33.216 E021.41.32.136  ;
N051.47.33.216 E021.41.32.136 N051.47.48.192 E021.42.00.971  ;
N051.47.48.192 E021.42.00.971 N051.47.59.855 E021.42.33.588  ;
N051.47.59.855 E021.42.33.588 N051.48.07.811 E021.43.08.975  ;
N051.48.07.811 E021.43.08.975 N051.48.11.843 E021.43.46.055  ;
N051.48.11.843 E021.43.46.055 N051.48.11.843 E021.44.23.712  ;
N051.48.11.843 E021.44.23.712 N051.48.07.811 E021.45.00.791  ;
N051.48.07.811 E021.45.00.791 N051.47.59.855 E021.45.36.179  ;
N051.47.59.855 E021.45.36.179 N051.47.48.192 E021.46.08.796  ;
N051.47.48.192 E021.46.08.796 N051.47.33.216 E021.46.37.632  ;
N051.47.33.216 E021.46.37.632 N051.47.15.359 E021.47.01.824  ;
N051.41.31.308 E021.53.30.732 N051.41.11.111 E021.53.49.523  ;
N051.41.11.111 E021.53.49.523 N051.40.49.224 E021.54.02.375  ;
N051.40.49.224 E021.54.02.375 N051.40.26.291 E021.54.08.892  ;
N051.40.26.291 E021.54.08.892 N051.40.02.964 E021.54.08.892  ;
N051.40.02.964 E021.54.08.892 N051.39.40.031 E021.54.02.375  ;
N051.39.40.031 E021.54.02.375 N051.39.18.143 E021.53.49.523  ;
N051.39.18.143 E021.53.49.523 N051.38.57.948 E021.53.30.732  ;
N051.38.57.948 E021.53.30.732 N051.38.40.091 E021.53.06.575  ;
N051.38.40.091 E021.53.06.575 N051.38.25.115 E021.52.37.811  ;
N051.38.25.115 E021.52.37.811 N051.38.13.452 E021.52.05.268  ;
N051.38.13.452 E021.52.05.268 N051.38.05.496 E021.51.29.951  ;
N051.38.05.496 E021.51.29.951 N051.38.01.464 E021.50.52.944  ;
N051.38.01.464 E021.50.52.944 N051.38.01.464 E021.50.15.359  ;
N051.38.01.464 E021.50.15.359 N051.38.05.496 E021.49.38.352  ;
N051.38.05.496 E021.49.38.352 N051.38.13.452 E021.49.03.035  ;
N051.38.13.452 E021.49.03.035 N051.38.25.115 E021.48.30.491  ;
N051.38.25.115 E021.48.30.491 N051.38.40.091 E021.48.01.728  ;
N051.38.40.091 E021.48.01.728 N051.38.57.948 E021.47.37.571  ;
N051.44.41.999 E021.41.07.943 N051.38.57.948 E021.47.37.571  ;Connecting line
N051.41.31.308 E021.53.30.732 N051.47.15.359 E021.47.01.824  ;Connecting line  

;GOMSA
N052.20.28.931 E020.19.58.260 N052.20.23.783 E020.20.24.143  ;
N052.20.23.783 E020.20.24.143 N052.20.15.971 E020.20.48.192  ;
N052.20.15.971 E020.20.48.192 N052.20.05.711 E020.21.09.647  ;
N052.20.05.711 E020.21.09.647 N052.19.53.327 E020.21.27.863  ;
N052.19.53.327 E020.21.27.863 N052.19.39.215 E020.21.42.300  ;
N052.19.39.215 E020.21.42.300 N052.19.23.807 E020.21.52.523  ;
N052.19.23.807 E020.21.52.523 N052.19.07.500 E020.21.58.176  ;
N052.19.07.500 E020.21.58.176 N052.18.50.867 E020.21.59.112  ;
N052.18.50.867 E020.21.59.112 N052.18.34.380 E020.21.55.331  ;
N052.18.34.380 E020.21.55.331 N052.18.18.576 E020.21.46.907  ;
N052.18.18.576 E020.21.46.907 N052.18.03.852 E020.21.34.128  ;
N052.18.03.852 E020.21.34.128 N052.17.50.747 E020.21.17.352  ;
N052.17.50.747 E020.21.17.352 N052.17.39.623 E020.20.57.119  ;
N052.17.39.623 E020.20.57.119 N052.17.30.804 E020.20.34.044  ;
N052.17.30.804 E020.20.34.044 N052.17.24.539 E020.20.08.807  ;
N052.17.24.539 E020.20.08.807 N052.17.21.083 E020.19.42.167  ;
N052.17.21.083 E020.19.42.167 N052.17.20.507 E020.19.14.952  ;
N052.17.20.507 E020.19.14.952 N052.17.22.812 E020.18.47.988  ;
N052.18.30.311 E020.10.49.799 N052.18.35.459 E020.10.23.916  ;
N052.18.35.459 E020.10.23.916 N052.18.43.271 E020.09.59.868  ;
N052.18.43.271 E020.09.59.868 N052.18.53.531 E020.09.38.376  ;
N052.18.53.531 E020.09.38.376 N052.19.05.915 E020.09.20.159  ;
N052.19.05.915 E020.09.20.159 N052.19.20.027 E020.09.05.723  ;
N052.19.20.027 E020.09.05.723 N052.19.35.435 E020.08.55.535  ;
N052.19.35.435 E020.08.55.535 N052.19.51.744 E020.08.49.847  ;
N052.19.51.744 E020.08.49.847 N052.20.08.375 E020.08.48.912  ;
N052.20.08.375 E020.08.48.912 N052.20.24.864 E020.08.52.692  ;
N052.20.24.864 E020.08.52.692 N052.20.40.668 E020.09.01.116  ;
N052.20.40.668 E020.09.01.116 N052.20.55.392 E020.09.13.896  ;
N052.20.55.392 E020.09.13.896 N052.21.08.495 E020.09.30.671  ;
N052.21.08.495 E020.09.30.671 N052.21.19.619 E020.09.50.939  ;
N052.21.19.619 E020.09.50.939 N052.21.28.440 E020.10.14.015  ;
N052.21.28.440 E020.10.14.015 N052.21.34.703 E020.10.39.287  ;
N052.21.34.703 E020.10.39.287 N052.21.38.159 E020.11.05.927  ;
N052.21.38.159 E020.11.05.927 N052.21.38.735 E020.11.33.144  ;
N052.21.38.735 E020.11.33.144 N052.21.36.432 E020.12.00.144  ;
N052.20.28.931 E020.19.58.260 N052.21.36.432 E020.12.00.144  ;Connecting line
N052.18.30.311 E020.10.49.799 N052.17.22.812 E020.18.47.988  ;Connecting line                 

;TINBU
N052.20.18.744 E021.00.44.244 N052.20.09.419 E021.01.06.816  ;
N052.20.09.419 E021.01.06.816 N052.19.57.864 E021.01.26.400  ;
N052.19.57.864 E021.01.26.400 N052.19.44.400 E021.01.42.383  ;
N052.19.44.400 E021.01.42.383 N052.19.29.459 E021.01.54.335  ;
N052.19.29.459 E021.01.54.335 N052.19.13.439 E021.02.01.824  ;
N052.19.13.439 E021.02.01.824 N052.18.56.880 E021.02.04.667  ;
N052.18.56.880 E021.02.04.667 N052.18.40.284 E021.02.02.795  ;
N052.18.40.284 E021.02.02.795 N052.18.24.119 E021.01.56.208  ;
N052.18.24.119 E021.01.56.208 N052.18.08.928 E021.01.45.119  ;
N052.18.08.928 E021.01.45.119 N052.17.55.140 E021.01.29.891  ;
N052.17.55.140 E021.01.29.891 N052.17.43.151 E021.01.10.991  ;
N052.17.43.151 E021.01.10.991 N052.17.33.360 E021.00.48.960  ;
N052.17.33.360 E021.00.48.960 N052.17.26.087 E021.00.24.479  ;
N052.17.26.087 E021.00.24.479 N052.17.21.479 E020.59.58.308  ;
N052.17.21.479 E020.59.58.308 N052.17.19.752 E020.59.31.236  ;
N052.17.19.752 E020.59.31.236 N052.17.20.904 E020.59.04.055  ;
N052.17.20.904 E020.59.04.055 N052.17.24.936 E020.58.37.631  ;
N052.17.24.936 E020.58.37.631 N052.17.31.704 E020.58.12.756  ;
N052.19.57.144 E020.51.03.456 N052.20.06.467 E020.50.40.883  ;
N052.20.06.467 E020.50.40.883 N052.20.18.024 E020.50.21.264  ;
N052.20.18.024 E020.50.21.264 N052.20.31.488 E020.50.05.244  ;
N052.20.31.488 E020.50.05.244 N052.20.46.427 E020.49.53.291  ;
N052.20.46.427 E020.49.53.291 N052.21.02.447 E020.49.45.804  ;
N052.21.02.447 E020.49.45.804 N052.21.19.008 E020.49.42.960  ;
N052.21.19.008 E020.49.42.960 N052.21.35.604 E020.49.44.831  ;
N052.21.35.604 E020.49.44.831 N052.21.51.767 E020.49.51.456  ;
N052.21.51.767 E020.49.51.456 N052.22.06.960 E020.50.02.507  ;
N052.22.06.960 E020.50.02.507 N052.22.20.748 E020.50.17.772  ;
N052.22.20.748 E020.50.17.772 N052.22.32.735 E020.50.36.708  ;
N052.22.32.735 E020.50.36.708 N052.22.42.528 E020.50.58.740  ;
N052.22.42.528 E020.50.58.740 N052.22.49.799 E020.51.23.255  ;
N052.22.49.799 E020.51.23.255 N052.22.54.407 E020.51.49.428  ;
N052.22.54.407 E020.51.49.428 N052.22.56.136 E020.52.16.535  ;
N052.22.56.136 E020.52.16.535 N052.22.54.984 E020.52.43.716  ;
N052.22.54.984 E020.52.43.716 N052.22.50.951 E020.53.10.176  ;
N052.22.50.951 E020.53.10.176 N052.22.44.184 E020.53.35.088  ;
N052.20.18.744 E021.00.44.244 N052.22.44.184 E020.53.35.088  ;Connecting line
N052.19.57.144 E020.51.03.456 N052.17.31.704 E020.58.12.756  ;Connecting line

;ROPUX
N052.10.20.171 E021.36.49.392 N052.10.21.900 E021.36.22.392  ;
N052.10.21.900 E021.36.22.392 N052.10.26.508 E021.35.56.292  ;
N052.10.26.508 E021.35.56.292 N052.10.33.779 E021.35.31.883  ;
N052.10.33.779 E021.35.31.883 N052.10.43.572 E021.35.09.923  ;
N052.10.43.572 E021.35.09.923 N052.10.55.559 E021.34.51.060  ;
N052.10.55.559 E021.34.51.060 N052.11.09.347 E021.34.35.868  ;
N052.11.09.347 E021.34.35.868 N052.11.24.540 E021.34.24.816  ;
N052.11.24.540 E021.34.24.816 N052.11.40.703 E021.34.18.263  ;
N052.11.40.703 E021.34.18.263 N052.11.57.299 E021.34.16.356  ;
N052.11.57.299 E021.34.16.356 N052.12.13.860 E021.34.19.199  ;
N052.12.13.860 E021.34.19.199 N052.12.29.880 E021.34.26.687  ;
N052.12.29.880 E021.34.26.687 N052.12.44.819 E021.34.38.568  ;
N052.12.44.819 E021.34.38.568 N052.12.58.283 E021.34.54.552  ;
N052.12.58.283 E021.34.54.552 N052.13.09.840 E021.35.14.064  ;
N052.13.09.840 E021.35.14.064 N052.13.19.163 E021.35.36.599  ;
N052.13.19.163 E021.35.36.599 N052.13.25.931 E021.36.01.404  ;
N052.13.25.931 E021.36.01.404 N052.13.29.963 E021.36.27.756  ;
N052.13.29.963 E021.36.27.756 N052.13.31.116 E021.36.54.864  ;
N052.13.23.267 E021.45.04.139 N052.13.21.540 E021.45.31.139  ;
N052.13.21.540 E021.45.31.139 N052.13.16.932 E021.45.57.239  ;
N052.13.16.932 E021.45.57.239 N052.13.09.659 E021.46.21.648  ;
N052.13.09.659 E021.46.21.648 N052.12.59.868 E021.46.43.608  ;
N052.12.59.868 E021.46.43.608 N052.12.47.879 E021.47.02.472  ;
N052.12.47.879 E021.47.02.472 N052.12.34.092 E021.47.17.663  ;
N052.12.34.092 E021.47.17.663 N052.12.18.899 E021.47.28.715  ;
N052.12.18.899 E021.47.28.715 N052.12.02.736 E021.47.35.268  ;
N052.12.02.736 E021.47.35.268 N052.11.46.140 E021.47.37.175  ;
N052.11.46.140 E021.47.37.175 N052.11.29.579 E021.47.34.332  ;
N052.11.29.579 E021.47.34.332 N052.11.13.560 E021.47.26.844  ;
N052.11.13.560 E021.47.26.844 N052.10.58.619 E021.47.14.927  ;
N052.10.58.619 E021.47.14.927 N052.10.45.155 E021.46.58.979  ;
N052.10.45.155 E021.46.58.979 N052.10.33.600 E021.46.39.431  ;
N052.10.33.600 E021.46.39.431 N052.10.24.275 E021.46.16.932  ;
N052.10.24.275 E021.46.16.932 N052.10.17.507 E021.45.52.127  ;
N052.10.17.507 E021.45.52.127 N052.10.13.475 E021.45.25.775  ;
N052.10.13.475 E021.45.25.775 N052.10.12.324 E021.44.58.667  ;
N052.10.20.171 E021.36.48.060 N052.10.12.324 E021.44.57.335  ;Connecting line
N052.13.23.267 E021.45.05.471 N052.13.31.116 E021.36.56.196  ;Connecting line

;INSEX
N051.37.48.359 E020.56.24.108 N051.38.04.955 E020.56.25.980  ;
N051.38.04.955 E020.56.25.980 N051.38.21.120 E020.56.32.460  ;
N051.38.21.120 E020.56.32.460 N051.38.36.311 E020.56.43.368  ;
N051.38.36.311 E020.56.43.368 N051.38.50.099 E020.56.58.379  ;
N051.38.50.099 E020.56.58.379 N051.39.02.087 E020.57.16.991  ;
N051.39.02.087 E020.57.16.991 N051.39.11.880 E020.57.38.700  ;
N051.39.11.880 E020.57.38.700 N051.39.19.152 E020.58.02.819  ;
N051.39.19.152 E020.58.02.819 N051.39.23.759 E020.58.28.595  ;
N051.39.23.759 E020.58.28.595 N051.39.25.488 E020.58.55.235  ;
N051.39.25.488 E020.58.55.235 N051.39.24.335 E020.59.22.020  ;
N051.39.24.335 E020.59.22.020 N051.39.20.303 E020.59.48.012  ;
N051.39.20.303 E020.59.48.012 N051.39.13.535 E021.00.12.527  ;
N051.39.13.535 E021.00.12.527 N051.39.04.212 E021.00.34.740  ;
N051.39.04.212 E021.00.34.740 N051.38.52.655 E021.00.54.036  ;
N051.38.52.655 E021.00.54.036 N051.38.39.191 E021.01.09.804  ;
N051.38.39.191 E021.01.09.804 N051.38.24.252 E021.01.21.575  ;
N051.38.24.252 E021.01.21.575 N051.38.08.232 E021.01.28.955  ;
N051.38.08.232 E021.01.28.955 N051.37.51.671 E021.01.31.764  ;
N051.32.51.684 E021.01.35.687 N051.32.35.088 E021.01.33.816  ;
N051.32.35.088 E021.01.33.816 N051.32.18.923 E021.01.27.336  ;
N051.32.18.923 E021.01.27.336 N051.32.03.732 E021.01.16.463  ;
N051.32.03.732 E021.01.16.463 N051.31.49.944 E021.01.01.487  ;
N051.31.49.944 E021.01.01.487 N051.31.37.955 E021.00.42.876  ;
N051.31.37.955 E021.00.42.876 N051.31.28.164 E021.00.21.240  ;
N051.31.28.164 E021.00.21.240 N051.31.20.891 E020.59.57.192  ;
N051.31.20.891 E020.59.57.192 N051.31.16.283 E020.59.31.451  ;
N051.31.16.283 E020.59.31.451 N051.31.14.556 E020.59.04.812  ;
N051.31.14.556 E020.59.04.812 N051.31.15.708 E020.58.38.136  ;
N051.31.15.708 E020.58.38.136 N051.31.19.740 E020.58.12.144  ;
N051.31.19.740 E020.58.12.144 N051.31.26.508 E020.57.47.699  ;
N051.31.26.508 E020.57.47.699 N051.31.35.832 E020.57.25.524  ;
N051.31.35.832 E020.57.25.524 N051.31.47.387 E020.57.06.264  ;
N051.31.47.387 E020.57.06.264 N051.32.00.851 E020.56.50.531  ;
N051.32.00.851 E020.56.50.531 N051.32.15.792 E020.56.38.795  ;
N051.32.15.792 E020.56.38.795 N051.32.31.811 E020.56.31.416  ;
N051.32.31.811 E020.56.31.416 N051.32.48.372 E020.56.28.607  ;
N051.37.49.188 E020.56.24.108 N051.32.49.199 E020.56.28.607  ;Connecting line
N051.32.50.856 E021.01.35.687 N051.37.50.843 E021.01.31.764  ;Connecting line
                 
-EPWA 33  N051.51.07.869 E021.14.19.672 N051.52.53.420 E021.12.48.425
N051.51.07.869 E021.14.19.672 N051.52.53.420 E021.12.48.425

N051.49.18.222 E021.15.53.141 N051.47.35.410 E021.17.20.656 stargray
N051.47.35.410 E021.17.20.656 N051.48.29.058 E021.20.04.834 stargray

N051.50.31.398 E021.05.42.779 N051.48.46.230 E021.07.12.787 stargray
N051.48.46.230 E021.07.12.787 N051.49.40.133 E021.09.55.003 stargray

N052.09.56.066 E021.35.00.984 N052.06.18.803 E021.35.53.111 stargray

N051.51.07.869 E021.14.19.672 N051.50.20.579 E021.11.53.178 stargray

N051.33.16.721 E020.53.08.852 N051.33.26.908 E020.48.04.324 stargray

N051.59.32.459 E020.44.49.180 N051.57.50.216 E020.45.44.763 stargray

N051.59.32.459 E020.44.49.180 N052.00.18.725 E020.47.00.753 stargray

N052.03.04.918 E020.54.48.197 N052.02.06.187 E020.52.02.207 stargray

N052.07.22.623 E021.09.27.541 N052.08.54.322 E021.14.09.750 stargray

N051.49.08.310 E021.22.00.244 N051.49.57.049 E021.24.28.525 stargray
N051.49.57.049 E021.24.28.525 N051.51.34.024 E021.23.05.147 stargray

N052.22.27.541 E019.46.28.525 N052.17.22.623 E020.18.47.213 
N052.17.22.623 E020.18.47.213 N052.14.49.180 E020.34.29.508 
N052.14.49.180 E020.34.29.508 N052.12.57.049 E020.46.01.967 
N052.12.57.049 E020.46.01.967 N052.03.04.918 E020.54.48.197 
N052.03.04.918 E020.54.48.197 N051.55.50.164 E021.01.06.885 
N051.55.50.164 E021.01.06.885 N051.52.18.689 E021.04.10.820 
N051.52.18.689 E021.04.10.820 N051.50.44.817 E021.05.31.285 
N051.50.44.817 E021.05.31.285 N051.50.31.398 E021.05.42.779 
N051.50.31.398 E021.05.42.779 N051.50.18.674 E021.05.55.667 
N051.50.18.674 E021.05.55.667 N051.50.06.060 E021.06.11.046 
N051.50.06.060 E021.06.11.046 N051.49.57.597 E021.06.24.502 
N051.49.57.597 E021.06.24.502 N051.49.48.957 E021.06.41.085 
N051.49.48.957 E021.06.41.085 N051.49.40.476 E021.07.03.289 
N051.49.40.476 E021.07.03.289 N051.49.32.579 E021.07.34.053 
N051.49.32.579 E021.07.34.053 N051.49.29.982 E021.07.52.619 
N051.49.29.982 E021.07.52.619 N051.49.27.910 E021.08.18.323 
N051.49.27.910 E021.08.18.323 N051.49.28.486 E021.08.50.659 
N051.49.28.486 E021.08.50.659 N051.49.31.247 E021.09.14.896 
N051.49.31.247 E021.09.14.896 N051.49.34.937 E021.09.34.304 
N051.49.34.937 E021.09.34.304 N051.49.40.133 E021.09.55.003 
N051.49.40.133 E021.09.55.003 N051.50.16.823 E021.11.43.521 
N051.50.16.823 E021.11.43.521 N051.50.23.728 E021.12.01.275 
N051.50.23.728 E021.12.01.275 N051.50.36.088 E021.12.23.031 
N051.50.36.088 E021.12.23.031 N051.50.50.472 E021.12.41.632 
N051.50.50.472 E021.12.41.632 N051.51.03.973 E021.12.54.765 
N051.51.03.973 E021.12.54.765 N051.51.15.442 E021.13.02.719 
N051.51.15.442 E021.13.02.719 N051.51.32.992 E021.13.10.288 
N051.51.32.992 E021.13.10.288 N051.51.56.091 E021.13.14.043 
N051.51.56.091 E021.13.14.043 N051.52.10.594 E021.13.12.329 
N051.52.10.594 E021.13.12.329 N051.52.27.502 E021.13.06.307 
N051.52.27.502 E021.13.06.307 N051.52.39.710 E021.13.00.284 
N051.52.39.710 E021.13.00.284 N051.52.55.502 E021.12.46.624 
N051.52.55.502 E021.12.46.624 N051.54.39.344 E021.11.16.721 
N051.54.39.344 E021.11.16.721 N051.58.10.820 E021.08.14.754 
N051.58.10.820 E021.08.14.754 N052.00.28.525 E021.06.15.738 
N052.00.28.525 E021.06.15.738 N052.01.47.213 E021.05.06.885 

N051.34.52.131 E019.57.38.361 N051.34.25.574 E020.15.13.770 
N051.34.25.574 E020.15.13.770 N051.33.39.344 E020.41.43.279 
N051.33.39.344 E020.41.43.279 N051.33.30.256 E020.46.22.798 
N051.33.30.256 E020.46.22.798 N051.33.28.200 E020.47.25.228 
N051.33.28.200 E020.47.25.228 N051.33.26.579 E020.48.14.288 
N051.33.26.579 E020.48.14.288 N051.33.25.935 E020.49.14.825 
N051.33.25.935 E020.49.14.825 N051.33.29.965 E020.50.06.470 
N051.33.29.965 E020.50.06.470 N051.33.37.630 E020.50.55.347 
N051.33.37.630 E020.50.55.347 N051.33.48.306 E020.51.39.851 
N051.33.48.306 E020.51.39.851 N051.34.02.500 E020.52.22.938 
N051.34.02.500 E020.52.22.938 N051.34.21.816 E020.53.06.836 
N051.34.21.816 E020.53.06.836 N051.34.42.555 E020.53.43.444 
N051.34.42.555 E020.53.43.444 N051.35.06.285 E020.54.15.882 
N051.35.06.285 E020.54.15.882 N051.35.35.765 E020.54.47.053 
N051.35.35.765 E020.54.47.053 N051.35.58.105 E020.55.04.540 
N051.35.58.105 E020.55.04.540 N051.36.35.416 E020.55.31.323 
N051.36.35.416 E020.55.31.323 N051.37.48.197 E020.56.23.607 

N051.17.03.934 E020.41.37.377 N051.33.16.721 E020.53.08.852 
N051.33.16.721 E020.53.08.852 N051.37.48.197 E020.56.23.607 
N051.37.48.197 E020.56.23.607 N051.44.46.230 E020.52.43.279 
N051.44.46.230 E020.52.43.279 N051.51.48.197 E020.49.00.984 
N051.51.48.197 E020.49.00.984 N051.57.50.216 E020.45.44.763 
N051.57.50.216 E020.45.44.763 N051.57.59.035 E020.45.39.971 
N051.57.59.035 E020.45.39.971 N051.58.10.446 E020.45.35.925 
N051.58.10.446 E020.45.35.925 N051.58.21.440 E020.45.32.432 
N051.58.21.440 E020.45.32.432 N051.58.31.868 E020.45.31.776 
N051.58.31.868 E020.45.31.776 N051.58.44.265 E020.45.32.075 
N051.58.44.265 E020.45.32.075 N051.58.53.795 E020.45.33.987 
N051.58.53.795 E020.45.33.987 N051.59.08.926 E020.45.39.063 
N051.59.08.926 E020.45.39.063 N051.59.21.658 E020.45.45.730 
N051.59.21.658 E020.45.45.730 N051.59.33.164 E020.45.54.333 
N051.59.33.164 E020.45.54.333 N051.59.41.083 E020.46.01.941 
N051.59.41.083 E020.46.01.941 N051.59.51.040 E020.46.12.483 
N051.59.51.040 E020.46.12.483 N051.59.59.897 E020.46.25.209 
N051.59.59.897 E020.46.25.209 N052.00.08.439 E020.46.39.027 
N052.00.08.439 E020.46.39.027 N052.00.14.030 E020.46.50.008 
N052.00.14.030 E020.46.50.008 N052.00.18.725 E020.47.00.753 
N052.00.18.725 E020.47.00.753 N052.00.27.538 E020.47.24.088 
N052.00.27.538 E020.47.24.088 N052.02.00.603 E020.51.46.441 
N052.02.00.603 E020.51.46.441 N052.02.06.187 E020.52.02.207 
N052.02.06.187 E020.52.02.207 N052.02.12.588 E020.52.24.514 
N052.02.12.588 E020.52.24.514 N052.02.17.692 E020.52.49.036 
N052.02.17.692 E020.52.49.036 N052.02.19.968 E020.53.08.136 
N052.02.19.968 E020.53.08.136 N052.02.21.274 E020.53.23.944 
N052.02.21.274 E020.53.23.944 N052.02.21.230 E020.53.41.941 
N052.02.21.230 E020.53.41.941 N052.02.20.249 E020.53.57.058 
N052.02.20.249 E020.53.57.058 N052.02.18.609 E020.54.13.171 
N052.02.18.609 E020.54.13.171 N052.02.16.387 E020.54.28.318 
N052.02.16.387 E020.54.28.318 N052.02.12.702 E020.54.44.770 
N052.02.12.702 E020.54.44.770 N052.02.09.360 E020.54.57.405 
N052.02.09.360 E020.54.57.405 N052.02.03.564 E020.55.13.277 
N052.02.03.564 E020.55.13.277 N052.01.56.714 E020.55.29.860 
N052.01.56.714 E020.55.29.860 N052.01.49.986 E020.55.42.658 
N052.01.49.986 E020.55.42.658 N052.01.45.031 E020.55.50.608 
N052.01.45.031 E020.55.50.608 N052.01.38.189 E020.56.00.568 
N052.01.38.189 E020.56.00.568 N052.01.33.580 E020.56.05.476 
N052.01.33.580 E020.56.05.476 N052.01.26.879 E020.56.13.621 
N052.01.26.879 E020.56.13.621 N051.59.01.967 E020.58.19.672 

N051.44.41.311 E021.41.07.869 N051.54.21.639 E021.38.48.197 
N051.54.21.639 E021.38.48.197 N052.01.54.098 E021.36.58.033 
N052.01.54.098 E021.36.58.033 N052.05.51.144 E021.36.00.547 
N052.05.51.144 E021.36.00.547 N052.06.18.803 E021.35.53.111 
N052.06.18.803 E021.35.53.111 N052.06.38.646 E021.35.45.657 
N052.06.38.646 E021.35.45.657 N052.07.01.171 E021.35.34.398 
N052.07.01.171 E021.35.34.398 N052.07.21.252 E021.35.21.104 
N052.07.21.252 E021.35.21.104 N052.07.45.638 E021.35.00.740 
N052.07.45.638 E021.35.00.740 N052.08.10.715 E021.34.34.026 
N052.08.10.715 E021.34.34.026 N052.08.31.531 E021.34.06.826 
N052.08.31.531 E021.34.06.826 N052.08.49.773 E021.33.36.858 
N052.08.49.773 E021.33.36.858 N052.09.08.957 E021.32.59.328 
N052.09.08.957 E021.32.59.328 N052.09.27.604 E021.32.12.802 
N052.09.27.604 E021.32.12.802 N052.09.40.128 E021.31.29.935 
N052.09.40.128 E021.31.29.935 N052.09.53.145 E021.30.29.528 
N052.09.53.145 E021.30.29.528 N052.09.59.388 E021.29.38.582 
N052.09.59.388 E021.29.38.582 N052.10.01.484 E021.29.03.088 
N052.10.01.484 E021.29.03.088 N052.10.02.951 E021.28.17.705 
N052.10.02.951 E021.28.17.705 N052.10.02.981 E021.27.34.756 
N052.10.02.981 E021.27.34.756 N052.10.02.951 E021.17.33.443 

N052.09.32.459 E021.59.56.066 N052.09.38.361 E021.53.27.541 
N052.09.38.361 E021.53.27.541 N052.09.56.066 E021.35.00.984 
N052.09.56.066 E021.35.00.984 N052.10.02.951 E021.28.17.705 
N052.10.02.951 E021.28.17.705 N052.10.02.951 E021.17.33.443 
N052.10.02.951 E021.17.33.443 N052.09.13.583 E021.15.03.538 
N052.09.13.583 E021.15.03.538 N052.08.54.322 E021.14.09.750 
N052.08.54.322 E021.14.09.750 N052.08.41.842 E021.13.42.345 
N052.08.41.842 E021.13.42.345 N052.08.25.025 E021.13.12.557 
N052.08.25.025 E021.13.12.557 N052.08.04.170 E021.12.43.156 
N052.08.04.170 E021.12.43.156 N052.07.44.992 E021.12.22.287 
N052.07.44.992 E021.12.22.287 N052.07.16.948 E021.11.59.916 
N052.07.16.948 E021.11.59.916 N052.06.58.506 E021.11.48.895 
N052.06.58.506 E021.11.48.895 N052.06.37.764 E021.11.40.236 
N052.06.37.764 E021.11.40.236 N052.06.16.841 E021.11.34.428 
N052.06.16.841 E021.11.34.428 N052.05.52.224 E021.11.32.369 
N052.05.52.224 E021.11.32.369 N052.05.25.474 E021.11.35.543 
N052.05.25.474 E021.11.35.543 N052.04.54.337 E021.11.45.971 
N052.04.54.337 E021.11.45.971 N052.04.26.273 E021.12.02.401 
N052.04.26.273 E021.12.02.401 N052.04.06.681 E021.12.17.423 
N052.04.06.681 E021.12.17.423 N052.03.47.748 E021.12.33.813 
N052.03.47.748 E021.12.33.813 N052.00.32.459 E021.15.22.623 

N052.41.42.295 E019.49.11.803 N052.26.01.967 E020.34.18.689 
N052.26.01.967 E020.34.18.689 N052.22.42.295 E020.43.39.344 
N052.22.42.295 E020.43.39.344 N052.17.31.475 E020.58.12.787 
N052.17.31.475 E020.58.12.787 N052.16.15.738 E021.01.43.279 
N052.16.15.738 E021.01.43.279 N052.07.22.623 E021.09.27.541 
N052.07.22.623 E021.09.27.541 N052.00.32.459 E021.15.22.623 
N052.00.32.459 E021.15.22.623 N051.57.00.984 E021.18.25.574 
N051.57.00.984 E021.18.25.574 N051.53.28.525 E021.21.26.557 
N051.53.28.525 E021.21.26.557 N051.51.45.438 E021.22.55.326 
N051.51.45.438 E021.22.55.326 N051.51.34.024 E021.23.05.147 
N051.51.34.024 E021.23.05.147 N051.51.18.348 E021.23.15.847 
N051.51.18.348 E021.23.15.847 N051.51.07.912 E021.23.20.604 
N051.51.07.912 E021.23.20.604 N051.50.56.989 E021.23.23.751 
N051.50.56.989 E021.23.23.751 N051.50.45.164 E021.23.25.155 
N051.50.45.164 E021.23.25.155 N051.50.32.622 E021.23.24.420 
N051.50.32.622 E021.23.24.420 N051.50.12.296 E021.23.17.896 
N051.50.12.296 E021.23.17.896 N051.49.56.035 E021.23.08.477 
N051.49.56.035 E021.23.08.477 N051.49.44.930 E021.22.58.888 
N051.49.44.930 E021.22.58.888 N051.49.34.866 E021.22.47.711 
N051.49.34.866 E021.22.47.711 N051.49.25.298 E021.22.34.319 
N051.49.25.298 E021.22.34.319 N051.49.15.930 E021.22.17.657 
N051.49.15.930 E021.22.17.657 N051.49.07.207 E021.21.57.722 
N051.49.07.207 E021.21.57.722 N051.48.29.444 E021.20.03.640 
N051.48.29.444 E021.20.03.640 N051.48.22.484 E021.19.36.236 
N051.48.22.484 E021.19.36.236 N051.48.18.798 E021.19.10.559 
N051.48.18.798 E021.19.10.559 N051.48.17.228 E021.18.46.522 
N051.48.17.228 E021.18.46.522 N051.48.18.038 E021.18.15.956 
N051.48.18.038 E021.18.15.956 N051.48.21.104 E021.17.49.814 
N051.48.21.104 E021.17.49.814 N051.48.25.096 E021.17.29.911 
N051.48.25.096 E021.17.29.911 N051.48.31.836 E021.17.06.555 
N051.48.31.836 E021.17.06.555 N051.48.38.600 E021.16.49.398 
N051.48.38.600 E021.16.49.398 N051.48.46.202 E021.16.34.012 
N051.48.46.202 E021.16.34.012 N051.48.58.817 E021.16.14.567 
N051.48.58.817 E021.16.14.567 N051.49.06.534 E021.16.05.049 
N051.49.06.534 E021.16.05.049 N051.49.18.222 E021.15.53.141 
N051.49.18.222 E021.15.53.141 N051.51.07.869 E021.14.19.672 
     
                  
;;;;;;;;;;;;;;;;; HOLDINGS FOR STAR 33 ;;;;;;;;;;;;;;;;;;;
;Holding SORIX
N052.46.07.103 E019.50.21.047 N052.46.01.451 E019.50.58.416  ;
N052.46.01.451 E019.50.58.416 N052.45.51.984 E019.51.33.552  ;
N052.45.51.984 E019.51.33.552 N052.45.38.952 E019.52.05.447  ;
N052.45.38.952 E019.52.05.447 N052.45.22.752 E019.52.33.131  ;
N052.45.22.752 E019.52.33.131 N052.45.03.923 E019.52.55.775  ;
N052.45.03.923 E019.52.55.775 N052.44.42.971 E019.53.12.623  ;
N052.44.42.971 E019.53.12.623 N052.44.20.579 E019.53.23.244  ;
N052.44.20.579 E019.53.23.244 N052.43.57.396 E019.53.27.276  ;
N052.43.57.396 E019.53.27.276 N052.43.34.139 E019.53.24.576  ;
N052.43.34.139 E019.53.24.576 N052.43.11.532 E019.53.15.287  ;
N052.43.11.532 E019.53.15.287 N052.42.50.256 E019.52.59.628  ;
N052.42.50.256 E019.52.59.628 N052.42.30.924 E019.52.38.100  ;
N052.42.30.924 E019.52.38.100 N052.42.14.147 E019.52.11.352  ;
N052.42.14.147 E019.52.11.352 N052.42.00.468 E019.51.40.248  ;
N052.42.00.468 E019.51.40.248 N052.41.50.244 E019.51.05.651  ;
N052.41.50.244 E019.51.05.651 N052.41.43.835 E019.50.28.644  ;
N052.41.43.835 E019.50.28.644 N052.41.41.388 E019.49.50.376  ;
N052.41.41.388 E019.49.50.376 N052.41.43.007 E019.49.12.000  ;
N052.42.48.707 E019.37.46.919 N052.42.54.359 E019.37.09.588  ;
N052.42.54.359 E019.37.09.588 N052.43.03.828 E019.36.34.415  ;
N052.43.03.828 E019.36.34.415 N052.43.16.860 E019.36.02.484  ;
N052.43.16.860 E019.36.02.484 N052.43.33.060 E019.35.34.799  ;
N052.43.33.060 E019.35.34.799 N052.43.51.887 E019.35.12.156  ;
N052.43.51.887 E019.35.12.156 N052.44.12.839 E019.34.55.271  ;
N052.44.12.839 E019.34.55.271 N052.44.35.231 E019.34.44.652  ;
N052.44.35.231 E019.34.44.652 N052.44.58.416 E019.34.40.656  ;
N052.44.58.416 E019.34.40.656 N052.45.21.671 E019.34.43.320  ;
N052.45.21.671 E019.34.43.320 N052.45.44.280 E019.34.52.643  ;
N052.45.44.280 E019.34.52.643 N052.46.05.556 E019.35.08.304  ;
N052.46.05.556 E019.35.08.304 N052.46.24.888 E019.35.29.831  ;
N052.46.24.888 E019.35.29.831 N052.46.41.663 E019.35.56.579  ;
N052.46.41.663 E019.35.56.579 N052.46.55.344 E019.36.27.720  ;
N052.46.55.344 E019.36.27.720 N052.47.05.568 E019.37.02.315  ;
N052.47.05.568 E019.37.02.315 N052.47.11.975 E019.37.39.324  ;
N052.47.11.975 E019.37.39.324 N052.47.14.424 E019.38.17.628  ;
N052.47.14.424 E019.38.17.628 N052.47.12.803 E019.38.56.040  ;
N052.46.07.103 E019.50.21.047 N052.47.12.803 E019.38.56.040  ;Connecting line
N052.42.48.707 E019.37.46.919 N052.41.43.007 E019.49.12.000  ;Connecting line

;Holding BIMPA
N052.26.55.140 E019.46.21.360 N052.26.53.519 E019.46.59.448  ;
N052.26.53.519 E019.46.59.448 N052.26.47.867 E019.47.36.527  ;
N052.26.47.867 E019.47.36.527 N052.26.38.400 E019.48.11.448  ;
N052.26.38.400 E019.48.11.448 N052.26.25.367 E019.48.43.091  ;
N052.26.25.367 E019.48.43.091 N052.26.09.167 E019.49.10.596  ;
N052.26.09.167 E019.49.10.596 N052.25.50.339 E019.49.33.023  ;
N052.25.50.339 E019.49.33.023 N052.25.29.388 E019.49.49.800  ;
N052.25.29.388 E019.49.49.800 N052.25.06.996 E019.50.00.312  ;
N052.25.06.996 E019.50.00.312 N052.24.43.812 E019.50.04.308  ;
N052.24.43.812 E019.50.04.308 N052.24.20.555 E019.50.01.644  ;
N052.24.20.555 E019.50.01.644 N052.23.57.948 E019.49.52.391  ;
N052.23.57.948 E019.49.52.391 N052.23.36.672 E019.49.36.876  ;
N052.23.36.672 E019.49.36.876 N052.23.17.340 E019.49.15.491  ;
N052.23.17.340 E019.49.15.491 N052.23.00.564 E019.48.48.960  ;
N052.23.00.564 E019.48.48.960 N052.22.46.883 E019.48.18.071  ;
N052.22.46.883 E019.48.18.071 N052.22.36.659 E019.47.43.728  ;
N052.22.36.659 E019.47.43.728 N052.22.30.252 E019.47.07.008  ;
N052.22.30.252 E019.47.07.008 N052.22.27.803 E019.46.28.991  ;
N052.22.20.459 E019.35.00.564 N052.22.22.079 E019.34.22.476  ;
N052.22.22.079 E019.34.22.476 N052.22.27.731 E019.33.45.395  ;
N052.22.27.731 E019.33.45.395 N052.22.37.200 E019.33.10.512  ;
N052.22.37.200 E019.33.10.512 N052.22.50.232 E019.32.38.831  ;
N052.22.50.232 E019.32.38.831 N052.23.06.432 E019.32.11.364  ;
N052.23.06.432 E019.32.11.364 N052.23.25.259 E019.31.48.899  ;
N052.23.25.259 E019.31.48.899 N052.23.46.211 E019.31.32.160  ;
N052.23.46.211 E019.31.32.160 N052.24.08.603 E019.31.21.612  ;
N052.24.08.603 E019.31.21.612 N052.24.31.788 E019.31.17.616  ;
N052.24.31.788 E019.31.17.616 N052.24.55.043 E019.31.20.280  ;
N052.24.55.043 E019.31.20.280 N052.25.17.652 E019.31.29.531  ;
N052.25.17.652 E019.31.29.531 N052.25.38.928 E019.31.45.083  ;
N052.25.38.928 E019.31.45.083 N052.25.58.260 E019.32.06.431  ;
N052.25.58.260 E019.32.06.431 N052.26.15.036 E019.32.32.964  ;
N052.26.15.036 E019.32.32.964 N052.26.28.716 E019.33.03.887  ;
N052.26.28.716 E019.33.03.887 N052.26.38.940 E019.33.38.196  ;
N052.26.38.940 E019.33.38.196 N052.26.45.347 E019.34.14.916  ;
N052.26.45.347 E019.34.14.916 N052.26.47.795 E019.34.52.931  ;
N052.26.55.140 E019.46.21.360 N052.26.47.795 E019.34.52.931  ;Connecting line
N052.22.20.459 E019.35.00.564 N052.22.27.803 E019.46.28.991  ;Connecting line

;Holding AGAVA
N051.39.20.447 E019.57.46.188 N051.39.18.000 E019.58.23.519  ;
N051.39.18.000 E019.58.23.519 N051.39.11.591 E019.58.59.591  ;
N051.39.11.591 E019.58.59.591 N051.39.01.367 E019.59.33.323  ;
N051.39.01.367 E019.59.33.323 N051.38.47.688 E020.00.03.708  ;
N051.38.47.688 E020.00.03.708 N051.38.30.911 E020.00.29.771  ;
N051.38.30.911 E020.00.29.771 N051.38.11.579 E020.00.50.759  ;
N051.38.11.579 E020.00.50.759 N051.37.50.303 E020.01.06.023  ;
N051.37.50.303 E020.01.06.023 N051.37.27.696 E020.01.15.095  ;
N051.37.27.696 E020.01.15.095 N051.37.04.439 E020.01.17.723  ;
N051.37.04.439 E020.01.17.723 N051.36.41.256 E020.01.13.799  ;
N051.36.41.256 E020.01.13.799 N051.36.18.864 E020.01.03.468  ;
N051.36.18.864 E020.01.03.468 N051.35.57.912 E020.00.47.015  ;
N051.35.57.912 E020.00.47.015 N051.35.39.083 E020.00.24.948  ;
N051.35.39.083 E020.00.24.948 N051.35.22.883 E019.59.57.948  ;
N051.35.22.883 E019.59.57.948 N051.35.09.851 E019.59.26.844  ;
N051.35.09.851 E019.59.26.844 N051.35.00.384 E019.58.52.535  ;
N051.35.00.384 E019.58.52.535 N051.34.54.732 E019.58.16.140  ;
N051.34.54.732 E019.58.16.140 N051.34.53.112 E019.57.38.700  ;
N051.35.00.456 E019.46.22.368 N051.35.02.903 E019.45.45.035  ;
N051.35.02.903 E019.45.45.035 N051.35.09.312 E019.45.08.927  ;
N051.35.09.312 E019.45.08.927 N051.35.19.536 E019.44.35.196  ;
N051.35.19.536 E019.44.35.196 N051.35.33.215 E019.44.04.848  ;
N051.35.33.215 E019.44.04.848 N051.35.49.992 E019.43.38.784  ;
N051.35.49.992 E019.43.38.784 N051.36.09.323 E019.43.17.795  ;
N051.36.09.323 E019.43.17.795 N051.36.30.599 E019.43.02.531  ;
N051.36.30.599 E019.43.02.531 N051.36.53.208 E019.42.53.423  ;
N051.36.53.208 E019.42.53.423 N051.37.16.464 E019.42.50.832  ;
N051.37.16.464 E019.42.50.832 N051.37.39.647 E019.42.54.755  ;
N051.37.39.647 E019.42.54.755 N051.38.02.039 E019.43.05.088  ;
N051.38.02.039 E019.43.05.088 N051.38.22.991 E019.43.21.540  ;
N051.38.22.991 E019.43.21.540 N051.38.41.820 E019.43.43.608  ;
N051.38.41.820 E019.43.43.608 N051.38.58.020 E019.44.10.608  ;
N051.38.58.020 E019.44.10.608 N051.39.11.051 E019.44.41.712  ;
N051.39.11.051 E019.44.41.712 N051.39.20.520 E019.45.16.019  ;
N051.39.20.520 E019.45.16.019 N051.39.26.171 E019.45.52.415  ;
N051.39.26.171 E019.45.52.415 N051.39.27.791 E019.46.29.856  ;
N051.39.20.447 E019.57.46.188 N051.39.27.791 E019.46.29.856  ;Connecting line
N051.35.00.456 E019.46.22.368 N051.34.53.112 E019.57.38.700  ;Connecting line

;Holding LOGDA
N051.17.03.983 E020.41.38.039 N051.17.24.576 E020.41.55.536  ;
N051.17.24.576 E020.41.55.536 N051.17.42.935 E020.42.18.468  ;
N051.17.42.935 E020.42.18.468 N051.17.58.524 E020.42.46.152  ;
N051.17.58.524 E020.42.46.152 N051.18.10.871 E020.43.17.723  ;
N051.18.10.871 E020.43.17.723 N051.18.19.583 E020.43.52.284  ;
N051.18.19.583 E020.43.52.284 N051.18.24.443 E020.44.28.715  ;
N051.18.24.443 E020.44.28.715 N051.18.25.272 E020.45.05.940  ;
N051.18.25.272 E020.45.05.940 N051.18.21.995 E020.45.42.804  ;
N051.18.21.995 E020.45.42.804 N051.18.14.796 E020.46.18.228  ;
N051.18.14.796 E020.46.18.228 N051.18.03.852 E020.46.51.132  ;
N051.18.03.852 E020.46.51.132 N051.17.49.523 E020.47.20.472  ;
N051.17.49.523 E020.47.20.472 N051.17.32.207 E020.47.45.384  ;
N051.17.32.207 E020.47.45.384 N051.17.12.444 E020.48.05.147  ;
N051.17.12.444 E020.48.05.147 N051.16.50.844 E020.48.19.079  ;
N051.16.50.844 E020.48.19.079 N051.16.28.055 E020.48.26.819  ;
N051.16.28.055 E020.48.26.819 N051.16.04.763 E020.48.28.115  ;
N051.16.04.763 E020.48.28.115 N051.15.41.688 E020.48.22.932  ;
N051.15.41.688 E020.48.22.932 N051.15.19.512 E020.48.11.448  ;
N051.08.52.907 E020.43.48.684 N051.08.32.316 E020.43.31.223  ;
N051.08.32.316 E020.43.31.223 N051.08.13.956 E020.43.08.364  ;
N051.08.13.956 E020.43.08.364 N051.07.58.368 E020.42.40.752  ;
N051.07.58.368 E020.42.40.752 N051.07.46.019 E020.42.09.215  ;
N051.07.46.019 E020.42.09.215 N051.07.37.307 E020.41.34.764  ;
N051.07.37.307 E020.41.34.764 N051.07.32.448 E020.40.58.440  ;
N051.07.32.448 E020.40.58.440 N051.07.31.620 E020.40.21.287  ;
N051.07.31.620 E020.40.21.287 N051.07.34.895 E020.39.44.495  ;
N051.07.34.895 E020.39.44.495 N051.07.42.096 E020.39.09.143  ;
N051.07.42.096 E020.39.09.143 N051.07.53.039 E020.38.36.347  ;
N051.07.53.039 E020.38.36.347 N051.08.07.367 E020.38.07.044  ;
N051.08.07.367 E020.38.07.044 N051.08.24.683 E020.37.42.203  ;
N051.08.24.683 E020.37.42.203 N051.08.44.447 E020.37.22.512  ;
N051.08.44.447 E020.37.22.512 N051.09.06.047 E020.37.08.580  ;
N051.09.06.047 E020.37.08.580 N051.09.28.835 E020.37.00.840  ;
N051.09.28.835 E020.37.00.840 N051.09.52.127 E020.36.59.544  ;
N051.09.52.127 E020.36.59.544 N051.10.15.203 E020.37.04.727  ;
N051.10.15.203 E020.37.04.727 N051.10.37.380 E020.37.16.211  ;
N051.17.03.983 E020.41.38.039 N051.10.37.380 E020.37.16.211  ;Connecting line
N051.08.52.907 E020.43.48.684 N051.15.19.512 E020.48.11.448  ;Connecting line


;LIMVI 
N051.44.41.999 E021.41.07.943 N051.45.02.196 E021.40.49.115  ;
N051.45.02.196 E021.40.49.115 N051.45.24.083 E021.40.36.227  ;
N051.45.24.083 E021.40.36.227 N051.45.47.016 E021.40.29.676  ;
N051.45.47.016 E021.40.29.676 N051.46.10.343 E021.40.29.676  ;
N051.46.10.343 E021.40.29.676 N051.46.33.276 E021.40.36.227  ;
N051.46.33.276 E021.40.36.227 N051.46.55.164 E021.40.49.115  ;
N051.46.55.164 E021.40.49.115 N051.47.15.359 E021.41.07.943  ;
N051.47.15.359 E021.41.07.943 N051.47.33.216 E021.41.32.136  ;
N051.47.33.216 E021.41.32.136 N051.47.48.192 E021.42.00.971  ;
N051.47.48.192 E021.42.00.971 N051.47.59.855 E021.42.33.588  ;
N051.47.59.855 E021.42.33.588 N051.48.07.811 E021.43.08.975  ;
N051.48.07.811 E021.43.08.975 N051.48.11.843 E021.43.46.055  ;
N051.48.11.843 E021.43.46.055 N051.48.11.843 E021.44.23.712  ;
N051.48.11.843 E021.44.23.712 N051.48.07.811 E021.45.00.791  ;
N051.48.07.811 E021.45.00.791 N051.47.59.855 E021.45.36.179  ;
N051.47.59.855 E021.45.36.179 N051.47.48.192 E021.46.08.796  ;
N051.47.48.192 E021.46.08.796 N051.47.33.216 E021.46.37.632  ;
N051.47.33.216 E021.46.37.632 N051.47.15.359 E021.47.01.824  ;
N051.41.31.308 E021.53.30.732 N051.41.11.111 E021.53.49.523  ;
N051.41.11.111 E021.53.49.523 N051.40.49.224 E021.54.02.375  ;
N051.40.49.224 E021.54.02.375 N051.40.26.291 E021.54.08.892  ;
N051.40.26.291 E021.54.08.892 N051.40.02.964 E021.54.08.892  ;
N051.40.02.964 E021.54.08.892 N051.39.40.031 E021.54.02.375  ;
N051.39.40.031 E021.54.02.375 N051.39.18.143 E021.53.49.523  ;
N051.39.18.143 E021.53.49.523 N051.38.57.948 E021.53.30.732  ;
N051.38.57.948 E021.53.30.732 N051.38.40.091 E021.53.06.575  ;
N051.38.40.091 E021.53.06.575 N051.38.25.115 E021.52.37.811  ;
N051.38.25.115 E021.52.37.811 N051.38.13.452 E021.52.05.268  ;
N051.38.13.452 E021.52.05.268 N051.38.05.496 E021.51.29.951  ;
N051.38.05.496 E021.51.29.951 N051.38.01.464 E021.50.52.944  ;
N051.38.01.464 E021.50.52.944 N051.38.01.464 E021.50.15.359  ;
N051.38.01.464 E021.50.15.359 N051.38.05.496 E021.49.38.352  ;
N051.38.05.496 E021.49.38.352 N051.38.13.452 E021.49.03.035  ;
N051.38.13.452 E021.49.03.035 N051.38.25.115 E021.48.30.491  ;
N051.38.25.115 E021.48.30.491 N051.38.40.091 E021.48.01.728  ;
N051.38.40.091 E021.48.01.728 N051.38.57.948 E021.47.37.571  ;
N051.44.41.999 E021.41.07.943 N051.38.57.948 E021.47.37.571  ;Connecting line
N051.41.31.308 E021.53.30.732 N051.47.15.359 E021.47.01.824  ;Connecting line  

;GOMSA
N052.20.28.931 E020.19.58.260 N052.20.23.783 E020.20.24.143  ;
N052.20.23.783 E020.20.24.143 N052.20.15.971 E020.20.48.192  ;
N052.20.15.971 E020.20.48.192 N052.20.05.711 E020.21.09.647  ;
N052.20.05.711 E020.21.09.647 N052.19.53.327 E020.21.27.863  ;
N052.19.53.327 E020.21.27.863 N052.19.39.215 E020.21.42.300  ;
N052.19.39.215 E020.21.42.300 N052.19.23.807 E020.21.52.523  ;
N052.19.23.807 E020.21.52.523 N052.19.07.500 E020.21.58.176  ;
N052.19.07.500 E020.21.58.176 N052.18.50.867 E020.21.59.112  ;
N052.18.50.867 E020.21.59.112 N052.18.34.380 E020.21.55.331  ;
N052.18.34.380 E020.21.55.331 N052.18.18.576 E020.21.46.907  ;
N052.18.18.576 E020.21.46.907 N052.18.03.852 E020.21.34.128  ;
N052.18.03.852 E020.21.34.128 N052.17.50.747 E020.21.17.352  ;
N052.17.50.747 E020.21.17.352 N052.17.39.623 E020.20.57.119  ;
N052.17.39.623 E020.20.57.119 N052.17.30.804 E020.20.34.044  ;
N052.17.30.804 E020.20.34.044 N052.17.24.539 E020.20.08.807  ;
N052.17.24.539 E020.20.08.807 N052.17.21.083 E020.19.42.167  ;
N052.17.21.083 E020.19.42.167 N052.17.20.507 E020.19.14.952  ;
N052.17.20.507 E020.19.14.952 N052.17.22.812 E020.18.47.988  ;
N052.18.30.311 E020.10.49.799 N052.18.35.459 E020.10.23.916  ;
N052.18.35.459 E020.10.23.916 N052.18.43.271 E020.09.59.868  ;
N052.18.43.271 E020.09.59.868 N052.18.53.531 E020.09.38.376  ;
N052.18.53.531 E020.09.38.376 N052.19.05.915 E020.09.20.159  ;
N052.19.05.915 E020.09.20.159 N052.19.20.027 E020.09.05.723  ;
N052.19.20.027 E020.09.05.723 N052.19.35.435 E020.08.55.535  ;
N052.19.35.435 E020.08.55.535 N052.19.51.744 E020.08.49.847  ;
N052.19.51.744 E020.08.49.847 N052.20.08.375 E020.08.48.912  ;
N052.20.08.375 E020.08.48.912 N052.20.24.864 E020.08.52.692  ;
N052.20.24.864 E020.08.52.692 N052.20.40.668 E020.09.01.116  ;
N052.20.40.668 E020.09.01.116 N052.20.55.392 E020.09.13.896  ;
N052.20.55.392 E020.09.13.896 N052.21.08.495 E020.09.30.671  ;
N052.21.08.495 E020.09.30.671 N052.21.19.619 E020.09.50.939  ;
N052.21.19.619 E020.09.50.939 N052.21.28.440 E020.10.14.015  ;
N052.21.28.440 E020.10.14.015 N052.21.34.703 E020.10.39.287  ;
N052.21.34.703 E020.10.39.287 N052.21.38.159 E020.11.05.927  ;
N052.21.38.159 E020.11.05.927 N052.21.38.735 E020.11.33.144  ;
N052.21.38.735 E020.11.33.144 N052.21.36.432 E020.12.00.144  ;
N052.20.28.931 E020.19.58.260 N052.21.36.432 E020.12.00.144  ;Connecting line
N052.18.30.311 E020.10.49.799 N052.17.22.812 E020.18.47.988  ;Connecting line                 

;TINBU
N052.20.18.744 E021.00.44.244 N052.20.09.419 E021.01.06.816  ;
N052.20.09.419 E021.01.06.816 N052.19.57.864 E021.01.26.400  ;
N052.19.57.864 E021.01.26.400 N052.19.44.400 E021.01.42.383  ;
N052.19.44.400 E021.01.42.383 N052.19.29.459 E021.01.54.335  ;
N052.19.29.459 E021.01.54.335 N052.19.13.439 E021.02.01.824  ;
N052.19.13.439 E021.02.01.824 N052.18.56.880 E021.02.04.667  ;
N052.18.56.880 E021.02.04.667 N052.18.40.284 E021.02.02.795  ;
N052.18.40.284 E021.02.02.795 N052.18.24.119 E021.01.56.208  ;
N052.18.24.119 E021.01.56.208 N052.18.08.928 E021.01.45.119  ;
N052.18.08.928 E021.01.45.119 N052.17.55.140 E021.01.29.891  ;
N052.17.55.140 E021.01.29.891 N052.17.43.151 E021.01.10.991  ;
N052.17.43.151 E021.01.10.991 N052.17.33.360 E021.00.48.960  ;
N052.17.33.360 E021.00.48.960 N052.17.26.087 E021.00.24.479  ;
N052.17.26.087 E021.00.24.479 N052.17.21.479 E020.59.58.308  ;
N052.17.21.479 E020.59.58.308 N052.17.19.752 E020.59.31.236  ;
N052.17.19.752 E020.59.31.236 N052.17.20.904 E020.59.04.055  ;
N052.17.20.904 E020.59.04.055 N052.17.24.936 E020.58.37.631  ;
N052.17.24.936 E020.58.37.631 N052.17.31.704 E020.58.12.756  ;
N052.19.57.144 E020.51.03.456 N052.20.06.467 E020.50.40.883  ;
N052.20.06.467 E020.50.40.883 N052.20.18.024 E020.50.21.264  ;
N052.20.18.024 E020.50.21.264 N052.20.31.488 E020.50.05.244  ;
N052.20.31.488 E020.50.05.244 N052.20.46.427 E020.49.53.291  ;
N052.20.46.427 E020.49.53.291 N052.21.02.447 E020.49.45.804  ;
N052.21.02.447 E020.49.45.804 N052.21.19.008 E020.49.42.960  ;
N052.21.19.008 E020.49.42.960 N052.21.35.604 E020.49.44.831  ;
N052.21.35.604 E020.49.44.831 N052.21.51.767 E020.49.51.456  ;
N052.21.51.767 E020.49.51.456 N052.22.06.960 E020.50.02.507  ;
N052.22.06.960 E020.50.02.507 N052.22.20.748 E020.50.17.772  ;
N052.22.20.748 E020.50.17.772 N052.22.32.735 E020.50.36.708  ;
N052.22.32.735 E020.50.36.708 N052.22.42.528 E020.50.58.740  ;
N052.22.42.528 E020.50.58.740 N052.22.49.799 E020.51.23.255  ;
N052.22.49.799 E020.51.23.255 N052.22.54.407 E020.51.49.428  ;
N052.22.54.407 E020.51.49.428 N052.22.56.136 E020.52.16.535  ;
N052.22.56.136 E020.52.16.535 N052.22.54.984 E020.52.43.716  ;
N052.22.54.984 E020.52.43.716 N052.22.50.951 E020.53.10.176  ;
N052.22.50.951 E020.53.10.176 N052.22.44.184 E020.53.35.088  ;
N052.20.18.744 E021.00.44.244 N052.22.44.184 E020.53.35.088  ;Connecting line
N052.19.57.144 E020.51.03.456 N052.17.31.704 E020.58.12.756  ;Connecting line

;INSEX
N051.37.48.359 E020.56.24.108 N051.38.04.955 E020.56.25.980  ;
N051.38.04.955 E020.56.25.980 N051.38.21.120 E020.56.32.460  ;
N051.38.21.120 E020.56.32.460 N051.38.36.311 E020.56.43.368  ;
N051.38.36.311 E020.56.43.368 N051.38.50.099 E020.56.58.379  ;
N051.38.50.099 E020.56.58.379 N051.39.02.087 E020.57.16.991  ;
N051.39.02.087 E020.57.16.991 N051.39.11.880 E020.57.38.700  ;
N051.39.11.880 E020.57.38.700 N051.39.19.152 E020.58.02.819  ;
N051.39.19.152 E020.58.02.819 N051.39.23.759 E020.58.28.595  ;
N051.39.23.759 E020.58.28.595 N051.39.25.488 E020.58.55.235  ;
N051.39.25.488 E020.58.55.235 N051.39.24.335 E020.59.22.020  ;
N051.39.24.335 E020.59.22.020 N051.39.20.303 E020.59.48.012  ;
N051.39.20.303 E020.59.48.012 N051.39.13.535 E021.00.12.527  ;
N051.39.13.535 E021.00.12.527 N051.39.04.212 E021.00.34.740  ;
N051.39.04.212 E021.00.34.740 N051.38.52.655 E021.00.54.036  ;
N051.38.52.655 E021.00.54.036 N051.38.39.191 E021.01.09.804  ;
N051.38.39.191 E021.01.09.804 N051.38.24.252 E021.01.21.575  ;
N051.38.24.252 E021.01.21.575 N051.38.08.232 E021.01.28.955  ;
N051.38.08.232 E021.01.28.955 N051.37.51.671 E021.01.31.764  ;
N051.32.51.684 E021.01.35.687 N051.32.35.088 E021.01.33.816  ;
N051.32.35.088 E021.01.33.816 N051.32.18.923 E021.01.27.336  ;
N051.32.18.923 E021.01.27.336 N051.32.03.732 E021.01.16.463  ;
N051.32.03.732 E021.01.16.463 N051.31.49.944 E021.01.01.487  ;
N051.31.49.944 E021.01.01.487 N051.31.37.955 E021.00.42.876  ;
N051.31.37.955 E021.00.42.876 N051.31.28.164 E021.00.21.240  ;
N051.31.28.164 E021.00.21.240 N051.31.20.891 E020.59.57.192  ;
N051.31.20.891 E020.59.57.192 N051.31.16.283 E020.59.31.451  ;
N051.31.16.283 E020.59.31.451 N051.31.14.556 E020.59.04.812  ;
N051.31.14.556 E020.59.04.812 N051.31.15.708 E020.58.38.136  ;
N051.31.15.708 E020.58.38.136 N051.31.19.740 E020.58.12.144  ;
N051.31.19.740 E020.58.12.144 N051.31.26.508 E020.57.47.699  ;
N051.31.26.508 E020.57.47.699 N051.31.35.832 E020.57.25.524  ;
N051.31.35.832 E020.57.25.524 N051.31.47.387 E020.57.06.264  ;
N051.31.47.387 E020.57.06.264 N051.32.00.851 E020.56.50.531  ;
N051.32.00.851 E020.56.50.531 N051.32.15.792 E020.56.38.795  ;
N051.32.15.792 E020.56.38.795 N051.32.31.811 E020.56.31.416  ;
N051.32.31.811 E020.56.31.416 N051.32.48.372 E020.56.28.607  ;
N051.37.49.188 E020.56.24.108 N051.32.49.199 E020.56.28.607  ;Connecting line
N051.32.50.856 E021.01.35.687 N051.37.50.843 E021.01.31.764  ;Connecting line  

;IPSIM
N052.06.52.056 E021.28.11.243 N052.06.53.783 E021.27.44.243  ;
N052.06.53.783 E021.27.44.243 N052.06.58.391 E021.27.18.179  ;
N052.06.58.391 E021.27.18.179 N052.07.05.664 E021.26.53.808  ;
N052.07.05.664 E021.26.53.808 N052.07.15.455 E021.26.31.848  ;
N052.07.15.455 E021.26.31.848 N052.07.27.444 E021.26.13.019  ;
N052.07.27.444 E021.26.13.019 N052.07.41.232 E021.25.57.863  ;
N052.07.41.232 E021.25.57.863 N052.07.56.423 E021.25.46.812  ;
N052.07.56.423 E021.25.46.812 N052.08.12.588 E021.25.40.259  ;
N052.08.12.588 E021.25.40.259 N052.08.29.184 E021.25.38.388  ;
N052.08.29.184 E021.25.38.388 N052.08.45.743 E021.25.41.196  ;
N052.08.45.743 E021.25.41.196 N052.09.01.763 E021.25.48.683  ;
N052.09.01.763 E021.25.48.683 N052.09.16.704 E021.26.00.563  ;
N052.09.16.704 E021.26.00.563 N052.09.30.168 E021.26.16.511  ;
N052.09.30.168 E021.26.16.511 N052.09.41.723 E021.26.36.023  ;
N052.09.41.723 E021.26.36.023 N052.09.51.048 E021.26.58.524  ;
N052.09.51.048 E021.26.58.524 N052.09.57.816 E021.27.23.291  ;
N052.09.57.816 E021.27.23.291 N052.10.01.848 E021.27.49.607  ;
N052.10.01.848 E021.27.49.607 N052.10.02.999 E021.28.16.643  ;
N052.09.55.152 E021.36.25.308 N052.09.53.423 E021.36.52.307  ;
N052.09.53.423 E021.36.52.307 N052.09.48.815 E021.37.18.372  ;
N052.09.48.815 E021.37.18.372 N052.09.41.544 E021.37.42.744  ;
N052.09.41.544 E021.37.42.744 N052.09.31.751 E021.38.04.668  ;
N052.09.31.751 E021.38.04.668 N052.09.19.764 E021.38.23.531  ;
N052.09.19.764 E021.38.23.531 N052.09.05.975 E021.38.38.687  ;
N052.09.05.975 E021.38.38.687 N052.08.50.784 E021.38.49.704  ;
N052.08.50.784 E021.38.49.704 N052.08.34.619 E021.38.56.291  ;
N052.08.34.619 E021.38.56.291 N052.08.18.023 E021.38.58.164  ;
N052.08.18.023 E021.38.58.164 N052.08.01.464 E021.38.55.356  ;
N052.08.01.464 E021.38.55.356 N052.07.45.443 E021.38.47.867  ;
N052.07.45.443 E021.38.47.867 N052.07.30.504 E021.38.35.987  ;
N052.07.30.504 E021.38.35.987 N052.07.17.040 E021.38.20.039  ;
N052.07.17.040 E021.38.20.039 N052.07.05.483 E021.38.00.527  ;
N052.07.05.483 E021.38.00.527 N052.06.56.160 E021.37.38.028  ;
N052.06.56.160 E021.37.38.028 N052.06.49.392 E021.37.13.259  ;
N052.06.49.392 E021.37.13.259 N052.06.45.360 E021.36.46.944  ;
N052.06.45.360 E021.36.46.944 N052.06.44.207 E021.36.19.908  ;
N052.06.52.056 E021.28.09.875 N052.06.44.207 E021.36.18.539  ;Connecting line
N052.09.55.152 E021.36.26.676 N052.10.02.999 E021.28.18.011  ;Connecting line        
            
EPWA vor/dme 33              N001.39.20.999 E021.25.40.001 N001.41.44.999 E020.58.09.998 Blue
N052.08.08.232 E020.59.39.939 N052.07.15.495 E021.00.30.050 Blue
N052.06.20.986 E021.01.21.825 N052.05.28.897 E021.02.11.270 Blue
N052.04.38.935 E021.02.58.747 N052.03.46.387 E021.03.48.619 Blue
N052.02.57.397 E021.04.35.104 N052.02.01.215 E021.05.28.366 Blue
N052.01.09.654 E021.06.17.256 N052.00.19.553 E021.07.04.766 Blue
N051.59.30.701 E021.07.51.047 N051.58.37.617 E021.08.41.285 Blue
N051.55.59.466 E021.11.11.007 N051.55.11.437 E021.11.56.477 Blue
N051.57.44.680 E021.09.31.419 N051.56.52.746 E021.10.20.618 Blue
EPWA vor/dme 11           N052.10.52.175 E020.54.32.292 N052.11.12.696 E020.53.00.348 blue ;
                          N052.11.33.216 E020.51.28.368 N052.11.53.735 E020.49.56.387 blue ;
                          N052.12.14.256 E020.48.24.407 N052.12.34.775 E020.46.52.392 blue ;
                          N052.12.55.295 E020.45.20.375 N052.13.15.816 E020.43.48.360 blue ;
                          N052.13.36.335 E020.42.16.344 N052.13.56.856 E020.40.44.291 blue ;
                          N052.14.17.376 E020.39.12.240 N052.14.37.895 E020.37.40.187 blue ;
                          N052.14.58.416 E020.36.08.100 N052.15.18.935 E020.34.36.012 blue ;
                          N052.15.39.455 E020.33.03.923 N052.15.59.976 E020.31.31.800 blue ;


EPWA vor/dme 29               N001.39.20.999 E021.25.40.001 N001.41.44.999 E020.58.09.998 Blue
N052.09.11.000 E021.00.28.000 N052.08.43.000 E021.01.54.000 Blue
N052.08.14.000 E021.03.20.000 N052.07.46.000 E021.04.46.000 Blue
N052.07.17.000 E021.06.12.000 N052.06.49.000 E021.07.38.000 Blue
N052.06.20.000 E021.09.04.000 N052.05.52.000 E021.10.30.000 Blue
N052.05.23.000 E021.11.56.000 N052.04.55.000 E021.13.22.000 Blue
N052.04.26.000 E021.14.48.000 N052.03.58.000 E021.16.14.000 Blue
N052.03.29.000 E021.17.40.000 N052.03.00.000 E021.19.06.000 Blue
N052.02.32.000 E021.20.32.000 N052.02.03.000 E021.21.58.000 Blue
EPWA vor/dme 15        N001.39.20.999 E021.25.40.001 N001.41.44.999 E020.58.09.998 blue
                          N052.11.36.743 E020.56.36.347 N052.12.31.896 E020.55.57.791 blue
                          N052.13.27.047 E020.55.19.236 N052.14.22.199 E020.54.40.644 blue
                          N052.15.17.352 E020.54.02.051 N052.16.12.503 E020.53.23.423 blue
                          N052.17.07.656 E020.52.44.796 N052.18.02.808 E020.52.06.167 blue
                          N052.18.57.959 E020.51.27.503 N052.19.53.112 E020.50.48.840 blue
                          N052.20.48.263 E020.50.10.175 N052.21.43.415 E020.49.31.476 blue
                          N052.22.38.568 E020.48.52.775 N052.23.33.719 E020.48.14.039 blue
                          N052.24.28.872 E020.47.35.304 N052.25.24.024 E020.46.56.567 blue


EPPO vor/dme 11          N000.00.00.000 E000.00.00.000 N000.00.00.000 E000.00.00.000
                          N052.25.40.368 E016.46.42.276 N052.25.52.860 E016.45.06.012 Blue
                          N052.26.05.352 E016.43.29.748 N052.26.17.844 E016.41.53.484 Blue
                          N052.26.30.336 E016.40.17.220 N052.26.42.828 E016.38.40.955 Blue
                          N052.26.55.320 E016.37.04.656 N052.27.07.812 E016.35.28.356 Blue
                          N052.27.20.304 E016.33.52.056 N052.27.32.796 E016.32.15.756 Blue
                          N052.27.45.288 E016.30.39.456 N052.27.57.780 E016.29.03.120 Blue
                          N052.28.10.272 E016.27.26.783 N052.28.22.764 E016.25.50.447 Blue
                          N052.28.35.256 E016.24.14.111 N052.28.47.748 E016.22.37.740 Blue





HOLDING KRW               N001.39.20.999 E021.25.40.001 N001.41.44.999 E020.58.09.998
N050.10.50.467 E020.09.31.283 N050.10.19.123 E020.09.31.012 ;holding- 
N050.11.50.857 E020.09.05.808 N050.11.21.368 E020.09.22.545 ;holding- 
N050.12.18.645 E020.08.41.330 N050.11.50.857 E020.09.05.808 ;holding- 
N050.12.42.041 E020.08.09.854 N050.12.18.645 E020.08.41.330 ;holding- 
N050.13.02.258 E020.07.32.337 N050.12.42.041 E020.08.09.854 ;holding- 
N050.13.17.958 E020.06.49.919 N050.13.02.258 E020.07.32.337 ;holding- 
N050.13.34.163 E020.05.15.643 N050.13.28.701 E020.06.03.888 ;holding- 
N050.08.07.363 E020.07.32.143 N050.07.51.687 E020.06.49.704 ;holding- 
N050.13.28.701 E020.06.03.888 N050.13.17.958 E020.06.49.919 ;holding- 
N050.09.48.194 E020.09.22.484 N050.09.18.714 E020.09.05.708 ;holding- 
N050.09.18.714 E020.09.05.708 N050.08.51.548 E020.08.41.194 ;holding- 
N050.11.32.253 E019.52.20.836 N050.13.28.721 E020.03.38.407 ;holding- 
N050.08.27.521 E020.08.09.686 N050.08.07.363 E020.07.32.143 ;holding- 
N050.07.51.687 E020.06.49.704 N050.07.40.988 E020.06.03.651 ;holding- 
N050.05.44.520 E019.54.46.000 N050.07.40.988 E020.06.03.651 ;holding- 
N050.13.34.176 E020.04.26.651 N050.13.34.163 E020.05.15.643 ;holding- 
N050.11.21.368 E020.09.22.545 N050.10.50.467 E020.09.31.283 ;holding- 
N050.08.51.548 E020.08.41.194 N050.08.27.521 E020.08.09.686 ;holding- 
N050.05.39.767 E019.53.57.867 N050.05.39.560 E019.53.08.907 ;holding- 
N050.10.19.123 E020.09.31.012 N050.09.48.194 E020.09.22.484 ;holding- 
N050.13.28.721 E020.03.38.407 N050.13.34.176 E020.04.26.651 ;holding- 
N050.05.44.520 E019.54.46.000 N050.05.39.767 E019.53.57.867 ;holding- 
N050.05.39.560 E019.53.08.907 N050.05.44.531 E019.52.20.694 ;holding- 
N050.05.44.531 E019.52.20.694 N050.05.55.270 E019.51.34.692 ;holding- 
N050.05.55.270 E019.51.34.692 N050.06.10.965 E019.50.52.298 ;holding- 
N050.06.10.965 E019.50.52.298 N050.06.31.139 E019.50.14.801 ;holding- 
N050.06.31.139 E019.50.14.801 N050.06.55.180 E019.49.43.340 ;holding- 
N050.06.55.180 E019.49.43.340 N050.07.22.356 E019.49.18.871 ;holding- 
N050.07.22.356 E019.49.18.871 N050.07.51.843 E019.49.02.138 ;holding- 
N050.10.45.698 E019.50.14.901 N050.11.05.860 E019.50.52.414 ;holding- 
N050.08.22.743 E019.48.53.648 N050.08.54.120 E019.48.53.660 ;holding- 
N050.08.54.120 E019.48.53.660 N050.09.25.804 E019.49.02.174 ;holding- 
N050.09.25.804 E019.49.02.174 N050.09.54.499 E019.49.18.931 ;holding- 
N050.09.54.499 E019.49.18.931 N050.10.21.667 E019.49.43.421 ;holding- 
N050.10.21.667 E019.49.43.421 N050.10.45.698 E019.50.14.901 ;holding- 
N050.11.21.541 E019.51.34.820 N050.11.32.253 E019.52.20.836 ;holding- 
N050.07.51.843 E019.49.02.138 N050.08.22.743 E019.48.53.648 ;holding- 
N050.11.05.860 E019.50.52.414 N050.11.21.541 E019.51.34.820 ;holding- 
HOLDING KRT               N001.39.20.999 E021.25.40.001 N001.41.44.999 E020.58.09.998
N054.18.58.661 E018.11.57.318 N054.19.30.867 E018.11.55.429 ;holding- 
N054.22.01.165 E018.14.43.463 N054.22.12.761 E018.15.33.339 ;holding- 
N054.21.51.620 E018.19.51.673 N054.21.32.309 E018.20.34.395 ;holding- 
N054.22.06.344 E018.19.04.167 N054.21.51.620 E018.19.51.673 ;holding- 
N054.22.16.376 E018.18.12.999 N054.22.06.344 E018.19.04.167 ;holding- 
N054.22.20.393 E018.17.19.723 N054.22.16.376 E018.18.12.999 ;holding- 
N054.22.19.291 E018.16.25.958 N054.22.20.393 E018.17.19.723 ;holding- 
N054.22.12.761 E018.15.33.339 N054.22.19.291 E018.16.25.958 ;holding- 
N054.21.44.368 E018.13.57.846 N054.22.01.165 E018.14.43.463 ;holding- 
N054.21.23.368 E018.13.17.875 N054.21.44.368 E018.13.57.846 ;holding- 
N054.20.58.639 E018.12.44.763 N054.21.23.368 E018.13.17.875 ;holding- 
N054.20.30.932 E018.12.19.517 N054.20.58.639 E018.12.44.763 ;holding- 
N054.19.30.867 E018.11.55.429 N054.20.01.036 E018.12.02.904 ;holding- 
N054.21.08.996 E018.21.10.050 N054.20.42.356 E018.21.38.478 ;holding- 
N054.18.27.972 E018.12.08.515 N054.18.58.661 E018.11.57.318 ;holding- 
N054.17.58.920 E018.12.28.799 N054.18.27.972 E018.12.08.515 ;holding- 
N054.14.01.403 E018.27.28.572 N054.13.32.162 E018.27.48.158 ;holding- 
N054.20.01.036 E018.12.02.904 N054.20.30.932 E018.12.19.517 ;holding- 
N054.17.58.920 E018.12.28.799 N054.11.17.966 E018.18.18.893 ;holding- 
N054.21.32.309 E018.20.34.395 N054.21.08.996 E018.21.10.050 ;holding- 
N054.20.42.356 E018.21.38.478 N054.14.01.403 E018.27.28.572 ;holding- 
N054.10.51.483 E018.18.47.754 N054.11.17.966 E018.18.18.893 ;holding- 
N054.10.28.148 E018.19.23.620 N054.10.51.483 E018.18.47.754 ;holding- 
N054.10.08.809 E018.20.05.870 N054.10.28.148 E018.19.23.620 ;holding- 
N054.09.54.540 E018.20.53.220 N054.10.08.809 E018.20.05.870 ;holding- 
N054.09.44.333 E018.21.44.232 N054.09.54.540 E018.20.53.220 ;holding- 
N054.09.39.939 E018.22.37.356 N054.09.44.333 E018.21.44.232 ;holding- 
N054.09.41.694 E018.23.30.977 N054.09.39.939 E018.22.37.356 ;holding- 
N054.13.01.466 E018.27.59.267 N054.12.30.108 E018.28.01.339 ;holding- 
N054.09.59.232 E018.25.13.230 N054.09.47.504 E018.24.23.467 ;holding- 
N054.10.15.836 E018.25.58.755 N054.09.59.232 E018.25.13.230 ;holding- 
N054.10.36.810 E018.26.38.658 N054.10.15.836 E018.25.58.755 ;holding- 
N054.11.01.518 E018.27.11.726 N054.10.36.810 E018.26.38.658 ;holding- 
N054.11.29.209 E018.27.36.956 N054.11.01.518 E018.27.11.726 ;holding- 
N054.11.59.123 E018.27.53.580 N054.11.29.209 E018.27.36.956 ;holding- 
N054.12.30.108 E018.28.01.339 N054.11.59.123 E018.27.53.580 ;holding- 
N054.13.32.162 E018.27.48.158 N054.13.01.466 E018.27.59.267 ;holding- 
N054.09.47.504 E018.24.23.467 N054.09.41.694 E018.23.30.977 ;holding-
HOLDING TRZ               N001.39.20.999 E021.25.40.001 N001.41.44.999 E020.58.09.998
N051.16.40.888 E017.01.24.576 N051.16.50.578 E017.00.36.560 ;holding- 
N051.18.29.519 E017.06.51.480 N051.18.01.542 E017.06.28.771 ;holding- 
N051.19.43.256 E016.57.36.626 N051.20.14.398 E016.57.42.753 ;holding- 
N051.19.11.923 E016.57.39.247 N051.19.43.256 E016.57.36.626 ;holding- 
N051.18.41.350 E016.57.50.535 N051.19.11.923 E016.57.39.247 ;holding- 
N051.18.12.467 E016.58.10.148 N051.18.41.350 E016.57.50.535 ;holding- 
N051.17.46.150 E016.58.37.489 N051.18.12.467 E016.58.10.148 ;holding- 
N051.17.23.200 E016.59.11.728 N051.17.46.150 E016.58.37.489 ;holding- 
N051.27.13.795 E017.02.09.217 N051.27.41.898 E017.02.31.473 ;holding- 
N051.16.50.578 E017.00.36.560 N051.17.04.314 E016.59.51.825 ;holding- 
N051.27.41.898 E017.02.31.473 N051.28.06.938 E017.03.01.801 ;holding- 
N051.16.37.982 E017.02.14.412 N051.16.40.888 E017.01.24.576 ;holding- 
N051.16.38.697 E017.03.04.556 N051.16.37.982 E017.02.14.412 ;holding- 
N051.16.45.751 E017.03.53.482 N051.16.38.697 E017.03.04.556 ;holding- 
N051.16.58.685 E017.04.39.705 N051.16.45.751 E017.03.53.482 ;holding- 
N051.17.15.157 E017.05.21.820 N051.16.58.685 E017.04.39.705 ;holding- 
N051.17.36.486 E017.05.58.547 N051.17.15.157 E017.05.21.820 ;holding- 
N051.18.01.542 E017.06.28.771 N051.17.36.486 E017.05.58.547 ;holding- 
N051.17.04.314 E016.59.51.825 N051.17.23.200 E016.59.11.728 ;holding- 
N051.28.53.194 E017.08.24.611 N051.28.38.923 E017.09.09.434 ;holding- 
N051.18.29.519 E017.06.51.480 N051.24.58.937 E017.11.03.163 ;holding- 
N051.25.28.772 E017.11.18.561 N051.24.58.937 E017.11.03.163 ;holding- 
N051.25.59.911 E017.11.24.743 N051.25.28.772 E017.11.18.561 ;holding- 
N051.26.31.245 E017.11.22.157 N051.25.59.911 E017.11.24.743 ;holding- 
N051.27.01.824 E017.11.10.883 N051.26.31.245 E017.11.22.157 ;holding- 
N051.27.30.717 E017.10.51.262 N051.27.01.824 E017.11.10.883 ;holding- 
N051.27.57.048 E017.10.23.891 N051.27.30.717 E017.10.51.262 ;holding- 
N051.20.14.398 E016.57.42.753 N051.20.44.378 E016.57.57.534 ;holding- 
N051.28.38.923 E017.09.09.434 N051.28.20.626 E017.09.49.601 ;holding- 
N051.20.44.378 E016.57.57.534 N051.27.13.795 E017.02.09.217 ;holding- 
N051.29.02.396 E017.07.36.494 N051.28.53.194 E017.08.24.611 ;holding- 
N051.29.06.250 E017.06.46.545 N051.29.02.396 E017.07.36.494 ;holding- 
N051.29.04.638 E017.05.56.281 N051.29.06.250 E017.06.46.545 ;holding- 
N051.28.57.610 E017.05.07.229 N051.29.04.638 E017.05.56.281 ;holding- 
N051.28.45.378 E017.04.20.881 N051.28.57.610 E017.05.07.229 ;holding- 
N051.28.28.315 E017.03.38.644 N051.28.45.378 E017.04.20.881 ;holding- 
N051.28.06.938 E017.03.01.801 N051.28.28.315 E017.03.38.644 ;holding- 
N051.28.20.626 E017.09.49.601 N051.27.57.048 E017.10.23.891 ;holding- 
HOLDING WAR (RWY 11)      N001.23.16.000 E020.21.38.000 N001.01.32.000 E020.50.47.000
N052.15.32.911 E020.39.25.549 N052.15.13.000 E020.40.05.000
N052.15.13.000 E020.40.05.000 N052.15.04.000 E020.40.36.000
N052.15.04.000 E020.40.36.000 N052.14.58.000 E020.41.09.000
N052.14.58.000 E020.41.09.000 N052.14.56.000 E020.41.43.000
N052.14.56.000 E020.41.43.000 N052.14.58.000 E020.42.18.000
N052.14.58.000 E020.42.18.000 N052.15.04.000 E020.42.51.000
N052.15.04.000 E020.42.51.000 N052.15.13.000 E020.43.22.000
N052.15.13.000 E020.43.22.000 N052.15.25.000 E020.43.50.000
N052.15.25.000 E020.43.50.000 N052.15.39.000 E020.44.14.000
N052.15.39.000 E020.44.14.000 N052.15.56.000 E020.44.33.000
N052.15.56.000 E020.44.33.000 N052.16.15.000 E020.44.48.000
N052.16.15.000 E020.44.48.000 N052.16.36.000 E020.44.57.000
N052.16.36.000 E020.44.57.000 N052.16.56.000 E020.45.00.000
N052.16.56.000 E020.45.00.000 N052.17.17.000 E020.44.57.000
N052.17.17.000 E020.44.57.000 N052.17.38.000 E020.44.48.000
N052.17.38.000 E020.44.48.000 N052.17.56.000 E020.44.33.000
N052.17.56.000 E020.44.33.000 N052.18.14.000 E020.44.14.000
N052.18.14.000 E020.44.14.000 N052.18.28.000 E020.43.50.000
N052.18.28.000 E020.43.50.000 N052.18.21.000 E020.44.02.000
N052.18.21.000 E020.44.02.000 N052.21.02.000 E020.39.35.000
N052.21.02.000 E020.39.35.000 N052.21.16.000 E020.39.11.000
N052.21.16.000 E020.39.11.000 N052.21.28.000 E020.38.43.000
N052.21.28.000 E020.38.43.000 N052.21.37.000 E020.38.12.000
N052.21.37.000 E020.38.12.000 N052.21.43.000 E020.37.39.000
N052.21.43.000 E020.37.39.000 N052.21.45.000 E020.37.05.000
N052.21.45.000 E020.37.05.000 N052.21.43.000 E020.36.30.000
N052.21.43.000 E020.36.30.000 N052.21.37.000 E020.35.57.000
N052.21.37.000 E020.35.57.000 N052.21.28.000 E020.35.26.000
N052.21.28.000 E020.35.26.000 N052.21.16.000 E020.34.58.000
N052.21.16.000 E020.34.58.000 N052.21.02.000 E020.34.34.000
N052.21.02.000 E020.34.34.000 N052.20.45.000 E020.34.14.000
N052.20.45.000 E020.34.14.000 N052.20.26.000 E020.34.00.000
N052.20.26.000 E020.34.00.000 N052.20.05.000 E020.33.51.000
N052.20.05.000 E020.33.51.000 N052.19.45.000 E020.33.48.000
N052.19.45.000 E020.33.48.000 N052.19.24.000 E020.33.51.000
N052.19.24.000 E020.33.51.000 N052.19.03.000 E020.34.00.000
N052.19.03.000 E020.34.00.000 N052.18.45.000 E020.34.14.000
N052.18.45.000 E020.34.14.000 N052.18.27.000 E020.34.34.000
N052.18.27.000 E020.34.34.000 N052.18.20.000 E020.34.46.000
N052.18.20.000 E020.34.46.000 N052.15.32.911 E020.39.25.549
HOLDING WAR (RWY 15)      N001.23.16.000 E020.21.38.000 N001.01.32.000 E020.50.47.000
N052.15.32.911 E020.39.25.549 N052.15.32.000 E020.39.27.000
N052.15.32.000 E020.39.27.000 N052.15.38.000 E020.40.00.000
N052.15.38.000 E020.40.00.000 N052.15.40.000 E020.40.35.000
N052.15.40.000 E020.40.35.000 N052.15.38.000 E020.41.09.000
N052.15.38.000 E020.41.09.000 N052.15.32.000 E020.41.42.000
N052.15.32.000 E020.41.42.000 N052.15.23.000 E020.42.12.000
N052.15.23.000 E020.42.12.000 N052.15.11.000 E020.42.40.000
N052.15.11.000 E020.42.40.000 N052.14.57.000 E020.43.05.000
N052.14.57.000 E020.43.05.000 N052.14.40.000 E020.43.24.000 
N052.14.40.000 E020.43.24.000 N052.14.21.000 E020.43.43.000  
N052.14.21.000 E020.43.43.000 N052.14.00.000 E020.43.47.000  
N052.14.00.000 E020.43.47.000 N052.13.40.000 E020.43.50.000  
N052.13.40.000 E020.43.50.000 N052.13.19.000 E020.43.47.000   
N052.13.19.000 E020.43.47.000 N052.12.58.000 E020.43.39.000
N052.12.58.000 E020.43.39.000 N052.12.40.000 E020.43.24.000
N052.12.40.000 E020.43.24.000 N052.12.22.000 E020.43.05.000
N052.12.22.000 E020.43.05.000 N052.12.08.000 E020.42.40.000
N052.12.08.000 E020.42.40.000 N052.11.56.000 E020.42.12.000
N052.11.56.000 E020.42.12.000 N052.11.47.000 E020.41.42.000
N052.11.47.000 E020.41.42.000 N052.10.20.000 E020.35.36.000
N052.10.20.000 E020.35.36.000 N052.10.19.000 E020.35.31.000
N052.10.19.000 E020.35.31.000 N052.10.13.000 E020.34.59.000
N052.10.13.000 E020.34.59.000 N052.10.12.000 E020.34.24.000
N052.10.12.000 E020.34.24.000 N052.10.13.000 E020.33.50.000
N052.10.13.000 E020.33.50.000 N052.10.19.000 E020.33.18.000
N052.10.19.000 E020.33.18.000 N052.10.28.000 E020.32.47.000
N052.10.28.000 E020.32.47.000 N052.10.40.000 E020.32.19.000
N052.10.40.000 E020.32.19.000 N052.10.54.000 E020.31.55.000
N052.10.54.000 E020.31.55.000 N052.11.12.000 E020.31.35.000
N052.11.12.000 E020.31.35.000 N052.11.30.000 E020.31.21.000
N052.11.30.000 E020.31.21.000 N052.11.51.000 E020.31.12.000
N052.11.51.000 E020.31.12.000 N052.12.11.000 E020.31.09.000
N052.12.11.000 E020.31.09.000 N052.12.32.000 E020.31.12.000
N052.12.32.000 E020.31.12.000 N052.12.53.000 E020.31.21.000
N052.12.53.000 E020.31.21.000 N052.13.11.000 E020.31.35.000
N052.13.11.000 E020.31.35.000 N052.13.29.000 E020.31.55.000
N052.13.29.000 E020.31.55.000 N052.13.43.000 E020.32.19.000
N052.13.43.000 E020.32.19.000 N052.13.55.000 E020.32.47.000
N052.13.55.000 E020.32.47.000 N052.14.04.000 E020.33.14.000
N052.14.04.000 E020.33.14.000 N052.15.32.911 E020.39.25.549 
HOLDING KRN               N001.39.20.999 E021.25.40.001 N001.41.44.999 E020.58.09.998
N051.48.34.121 E020.18.34.294 N051.48.26.116 E020.17.45.210 ;holding- 
N051.55.27.227 E020.32.33.690 N051.54.58.795 E020.32.54.522 ;holding- 
N051.51.21.321 E020.30.46.376 N051.51.08.061 E020.30.00.311 ;holding- 
N051.52.01.519 E020.32.03.963 N051.51.39.326 E020.31.28.992 ;holding- 
N051.52.27.227 E020.32.33.114 N051.52.01.519 E020.32.03.963 ;holding- 
N051.52.55.668 E020.32.54.589 N051.52.27.227 E020.32.33.114 ;holding- 
N051.53.25.978 E020.33.07.733 N051.52.55.668 E020.32.54.589 ;holding- 
N051.53.57.235 E020.33.12.147 N051.53.25.978 E020.33.07.733 ;holding- 
N051.56.54.430 E020.27.29.683 N051.56.57.175 E020.28.20.337 ;holding- 
N051.54.58.795 E020.32.54.522 N051.54.28.491 E020.33.07.699 ;holding- 
N051.48.25.981 E020.16.03.995 N051.48.34.227 E020.15.14.917 ;holding- 
N051.55.52.923 E020.32.03.837 N051.55.27.227 E020.32.33.690 ;holding- 
N051.56.15.102 E020.31.27.869 N051.55.52.923 E020.32.03.837 ;holding- 
N051.56.33.013 E020.30.46.206 N051.56.15.102 E020.31.27.869 ;holding- 
N051.56.46.340 E020.30.00.115 N051.56.33.013 E020.30.46.206 ;holding- 
N051.56.54.451 E020.29.10.994 N051.56.46.340 E020.30.00.115 ;holding- 
N051.56.57.175 E020.28.20.337 N051.56.54.451 E020.29.10.994 ;holding- 
N051.51.39.326 E020.31.28.992 N051.51.21.321 E020.30.46.376 ;holding- 
N051.54.28.491 E020.33.07.699 N051.53.57.235 E020.33.12.147 ;holding- 
N051.50.51.895 E020.12.07.443 N051.51.23.150 E020.12.02.983 ;holding- 
N051.51.08.061 E020.30.00.311 N051.48.34.121 E020.18.34.294 ;holding- 
N051.56.46.319 E020.26.40.560 N051.54.12.411 E020.15.14.542 ;holding- 
N051.53.59.318 E020.14.28.539 N051.54.12.411 E020.15.14.542 ;holding- 
N051.53.41.011 E020.13.46.944 N051.53.59.318 E020.14.28.539 ;holding- 
N051.53.18.879 E020.13.11.625 N051.53.41.011 E020.13.46.944 ;holding- 
N051.52.53.166 E020.12.41.935 N051.53.18.879 E020.13.11.625 ;holding- 
N051.52.24.721 E020.12.20.495 N051.52.53.166 E020.12.41.935 ;holding- 
N051.48.26.116 E020.17.45.210 N051.48.23.266 E020.16.54.605 ;holding- 
N051.51.23.150 E020.12.02.983 N051.51.54.409 E020.12.07.378 ;holding- 
N051.48.23.266 E020.16.54.605 N051.48.25.981 E020.16.03.995 ;holding- 
N051.50.21.594 E020.12.20.623 N051.50.51.895 E020.12.07.443 ;holding- 
N051.49.53.166 E020.12.42.122 N051.50.21.594 E020.12.20.623 ;holding- 
N051.49.27.476 E020.13.11.286 N051.49.53.166 E020.12.42.122 ;holding- 
N051.49.05.304 E020.13.47.231 N051.49.27.476 E020.13.11.286 ;holding- 
N051.48.47.324 E020.14.28.863 N051.49.05.304 E020.13.47.231 ;holding- 
N051.48.34.227 E020.15.14.917 N051.48.47.324 E020.14.28.863 ;holding- 
N051.56.46.319 E020.26.40.560 N051.56.54.430 E020.27.29.683 ;holding- 
N051.51.54.409 E020.12.07.378 N051.52.24.721 E020.12.20.495 ;holding- 
HOLDING LIN (RWY 29)      N001.23.16.000 E020.21.38.000 N001.01.32.000 E020.50.47.000
N051.55.58.390 E021.09.30.701 N051.56.08.000 E021.09.42.000
N051.56.08.000 E021.09.42.000 N051.56.22.000 E021.10.06.000
N051.56.08.000 E021.09.42.000 N051.56.34.000 E021.10.34.000
N051.56.34.000 E021.10.34.000 N051.56.43.000 E021.11.05.000
N051.56.43.000 E021.11.05.000 N051.56.49.000 E021.11.38.000
N051.56.49.000 E021.11.38.000 N051.56.51.000 E021.12.12.000
N051.56.51.000 E021.12.12.000 N051.56.49.000 E021.12.45.000
N051.56.49.000 E021.12.45.000 N051.56.43.000 E021.13.18.000
N051.56.43.000 E021.13.18.000 N051.56.34.000 E021.13.49.000
N051.56.34.000 E021.13.49.000 N051.56.22.000 E021.14.17.000
N051.56.22.000 E021.14.17.000 N051.56.08.000 E021.14.41.000
N051.56.08.000 E021.14.41.000 N051.55.51.000 E021.15.00.000
N051.55.51.000 E021.15.00.000 N051.55.32.000 E021.15.14.000
N051.55.32.000 E021.15.14.000 N051.55.11.000 E021.15.23.000
N051.55.11.000 E021.15.23.000 N051.54.51.000 E021.15.26.000
N051.54.51.000 E021.15.26.000 N051.54.30.000 E021.15.23.000
N051.54.30.000 E021.15.23.000 N051.54.09.000 E021.15.14.000
N051.54.09.000 E021.15.14.000 N051.53.43.000 E021.14.53.000
N051.53.43.000 E021.14.53.000 N051.50.24.000 E021.11.15.000
N051.50.24.000 E021.11.15.000 N051.50.13.000 E021.11.01.000
N051.50.13.000 E021.11.01.000 N051.49.59.000 E021.10.37.000
N051.49.59.000 E021.10.37.000 N051.49.47.000 E021.10.10.000
N051.49.47.000 E021.10.10.000 N051.49.38.000 E021.09.39.000
N051.49.38.000 E021.09.39.000 N051.49.32.000 E021.09.06.000
N051.49.32.000 E021.09.06.000 N051.49.30.000 E021.08.32.000
N051.49.30.000 E021.08.32.000 N051.49.32.000 E021.07.59.000
N051.49.32.000 E021.07.59.000 N051.49.38.000 E021.07.26.000
N051.49.38.000 E021.07.26.000 N051.49.47.000 E021.06.55.000
N051.49.47.000 E021.06.55.000 N051.49.59.000 E021.06.28.000
N051.49.59.000 E021.06.28.000 N051.50.13.000 E021.06.04.000
N051.50.13.000 E021.06.04.000 N051.50.30.000 E021.05.44.000
N051.50.30.000 E021.05.44.000 N051.50.49.000 E021.05.30.000
N051.50.49.000 E021.05.30.000 N051.51.10.000 E021.05.21.000
N051.51.10.000 E021.05.21.000 N051.51.30.000 E021.05.18.000
N051.51.30.000 E021.05.18.000 N051.51.51.000 E021.05.21.000
N051.51.51.000 E021.05.21.000 N051.52.12.000 E021.05.30.000
N051.52.12.000 E021.05.30.000 N051.52.38.000 E021.05.51.000
N051.52.38.000 E021.05.51.000 N051.55.58.390 E021.09.30.701
HOLDING KRT (VOR/ILS)     N001.39.20.999 E021.25.40.001 N001.41.44.999 E020.58.09.998
N054.20.30.932 E018.12.19.517 N054.20.58.639 E018.12.44.763 ;holding- 
N054.10.28.148 E018.19.23.620 N054.10.51.483 E018.18.47.754 ;holding- 
N054.22.16.376 E018.18.12.999 N054.22.06.344 E018.19.04.167 ;holding- 
N054.22.20.393 E018.17.19.723 N054.22.16.376 E018.18.12.999 ;holding- 
N054.22.19.291 E018.16.25.958 N054.22.20.393 E018.17.19.723 ;holding- 
N054.22.12.761 E018.15.33.339 N054.22.19.291 E018.16.25.958 ;holding- 
N054.22.01.165 E018.14.43.463 N054.22.12.761 E018.15.33.339 ;holding- 
N054.21.44.368 E018.13.57.846 N054.22.01.165 E018.14.43.463 ;holding- 
N054.20.58.639 E018.12.44.763 N054.21.23.368 E018.13.17.875 ;holding- 
N054.21.32.309 E018.20.34.395 N054.21.08.996 E018.21.10.050 ;holding- 
N054.20.01.036 E018.12.02.904 N054.20.30.932 E018.12.19.517 ;holding- 
N054.19.30.867 E018.11.55.429 N054.20.01.036 E018.12.02.904 ;holding- 
N054.18.58.661 E018.11.57.318 N054.19.30.867 E018.11.55.429 ;holding- 
N054.18.27.972 E018.12.08.515 N054.18.58.661 E018.11.57.318 ;holding- 
N054.17.58.920 E018.12.28.799 N054.18.27.972 E018.12.08.515 ;holding- 
N054.17.58.920 E018.12.28.799 N054.11.17.966 E018.18.18.893 ;holding- 
N054.20.42.356 E018.21.38.478 N054.14.01.403 E018.27.28.572 ;holding- 
N054.21.23.368 E018.13.17.875 N054.21.44.368 E018.13.57.846 ;holding- 
N054.11.01.518 E018.27.11.726 N054.10.36.810 E018.26.38.658 ;holding- 
N054.10.08.809 E018.20.05.870 N054.10.28.148 E018.19.23.620 ;holding- 
N054.09.54.540 E018.20.53.220 N054.10.08.809 E018.20.05.870 ;holding- 
N054.09.44.333 E018.21.44.232 N054.09.54.540 E018.20.53.220 ;holding- 
N054.09.39.939 E018.22.37.356 N054.09.44.333 E018.21.44.232 ;holding- 
N054.09.41.694 E018.23.30.977 N054.09.39.939 E018.22.37.356 ;holding- 
N054.09.47.504 E018.24.23.467 N054.09.41.694 E018.23.30.977 ;holding- 
N054.09.59.232 E018.25.13.230 N054.09.47.504 E018.24.23.467 ;holding- 
N054.22.06.344 E018.19.04.167 N054.21.51.620 E018.19.51.673 ;holding- 
N054.10.36.810 E018.26.38.658 N054.10.15.836 E018.25.58.755 ;holding- 
N054.21.51.620 E018.19.51.673 N054.21.32.309 E018.20.34.395 ;holding- 
N054.11.29.209 E018.27.36.956 N054.11.01.518 E018.27.11.726 ;holding- 
N054.11.59.123 E018.27.53.580 N054.11.29.209 E018.27.36.956 ;holding- 
N054.12.30.108 E018.28.01.339 N054.11.59.123 E018.27.53.580 ;holding- 
N054.13.01.466 E018.27.59.267 N054.12.30.108 E018.28.01.339 ;holding- 
N054.13.32.162 E018.27.48.158 N054.13.01.466 E018.27.59.267 ;holding- 
N054.14.01.403 E018.27.28.572 N054.13.32.162 E018.27.48.158 ;holding- 
N054.21.08.996 E018.21.10.050 N054.20.42.356 E018.21.38.478 ;holding- 
N054.10.15.836 E018.25.58.755 N054.09.59.232 E018.25.13.230 ;holding- 
N054.10.51.483 E018.18.47.754 N054.11.17.966 E018.18.18.893 ;holding- 
HOLDING KRT (NDB)         N001.39.20.999 E021.25.40.001 N001.41.44.999 E020.58.09.998
N054.09.08.744 E018.22.42.001 N054.09.08.770 E018.21.48.378 ;holding- 
N054.12.23.606 E018.27.22.499 N054.11.52.230 E018.27.21.999 ;holding- 
N054.11.52.230 E018.27.21.999 N054.11.21.336 E018.27.12.639 ;holding- 
N054.11.21.336 E018.27.12.639 N054.10.51.861 E018.26.54.249 ;holding- 
N054.10.51.861 E018.26.54.249 N054.10.24.702 E018.26.27.389 ;holding- 
N054.10.24.702 E018.26.27.389 N054.10.00.684 E018.25.52.874 ;holding- 
N054.10.00.684 E018.25.52.874 N054.09.40.536 E018.25.11.753 ;holding- 
N054.09.40.536 E018.25.11.753 N054.09.24.872 E018.24.25.275 ;holding- 
N054.09.14.165 E018.23.34.854 N054.09.08.744 E018.22.42.001 ;holding- 
N054.20.39.183 E018.21.02.340 N054.20.11.982 E018.21.29.126 ;holding- 
N054.09.08.770 E018.21.48.378 N054.09.14.245 E018.20.55.560 ;holding- 
N054.09.14.245 E018.20.55.560 N054.09.25.235 E018.20.05.170 ;holding- 
N054.09.25.235 E018.20.05.170 N054.09.40.713 E018.19.18.738 ;holding- 
N054.09.40.713 E018.19.18.738 N054.10.00.902 E018.18.37.676 ;holding- 
N054.10.00.902 E018.18.37.676 N054.10.24.954 E018.18.03.232 ;holding- 
N054.10.24.954 E018.18.03.232 N054.10.52.307 E018.17.35.938 ;holding- 
N054.17.39.840 E018.12.10.999 N054.10.52.307 E018.17.35.938 ;holding- 
N054.09.24.872 E018.24.25.275 N054.09.14.165 E018.23.34.854 ;holding- 
N054.21.39.165 E018.14.39.137 N054.21.49.768 E018.15.29.678 ;holding- 
N054.17.39.840 E018.12.10.999 N054.18.09.289 E018.11.51.555 ;holding- 
N054.18.09.289 E018.11.51.555 N054.18.40.188 E018.11.42.204 ;holding- 
N054.18.40.188 E018.11.42.204 N054.19.11.564 E018.11.42.194 ;holding- 
N054.19.11.564 E018.11.42.194 N054.19.42.464 E018.11.51.524 ;holding- 
N054.19.42.464 E018.11.51.524 N054.20.11.950 E018.12.09.911 ;holding- 
N054.20.11.950 E018.12.09.911 N054.20.39.126 E018.12.36.796 ;holding- 
N054.20.39.126 E018.12.36.796 N054.21.03.165 E018.13.11.362 ;holding- 
N054.12.54.511 E018.27.12.775 N054.12.23.606 E018.27.22.499 ;holding- 
N054.21.23.338 E018.13.52.560 N054.21.39.165 E018.14.39.137 ;holding- 
N054.13.24.143 E018.26.54.985 N054.12.54.511 E018.27.12.775 ;holding- 
N054.21.49.768 E018.15.29.678 N054.21.55.223 E018.16.22.648 ;holding- 
N054.21.55.223 E018.16.22.648 N054.21.55.229 E018.17.16.437 ;holding- 
N054.21.55.229 E018.17.16.437 N054.21.49.786 E018.18.09.410 ;holding- 
N054.21.49.786 E018.18.09.410 N054.21.39.144 E018.18.59.959 ;holding- 
N054.21.39.144 E018.18.59.959 N054.21.23.378 E018.19.46.546 ;holding- 
N054.21.23.378 E018.19.46.546 N054.21.03.215 E018.20.27.758 ;holding- 
N054.21.03.215 E018.20.27.758 N054.20.39.183 E018.21.02.340 ;holding- 
N054.21.03.165 E018.13.11.362 N054.21.23.338 E018.13.52.560 ;holding- 
N054.20.11.982 E018.21.29.126 N054.13.24.143 E018.26.54.985 ;holding-
HOLDING TRZ               N001.39.20.999 E021.25.40.001 N001.41.44.999 E020.58.09.998
N051.16.40.888 E017.01.24.576 N051.16.50.578 E017.00.36.560 ;holding- 
N051.18.29.519 E017.06.51.480 N051.18.01.542 E017.06.28.771 ;holding- 
N051.19.43.256 E016.57.36.626 N051.20.14.398 E016.57.42.753 ;holding- 
N051.19.11.923 E016.57.39.247 N051.19.43.256 E016.57.36.626 ;holding- 
N051.18.41.350 E016.57.50.535 N051.19.11.923 E016.57.39.247 ;holding- 
N051.18.12.467 E016.58.10.148 N051.18.41.350 E016.57.50.535 ;holding- 
N051.17.46.150 E016.58.37.489 N051.18.12.467 E016.58.10.148 ;holding- 
N051.17.23.200 E016.59.11.728 N051.17.46.150 E016.58.37.489 ;holding- 
N051.27.13.795 E017.02.09.217 N051.27.41.898 E017.02.31.473 ;holding- 
N051.16.50.578 E017.00.36.560 N051.17.04.314 E016.59.51.825 ;holding- 
N051.27.41.898 E017.02.31.473 N051.28.06.938 E017.03.01.801 ;holding- 
N051.16.37.982 E017.02.14.412 N051.16.40.888 E017.01.24.576 ;holding- 
N051.16.38.697 E017.03.04.556 N051.16.37.982 E017.02.14.412 ;holding- 
N051.16.45.751 E017.03.53.482 N051.16.38.697 E017.03.04.556 ;holding- 
N051.16.58.685 E017.04.39.705 N051.16.45.751 E017.03.53.482 ;holding- 
N051.17.15.157 E017.05.21.820 N051.16.58.685 E017.04.39.705 ;holding- 
N051.17.36.486 E017.05.58.547 N051.17.15.157 E017.05.21.820 ;holding- 
N051.18.01.542 E017.06.28.771 N051.17.36.486 E017.05.58.547 ;holding- 
N051.17.04.314 E016.59.51.825 N051.17.23.200 E016.59.11.728 ;holding- 
N051.28.53.194 E017.08.24.611 N051.28.38.923 E017.09.09.434 ;holding- 
N051.18.29.519 E017.06.51.480 N051.24.58.937 E017.11.03.163 ;holding- 
N051.25.28.772 E017.11.18.561 N051.24.58.937 E017.11.03.163 ;holding- 
N051.25.59.911 E017.11.24.743 N051.25.28.772 E017.11.18.561 ;holding- 
N051.26.31.245 E017.11.22.157 N051.25.59.911 E017.11.24.743 ;holding- 
N051.27.01.824 E017.11.10.883 N051.26.31.245 E017.11.22.157 ;holding- 
N051.27.30.717 E017.10.51.262 N051.27.01.824 E017.11.10.883 ;holding- 
N051.27.57.048 E017.10.23.891 N051.27.30.717 E017.10.51.262 ;holding- 
N051.20.14.398 E016.57.42.753 N051.20.44.378 E016.57.57.534 ;holding- 
N051.28.38.923 E017.09.09.434 N051.28.20.626 E017.09.49.601 ;holding- 
N051.20.44.378 E016.57.57.534 N051.27.13.795 E017.02.09.217 ;holding- 
N051.29.02.396 E017.07.36.494 N051.28.53.194 E017.08.24.611 ;holding- 
N051.29.06.250 E017.06.46.545 N051.29.02.396 E017.07.36.494 ;holding- 
N051.29.04.638 E017.05.56.281 N051.29.06.250 E017.06.46.545 ;holding- 
N051.28.57.610 E017.05.07.229 N051.29.04.638 E017.05.56.281 ;holding- 
N051.28.45.378 E017.04.20.881 N051.28.57.610 E017.05.07.229 ;holding- 
N051.28.28.315 E017.03.38.644 N051.28.45.378 E017.04.20.881 ;holding- 
N051.28.06.938 E017.03.01.801 N051.28.28.315 E017.03.38.644 ;holding- 
N051.28.20.626 E017.09.49.601 N051.27.57.048 E017.10.23.891 ;holding- 
	
EPWA granica arr 11 N052.14.47.622 E019.16.54.369 N052.16.12.289 E020.02.31.126 PROHI
N052.16.12.289 E020.02.31.126 N052.04.13.784 E020.46.38.763 PROHI
N052.04.13.784 E020.46.38.763 N052.10.02.901 E020.57.52.272 PROHI
N052.10.02.901 E020.57.52.272 N052.13.46.331 E021.06.22.864 PROHI
N052.13.46.331 E021.06.22.864 N052.03.18.646 E021.12.59.601 PROHI
N052.03.18.646 E021.12.59.601 N052.14.30.357 E021.57.10.740 PROHI

EPWA granica arr 15 N052.15.06.606 E019.17.07.735 N052.15.29.026 E019.50.19.386 PROHI
N052.15.29.026 E019.50.19.386 N052.08.47.895 E020.30.30.143 PROHI
N052.08.47.895 E020.30.30.143 N052.04.22.670 E020.46.46.760 PROHI
N052.04.22.670 E020.46.46.760 N052.14.17.670 E021.07.54.186 PROHI
N052.14.17.670 E021.07.54.186 N052.04.08.926 E021.17.07.616 PROHI
N052.04.08.926 E021.17.07.616 N052.14.10.455 E021.57.29.327 PROHI

EPWA granica arr 29 N052.38.07.200 E019.33.55.214 N052.10.02.357 E020.57.59.546 PROHI
N052.10.02.357 E020.57.59.546 N052.05.53.270 E020.44.31.552 PROHI
N052.05.53.270 E020.44.31.552 N051.56.04.176 E020.48.12.235 PROHI
N051.56.04.176 E020.48.12.235 N051.52.05.372 E020.55.00.301 PROHI
N051.52.05.372 E020.55.00.301 N051.46.55.718 E021.26.16.173 PROHI
N051.46.55.718 E021.26.16.173 N051.40.13.293 E021.32.19.059 PROHI

EPWA granica arr 33 N052.37.52.299 E019.34.00.698 N052.10.06.100 E020.57.05.692 PROHI
N052.10.06.100 E020.57.05.692 N052.05.58.225 E020.44.14.118 PROHI
N052.05.58.225 E020.44.14.118 N052.01.01.954 E020.40.52.882 PROHI
N052.01.01.954 E020.40.52.882 N051.48.48.478 E020.46.32.833 PROHI
N051.48.48.478 E020.46.32.833 N051.45.12.973 E021.23.57.731 PROHI
N051.45.12.973 E021.23.57.731 N051.39.51.097 E021.32.30.766 PROHI
 
[SID]
            
EPWA 29      N052.11.03.480 E020.54.04.067 N052.11.05.676 E020.53.56.291
                          N052.11.05.676 E020.53.56.291 N052.11.08.051 E020.53.48.696
                          N052.11.08.051 E020.53.48.696 N052.11.10.607 E020.53.41.208
                          N052.11.10.607 E020.53.41.208 N052.11.13.271 E020.53.33.899
                          N052.11.13.271 E020.53.33.899 N052.11.16.152 E020.53.26.736
                          N052.11.16.152 E020.53.26.736 N052.11.19.140 E020.53.19.715
                          N052.11.19.140 E020.53.19.715 N052.11.22.307 E020.53.12.876
                          N052.11.22.307 E020.53.12.876 N052.11.25.584 E020.53.06.251
                          N052.11.25.584 E020.53.06.251 N052.11.29.040 E020.52.59.807
                          N052.11.29.040 E020.52.59.807 N052.11.32.604 E020.52.53.544
                          N052.11.32.604 E020.52.53.544 N052.11.36.312 E020.52.47.496
                          N052.11.36.312 E020.52.47.496 N052.11.40.127 E020.52.41.664
                          N052.11.40.127 E020.52.41.664 N052.11.44.087 E020.52.36.083
                          N052.11.44.087 E020.52.36.083 N052.11.48.156 E020.52.30.683
                          N052.11.48.156 E020.52.30.683 N052.11.52.332 E020.52.25.536
                          N052.11.52.332 E020.52.25.536 N052.11.56.616 E020.52.20.639
                          N052.11.56.616 E020.52.20.639 N052.12.01.007 E020.52.15.996
                          N052.12.01.007 E020.52.15.996 N052.12.05.507 E020.52.11.604
                          N052.12.05.507 E020.52.11.604 N052.12.10.080 E020.52.07.463
                          N052.12.10.080 E020.52.07.463 N052.12.14.724 E020.52.03.576
                          N052.12.14.724 E020.52.03.576 N052.12.19.476 E020.51.59.939
                          N052.12.19.476 E020.51.59.939 N052.12.24.299 E020.51.56.627
                          N052.12.24.299 E020.51.56.627 N052.13.49.908 E020.51.11.232
                          N052.13.49.908 E020.51.11.232 WA706 WA706
                          N052.18.02.232 E020.46.05.663 WA791 WA791 ;WA706 WA706 
                  WA791 WA791 INRAS INRAS
                  INRAS INRAS OLILA OLILA        
                  
				  
				  			WA706 WA706 N052.16.09.552 E020.47.09.095
                          N052.16.09.552 E020.47.09.095 N052.16.13.151 E020.47.03.624
                          N052.16.13.151 E020.47.03.624 N052.16.16.859 E020.46.58.331
                          N052.16.16.859 E020.46.58.331 N052.16.20.711 E020.46.53.255
                          N052.16.20.711 E020.46.53.255 N052.16.24.636 E020.46.48.432
                          N052.16.24.636 E020.46.48.432 N052.16.28.668 E020.46.43.823
                          N052.16.28.668 E020.46.43.823 N052.16.32.772 E020.46.39.431
                          N052.16.32.772 E020.46.39.431 N052.16.37.019 E020.46.35.291
                          N052.16.37.019 E020.46.35.291 N052.16.41.304 E020.46.31.367
                          N052.16.41.304 E020.46.31.367 N052.16.45.695 E020.46.27.732
                          N052.16.45.695 E020.46.27.732 N052.16.50.159 E020.46.24.312
                          N052.16.50.159 E020.46.24.312 N052.16.54.696 E020.46.21.179
                          N052.16.54.696 E020.46.21.179 N052.16.59.267 E020.46.18.300
                          N052.16.59.267 E020.46.18.300 N052.17.03.948 E020.46.15.672
                          N052.17.03.948 E020.46.15.672 N052.17.08.628 E020.46.13.331
                          N052.17.08.628 E020.46.13.331 N052.17.13.380 E020.46.11.244
                          N052.17.13.380 E020.46.11.244 N052.17.18.203 E020.46.09.444
                          N052.17.18.203 E020.46.09.444 N052.17.23.027 E020.46.07.896
                          N052.17.23.027 E020.46.07.896 N052.17.27.888 E020.46.06.635
                          N052.17.27.888 E020.46.06.635 N052.17.32.783 E020.46.05.663
                          N052.17.32.783 E020.46.05.663 N052.17.37.679 E020.46.04.943
                          N052.17.37.679 E020.46.04.943 N052.17.42.576 E020.46.04.547
                          N052.17.42.576 E020.46.04.547 N052.17.47.507 E020.46.04.404
                          N052.17.47.507 E020.46.04.404 N052.17.52.439 E020.46.04.547
                          N052.17.52.439 E020.46.04.547 N052.17.57.335 E020.46.04.943
                          N052.17.57.335 E020.46.04.943 N052.18.02.232 E020.46.05.663
                          N052.18.02.232 E020.46.05.663 N052.18.07.128 E020.46.06.635
                          N052.18.07.128 E020.46.06.635 N052.18.11.988 E020.46.07.896
                          N052.18.11.988 E020.46.07.896 N052.18.16.812 E020.46.09.444
                          N052.18.16.812 E020.46.09.444 N052.18.21.636 E020.46.11.244
                          N052.18.21.636 E020.46.11.244 N052.18.26.388 E020.46.13.331
                          N052.18.26.388 E020.46.13.331 N052.18.31.068 E020.46.15.672
                          N052.18.31.068 E020.46.15.672 N052.18.35.748 E020.46.18.300
                          N052.18.35.748 E020.46.18.300 N052.18.40.319 E020.46.21.179
                          N052.18.40.319 E020.46.21.179 N052.18.44.856 E020.46.24.312
                          N052.18.44.856 E020.46.24.312 N052.18.49.319 E020.46.27.732
                          N052.18.49.319 E020.46.27.732 N052.18.53.712 E020.46.31.367
                          N052.18.53.712 E020.46.31.367 N052.18.57.996 E020.46.35.291
                          N052.18.57.996 E020.46.35.291 N052.19.02.243 E020.46.39.431
                          N052.19.02.243 E020.46.39.431 N052.19.06.347 E020.46.43.823
                          N052.19.06.347 E020.46.43.823 N052.19.10.379 E020.46.48.432
                          N052.19.10.379 E020.46.48.432 N052.19.14.303 E020.46.53.255
                          N052.19.14.303 E020.46.53.255 N052.19.18.156 E020.46.58.331
                          N052.19.18.156 E020.46.58.331 N052.19.21.864 E020.47.03.624
                          N052.19.21.864 E020.47.03.624 N052.19.25.464 E020.47.09.095
                          N052.19.25.464 E020.47.09.095 N052.19.28.919 E020.47.14.784
                          N052.19.28.919 E020.47.14.784 N052.19.32.303 E020.47.20.687
                          N052.19.32.303 E020.47.20.687 N052.19.35.507 E020.47.26.735
                          N052.19.35.507 E020.47.26.735 N052.19.38.604 E020.47.33.000
                          N052.19.38.604 E020.47.33.000 N052.19.41.592 E020.47.39.444
                          N052.19.41.592 E020.47.39.444 N052.19.44.400 E020.47.46.031
                          N052.19.44.400 E020.47.46.031 N052.19.47.099 E020.47.52.763
                          N052.19.47.099 E020.47.52.763 N052.19.49.619 E020.47.59.676
                          N052.19.49.619 E020.47.59.676 N052.19.51.996 E020.48.06.696
                          N052.19.51.996 E020.48.06.696 WA798 WA798 
                  WA798 WA798 WA572 WA572
                  WA572 WA572 BAMSO BAMSO
                  
                  N052.10.19.201 E020.56.42.446 N052.11.03.984 E020.54.02.196
                          N052.11.04.415 E020.54.00.575 N052.11.03.984 E020.54.02.196
                          N052.10.51.888 E020.50.46.067 N052.10.54.263 E020.50.51.648
                          N052.10.54.263 E020.50.51.648 N052.10.56.568 E020.50.57.372
                          N052.10.56.568 E020.50.57.372 N052.10.58.728 E020.51.03.239
                          N052.10.58.728 E020.51.03.239 N052.11.00.744 E020.51.09.180
                          N052.11.00.744 E020.51.09.180 N052.11.02.651 E020.51.15.264
                          N052.11.02.651 E020.51.15.264 N052.11.04.415 E020.51.21.455
                          N052.11.04.415 E020.51.21.455 N052.11.06.072 E020.51.27.756
                          N052.11.06.072 E020.51.27.756 N052.11.07.547 E020.51.34.128
                          N052.11.07.547 E020.51.34.128 N052.11.08.915 E020.51.40.572
                          N052.11.08.915 E020.51.40.572 N052.11.10.139 E020.51.47.088
                          N052.11.10.139 E020.51.47.088 N052.11.11.220 E020.51.53.712
                          N052.11.11.220 E020.51.53.712 N052.11.12.155 E020.52.00.335
                          N052.11.12.155 E020.52.00.335 N052.11.12.983 E020.52.07.067
                          N052.11.12.983 E020.52.07.067 N052.11.13.632 E020.52.13.799
                          N052.11.13.632 E020.52.13.799 N052.11.14.136 E020.52.20.567
                          N052.11.14.136 E020.52.20.567 N052.11.14.495 E020.52.27.371
                          N052.11.14.495 E020.52.27.371 N052.11.14.712 E020.52.34.175
                          N052.11.14.712 E020.52.34.175 N052.11.14.784 E020.52.41.016
                          N052.11.14.784 E020.52.41.016 N052.11.14.712 E020.52.47.856
                          N052.11.14.712 E020.52.47.856 N052.11.14.495 E020.52.54.660
                          N052.11.14.495 E020.52.54.660 N052.11.14.136 E020.53.01.463
                          N052.11.14.136 E020.53.01.463 N052.11.13.632 E020.53.08.231
                          N052.11.13.632 E020.53.08.231 N052.11.12.983 E020.53.14.963
                          N052.11.12.983 E020.53.14.963 N052.11.12.155 E020.53.21.695
                          N052.11.12.155 E020.53.21.695 N052.11.11.220 E020.53.28.320
                          N052.11.11.220 E020.53.28.320 N052.11.10.139 E020.53.34.943
                          N052.11.10.139 E020.53.34.943 N052.11.08.915 E020.53.41.460
                          N052.11.08.915 E020.53.41.460 N052.11.07.547 E020.53.47.904
                          N052.11.07.547 E020.53.47.904 N052.11.06.072 E020.53.54.275
                          N052.11.06.072 E020.53.54.275 N052.11.04.415 E020.54.00.575
                          N052.10.51.888 E020.50.46.067 N052.09.48.132 E020.48.11.915
                          N052.09.48.132 E020.48.11.915 WA701 WA701
                          				   SURIM SURIM N052.08.47.327 E020.41.41.604
                          N052.08.47.327 E020.41.41.711 N052.08.50.784 E020.41.46.284
                          N052.08.50.784 E020.41.46.284 N052.08.54.131 E020.41.51.036
                          N052.08.54.131 E020.41.51.036 N052.08.57.407 E020.41.56.003
                          N052.08.57.407 E020.41.56.003 N052.09.00.575 E020.42.01.116
                          N052.09.00.575 E020.42.01.116 N052.09.03.600 E020.42.06.443
                          N052.09.03.600 E020.42.06.443 N052.09.06.515 E020.42.11.915
                          N052.09.06.515 E020.42.11.915 N052.09.09.323 E020.42.17.567
                          N052.09.09.323 E020.42.17.567 N052.09.12.024 E020.42.23.363
                          N052.09.12.024 E020.42.23.363 N052.09.14.579 E020.42.29.339
                          N052.09.14.579 E020.42.29.339 N052.09.17.028 E020.42.35.423
                          N052.09.17.028 E020.42.35.423 N052.09.19.296 E020.42.41.651
                          N052.09.19.296 E020.42.41.651 N052.09.21.456 E020.42.47.987
                          N052.09.21.456 E020.42.47.987 N052.09.23.507 E020.42.54.467
                          N052.09.23.507 E020.42.54.467 N052.09.25.379 E020.43.01.056
                          N052.09.25.379 E020.43.01.056 N052.09.27.143 E020.43.07.752
                          N052.09.27.143 E020.43.07.752 N052.09.28.728 E020.43.14.520
                          N052.09.28.728 E020.43.14.520 N052.09.30.168 E020.43.21.395
                          N052.09.30.168 E020.43.21.395 N052.09.31.464 E020.43.28.344
                          N052.09.31.464 E020.43.28.344 N052.09.32.651 E020.43.35.363
                          N052.09.32.651 E020.43.35.363 N052.09.33.624 E020.43.42.455
                          N052.09.33.624 E020.43.42.455 N052.09.34.487 E020.43.49.584
                          N052.09.34.487 E020.43.49.584 WA701 WA701
				  
				  
				   
				   
				   
                  SURIM SURIM ABSEL ABSEL
                  ABSEL ABSEL EREDA EREDA
                  EREDA EREDA XENOM XENOM
                  XENOM XENOM TISTA TISTA
                  TISTA TISTA XIMBA XIMBA
                  
                  SURIM SURIM EVDEX EVDEX
                  EVDEX EVDEX NIPUS NIPUS
                  NIPUS NIPUS EVINA EVINA
                  
                  N052.10.51.888 E020.50.46.067 WA703 WA703 ;EPWA EPWA  WA703 WA703  
                           MAKUS MAKUS N052.11.26.735 E020.40.50.232
                          N052.11.26.735 E020.40.50.339 N052.11.28.716 E020.41.00.780
                          N052.11.28.716 E020.41.00.780 N052.11.30.443 E020.41.11.327
                          N052.11.30.443 E020.41.11.327 N052.11.31.956 E020.41.21.948
                          N052.11.31.956 E020.41.21.948 N052.11.33.216 E020.41.32.675
                          N052.11.33.216 E020.41.32.675 N052.11.34.259 E020.41.43.475
                          N052.11.34.259 E020.41.43.475 N052.11.35.088 E020.41.54.311
                          N052.11.35.088 E020.41.54.311 N052.11.35.664 E020.42.05.184
                          N052.11.35.664 E020.42.05.184 N052.11.36.023 E020.42.16.092
                          N052.11.36.023 E020.42.16.092 N052.11.36.132 E020.42.26.999
                          N052.11.36.132 E020.42.26.999 N052.11.36.023 E020.42.37.907
                          N052.11.36.023 E020.42.37.907 N052.11.35.664 E020.42.48.816
                          N052.11.35.664 E020.42.48.816 N052.11.35.088 E020.42.59.688
                          N052.11.35.088 E020.42.59.688 N052.11.34.259 E020.43.10.524
                          N052.11.34.259 E020.43.10.524 WA703 WA703 PROHI
                  
                  
                  
                  MAKUS MAKUS SOXER SOXER
                  
                  MAKUS MAKUS LOLSI LOLSI                  
				                          
                          
EPWA 15        N052.08.57.792 E020.58.52.783 N052.07.05.717 E021.00.29.762
               N052.07.05.717 E021.00.29.762 N052.06.54.573 E021.00.39.878
               N052.06.54.573 E021.00.39.878 N052.06.47.312 E021.00.46.992
               N052.06.47.312 E021.00.46.992 N052.06.40.378 E021.00.54.327
               N052.06.40.378 E021.00.54.327 N052.06.34.736 E021.01.00.801
               N052.06.34.736 E021.01.00.801 N052.06.27.939 E021.01.09.440
               N052.06.27.939 E021.01.09.440 N052.06.21.525 E021.01.18.777
               N052.06.21.525 E021.01.18.777 N052.06.18.538 E021.01.23.564
               N052.06.18.538 E021.01.23.564 N052.06.12.633 E021.01.33.968
               N052.06.12.633 E021.01.33.968 N052.06.07.280 E021.01.44.845
               N052.06.07.280 E021.01.44.845 N052.06.02.486 E021.01.55.960
               N052.06.02.486 E021.01.55.960 N052.05.58.155 E021.02.07.612
               N052.05.58.155 E021.02.07.612 N052.05.54.070 E021.02.20.162
               N052.05.54.070 E021.02.20.162 N052.05.50.708 E021.02.32.347
               N052.05.50.708 E021.02.32.347 N052.05.47.657 E021.02.44.791
               N052.05.47.657 E021.02.44.791 N052.05.44.808 E021.02.58.253
               N052.05.44.808 E021.02.58.253 N052.05.41.115 E021.03.18.662
               N052.05.41.115 E021.03.18.662 N052.05.38.013 E021.03.38.735
               N052.05.38.013 E021.03.38.735 N052.05.24.886 E021.05.20.490
               N052.05.24.886 E021.05.20.490 N052.05.17.593 E021.06.21.410
               N052.05.17.593 E021.06.21.410 N052.05.14.447 E021.06.47.977
               N052.05.14.447 E021.06.47.977 WA651 WA651
			   WA651 WA651 N052.05.56.521 E021.10.43.227 
			   N052.05.56.521 E021.10.43.227  N052.05.58.887 E021.10.54.728
                          N052.05.58.887 E021.10.54.728 N052.06.01.527 E021.11.06.093
                          N052.06.01.527 E021.11.06.093 N052.06.02.934 E021.11.11.764
                          N052.06.02.934 E021.11.11.764 N052.06.04.980 E021.11.19.201
                          N052.06.04.980 E021.11.19.201 N052.06.08.411 E021.11.30.165
                          N052.06.08.411 E021.11.30.165 N052.06.12.278 E021.11.40.674
                          N052.06.12.278 E021.11.40.674 N052.06.14.390 E021.11.45.647
                          N052.06.14.390 E021.11.45.647 N052.06.19.018 E021.11.55.311
                          N052.06.19.018 E021.11.55.311 N052.06.21.446 E021.11.59.814
                          N052.06.21.446 E021.11.59.814 N052.06.26.876 E021.12.08.506
                          N052.06.26.876 E021.12.08.506 N052.06.29.750 E021.12.12.477
                          N052.06.29.750 E021.12.12.477 N052.06.35.707 E021.12.19.768
                          N052.06.35.707 E021.12.19.768 N052.06.38.885 E021.12.23.148
                          N052.06.38.885 E021.12.23.148 N052.06.45.142 E021.12.28.882
                          N052.06.45.142 E021.12.28.882 N052.06.51.136 E021.12.33.427
                          N052.06.51.136 E021.12.33.427 N052.06.58.279 E021.12.37.734
                          N052.06.58.279 E021.12.37.734 N052.07.01.819 E021.12.39.476
                          N052.07.01.819 E021.12.39.476 N052.07.05.530 E021.12.41.091
                          N052.07.05.530 E021.12.41.091 N052.07.13.325 E021.12.43.722
                          N052.07.13.325 E021.12.43.722 N052.07.20.782 E021.12.45.531
                          N052.07.20.782 E021.12.45.531 N052.07.28.228 E021.12.46.788
                          N052.07.28.228 E021.12.46.788 N052.07.39.539 E021.12.47.932
                          N052.07.39.539 E021.12.47.932 LANPA LANPA
			      LANPA LANPA INSON INSON
                  INSON INSON WA663 WA663
                  WA663 WA663 OLILA OLILA
                  
                  N052.06.58.279 E021.12.37.734 WA657 WA657 ;WA651 WA651 WA657 WA657
                  WA657 WA657 WA698 WA698
                  WA698 WA698 BAMSO BAMSO
                  
                  N052.05.18.672 E021.01.06.671 WA656 WA656 ; EPWA WA656
                  WA656 WA656 XIMBA XIMBA 
                  
                  N052.07.05.700 E021.00.29.664 N052.07.00.588 E021.00.34.452
                          N052.07.00.588 E021.00.34.452 N052.06.55.440 E021.00.38.915
                          N052.06.55.440 E021.00.38.915 N052.06.50.148 E021.00.43.092
                          N052.06.50.148 E021.00.43.092 N052.06.44.783 E021.00.46.979
                          N052.06.44.783 E021.00.46.979 N052.06.39.348 E021.00.50.544
                          N052.06.39.348 E021.00.50.544 N052.06.33.840 E021.00.53.819
                          N052.06.33.840 E021.00.53.819 N052.06.28.259 E021.00.56.771
                          N052.06.28.259 E021.00.56.771 N052.06.22.644 E021.00.59.400
                          N052.06.22.644 E021.00.59.400 N052.06.16.955 E021.01.01.704
                          N052.06.16.955 E021.01.01.704 N052.06.11.196 E021.01.03.684
                          N052.06.11.196 E021.01.03.684 N052.06.05.435 E021.01.05.339
                          N052.06.05.435 E021.01.05.339 N052.05.59.639 E021.01.06.671
                          N052.05.59.639 E021.01.06.671 N052.05.53.808 E021.01.07.679
                          N052.05.53.808 E021.01.07.679 N052.05.47.939 E021.01.08.363
                          N052.05.47.939 E021.01.08.363 N052.05.42.071 E021.01.08.687
                          N052.05.42.071 E021.01.08.687 N052.05.36.240 E021.01.08.687
                          N052.05.36.240 E021.01.08.687 N052.05.30.371 E021.01.08.363
                          N052.05.30.371 E021.01.08.363 N052.05.24.503 E021.01.07.679
                          N052.05.24.503 E021.01.07.679 N052.05.18.672 E021.01.06.671
                          N052.05.18.672 E021.01.06.671 N052.05.12.876 E021.01.05.339
                          N052.05.12.876 E021.01.05.339 N052.05.07.115 E021.01.03.684
                          N052.05.07.115 E021.01.03.684 N052.05.01.356 E021.01.01.704
                          N052.05.01.356 E021.01.01.704 N052.04.55.667 E021.00.59.400
                          N052.04.55.667 E021.00.59.400 N052.04.50.052 E021.00.56.771
                          N052.04.50.052 E021.00.56.771 N052.04.44.471 E021.00.53.819
                          N052.04.44.471 E021.00.53.819 N052.04.38.963 E021.00.50.544
                          N052.04.38.963 E021.00.50.544 N052.04.33.528 E021.00.46.979
                          N052.04.33.528 E021.00.46.979 N052.04.28.163 E021.00.43.092
                          N052.04.28.163 E021.00.43.092 N052.04.22.871 E021.00.38.915
                          N052.04.22.871 E021.00.38.915 N052.04.17.724 E021.00.34.452
                          N052.04.17.724 E021.00.34.452 N052.04.12.611 E021.00.29.664
                          N052.04.12.611 E021.00.29.664 N052.04.07.643 E021.00.24.588
                          N052.04.07.643 E021.00.24.588 N052.04.02.783 E021.00.19.259
                          N052.04.02.783 E021.00.19.259 N052.03.58.068 E021.00.13.643
                          N052.03.58.068 E021.00.13.643 N052.03.53.423 E021.00.07.775
                          N052.03.53.423 E021.00.07.775 N052.03.48.923 E021.00.01.656
                          N052.03.48.923 E021.00.01.656 N052.03.44.567 E020.59.55.248
                          N052.03.44.567 E020.59.55.248 N052.03.40.356 E020.59.48.623
                          N052.03.40.356 E020.59.48.623 N052.03.36.287 E020.59.41.748
                          N052.03.36.287 E020.59.41.748 N052.03.32.364 E020.59.34.656
                          N052.03.32.364 E020.59.34.656 N052.03.28.584 E020.59.27.347
                          N052.03.28.584 E020.59.27.347 N052.03.24.983 E020.59.19.823
                          N052.03.24.983 E020.59.19.823 WA653 WA653
                  WA653 WA653 NITKI NITKI
                  NITKI NITKI NIPUS NIPUS
                  NIPUS NIPUS EVINA EVINA
                  
                  WA653 WA653 GILAL GILAL
                  GILAL GILAL SOXER SOXER
                  
                  GILAL GILAL LOLSI LOLSI      

EPWA 11     N052.09.39.504 E020.59.02.221 N052.09.06.173 E021.01.02.701
                          N052.09.06.173 E021.01.02.701 N052.09.03.858 E021.01.11.206 
                          N052.09.03.858 E021.01.11.206 N052.09.02.689 E021.01.15.812
                          N052.09.02.689 E021.01.15.812 N052.08.59.338 E021.01.29.604
                          N052.08.59.338 E021.01.29.604 N052.08.58.318 E021.01.34.095
                          N052.08.58.318 E021.01.34.095 N052.08.56.482 E021.01.43.413
                          N052.08.56.482 E021.01.43.413 N052.08.55.695 E021.01.48.011
                          N052.08.55.695 E021.01.48.011 N052.08.54.952 E021.01.52.854
                          N052.08.54.952 E021.01.52.854 N052.08.53.843 E021.02.02.277
                          N052.08.53.843 E021.02.02.277 N052.08.53.293 E021.02.08.868
                          N052.08.53.293 E021.02.08.868 N052.08.52.890 E021.02.18.355
                          N052.08.52.890 E021.02.18.355 N052.08.52.954 E021.02.28.070
                          N052.08.52.954 E021.02.28.070 N052.08.53.207 E021.02.33.020
                          N052.08.53.207 E021.02.33.020 N052.08.54.051 E021.02.42.204
                          N052.08.54.051 E021.02.42.204 N052.08.55.462 E021.02.51.781
                          N052.08.55.462 E021.02.51.781 N052.08.56.256 E021.02.56.336
                          N052.08.56.256 E021.02.56.336 N052.08.58.191 E021.03.05.287
                          N052.08.58.191 E021.03.05.287 N052.08.59.730 E021.03.11.322
                          N052.08.59.730 E021.03.11.322 N052.09.02.022 E021.03.19.840
                          N052.09.02.022 E021.03.19.840 N052.09.05.797 E021.03.32.615
                          N052.09.05.797 E021.03.32.615 N052.09.21.111 E021.04.28.897
                          N052.09.21.111 E021.04.28.897 N052.09.32.174 E021.05.13.180
						  N052.09.32.174 E021.05.13.180 WA601 WA601
                  		  WA601 WA601 N052.08.44.419 E021.12.17.538
 						  N052.08.44.419 E021.12.17.538 N052.08.43.318 E021.12.28.968
                          N052.08.43.318 E021.12.28.968 N052.08.42.059 E021.12.46.696
                          N052.08.42.059 E021.12.46.696 N052.08.41.599 E021.12.59.627
                          N052.08.41.599 E021.12.59.627 N052.08.41.522 E021.13.05.627
                          N052.08.41.522 E021.13.05.627 N052.08.41.696 E021.13.17.498
                          N052.08.41.696 E021.13.17.498 N052.08.41.960 E021.13.23.902
                          N052.08.41.960 E021.13.23.902 N052.08.42.938 E021.13.35.829
                          N052.08.42.938 E021.13.35.829 N052.08.43.655 E021.13.41.770
                          N052.08.43.655 E021.13.41.770 N052.08.45.559 E021.13.53.432
                          N052.08.45.559 E021.13.53.432 N052.08.48.145 E021.14.05.014
                          N052.08.48.145 E021.14.05.014 N052.08.49.717 E021.14.10.683
                          N052.08.49.717 E021.14.10.683 N052.08.51.411 E021.14.16.238
                          N052.08.51.411 E021.14.16.238 N052.08.55.052 E021.14.26.558
                          N052.08.55.052 E021.14.26.558 N052.08.57.119 E021.14.31.555
                          N052.08.57.119 E021.14.31.555 N052.09.05.384 E021.14.47.909
                          N052.09.05.384 E021.14.47.909 N052.09.08.002 E021.14.52.092
                          N052.09.08.002 E021.14.52.092 N052.09.13.595 E021.15.00.055
                          N052.09.13.595 E021.15.00.055 N052.09.19.640 E021.15.07.306
                          N052.09.19.640 E021.15.07.306 N052.09.22.624 E021.15.10.401
                          N052.09.22.624 E021.15.10.401 N052.09.29.071 E021.15.16.161
                          N052.09.29.071 E021.15.16.161 N052.09.35.757 E021.15.20.917
                          N052.09.35.757 E021.15.20.917 N052.09.39.141 E021.15.22.916
                          N052.09.39.141 E021.15.22.916 N052.09.47.964 E021.15.26.777
                          N052.09.47.964 E021.15.26.777 N052.09.54.969 E021.15.28.687
                          N052.09.54.969 E021.15.28.687 N052.10.02.126 E021.15.29.619
                          N052.10.02.126 E021.15.29.619 N052.10.05.616 E021.15.29.766
                          N052.10.05.616 E021.15.29.766 N052.10.13.822 E021.15.29.378
                          N052.10.13.822 E021.15.29.378 N052.10.20.819 E021.15.28.409
                          N052.10.20.819 E021.15.28.409 N052.10.27.646 E021.15.26.998
				  
				  
				  N052.10.27.646 E021.15.26.998 LANPA LANPA
                  LANPA LANPA INSON INSON
                  INSON INSON WA663 WA663
                  WA663 WA663 OLILA OLILA
                  
                  N052.08.51.411 E021.14.16.238 N052.15.12.900 E021.41.42.600 ;WA601 WA601 WA698 WA698
                  WA698 WA698 BAMSO BAMSO
                  
                  N052.06.48.229 E021.03.40.141 N052.02.40.000 E021.03.20.000
				  N052.02.40.000 E021.03.20.000 WA604 WA604 					;EPWA EPWA WA604 WA604
                  WA604 WA604 XIMBA XIMBA
                  
                  N052.09.06.173 E021.01.02.701 N052.08.59.585 E021.01.22.415
                          N052.08.59.585 E021.01.22.415 N052.08.53.704 E021.01.41.190
                          N052.08.53.704 E021.01.41.190 N052.08.49.577 E021.01.53.101
                          N052.08.49.577 E021.01.53.101 N052.08.44.988 E021.02.05.256
                          N052.08.44.988 E021.02.05.256 N052.08.39.950 E021.02.16.889
                          N052.08.39.950 E021.02.16.889 N052.08.34.519 E021.02.27.940
                          N052.08.34.519 E021.02.27.940 N052.08.28.773 E021.02.38.161
                          N052.08.28.773 E021.02.38.161 N052.08.25.551 E021.02.43.383
                          N052.08.25.551 E021.02.43.383 N052.08.19.091 E021.02.52.683
                          N052.08.19.091 E021.02.52.683 N052.08.12.207 E021.03.01.402
                          N052.08.12.207 E021.03.01.402 N052.08.05.024 E021.03.09.244
                          N052.08.05.024 E021.03.09.244 N052.08.01.565 E021.03.12.588
                          N052.08.01.565 E021.03.12.588 N052.07.54.024 E021.03.19.214
                          N052.07.54.024 E021.03.19.214 N052.07.46.312 E021.03.24.919
                          N052.07.46.312 E021.03.24.919 N052.07.42.307 E021.03.27.535
                          N052.07.42.307 E021.03.27.535 N052.07.34.262 E021.03.31.943
                          N052.07.34.262 E021.03.31.943 N052.07.30.475 E021.03.33.693
                          N052.07.30.475 E021.03.33.693 N052.07.21.687 E021.03.37.002
                          N052.07.21.687 E021.03.37.002 N052.07.13.397 E021.03.39.155
                          N052.07.13.397 E021.03.39.155 N052.07.09.272 E021.03.39.871
                          N052.07.09.272 E021.03.39.871 N052.07.00.590 E021.03.40.676
                          N052.07.00.590 E021.03.40.676 N052.06.56.515 E021.03.40.716
                          N052.06.56.515 E021.03.40.716 N052.06.48.229 E021.03.40.141
                          N052.06.48.229 E021.03.40.141 N052.06.40.058 E021.03.38.684
                          N052.06.40.058 E021.03.38.684 N052.06.32.167 E021.03.36.405
                          N052.06.32.167 E021.03.36.405 N052.06.24.027 E021.03.33.170
                          N052.06.24.027 E021.03.33.170 N052.06.16.113 E021.03.29.064
                          N052.06.16.113 E021.03.29.064 N052.06.12.051 E021.03.26.585
                          N052.06.12.051 E021.03.26.585 N052.06.04.367 E021.03.21.163
                          N052.06.04.367 E021.03.21.163 N052.05.57.031 E021.03.14.984
                          N052.05.57.031 E021.03.14.984 N052.05.53.374 E021.03.11.514
                          N052.05.53.374 E021.03.11.514 N052.03.18.150 E021.00.17.585
                  N052.03.18.150 E021.00.17.585 WA606 WA606
                  WA606 WA606 NITKI NITKI
                  NITKI NITKI NIPUS NIPUS
                  NIPUS NIPUS EVINA EVINA
                  
                  WA606 WA606 GILAL GILAL
                  GILAL GILAL SOXER SOXER
                  
                  GILAL GILAL LOLSI LOLSI

      
EPWA 33     N052.13.34.463 E020.52.19.416 N052.13.34.463 E020.52.16.680
                          N052.13.34.463 E020.52.16.680 N052.13.34.571 E020.52.13.943
                          N052.13.34.571 E020.52.13.943 N052.13.34.715 E020.52.11.207
                          N052.13.34.715 E020.52.11.207 N052.13.34.932 E020.52.08.507
                          N052.13.34.932 E020.52.08.507 N052.13.35.183 E020.52.05.807
                          N052.13.35.183 E020.52.05.807 N052.13.35.507 E020.52.03.107
                          N052.13.35.507 E020.52.03.107 N052.13.35.868 E020.52.00.444
                          N052.13.35.868 E020.52.00.444 N052.13.36.300 E020.51.57.816
                          N052.13.36.300 E020.51.57.816 N052.13.36.803 E020.51.55.188
                          N052.13.36.803 E020.51.55.188 N052.13.37.344 E020.51.52.595
                          N052.13.37.344 E020.51.52.595 N052.13.37.955 E020.51.50.040
                          N052.13.37.955 E020.51.50.040 N052.13.38.603 E020.51.47.519
                          N052.13.38.603 E020.51.47.519 N052.13.39.323 E020.51.45.071
                          N052.13.39.323 E020.51.45.071 N052.13.40.080 E020.51.42.624
                          N052.13.40.080 E020.51.42.624 N052.13.40.872 E020.51.40.212
                          N052.13.40.872 E020.51.40.212 N052.13.41.735 E020.51.37.872
                          N052.13.41.735 E020.51.37.872 N052.13.42.672 E020.51.35.568
                          N052.13.42.672 E020.51.35.568 N052.13.43.608 E020.51.33.335
                          N052.13.43.608 E020.51.33.335 N052.13.44.615 E020.51.31.140
                          N052.13.44.615 E020.51.31.140 N052.13.45.695 E020.51.29.015
                          N052.13.45.695 E020.51.29.015 WA751 WA751
				  N052.18.08.028 E020.45.55.620 WA791 WA791				   
                  WA791 WA791 INRAS INRAS
                  INRAS INRAS OLILA OLILA
                  
                   
				  
				  WA751 WA751 N052.16.11.892 E020.47.04.739
                          N052.16.11.892 E020.47.04.739 N052.16.15.347 E020.46.59.051
                          N052.16.15.347 E020.46.59.051 N052.16.18.947 E020.46.53.579
                          N052.16.18.947 E020.46.53.579 N052.16.22.655 E020.46.48.288
                          N052.16.22.655 E020.46.48.288 N052.16.26.508 E020.46.43.212
                          N052.16.26.508 E020.46.43.212 N052.16.30.432 E020.46.38.387
                          N052.16.30.432 E020.46.38.387 N052.16.34.464 E020.46.33.743
                          N052.16.34.464 E020.46.33.743 N052.16.38.568 E020.46.29.388
                          N052.16.38.568 E020.46.29.388 N052.16.42.815 E020.46.25.247
                          N052.16.42.815 E020.46.25.247 N052.16.47.099 E020.46.21.324
                          N052.16.47.099 E020.46.21.324 N052.16.51.492 E020.46.17.688
                          N052.16.51.492 E020.46.17.688 N052.16.55.955 E020.46.14.268
                          N052.16.55.955 E020.46.14.268 N052.17.00.492 E020.46.11.136
                          N052.17.00.492 E020.46.11.136 N052.17.05.063 E020.46.08.255
                          N052.17.05.063 E020.46.08.255 N052.17.09.743 E020.46.05.627
                          N052.17.09.743 E020.46.05.627 N052.17.14.424 E020.46.03.287
                          N052.17.14.424 E020.46.03.287 N052.17.19.176 E020.46.01.199
                          N052.17.19.176 E020.46.01.199 N052.17.23.999 E020.45.59.364
                          N052.17.23.999 E020.45.59.364 N052.17.28.823 E020.45.57.851
                          N052.17.28.823 E020.45.57.851 N052.17.33.684 E020.45.56.592
                          N052.17.33.684 E020.45.56.592 N052.17.38.579 E020.45.55.620
                          N052.17.38.579 E020.45.55.620 N052.17.43.475 E020.45.54.900
                          N052.17.43.475 E020.45.54.900 N052.17.48.372 E020.45.54.467
                          N052.17.48.372 E020.45.54.467 N052.17.53.303 E020.45.54.360
                          N052.17.53.303 E020.45.54.360 N052.17.58.235 E020.45.54.467
                          N052.17.58.235 E020.45.54.467 N052.18.03.132 E020.45.54.900
                          N052.18.03.132 E020.45.54.900 N052.18.08.028 E020.45.55.620
                          N052.18.08.028 E020.45.55.620 N052.18.12.923 E020.45.56.592
                          N052.18.12.923 E020.45.56.592 N052.18.17.784 E020.45.57.851
                          N052.18.17.784 E020.45.57.851 N052.18.22.608 E020.45.59.364
                          N052.18.22.608 E020.45.59.364 N052.18.27.432 E020.46.01.199
                          N052.18.27.432 E020.46.01.199 N052.18.32.183 E020.46.03.287
                          N052.18.32.183 E020.46.03.287 N052.18.36.864 E020.46.05.627
                          N052.18.36.864 E020.46.05.627 N052.18.41.544 E020.46.08.255
                          N052.18.41.544 E020.46.08.255 N052.18.46.115 E020.46.11.136
                          N052.18.46.115 E020.46.11.136 N052.18.50.652 E020.46.14.268
                          N052.18.50.652 E020.46.14.268 N052.18.55.115 E020.46.17.688
                          N052.18.55.115 E020.46.17.688 N052.18.59.508 E020.46.21.324
                          N052.18.59.508 E020.46.21.324 N052.19.03.792 E020.46.25.247
                          N052.19.03.792 E020.46.25.247 N052.19.08.039 E020.46.29.388
                          N052.19.08.039 E020.46.29.388 N052.19.12.143 E020.46.33.743
                          N052.19.12.143 E020.46.33.743 N052.19.16.175 E020.46.38.387
                          N052.19.16.175 E020.46.38.387 N052.19.20.099 E020.46.43.212
                          N052.19.20.099 E020.46.43.212 N052.19.23.952 E020.46.48.288
                          N052.19.23.952 E020.46.48.288 N052.19.27.660 E020.46.53.579
                          N052.19.27.660 E020.46.53.579 N052.19.31.260 E020.46.59.051
                          N052.19.31.260 E020.46.59.051 N052.19.34.715 E020.47.04.739
                          N052.19.34.715 E020.47.04.739 N052.19.38.099 E020.47.10.644
                          N052.19.38.099 E020.47.10.644 N052.19.41.303 E020.47.16.692
                          N052.19.41.303 E020.47.16.692 N052.19.44.400 E020.47.22.955
                          N052.19.44.400 E020.47.22.955 N052.19.47.388 E020.47.29.399
                          N052.19.47.388 E020.47.29.399 N052.19.50.196 E020.47.35.988
                          N052.19.50.196 E020.47.35.988 N052.19.52.895 E020.47.42.720
                          N052.19.52.895 E020.47.42.720 N052.19.55.415 E020.47.49.631
                          N052.19.55.415 E020.47.49.631 N052.19.57.792 E020.47.56.652
                          N052.19.57.792 E020.47.56.652 N052.20.00.023 E020.48.03.815
                          N052.20.00.023 E020.48.03.815 N052.20.02.111 E020.48.11.124
                          N052.20.02.111 E020.48.11.124 N052.20.04.019 E020.48.18.540
                          N052.20.04.019 E020.48.18.540 N052.20.05.784 E020.48.26.064
                          N052.20.05.784 E020.48.26.064 N052.20.07.403 E020.48.33.659
                          N052.20.07.403 E020.48.33.659 WA798 WA798  
                  WA798 WA798 WA572 WA572
                  WA572 WA572 BAMSO BAMSO
                  
                  N052.10.43.134 E020.57.20.863 N052.12.18.936 E020.55.59.555
                          N052.12.20.015 E020.55.58.547 N052.12.18.936 E020.55.59.555
                          N052.13.20.531 E020.50.54.636 N052.13.22.619 E020.51.01.943
                          N052.13.22.619 E020.51.01.943 N052.13.24.528 E020.51.09.323
                          N052.13.24.528 E020.51.09.323 N052.13.26.292 E020.51.16.811
                          N052.13.26.292 E020.51.16.811 N052.13.27.912 E020.51.24.408
                          N052.13.27.912 E020.51.24.408 N052.13.29.352 E020.51.32.076
                          N052.13.29.352 E020.51.32.076 N052.13.30.611 E020.51.39.852
                          N052.13.30.611 E020.51.39.852 N052.13.31.727 E020.51.47.664
                          N052.13.31.727 E020.51.47.664 N052.13.32.664 E020.51.55.547
                          N052.13.32.664 E020.51.55.547 N052.13.33.456 E020.52.03.467
                          N052.13.33.456 E020.52.03.467 N052.13.34.032 E020.52.11.423
                          N052.13.34.032 E020.52.11.423 N052.13.34.463 E020.52.19.416
                          N052.13.34.463 E020.52.19.416 N052.13.34.715 E020.52.27.443
                          N052.13.34.715 E020.52.27.443 N052.13.34.824 E020.52.35.471
                          N052.13.34.824 E020.52.35.471 N052.13.34.715 E020.52.43.500
                          N052.13.34.715 E020.52.43.500 N052.13.34.463 E020.52.51.528
                          N052.13.34.463 E020.52.51.528 N052.13.34.032 E020.52.59.519
                          N052.13.34.032 E020.52.59.519 N052.13.33.456 E020.53.07.476
                          N052.13.33.456 E020.53.07.476 N052.13.32.664 E020.53.15.395
                          N052.13.32.664 E020.53.15.395 N052.13.31.727 E020.53.23.280
                          N052.13.31.727 E020.53.23.280 N052.13.30.611 E020.53.31.128
                          N052.13.30.611 E020.53.31.128 N052.13.29.352 E020.53.38.868
                          N052.13.29.352 E020.53.38.868 N052.13.27.912 E020.53.46.536
                          N052.13.27.912 E020.53.46.536 N052.13.26.292 E020.53.54.131
                          N052.13.26.292 E020.53.54.131 N052.13.24.528 E020.54.01.619
                          N052.13.24.528 E020.54.01.619 N052.13.22.619 E020.54.08.999
                          N052.13.22.619 E020.54.08.999 N052.13.20.531 E020.54.16.308
                          N052.13.20.531 E020.54.16.308 N052.13.18.300 E020.54.23.436
                          N052.13.18.300 E020.54.23.436 N052.13.15.923 E020.54.30.456
                          N052.13.15.923 E020.54.30.456 N052.13.13.404 E020.54.37.332
                          N052.13.13.404 E020.54.37.332 N052.13.10.703 E020.54.44.064
                          N052.13.10.703 E020.54.44.064 N052.13.07.895 E020.54.50.651
                          N052.13.07.895 E020.54.50.651 N052.13.04.907 E020.54.57.059
                          N052.13.04.907 E020.54.57.059 N052.13.01.812 E020.55.03.288
                          N052.13.01.812 E020.55.03.288 N052.12.58.607 E020.55.09.372
                          N052.12.58.607 E020.55.09.372 N052.12.55.223 E020.55.15.239
                          N052.12.55.223 E020.55.15.239 N052.12.51.767 E020.55.20.892
                          N052.12.51.767 E020.55.20.892 N052.12.48.168 E020.55.26.399
                          N052.12.48.168 E020.55.26.399 N052.12.44.460 E020.55.31.656
                          N052.12.44.460 E020.55.31.656 N052.12.40.608 E020.55.36.696
                          N052.12.40.608 E020.55.36.696 N052.12.36.683 E020.55.41.520
                          N052.12.36.683 E020.55.41.520 N052.12.32.651 E020.55.46.128
                          N052.12.32.651 E020.55.46.128 N052.12.28.547 E020.55.50.520
                          N052.12.28.547 E020.55.50.520 N052.12.24.299 E020.55.54.660
                          N052.12.24.299 E020.55.54.660 N052.12.20.015 E020.55.58.547
                          N052.13.20.531 E020.50.54.636 N052.11.22.639 E020.43.18.747
                          N052.11.22.639 E020.43.18.747 WA753 WA753				 
                  WA753 WA753 SURIM SURIM
                  SURIM SURIM ABSEL ABSEL
                  ABSEL ABSEL EREDA EREDA
                  EREDA EREDA XENOM XENOM
                  XENOM XENOM TISTA TISTA
                  TISTA TISTA XIMBA XIMBA
                  
                  SURIM SURIM EVDEX EVDEX
                  EVDEX EVDEX NIPUS NIPUS
                  NIPUS NIPUS EVINA EVINA
                  
                  
				  
				  WA753 WA753 N052.10.17.724 E020.42.04.823
                          N052.10.17.724 E020.42.04.823 N052.10.13.296 E020.41.58.524
                          N052.10.13.296 E020.41.58.524 N052.10.09.012 E020.41.52.008
                          N052.10.09.012 E020.41.52.008 N052.10.04.871 E020.41.45.240
                          N052.10.04.871 E020.41.45.240 N052.10.00.876 E020.41.38.256
                          N052.10.00.876 E020.41.38.256 N052.09.57.024 E020.41.31.019
                          N052.09.57.024 E020.41.31.019 N052.09.53.351 E020.41.23.603
                          N052.09.53.351 E020.41.23.603 N052.09.49.824 E020.41.15.972
                          N052.09.49.824 E020.41.15.972 N052.09.46.440 E020.41.08.124
                          N052.09.46.440 E020.41.08.124 N052.09.43.236 E020.41.00.096
                          N052.09.43.236 E020.41.00.096 N052.09.40.248 E020.40.51.888
                          N052.09.40.248 E020.40.51.888 N052.09.37.403 E020.40.43.536
                          N052.09.37.403 E020.40.43.536 N052.09.34.739 E020.40.35.004
                          N052.09.34.739 E020.40.35.004 N052.09.32.256 E020.40.26.328
                          N052.09.32.256 E020.40.26.328 N052.09.29.952 E020.40.17.508
                          N052.09.29.952 E020.40.17.508 N052.09.27.863 E020.40.08.579
                          N052.09.27.863 E020.40.08.579 N052.09.25.955 E020.39.59.544
                          N052.09.25.955 E020.39.59.544 N052.09.24.228 E020.39.50.400
                          N052.09.24.228 E020.39.50.400 N052.09.22.715 E020.39.41.147
                          N052.09.22.715 E020.39.41.147 N052.09.21.384 E020.39.31.824
                          N052.09.21.384 E020.39.31.824 N052.09.20.268 E020.39.22.428
                          N052.09.20.268 E020.39.22.428 N052.09.19.368 E020.39.12.996
                          N052.09.19.368 E020.39.12.996 N052.09.18.648 E020.39.03.492
                          N052.09.18.648 E020.39.03.492 N052.09.18.143 E020.38.53.951
                          N052.09.18.143 E020.38.53.951 MAKUS MAKUS
				  MAKUS MAKUS SOXER SOXER
                  
                  MAKUS MAKUS LOLSI LOLSI   



EPLL 25             N000.00.00.000 E000.00.00.000 N000.00.00.000 E000.00.00.000
                          N051.42.58.780 E019.22.21.340 N051.41.55.348 E019.17.38.008
                          N051.41.55.348 E019.17.38.008 N051.41.52.767 E019.17.26.268
                          N051.41.52.767 E019.17.26.268 N051.41.50.906 E019.17.17.533
                          N051.41.50.906 E019.17.17.533 N051.41.48.683 E019.17.06.523
                          N051.41.48.683 E019.17.06.523 N051.41.46.724 E019.16.56.049
                          N051.41.46.724 E019.16.56.049 N051.41.44.675 E019.16.43.298
                          N051.41.44.675 E019.16.43.298 N051.41.43.835 E019.16.37.191
                          N051.41.43.835 E019.16.37.191 N051.41.43.108 E019.16.30.925
                          N051.41.43.108 E019.16.30.925 N051.41.42.411 E019.16.24.497
                          N051.41.42.411 E019.16.24.497 N051.41.41.863 E019.16.18.059
                          N051.41.41.863 E019.16.18.059 N051.41.41.465 E019.16.12.256
                          N051.41.41.465 E019.16.12.256 N051.41.41.137 E019.16.05.115
                          N051.41.41.137 E019.16.05.115 N051.41.40.938 E019.15.58.890
                          N051.41.40.938 E019.15.58.890 N051.41.40.843 E019.15.52.414
                          N051.41.40.843 E019.15.52.414 N051.41.40.867 E019.15.45.538
                          N051.41.40.867 E019.15.45.538 N051.41.40.962 E019.15.40.646
                          N051.41.40.962 E019.15.40.646 N051.41.41.221 E019.15.33.430
                          N051.41.41.221 E019.15.33.430 N051.41.41.585 E019.15.26.758
                          N051.41.41.585 E019.15.26.758 N051.41.42.065 E019.15.20.133
                          N051.41.42.065 E019.15.20.133 N051.41.43.331 E019.15.07.385
                          N051.41.43.331 E019.15.07.385 N051.41.44.048 E019.15.01.669
                          N051.41.44.048 E019.15.01.669 N051.41.45.003 E019.14.54.774
                          N051.41.45.003 E019.14.54.774 N051.41.45.804 E019.14.49.807
                          N051.41.45.804 E019.14.49.807 N051.41.47.087 E019.14.42.818
                          N051.41.47.087 E019.14.42.818 N051.41.49.527 E019.14.31.109
                          N051.41.49.527 E019.14.31.109 N051.41.50.943 E019.14.25.143
                          N051.41.50.943 E019.14.25.143 N051.41.52.488 E019.14.19.006
                          N051.41.52.488 E019.14.19.006 N051.41.54.140 E019.14.13.075
                          N051.41.54.140 E019.14.13.075 N051.41.55.663 E019.14.07.996
                          N051.41.55.663 E019.14.07.996 N051.41.57.767 E019.14.01.443
                          N051.41.57.767 E019.14.01.443 N051.41.59.540 E019.13.56.308
                          N051.41.59.540 E019.13.56.308 N051.42.03.674 E019.13.45.479
                          N051.42.03.674 E019.13.45.479 N051.42.06.001 E019.13.39.829
                          N051.42.06.001 E019.13.39.829 N051.42.08.272 E019.13.34.772
                          N051.42.08.272 E019.13.34.772 N051.42.10.044 E019.13.30.929
                          N051.42.10.044 E019.13.30.929 N051.42.12.858 E019.13.25.195
                          N051.42.12.858 E019.13.25.195 N051.42.15.286 E019.13.20.575
                          N051.42.15.286 E019.13.20.575 N051.42.18.052 E019.13.15.597
                          N051.42.18.052 E019.13.15.597 N051.42.20.442 E019.13.11.510
                          N051.42.20.442 E019.13.11.510 N051.42.26.387 E019.13.02.231
                          N051.42.26.387 E019.13.02.231 N051.42.29.314 E019.12.57.993
                          N051.42.29.314 E019.12.57.993 N051.42.31.983 E019.12.54.391
                          N051.42.31.983 E019.12.54.391 N051.42.35.274 E019.12.50.105
                          N051.42.35.274 E019.12.50.105 N051.42.38.369 E019.12.46.389
                          N051.42.38.369 E019.12.46.389 N051.42.41.519 E019.12.42.797
                          N051.42.41.519 E019.12.42.797 N051.42.44.382 E019.12.39.662
                          N051.42.44.382 E019.12.39.662 N051.42.51.307 E019.12.32.804
                          N051.42.51.307 E019.12.32.804 N051.42.55.020 E019.12.29.496
                          N051.42.55.020 E019.12.29.496 N051.42.58.375 E019.12.26.686
                          N051.42.58.375 E019.12.26.686 N051.43.02.107 E019.12.23.788
                          N051.43.02.107 E019.12.23.788 N051.43.05.705 E019.12.21.214
                          N051.43.05.705 E019.12.21.214 N051.43.09.124 E019.12.18.898
                          N051.43.09.124 E019.12.18.898 N051.43.12.754 E019.12.16.648
                          N051.43.12.754 E019.12.16.648 N051.43.20.543 E019.12.12.442
                          N051.43.20.543 E019.12.12.442 N051.43.27.876 E019.12.09.176
                          N051.43.27.876 E019.12.09.176 N051.43.32.067 E019.12.07.631
                          N051.43.32.067 E019.12.07.631 N051.43.35.702 E019.12.06.464
                          N051.43.35.702 E019.12.06.464 N051.43.39.778 E019.12.05.347
                          N051.43.39.778 E019.12.05.347 N051.43.44.111 E019.12.04.358
                          N051.43.44.111 E019.12.04.358 N051.43.47.985 E019.12.03.658
                          N051.43.47.985 E019.12.03.658 N051.43.52.444 E019.12.03.077
                          N051.43.52.444 E019.12.03.077 N051.43.56.446 E019.12.02.765
                          N051.43.56.446 E019.12.02.765 N051.44.04.391 E019.12.02.650
                          N051.44.04.391 E019.12.02.650 N051.44.08.356 E019.12.02.879
                          N051.44.08.356 E019.12.02.879 N051.44.12.128 E019.12.03.232
                          N051.44.12.128 E019.12.03.232 N051.44.16.848 E019.12.03.941
                          N051.44.16.848 E019.12.03.941 N051.44.22.217 E019.12.05.053
                          N051.44.22.217 E019.12.05.053 N051.44.25.513 E019.12.05.899
                          N051.44.25.513 E019.12.05.899 N051.44.34.031 E019.12.08.713
                          N051.44.34.031 E019.12.08.713 N051.44.37.854 E019.12.10.254
                          N051.44.37.854 E019.12.10.254 N051.44.41.738 E019.12.12.039
                          N051.44.41.738 E019.12.12.039 N051.44.45.371 E019.12.13.852
                          N051.44.45.371 E019.12.13.852 N051.44.52.732 E019.12.18.066
                          N051.44.52.732 E019.12.18.066 N051.44.56.769 E019.12.20.672
                          N051.44.56.769 E019.12.20.672 N051.45.04.037 E019.12.25.906
                          N051.45.04.037 E019.12.25.906 N051.45.07.968 E019.12.29.035
                          N051.45.07.968 E019.12.29.035 N051.45.11.559 E019.12.32.103
                          N051.45.11.559 E019.12.32.103 N051.45.15.220 E019.12.35.417
                          N051.45.15.220 E019.12.35.417 N051.45.22.243 E019.12.42.393
                          N051.45.22.243 E019.12.42.393 N051.45.25.737 E019.12.46.157
                          N051.45.25.737 E019.12.46.157 N051.45.32.088 E019.12.53.545
                          N051.45.32.088 E019.12.53.545 N051.45.36.255 E019.12.58.757
                          N051.45.36.255 E019.12.58.757 N051.45.39.418 E019.13.03.021
                          N051.45.39.418 E019.13.03.021 N051.45.42.644 E019.13.07.632
                          N051.45.42.644 E019.13.07.632 N051.45.48.857 E019.13.17.045
                          N051.45.48.857 E019.13.17.045 N051.45.51.801 E019.13.21.908
                          N051.45.51.801 E019.13.21.908 N051.45.54.331 E019.13.26.276
                          N051.45.54.331 E019.13.26.276 N051.46.00.733 E019.13.38.289
                          N051.46.00.733 E019.13.38.289 N051.46.04.734 E019.13.46.643
                          N051.46.04.734 E019.13.46.643 N051.46.08.301 E019.13.54.680
                          N051.46.08.301 E019.13.54.680 N051.46.13.321 E019.14.07.085
                          N051.46.13.321 E019.14.07.085 N051.46.17.665 E019.14.19.082
                          N051.46.17.665 E019.14.19.082 N051.46.21.127 E019.14.29.648
                          N051.46.21.127 E019.14.29.648 N051.46.25.160 E019.14.43.129
                          N051.46.25.160 E019.14.43.129 N051.46.28.171 E019.14.54.382
                          N051.46.28.171 E019.14.54.382 N051.46.30.111 E019.15.02.302
                          N051.46.30.111 E019.15.02.302 N051.46.33.081 E019.15.15.294
                          N051.46.33.081 E019.15.15.294 N051.46.36.925 E019.15.34.422
                          N051.46.36.925 E019.15.34.422 N051.46.40.324 E019.15.54.896
                          N051.46.40.324 E019.15.54.896 N051.46.43.746 E019.16.21.398
                          N051.46.43.746 E019.16.21.398 N051.46.45.832 E019.16.41.840
                          N051.46.45.832 E019.16.41.840 N051.46.49.051 E019.17.23.002
                          N051.46.49.051 E019.17.23.002 N051.46.51.432 E019.17.56.766
                          N051.46.51.432 E019.17.56.766 LL711          LL711
                          LL711          LL711          N051.47.31.916 E019.27.34.431
                          N051.47.31.916 E019.27.34.431 N051.47.32.740 E019.27.45.813
                          N051.47.32.740 E019.27.45.813 N051.47.33.219 E019.27.52.437
                          N051.47.33.219 E019.27.52.437 N051.47.34.188 E019.28.05.120
                          N051.47.34.188 E019.28.05.120 N051.47.34.887 E019.28.12.907
                          N051.47.34.887 E019.28.12.907 N051.47.35.552 E019.28.19.268
                          N051.47.35.552 E019.28.19.268 N051.47.36.326 E019.28.26.525
                          N051.47.36.326 E019.28.26.525 N051.47.38.025 E019.28.39.257
                          N051.47.38.025 E019.28.39.257 N051.47.39.245 E019.28.47.128
                          N051.47.39.245 E019.28.47.128 N051.47.40.373 E019.28.53.745
                          N051.47.40.373 E019.28.53.745 N051.47.41.497 E019.28.59.519
                          N051.47.41.497 E019.28.59.519 N051.47.45.516 E019.29.16.635
                          N051.47.45.516 E019.29.16.635 N051.47.49.020 E019.29.28.624
                          N051.47.49.020 E019.29.28.624 N051.47.51.250 E019.29.35.311
                          N051.47.51.250 E019.29.35.311 N051.47.55.479 E019.29.46.492
                          N051.47.55.479 E019.29.46.492 N051.48.00.536 E019.29.58.142
                          N051.48.00.536 E019.29.58.142 N051.48.02.926 E019.30.03.072
                          N051.48.02.926 E019.30.03.072 N051.48.05.963 E019.30.09.042
                          N051.48.05.963 E019.30.09.042 N051.48.11.648 E019.30.18.887
                          N051.48.11.648 E019.30.18.887 N051.48.14.487 E019.30.23.464
                          N051.48.14.487 E019.30.23.464 N051.48.17.226 E019.30.27.550
                          N051.48.17.226 E019.30.27.550 N051.48.20.969 E019.30.32.748
                          N051.48.20.969 E019.30.32.748 N051.48.27.239 E019.30.40.699
                          N051.48.27.239 E019.30.40.699 N051.48.30.886 E019.30.44.820
                          N051.48.30.886 E019.30.44.820 N051.48.34.376 E019.30.48.558
                          N051.48.34.376 E019.30.48.558 N051.48.38.432 E019.30.52.487
                          N051.48.38.432 E019.30.52.487 N051.48.41.539 E019.30.55.333
                          N051.48.41.539 E019.30.55.333 N051.48.49.809 E019.31.02.048
                          N051.48.49.809 E019.31.02.048 N051.48.59.484 E019.31.08.445
                          N051.48.59.484 E019.31.08.445 N051.49.04.010 E019.31.10.957
                          N051.49.04.010 E019.31.10.957 N051.49.07.716 E019.31.12.771
                          N051.49.07.716 E019.31.12.771 N051.49.16.346 E019.31.16.276
                          N051.49.16.346 E019.31.16.276 N051.49.21.019 E019.31.17.736
                          N051.49.21.019 E019.31.17.736 N051.49.25.158 E019.31.18.811
                          N051.49.25.158 E019.31.18.811 N051.49.28.823 E019.31.19.581
                          N051.49.28.823 E019.31.19.581 N051.49.36.977 E019.31.20.624
                          N051.49.36.977 E019.31.20.624 N051.49.41.946 E019.31.20.870
                          N051.49.41.946 E019.31.20.870 N051.49.45.658 E019.31.20.855
                          N051.49.45.658 E019.31.20.855 N051.49.54.767 E019.31.20.064
                          N051.49.54.767 E019.31.20.064 N051.50.03.204 E019.31.18.387
                          N051.50.03.204 E019.31.18.387 N051.50.07.244 E019.31.17.248
                          N051.50.07.244 E019.31.17.248 N051.50.11.598 E019.31.15.812
                          N051.50.11.598 E019.31.15.812 N051.50.18.960 E019.31.12.734
                          N051.50.18.960 E019.31.12.734 N051.50.23.791 E019.31.10.281
                          N051.50.23.791 E019.31.10.281 N051.50.27.745 E019.31.08.065
                          N051.50.27.745 E019.31.08.065 N051.50.31.494 E019.31.05.714
                          N051.50.31.494 E019.31.05.714 N051.50.35.521 E019.31.02.930
                          N051.50.35.521 E019.31.02.930 N051.50.42.238 E019.30.57.716
                          N051.50.42.238 E019.30.57.716 N051.50.49.359 E019.30.51.276
                          N051.50.49.359 E019.30.51.276 N051.50.52.755 E019.30.47.858
                          N051.50.52.755 E019.30.47.858 N051.50.56.631 E019.30.43.702
                          N051.50.56.631 E019.30.43.702 N051.51.00.017 E019.30.39.723
                          N051.51.00.017 E019.30.39.723 N051.51.04.553 E019.30.33.986
                          N051.51.04.553 E019.30.33.986 N051.51.11.089 E019.30.24.715
                          N051.51.11.089 E019.30.24.715 N051.51.13.472 E019.30.21.058
                          N051.51.13.472 E019.30.21.058 N051.51.17.175 E019.30.14.896
                          N051.51.17.175 E019.30.14.896 N051.51.22.704 E019.30.04.623
                          N051.51.22.704 E019.30.04.623 N051.51.27.892 E019.29.53.627
                          N051.51.27.892 E019.29.53.627 N051.51.30.240 E019.29.48.015
                          N051.51.30.240 E019.29.48.015 N051.51.34.796 E019.29.36.095
                          N051.51.34.796 E019.29.36.095 N051.51.38.801 E019.29.23.771
                          N051.51.38.801 E019.29.23.771 N051.51.40.439 E019.29.17.944
                          N051.51.40.439 E019.29.17.944 N051.51.42.248 E019.29.11.202
                          N051.51.42.248 E019.29.11.202 N051.51.44.778 E019.29.00.036
                          N051.51.44.778 E019.29.00.036 N051.51.46.750 E019.28.49.925
                          N051.51.46.750 E019.28.49.925 N051.51.47.370 E019.28.46.044
                          N051.51.47.370 E019.28.46.044 N051.51.49.662 E019.28.29.371
                          N051.51.49.662 E019.28.29.371 N051.51.50.865 E019.28.16.166
                          N051.51.50.865 E019.28.16.166 N051.51.51.308 E019.28.08.941
                          N051.51.51.308 E019.28.08.941 N051.51.51.727 E019.27.55.204
                          N051.51.51.727 E019.27.55.204 N051.51.51.728 E019.27.48.496
                          N051.51.51.728 E019.27.48.496 N051.51.51.554 E019.27.41.439
                          N051.51.51.554 E019.27.41.439 N051.51.51.270 E019.27.34.373
                          N051.51.51.270 E019.27.34.373 N051.51.50.875 E019.27.27.748
                          N051.51.50.875 E019.27.27.748 N051.51.49.718 E019.27.13.891
                          N051.51.49.718 E019.27.13.891 N051.51.48.986 E019.27.07.279
                          N051.51.48.986 E019.27.07.279 N051.51.48.210 E019.27.01.321
                          N051.51.48.210 E019.27.01.321 N051.51.47.140 E019.26.53.383
                          N051.51.47.140 E019.26.53.383 N051.51.44.950 E019.26.39.982
                          N051.51.44.950 E019.26.39.982 N051.51.44.158 E019.26.35.329
                          N051.51.44.158 E019.26.35.329 N051.51.42.597 E019.26.27.027
                          N051.51.42.597 E019.26.27.027 N051.51.41.226 E019.26.20.288
                          N051.51.41.226 E019.26.20.288 N051.51.38.495 E019.26.07.348
                          N051.51.38.495 E019.26.07.348 N051.51.37.170 E019.26.01.327
                          N051.51.37.170 E019.26.01.327 N051.51.35.724 E019.25.54.746
                          N051.51.35.724 E019.25.54.746 N051.51.32.783 E019.25.41.975
                          N051.51.32.783 E019.25.41.975 N051.51.28.749 E019.25.24.953
                          N051.51.28.749 E019.25.24.953 N051.51.27.309 E019.25.18.763
                          N051.51.27.309 E019.25.18.763 N051.51.22.733 E019.24.59.608
                          N051.51.22.733 E019.24.59.608 N051.51.19.851 E019.24.47.559
                          N051.51.19.851 E019.24.47.559 N051.51.16.465 E019.24.33.460
                          N051.51.16.465 E019.24.33.460 N051.51.13.395 E019.24.20.523
                          N051.51.13.395 E019.24.20.523 N051.51.11.998 E019.24.14.612
                          N051.51.11.998 E019.24.14.612 N051.51.08.867 E019.24.01.202
                          N051.51.08.867 E019.24.01.202 N051.51.06.169 E019.23.49.845
                          N051.51.06.169 E019.23.49.845 N051.51.02.967 E019.23.36.179
                          N051.51.02.967 E019.23.36.179 N051.51.01.363 E019.23.29.175
                          N051.51.01.363 E019.23.29.175 N051.50.58.332 E019.23.16.322
                          N051.50.58.332 E019.23.16.322 N051.50.53.856 E019.22.57.104
                          N051.50.53.856 E019.22.57.104 N051.50.52.380 E019.22.50.605
                          N051.50.52.380 E019.22.50.605 N051.50.49.399 E019.22.37.731
                          N051.50.49.399 E019.22.37.731 N051.50.48.113 E019.22.32.081
                          N051.50.48.113 E019.22.32.081 N051.50.46.483 E019.22.24.808
                          N051.50.46.483 E019.22.24.808 N051.50.43.741 E019.22.11.866
                          N051.50.43.741 E019.22.11.866 N051.50.42.360 E019.22.05.070
                          N051.50.42.360 E019.22.05.070 N051.50.41.236 E019.21.58.903
                          N051.50.41.236 E019.21.58.903 N051.50.40.069 E019.21.52.301
                          N051.50.40.069 E019.21.52.301 N051.50.37.890 E019.21.38.731
                          N051.50.37.890 E019.21.38.731 N051.50.37.227 E019.21.33.803
                          N051.50.37.227 E019.21.33.803 N051.50.36.160 E019.21.25.430
                          N051.50.36.160 E019.21.25.430 N051.50.35.449 E019.21.19.146
                          N051.50.35.449 E019.21.19.146 N051.50.34.735 E019.21.12.020
                          N051.50.34.735 E019.21.12.020 N051.50.33.664 E019.20.58.824
                          N051.50.33.664 E019.20.58.824 N051.50.33.210 E019.20.51.619
                          N051.50.33.210 E019.20.51.619 N051.50.32.847 E019.20.44.623
                          N051.50.32.847 E019.20.44.623 N051.50.32.318 E019.20.31.207
                          N051.50.32.318 E019.20.31.207 N051.50.32.064 E019.20.17.136
                          N051.50.32.064 E019.20.17.136 N051.50.32.067 E019.20.10.998
                          N051.50.32.067 E019.20.10.998 N051.50.32.057 E019.20.03.566
                          N051.50.32.057 E019.20.03.566 N051.50.32.277 E019.19.50.223
                          N051.50.32.277 E019.19.50.223 N051.50.32.435 E019.19.43.500
                          N051.50.32.435 E019.19.43.500 N051.50.32.622 E019.19.37.095
                          N051.50.32.622 E019.19.37.095 N051.50.33.139 E019.19.23.285
                          N051.50.33.139 E019.19.23.285 N051.50.33.474 E019.19.15.972
                          N051.50.33.474 E019.19.15.972 N051.50.34.164 E019.19.02.367
                          N051.50.34.164 E019.19.02.367 N051.50.34.598 E019.18.55.679
                          N051.50.34.598 E019.18.55.679 N051.50.35.026 E019.18.49.036
                          N051.50.35.026 E019.18.49.036 N051.50.36.007 E019.18.34.788
                          N051.50.36.007 E019.18.34.788 N051.50.37.025 E019.18.22.356
                          N051.50.37.025 E019.18.22.356 N051.50.37.680 E019.18.14.623
                          N051.50.37.680 E019.18.14.623 N051.50.38.898 E019.18.00.784
                          N051.50.38.898 E019.18.00.784 N051.50.39.522 E019.17.54.591
                          N051.50.39.522 E019.17.54.591 N051.50.40.130 E019.17.48.130
                          N051.50.40.130 E019.17.48.130 DERAM          DERAM
EPLL 07             N000.00.00.000 E000.00.00.000 N000.00.00.000 E000.00.00.000
                          N051.43.25.585 E019.24.24.444 N051.43.51.525 E019.26.24.989
                          N051.43.51.525 E019.26.24.989 N051.44.02.847 E019.27.16.190
                          N051.44.02.847 E019.27.16.190 N051.44.08.723 E019.27.42.615
                          N051.44.08.723 E019.27.42.615 N051.44.18.548 E019.28.27.157
                          N051.44.18.548 E019.28.27.157 N051.44.24.709 E019.28.53.551
                          N051.44.24.709 E019.28.53.551 N051.44.31.619 E019.29.20.052
                          N051.44.31.619 E019.29.20.052 TUNOP          TUNOP
                          TUNOP          TUNOP          N051.46.57.479 E019.36.11.450
                          N051.46.57.479 E019.36.11.450 N051.47.00.780 E019.36.20.778
                          N051.47.00.780 E019.36.20.778 N051.47.03.011 E019.36.27.014
                          N051.47.03.011 E019.36.27.014 N051.47.05.435 E019.36.33.555
                          N051.47.05.435 E019.36.33.555 N051.47.07.909 E019.36.40.199
                          N051.47.07.909 E019.36.40.199 N051.47.09.931 E019.36.45.331
                          N051.47.09.931 E019.36.45.331 N051.47.12.214 E019.36.51.055
                          N051.47.12.214 E019.36.51.055 N051.47.14.366 E019.36.56.128
                          N051.47.14.366 E019.36.56.128 N051.47.19.320 E019.37.07.160
                          N051.47.19.320 E019.37.07.160 N051.47.22.026 E019.37.12.771
                          N051.47.22.026 E019.37.12.771 N051.47.24.697 E019.37.17.943
                          N051.47.24.697 E019.37.17.943 N051.47.27.482 E019.37.22.999
                          N051.47.27.482 E019.37.22.999 N051.47.30.022 E019.37.27.283
                          N051.47.30.022 E019.37.27.283 N051.47.33.267 E019.37.32.534
                          N051.47.33.267 E019.37.32.534 N051.47.39.550 E019.37.41.536
                          N051.47.39.550 E019.37.41.536 N051.47.43.174 E019.37.46.229
                          N051.47.43.174 E019.37.46.229 N051.47.46.574 E019.37.50.292
                          N051.47.46.574 E019.37.50.292 N051.47.49.924 E019.37.54.081
                          N051.47.49.924 E019.37.54.081 N051.47.52.926 E019.37.57.207
                          N051.47.52.926 E019.37.57.207 N051.47.56.819 E019.38.01.033
                          N051.47.56.819 E019.38.01.033 N051.48.01.217 E019.38.04.965
                          N051.48.01.217 E019.38.04.965 N051.48.04.610 E019.38.07.763
                          N051.48.04.610 E019.38.07.763 N051.48.08.867 E019.38.10.991
                          N051.48.08.867 E019.38.10.991 N051.48.12.778 E019.38.13.695
                          N051.48.12.778 E019.38.13.695 N051.48.16.838 E019.38.16.279
                          N051.48.16.838 E019.38.16.279 N051.48.24.152 E019.38.20.238
                          N051.48.24.152 E019.38.20.238 N051.48.32.733 E019.38.23.949
                          N051.48.32.733 E019.38.23.949 N051.48.41.490 E019.38.26.680
                          N051.48.41.490 E019.38.26.680 N051.48.54.119 E019.38.28.888
                          N051.48.54.119 E019.38.28.888 N051.48.57.459 E019.38.29.160
                          N051.48.57.459 E019.38.29.160 N051.49.23.770 E019.38.26.148
                          N051.49.23.770 E019.38.26.148 N051.49.28.164 E019.38.24.811
                          N051.49.28.164 E019.38.24.811 N051.49.40.105 E019.38.19.765
                          N051.49.40.105 E019.38.19.765 N051.49.44.615 E019.38.17.337
                          N051.49.44.615 E019.38.17.337 N051.49.47.982 E019.38.15.336
                          N051.49.47.982 E019.38.15.336 N051.49.52.492 E019.38.12.365
                          N051.49.52.492 E019.38.12.365 N051.49.55.551 E019.38.10.114
                          N051.49.55.551 E019.38.10.114 N051.49.59.793 E019.38.06.798
                          N051.49.59.793 E019.38.06.798 N051.50.03.358 E019.38.03.769
                          N051.50.03.358 E019.38.03.769 N051.50.07.245 E019.38.00.176
                          N051.50.07.245 E019.38.00.176 N051.50.11.316 E019.37.56.136
                          N051.50.11.316 E019.37.56.136 N051.50.14.437 E019.37.52.748
                          N051.50.14.437 E019.37.52.748 N051.50.18.033 E019.37.48.601
                          N051.50.18.033 E019.37.48.601 N051.50.21.498 E019.37.44.294
                          N051.50.21.498 E019.37.44.294 N051.50.24.428 E019.37.40.462
                          N051.50.24.428 E019.37.40.462 N051.50.27.940 E019.37.35.455
                          N051.50.27.940 E019.37.35.455 N051.50.32.365 E019.37.28.709
                          N051.50.32.365 E019.37.28.709 N051.50.34.704 E019.37.24.855
                          N051.50.34.704 E019.37.24.855 N051.50.38.164 E019.37.18.732
                          N051.50.38.164 E019.37.18.732 N051.50.40.858 E019.37.13.607
                          N051.50.40.858 E019.37.13.607 N051.50.43.549 E019.37.08.128
                          N051.50.43.549 E019.37.08.128 N051.50.46.046 E019.37.02.608
                          N051.50.46.046 E019.37.02.608 N051.50.48.488 E019.36.56.894
                          N051.50.48.488 E019.36.56.894 N051.50.50.364 E019.36.52.213
                          N051.50.50.364 E019.36.52.213 N051.50.53.035 E019.36.45.112
                          N051.50.53.035 E019.36.45.112 N051.50.55.106 E019.36.39.037
                          N051.50.55.106 E019.36.39.037 N051.50.56.897 E019.36.33.244
                          N051.50.56.897 E019.36.33.244 N051.50.58.776 E019.36.26.773
                          N051.50.58.776 E019.36.26.773 N051.51.00.486 E019.36.20.464
                          N051.51.00.486 E019.36.20.464 N051.51.02.017 E019.36.13.954
                          N051.51.02.017 E019.36.13.954 N051.51.03.099 E019.36.09.045
                          N051.51.03.099 E019.36.09.045 N051.51.04.672 E019.36.01.081
                          N051.51.04.672 E019.36.01.081 N051.51.05.798 E019.35.54.786
                          N051.51.05.798 E019.35.54.786 N051.51.06.782 E019.35.48.091
                          N051.51.06.782 E019.35.48.091 N051.51.07.697 E019.35.41.031
                          N051.51.07.697 E019.35.41.031 N051.51.08.445 E019.35.34.147
                          N051.51.08.445 E019.35.34.147 N051.51.09.001 E019.35.28.211
                          N051.51.09.001 E019.35.28.211 N051.51.09.493 E019.35.21.058
                          N051.51.09.493 E019.35.21.058 N051.51.09.838 E019.35.13.719
                          N051.51.09.838 E019.35.13.719 N051.51.09.979 E019.35.08.839
                          N051.51.09.979 E019.35.08.839 N051.51.10.025 E019.35.00.367
                          N051.51.10.025 E019.35.00.367 N051.51.09.930 E019.34.53.284
                          N051.51.09.930 E019.34.53.284 N051.51.09.701 E019.34.46.515
                          N051.51.09.701 E019.34.46.515 N051.51.09.342 E019.34.39.780
                          N051.51.09.342 E019.34.39.780 N051.51.08.838 E019.34.32.482
                          N051.51.08.838 E019.34.32.482 N051.51.08.221 E019.34.25.838
                          N051.51.08.221 E019.34.25.838 N051.51.07.680 E019.34.20.854
                          N051.51.07.680 E019.34.20.854 N051.51.06.690 E019.34.13.132
                          N051.51.06.690 E019.34.13.132 N051.51.04.654 E019.33.59.400
                          N051.51.04.654 E019.33.59.400 N051.51.02.383 E019.33.46.372
                          N051.51.02.383 E019.33.46.372 N051.51.01.186 E019.33.40.096
                          N051.51.01.186 E019.33.40.096 N051.50.59.827 E019.33.33.283
                          N051.50.59.827 E019.33.33.283 N051.50.55.561 E019.33.13.217
                          N051.50.55.561 E019.33.13.217 N051.50.49.852 E019.32.48.153
                          N051.50.49.852 E019.32.48.153 N051.50.46.814 E019.32.35.041
                          N051.50.46.814 E019.32.35.041 N051.50.37.867 E019.31.56.554
                          N051.50.37.867 E019.31.56.554 N051.50.31.977 E019.31.31.208
                          N051.50.31.977 E019.31.31.208 N051.50.27.591 E019.31.12.437
                          N051.50.27.591 E019.31.12.437 N051.50.23.039 E019.30.52.655
                          N051.50.23.039 E019.30.52.655 N051.50.18.479 E019.30.33.167
                          N051.50.18.479 E019.30.33.167 N051.50.12.543 E019.30.07.448
                          N051.50.12.543 E019.30.07.448 N051.50.05.179 E019.29.35.429
                          N051.50.05.179 E019.29.35.429 N051.49.55.492 E019.28.42.445
                          N051.49.55.492 E019.28.42.445 N051.49.52.173 E019.28.14.982
                          N051.49.52.173 E019.28.14.982 N051.49.50.041 E019.27.48.024
                          N051.49.50.041 E019.27.48.024 N051.49.49.125 E019.27.26.856
                          N051.49.49.125 E019.27.26.856 N051.49.48.729 E019.26.59.367
                          N051.49.48.729 E019.26.59.367 N051.49.49.430 E019.26.24.572
                          N051.49.49.430 E019.26.24.572 N051.49.50.891 E019.25.57.113
                          N051.49.50.891 E019.25.57.113 N051.49.52.385 E019.25.37.154
                          N051.49.52.385 E019.25.37.154 N051.49.54.833 E019.25.09.297
                          N051.49.54.833 E019.25.09.297 N051.49.55.479 E019.25.02.662
                          N051.49.55.479 E019.25.02.662 DERAM          DERAM
                          
                          
EPGD 29           N001.39.20.999 E021.25.40.001 N001.41.44.999 E020.58.09.998
                          N054.22.52.487 E018.27.05.178 N054.24.02.267 E018.22.20.279
                          N054.24.02.267 E018.22.20.279 N054.28.22.000 E018.04.33.000
                          N054.28.21.179 E018.04.36.371 N054.28.23.304 E018.04.27.731
                          N054.28.23.304 E018.04.27.731 N054.28.25.607 E018.04.19.235
                          N054.28.25.607 E018.04.19.235 N054.28.28.091 E018.04.10.884
                          N054.28.28.091 E018.04.10.884 N054.28.30.720 E018.04.02.675
                          N054.28.30.720 E018.04.02.675 N054.28.33.527 E018.03.54.611
                          N054.28.33.527 E018.03.54.611 N054.28.36.516 E018.03.46.763
                          N054.28.36.516 E018.03.46.763 N054.28.39.612 E018.03.39.059
                          N054.28.39.612 E018.03.39.059 N054.28.42.888 E018.03.31.571
                          N054.28.42.888 E018.03.31.571 N054.28.46.307 E018.03.24.300
                          N054.28.46.307 E018.03.24.300 N054.28.49.908 E018.03.17.208
                          N054.28.49.908 E018.03.17.208 N054.28.53.616 E018.03.10.367
                          N054.28.53.616 E018.03.10.367 N054.28.57.468 E018.03.03.708
                          N054.28.57.468 E018.03.03.708 N054.29.01.428 E018.02.57.336
                          N054.29.01.428 E018.02.57.336 N054.29.05.567 E018.02.51.180
                          N054.29.05.567 E018.02.51.180 N054.29.09.779 E018.02.45.275
                          N054.29.09.779 E018.02.45.275 N054.29.14.135 E018.02.39.623
                          N054.29.14.135 E018.02.39.623 N054.29.18.600 E018.02.34.260
                          N054.29.18.600 E018.02.34.260 N054.29.23.172 E018.02.29.147
                          N054.29.23.172 E018.02.29.147 N054.29.27.815 E018.02.24.323
                          N054.29.27.815 E018.02.24.323 N054.29.32.604 E018.02.19.752
                          N054.29.32.604 E018.02.19.752 N054.29.37.427 E018.02.15.503
                          N054.29.37.427 E018.02.15.503 N054.29.42.360 E018.02.11.543
                          N054.29.42.360 E018.02.11.543 N054.29.47.399 E018.02.07.872
                          N054.29.47.399 E018.02.07.872 N054.29.52.475 E018.02.04.524
                          N054.29.52.475 E018.02.04.524 N054.29.57.623 E018.02.01.464
                          N054.29.57.623 E018.02.01.464 N054.30.02.844 E018.01.58.727
                          N054.30.02.844 E018.01.58.727 N054.30.08.099 E018.01.56.279
                          N054.30.08.099 E018.01.56.279 N054.30.13.392 E018.01.54.191
                          N054.30.13.392 E018.01.54.191 N054.30.18.755 E018.01.52.392
                          N054.30.18.755 E018.01.52.392 N054.30.24.120 E018.01.50.915
                          N054.30.24.120 E018.01.50.915 N054.30.29.520 E018.01.49.764
                          N054.30.29.520 E018.01.49.764 N054.30.34.955 E018.01.48.972
                          N054.30.34.955 E018.01.48.972 N054.30.40.392 E018.01.48.467
                          N054.30.40.392 E018.01.48.467 N054.30.45.827 E018.01.48.288
                          N054.30.45.827 E018.01.48.288 N054.30.51.264 E018.01.48.467
                          N054.30.51.264 E018.01.48.467 N054.30.56.699 E018.01.48.972
                          N054.30.56.699 E018.01.48.972 N054.31.02.136 E018.01.49.764
                          N054.31.02.136 E018.01.49.764 N054.31.07.536 E018.01.50.915
                          N054.31.07.536 E018.01.50.915 N054.31.12.899 E018.01.52.392
                          N054.31.12.899 E018.01.52.392 N054.47.43.000 E017.49.36.200
                          N054.19.24.924 E018.19.03.971 N054.19.26.975 E018.18.55.692
                          N054.19.26.975 E018.18.55.692 N054.19.29.172 E018.18.47.556
                          N054.19.29.172 E018.18.47.556 N054.19.31.547 E018.18.39.564
                          N054.19.31.547 E018.18.39.564 N054.19.34.104 E018.18.31.680
                          N054.19.34.104 E018.18.31.680 N054.19.36.768 E018.18.23.976
                          N054.19.36.768 E018.18.23.976 N054.19.39.648 E018.18.16.451
                          N054.19.39.648 E018.18.16.451 N054.19.42.636 E018.18.09.108
                          N054.19.42.636 E018.18.09.108 N054.19.45.803 E018.18.01.907
                          N054.19.45.803 E018.18.01.907 N054.19.49.080 E018.17.54.924
                          N054.19.49.080 E018.17.54.924 N054.19.52.536 E018.17.48.156
                          N054.19.52.536 E018.17.48.156 N054.19.56.100 E018.17.41.567
                          N054.19.56.100 E018.17.41.567 N054.19.59.808 E018.17.35.231
                          N054.19.59.808 E018.17.35.231 N054.20.03.623 E018.17.29.111
                          N054.20.03.623 E018.17.29.111 N054.20.07.583 E018.17.23.208
                          N054.20.07.583 E018.17.23.208 N054.20.11.652 E018.17.17.555
                          N054.20.11.652 E018.17.17.555 N054.20.15.828 E018.17.12.155
                          N054.20.15.828 E018.17.12.155 N054.20.20.112 E018.17.06.972
                          N054.20.20.112 E018.17.06.972 N054.20.24.503 E018.17.02.075
                          N054.20.24.503 E018.17.02.075 N054.20.29.003 E018.16.57.468
                          N054.20.29.003 E018.16.57.468 N054.20.33.576 E018.16.53.112
                          N054.20.33.576 E018.16.53.112 N054.20.38.219 E018.16.49.044
                          N054.20.38.219 E018.16.49.044 N054.20.42.971 E018.16.45.227
                          N054.20.42.971 E018.16.45.227 N054.20.47.795 E018.16.41.735
                          N054.20.47.795 E018.16.41.735 N054.20.52.691 E018.16.38.496
                          N054.20.52.691 E018.16.38.496 N054.20.57.623 E018.16.35.580
                          N054.20.57.623 E018.16.35.580 N054.21.02.664 E018.16.32.951
                          N054.21.02.664 E018.16.32.951 N054.21.07.703 E018.16.30.611
                          N054.21.07.703 E018.16.30.611 N054.21.12.816 E018.16.28.595
                          N054.21.12.816 E018.16.28.595 N054.21.17.927 E018.16.26.903
                          N054.21.17.927 E018.16.26.903 N054.21.23.111 E018.16.25.464
                          N054.21.23.111 E018.16.25.464 N054.21.28.296 E018.16.24.384
                          N054.21.28.296 E018.16.24.384 N054.21.33.516 E018.16.23.591
                          N054.21.33.516 E018.16.23.591 N054.21.38.772 E018.16.23.123
                          N054.21.38.772 E018.16.23.123 N054.21.43.992 E018.16.22.980
                          N054.21.43.992 E018.16.22.980 N054.21.49.211 E018.16.23.123
                          N054.21.49.211 E018.16.23.123 N054.21.54.468 E018.16.23.591
                          N054.21.54.468 E018.16.23.591 N054.21.59.687 E018.16.24.384
                          N054.21.59.687 E018.16.24.384 N054.22.04.872 E018.16.25.464
                          N054.22.04.872 E018.16.25.464 N054.22.10.055 E018.16.26.903
                          N054.22.10.055 E018.16.26.903 N054.22.15.167 E018.16.28.595
                          N054.22.15.167 E018.16.28.595 N054.22.20.280 E018.16.30.611
                          N054.22.20.280 E018.16.30.611 N054.22.25.319 E018.16.32.951
                          N054.22.25.319 E018.16.32.951 N054.22.30.360 E018.16.35.580
                          N054.22.30.360 E018.16.35.580 N054.22.35.291 E018.16.38.496
                          N054.22.35.291 E018.16.38.496 N054.22.40.188 E018.16.41.735
                          N054.22.40.188 E018.16.41.735 N054.22.45.012 E018.16.45.227
                          N054.22.45.012 E018.16.45.227 N054.22.49.764 E018.16.49.044
                          N054.22.49.764 E018.16.49.044 N054.22.54.407 E018.16.53.112
                          N054.22.54.407 E018.16.53.112 N054.22.58.979 E018.16.57.468
                          N054.22.58.979 E018.16.57.468 N054.23.03.480 E018.17.02.111
                          N054.23.03.480 E018.17.02.111 N054.23.07.871 E018.17.06.972
                          N054.23.07.871 E018.17.06.972 N054.23.12.156 E018.17.12.155
                          N054.23.12.156 E018.17.12.155 N054.23.16.331 E018.17.17.555
                          N054.23.16.331 E018.17.17.555 N054.23.20.400 E018.17.23.208
                          N054.23.20.400 E018.17.23.208 N054.23.24.359 E018.17.29.111
                          N054.23.24.359 E018.17.29.111 N054.23.28.175 E018.17.35.231
                          N054.23.28.175 E018.17.35.231 N054.23.31.883 E018.17.41.567
                          N054.23.31.883 E018.17.41.567 N054.23.35.448 E018.17.48.156
                          N054.23.35.448 E018.17.48.156 N054.23.38.904 E018.17.54.924
                          N054.23.38.904 E018.17.54.924 N054.23.42.179 E018.18.01.907
                          N054.23.42.179 E018.18.01.907 N054.23.45.347 E018.18.09.108
                          N054.23.45.347 E018.18.09.108 N054.23.48.336 E018.18.16.451
                          N054.23.48.336 E018.18.16.451 N054.23.51.215 E018.18.23.976
                          N054.23.51.215 E018.18.23.976 N054.23.53.879 E018.18.31.680
                          N054.23.53.879 E018.18.31.680 N054.23.56.435 E018.18.39.564
                          N054.23.56.435 E018.18.39.564 N054.23.58.812 E018.18.47.556
                          N054.23.58.812 E018.18.47.556 N054.24.01.008 E018.18.55.692
                          N054.24.01.008 E018.18.55.692 N054.24.03.059 E018.19.03.971
                          N054.24.03.059 E018.19.03.971 N054.24.04.932 E018.19.12.360
                          N054.24.04.932 E018.19.12.360 N054.24.06.660 E018.19.20.855
                          N054.24.06.660 E018.19.20.855 N054.24.08.172 E018.19.29.460
                          N054.24.08.172 E018.19.29.460 N054.24.09.540 E018.19.38.135
                          N054.24.09.540 E018.19.38.135 N054.24.10.727 E018.19.46.883
                          N054.24.10.727 E018.19.46.883 N054.24.11.699 E018.19.55.703
                          N054.24.11.699 E018.19.55.703 N054.24.12.528 E018.20.04.596
                          N054.24.12.528 E018.20.04.596 N054.24.13.176 E018.20.13.523
                          N054.24.13.176 E018.20.13.523 N054.24.13.644 E018.20.22.451
                          N054.24.13.644 E018.20.22.451 N054.24.13.896 E018.20.31.416
                          N054.24.13.896 E018.20.31.416 N054.24.14.003 E018.20.40.416
                          N054.24.14.003 E018.20.40.416 N054.24.13.896 E018.20.49.415
                          N054.24.13.896 E018.20.49.415 N054.24.13.644 E018.20.58.380
                          N054.24.13.644 E018.20.58.380 N054.24.13.176 E018.21.07.343
                          N054.24.13.176 E018.21.07.343 N054.24.12.528 E018.21.16.236
                          N054.24.12.528 E018.21.16.236 N054.24.11.699 E018.21.25.128
                          N054.24.11.699 E018.21.25.128 N054.24.10.727 E018.21.33.947
                          N054.24.10.727 E018.21.33.947 N054.24.09.540 E018.21.42.696
                          N054.24.09.540 E018.21.42.696 N054.24.08.172 E018.21.51.372
                          N054.24.08.172 E018.21.51.372 N054.24.06.660 E018.21.59.975
                          N054.24.06.660 E018.21.59.975 N054.24.04.932 E018.22.08.471
                          N054.24.04.932 E018.22.08.471 N054.24.03.059 E018.22.16.859
                          N054.19.21.323 E018.19.20.855 N054.19.23.052 E018.19.12.360
                          N054.19.23.052 E018.19.12.360 N054.19.24.924 E018.19.03.971
                          N054.19.21.323 E018.19.20.855 N054.12.04.680 E019.08.42.359                          
                          N054.22.49.764 E018.16.49.044 N054.17.58.920 E018.12.28.799
                          N054.17.58.920 E018.12.28.944 N054.17.54.492 E018.12.24.156
                          N054.17.54.492 E018.12.24.156 N054.17.50.136 E018.12.19.152
                          N054.17.50.136 E018.12.19.152 N054.17.45.888 E018.12.13.859
                          N054.17.45.888 E018.12.13.859 N054.17.41.783 E018.12.08.352
                          N054.17.41.783 E018.12.08.352 N054.17.37.751 E018.12.02.592
                          N054.17.37.751 E018.12.02.592 N054.17.33.864 E018.11.56.579
                          N054.17.33.864 E018.11.56.579 N054.17.30.119 E018.11.50.352
                          N054.17.30.119 E018.11.50.352 N054.17.26.483 E018.11.43.871
                          N054.17.26.483 E018.11.43.871 N054.17.22.955 E018.11.37.212
                          N054.17.22.955 E018.11.37.212 N054.17.19.608 E018.11.30.335
                          N054.17.19.608 E018.11.30.335 N054.17.16.368 E018.11.23.243
                          N054.17.16.368 E018.11.23.243 N054.17.13.308 E018.11.16.008
                          N054.17.13.308 E018.11.16.008 N054.17.10.392 E018.11.08.556
                          N054.17.10.392 E018.11.08.556 N054.17.07.584 E018.11.00.923
                          N054.17.07.584 E018.11.00.923 N054.17.04.992 E018.10.53.147
                          N054.17.04.992 E018.10.53.147 N054.17.02.508 E018.10.45.228
                          N054.17.02.508 E018.10.45.228 N054.17.00.240 E018.10.37.163
                          N054.17.00.240 E018.10.37.163 N054.16.58.115 E018.10.28.956
                          N054.16.58.115 E018.10.28.956 N054.16.56.136 E018.10.20.639
                          N054.16.56.136 E018.10.20.639 N054.16.54.335 E018.10.12.215
                          N054.16.54.335 E018.10.12.215 N054.16.52.715 E018.10.03.684
                          N054.16.52.715 E018.10.03.684 N054.16.51.275 E018.09.55.043
                          N054.16.51.275 E018.09.55.043 N054.16.50.016 E018.09.46.332
                          N054.16.50.016 E018.09.46.332 N054.16.48.935 E018.09.37.548
                          N054.16.48.935 E018.09.37.548 N054.16.48.035 E018.09.28.727
                          N054.16.48.035 E018.09.28.727 N054.16.47.280 E018.09.19.835
                          N054.16.47.280 E018.09.19.835 N054.16.46.739 E018.09.10.908
                          N054.16.46.739 E018.09.10.908 N054.16.46.380 E018.09.01.943
                          N054.16.46.380 E018.09.01.943 N054.16.46.199 E018.08.52.980
                          N054.16.46.199 E018.08.52.980 N054.16.46.199 E018.08.43.980
                          N054.16.46.199 E018.08.43.980 N054.16.46.380 E018.08.35.015
                          N054.16.46.380 E018.08.35.015 N054.16.46.739 E018.08.26.052
                          N054.16.46.739 E018.08.26.052 N054.16.47.280 E018.08.17.123
                          N054.16.47.280 E018.08.17.123 N054.16.48.035 E018.08.08.231
                          N054.16.48.035 E018.08.08.231 N054.16.48.935 E018.07.59.411
                          N054.16.48.935 E018.07.59.411 N054.16.50.016 E018.07.50.627
                          N054.16.50.016 E018.07.50.627 N054.16.51.275 E018.07.41.915
                          N054.16.51.275 E018.07.41.915 N054.16.52.715 E018.07.33.276
                          N054.16.52.715 E018.07.33.276 N054.16.54.335 E018.07.24.743
                          N054.16.54.335 E018.07.24.743 N054.16.56.136 E018.07.16.320                        
                          N054.16.56.136 E018.07.16.320 N054.17.21.948 E018.05.21.192
                          N054.17.21.948 E018.05.21.192 N054.13.27.000 E017.26.56.000
                          N054.14.26.088 E018.13.39.792 N054.14.29.579 E018.13.32.160
                          N054.14.29.579 E018.13.32.160 N054.14.33.215 E018.13.24.743
                          N054.14.33.215 E018.13.24.743 N054.14.36.995 E018.13.17.544
                          N054.14.36.995 E018.13.17.544 N054.14.40.920 E018.13.10.559
                          N054.14.40.920 E018.13.10.559 N054.14.44.987 E018.13.03.827
                          N054.14.44.987 E018.13.03.827 N054.14.49.199 E018.12.57.348
                          N054.14.49.199 E018.12.57.348 N054.14.53.519 E018.12.51.120
                          N054.14.53.519 E018.12.51.120 N054.14.57.983 E018.12.45.180
                          N054.14.57.983 E018.12.45.180 N054.15.02.555 E018.12.39.491
                          N054.15.02.555 E018.12.39.491 N054.15.07.235 E018.12.34.055
                          N054.15.07.235 E018.12.34.055 N054.15.12.024 E018.12.28.944
                          N054.15.12.024 E018.12.28.944 N054.15.16.919 E018.12.24.083
                          N054.15.16.919 E018.12.24.083 N054.15.21.924 E018.12.19.547
                          N054.15.21.924 E018.12.19.547 N054.15.27.000 E018.12.15.299
                          N054.15.27.000 E018.12.15.299 N054.15.32.184 E018.12.11.376
                          N054.15.32.184 E018.12.11.376 N054.15.37.404 E018.12.07.739
                          N054.15.37.404 E018.12.07.739 N054.15.42.732 E018.12.04.427
                          N054.15.42.732 E018.12.04.427 N054.15.48.095 E018.12.01.439
                          N054.15.48.095 E018.12.01.439 N054.15.53.532 E018.11.58.739
                          N054.15.53.532 E018.11.58.739 N054.15.59.039 E018.11.56.400
                          N054.15.59.039 E018.11.56.400 N054.16.04.547 E018.11.54.384
                          N054.16.04.547 E018.11.54.384 N054.16.10.128 E018.11.52.728
                          N054.16.10.128 E018.11.52.728 N054.16.15.743 E018.11.51.360
                          N054.16.15.743 E018.11.51.360 N054.16.21.359 E018.11.50.352
                          N054.16.21.359 E018.11.50.352 N054.16.26.976 E018.11.49.668
                          N054.16.26.976 E018.11.49.668 N054.16.32.628 E018.11.49.344
                          N054.16.32.628 E018.11.49.344 N054.16.38.315 E018.11.49.344
                          N054.16.38.315 E018.11.49.344 N054.16.43.968 E018.11.49.668
                          N054.16.43.968 E018.11.49.668 N054.16.49.583 E018.11.50.352
                          N054.16.49.583 E018.11.50.352 N054.16.55.199 E018.11.51.360
                          N054.16.55.199 E018.11.51.360 N054.17.00.816 E018.11.52.728
                          N054.17.00.816 E018.11.52.728 N054.17.06.396 E018.11.54.384
                          N054.17.06.396 E018.11.54.384 N054.17.11.903 E018.11.56.400
                          N054.17.11.903 E018.11.56.400 N054.17.17.412 E018.11.58.739
                          N054.17.17.412 E018.11.58.739 N054.17.22.847 E018.12.01.439
                          N054.17.22.847 E018.12.01.439 N054.17.28.212 E018.12.04.427
                          N054.17.28.212 E018.12.04.427 N054.17.33.540 E018.12.07.739
                          N054.17.33.540 E018.12.07.739 N054.17.38.760 E018.12.11.376
                          N054.17.38.760 E018.12.11.376 N054.17.43.944 E018.12.15.299
                          N054.17.43.944 E018.12.15.299 N054.17.49.020 E018.12.19.547
                          N054.17.49.020 E018.12.19.547 N054.17.54.024 E018.12.24.083
                          N054.17.54.024 E018.12.24.083 N054.17.58.920 E018.12.28.944
                          N054.14.26.088 E018.13.39.792 N054.13.31.007 E018.15.54.360
                          N054.13.31.007 E018.15.54.360 N053.44.12.998 E018.37.27.998
                          ROLOM ROLOM GD321 GD321
                          GD321 GD321 KEMUM KEMUM
EPGD 11           N001.39.20.999 E021.25.40.001 N001.41.44.999 E020.58.09.998
                          N054.22.16.314 E018.29.31.391 N054.20.42.570 E018.35.45.870
                          N054.20.42.570 E018.35.45.870 N054.19.04.944 E018.42.01.979
                          N054.19.04.944 E018.42.01.979 N054.12.04.680 E019.08.42.359
                          N054.20.42.575 E018.35.45.707 N054.20.40.020 E018.35.55.139
                          N054.20.40.020 E018.35.55.139 N054.20.37.284 E018.36.04.428
                          N054.20.37.284 E018.36.04.428 N054.20.34.331 E018.36.13.500
                          N054.20.34.331 E018.36.13.500 N054.20.31.199 E018.36.22.428
                          N054.20.31.199 E018.36.22.428 N054.20.27.887 E018.36.31.176
                          N054.20.27.887 E018.36.31.176 N054.20.24.396 E018.36.39.707
                          N054.20.24.396 E018.36.39.707 N054.20.20.760 E018.36.48.024
                          N054.20.20.760 E018.36.48.024 N054.20.16.943 E018.36.56.088
                          N054.20.16.943 E018.36.56.088 N054.20.12.948 E018.37.03.936
                          N054.20.12.948 E018.37.03.936 N054.20.08.807 E018.37.11.567
                          N054.20.08.807 E018.37.11.567 N054.20.04.523 E018.37.18.911
                          N054.20.04.523 E018.37.18.911 N054.20.00.060 E018.37.26.003
                          N054.20.00.060 E018.37.26.003 N054.19.55.487 E018.37.32.843
                          N054.19.55.487 E018.37.32.843 N054.19.50.772 E018.37.39.396
                          N054.19.50.772 E018.37.39.396 N054.19.45.911 E018.37.45.659
                          N054.19.45.911 E018.37.45.659 N054.19.40.944 E018.37.51.635
                          N054.19.40.944 E018.37.51.635 N054.19.35.831 E018.37.57.288
                          N054.19.35.831 E018.37.57.288 N054.19.30.648 E018.38.02.652
                          N054.19.30.648 E018.38.02.652 N054.19.25.320 E018.38.07.692
                          N054.19.25.320 E018.38.07.692 N054.19.19.920 E018.38.12.444
                          N054.19.19.920 E018.38.12.444 N054.19.14.411 E018.38.16.836
                          N054.19.14.411 E018.38.16.836 N054.19.08.831 E018.38.20.904
                          N054.19.08.831 E018.38.20.904 N054.19.03.144 E018.38.24.612
                          N054.19.03.144 E018.38.24.612 N054.18.57.420 E018.38.28.032
                          N054.18.57.420 E018.38.28.032 N054.18.51.587 E018.38.31.056
                          N054.18.51.587 E018.38.31.056 N054.18.45.719 E018.38.33.756
                          N054.18.45.719 E018.38.33.756 N054.18.39.815 E018.38.36.096
                          N054.18.39.815 E018.38.36.096 N054.18.33.839 E018.38.38.076
                          N054.18.33.839 E018.38.38.076 N054.18.27.864 E018.38.39.695
                          N054.18.27.864 E018.38.39.695 N054.18.21.816 E018.38.40.991
                          N054.18.21.816 E018.38.40.991 N054.18.15.768 E018.38.41.892
                          N054.18.15.768 E018.38.41.892 N054.18.09.720 E018.38.42.431
                          N054.18.09.720 E018.38.42.431 N054.18.03.635 E018.38.42.612
                          N054.18.03.635 E018.38.42.612 N054.17.57.552 E018.38.42.431
                          N054.17.57.552 E018.38.42.431 N054.17.51.504 E018.38.41.892
                          N054.17.51.504 E018.38.41.892 N054.17.45.456 E018.38.40.991
                          N054.17.45.456 E018.38.40.991 N054.17.39.408 E018.38.39.695
                          N054.17.39.408 E018.38.39.695 N054.17.33.431 E018.38.38.076
                          N054.17.33.431 E018.38.38.076 N054.17.27.455 E018.38.36.096
                          N054.17.27.455 E018.38.36.096 N054.17.21.551 E018.38.33.756
                          N054.17.21.551 E018.38.33.756 N054.17.15.683 E018.38.31.056
                          N054.17.15.683 E018.38.31.056 N054.17.09.852 E018.38.28.032
                          N054.17.09.852 E018.38.28.032 N054.17.04.128 E018.38.24.612
                          N054.17.04.128 E018.38.24.612 N054.16.58.439 E018.38.20.904
                          N054.16.58.439 E018.38.20.904 N054.16.52.860 E018.38.16.836
                          N054.16.52.860 E018.38.16.836 N054.16.47.352 E018.38.12.444
                          N054.16.47.352 E018.38.12.444 N054.16.41.952 E018.38.07.692
                          N054.16.41.952 E018.38.07.692 N054.16.36.623 E018.38.02.652
                          N054.16.36.623 E018.38.02.652 N054.16.31.439 E018.37.57.288
                          N054.16.31.439 E018.37.57.288 N054.16.26.328 E018.37.51.635
                          N054.16.26.328 E018.37.51.635 N054.16.21.359 E018.37.45.659
                          N054.16.21.359 E018.37.45.659 N054.16.16.500 E018.37.39.396
                          N054.16.16.500 E018.37.39.396 N054.16.11.783 E018.37.32.843
                          N054.16.11.783 E018.37.32.843 N054.16.07.212 E018.37.26.003
                          N054.16.07.212 E018.37.26.003 N054.16.02.747 E018.37.18.911
                          N054.16.02.747 E018.37.18.911 N054.15.58.464 E018.37.11.567
                          N054.15.58.464 E018.37.11.567 N054.15.54.324 E018.37.03.936
                          N054.15.54.324 E018.37.03.936 N054.15.50.327 E018.36.56.088
                          N054.15.50.327 E018.36.56.088 N054.15.46.512 E018.36.47.988
                          N054.15.46.512 E018.36.47.988 N054.15.42.876 E018.36.39.707
                          N054.15.42.876 E018.36.39.707 N054.15.39.383 E018.36.31.176
                          N054.15.39.383 E018.36.31.176 N054.15.36.071 E018.36.22.428
                          N054.15.36.071 E018.36.22.428 N054.15.32.939 E018.36.13.500
                          N054.15.32.939 E018.36.13.500 N054.15.29.988 E018.36.04.428
                          N054.15.29.988 E018.36.04.428 N054.15.27.252 E018.35.55.139
                          N054.15.27.252 E018.35.55.139 N054.15.24.696 E018.35.45.707
                          N054.15.24.696 E018.35.45.707 N054.15.22.319 E018.35.36.132
                          N054.15.22.319 E018.35.36.132 N054.15.20.123 E018.35.26.411
                          N054.15.20.123 E018.35.26.411 N054.15.18.144 E018.35.16.583
                          N054.15.18.144 E018.35.16.583 N054.15.16.380 E018.35.06.612
                          N054.15.16.380 E018.35.06.612 N054.15.14.795 E018.34.56.568
                          N054.15.14.795 E018.34.56.568 N054.15.13.427 E018.34.46.416
                          N054.15.13.427 E018.34.46.416 N054.15.12.276 E018.34.36.192
                          N054.15.12.276 E018.34.36.192 N054.15.11.339 E018.34.25.931
                          N054.15.11.339 E018.34.25.931 N054.15.10.584 E018.34.15.600
                          N054.15.10.584 E018.34.15.600 N054.15.10.043 E018.34.05.232
                          N054.15.10.043 E018.34.05.232 N054.15.09.756 E018.33.54.827
                          N054.15.09.756 E018.33.54.827 N054.15.09.647 E018.33.44.423
                          N054.15.09.647 E018.33.44.423 N054.15.09.756 E018.33.34.019
                          N054.15.09.756 E018.33.34.019 N054.15.10.043 E018.33.23.616
                          N054.15.10.043 E018.33.23.616 N054.15.10.584 E018.33.13.247
                          N054.15.10.584 E018.33.13.247 N054.15.11.339 E018.33.02.915
                          N054.15.11.339 E018.33.02.915 N054.15.12.276 E018.32.52.655
                          N054.15.12.276 E018.32.52.655 N054.15.13.427 E018.32.42.432
                          N054.15.13.427 E018.32.42.432 N054.15.14.795 E018.32.32.280
                          N054.15.14.795 E018.32.32.280 N054.15.16.380 E018.32.22.235
                          N054.15.16.380 E018.32.22.235 N054.17.58.920 E018.12.28.799
                          N054.17.58.920 E018.12.28.799 N054.13.27.000 E017.26.56.000
                          N053.44.12.998 E018.37.27.998 N054.13.41.916 E018.35.43.548
                          N054.13.41.916 E018.35.43.548 N054.16.47.352 E018.38.12.444
                          N054.24.00.936 E018.45.48.023 N054.23.58.559 E018.45.56.807
                          N054.23.58.559 E018.45.56.807 N054.23.55.967 E018.46.05.484
                          N054.23.55.967 E018.46.05.484 N054.23.53.231 E018.46.13.944
                          N054.23.53.231 E018.46.13.944 N054.23.50.315 E018.46.22.259
                          N054.23.50.315 E018.46.22.259 N054.23.47.255 E018.46.30.396
                          N054.23.47.255 E018.46.30.396 N054.23.44.016 E018.46.38.351
                          N054.23.44.016 E018.46.38.351 N054.23.40.596 E018.46.46.127
                          N054.23.40.596 E018.46.46.127 N054.23.37.031 E018.46.53.651
                          N054.23.37.031 E018.46.53.651 N054.23.33.323 E018.47.00.959
                          N054.23.33.323 E018.47.00.959 N054.23.29.471 E018.47.08.087
                          N054.23.29.471 E018.47.08.087 N054.23.25.476 E018.47.14.927
                          N054.23.25.476 E018.47.14.927 N054.23.21.336 E018.47.21.552
                          N054.23.21.336 E018.47.21.552 N054.23.17.088 E018.47.27.924
                          N054.23.17.088 E018.47.27.924 N054.23.12.660 E018.47.34.044
                          N054.23.12.660 E018.47.34.044 N054.23.08.159 E018.47.39.875
                          N054.23.08.159 E018.47.39.875 N054.23.03.515 E018.47.45.420
                          N054.23.03.515 E018.47.45.420 N054.22.58.800 E018.47.50.711
                          N054.22.58.800 E018.47.50.711 N054.22.53.940 E018.47.55.715
                          N054.22.53.940 E018.47.55.715 N054.22.49.007 E018.48.00.431
                          N054.22.49.007 E018.48.00.431 N054.22.43.968 E018.48.04.823
                          N054.22.43.968 E018.48.04.823 N054.22.38.820 E018.48.08.927
                          N054.22.38.820 E018.48.08.927 N054.22.33.636 E018.48.12.707
                          N054.22.33.636 E018.48.12.707 N054.22.28.344 E018.48.16.200
                          N054.22.28.344 E018.48.16.200 N054.22.23.016 E018.48.19.367
                          N054.22.23.016 E018.48.19.367 N054.22.17.579 E018.48.22.175
                          N054.22.17.579 E018.48.22.175 N054.22.12.144 E018.48.24.696
                          N054.22.12.144 E018.48.24.696 N054.22.06.636 E018.48.26.891
                          N054.22.06.636 E018.48.26.891 N054.22.01.055 E018.48.28.728
                          N054.22.01.055 E018.48.28.728 N054.21.55.475 E018.48.30.239
                          N054.21.55.475 E018.48.30.239 N054.21.49.859 E018.48.31.428
                          N054.21.49.859 E018.48.31.428 N054.21.44.244 E018.48.32.291
                          N054.21.44.244 E018.48.32.291 N054.21.38.592 E018.48.32.796
                          N054.21.38.592 E018.48.32.796 N054.21.32.939 E018.48.32.975
                          N054.21.32.939 E018.48.32.975 N054.21.27.287 E018.48.32.796
                          N054.21.27.287 E018.48.32.796 N054.21.21.635 E018.48.32.291
                          N054.21.21.635 E018.48.32.291 N054.21.16.019 E018.48.31.428
                          N054.21.16.019 E018.48.31.428 N054.21.10.404 E018.48.30.239
                          N054.21.10.404 E018.48.30.239 N054.21.04.824 E018.48.28.728
                          N054.21.04.824 E018.48.28.728 N054.20.59.243 E018.48.26.891
                          N054.20.59.243 E018.48.26.891 N054.20.53.736 E018.48.24.696
                          N054.20.53.736 E018.48.24.696 N054.20.48.300 E018.48.22.175
                          N054.20.48.300 E018.48.22.175 N054.20.42.863 E018.48.19.367
                          N054.20.42.863 E018.48.19.367 N054.20.37.536 E018.48.16.200
                          N054.20.37.536 E018.48.16.200 N054.20.32.243 E018.48.12.707
                          N054.20.32.243 E018.48.12.707 N054.20.27.060 E018.48.08.927
                          N054.20.27.060 E018.48.08.927 N054.20.21.911 E018.48.04.823
                          N054.20.21.911 E018.48.04.823 N054.20.16.872 E018.48.00.431
                          N054.20.16.872 E018.48.00.431 N054.20.11.939 E018.47.55.715
                          N054.20.11.939 E018.47.55.715 N054.20.07.079 E018.47.50.711
                          N054.20.07.079 E018.47.50.711 N054.20.02.364 E018.47.45.420
                          N054.20.02.364 E018.47.45.420 N054.19.57.720 E018.47.39.875
                          N054.19.57.720 E018.47.39.875 N054.19.53.219 E018.47.34.044
                          N054.19.53.219 E018.47.34.044 N054.19.48.791 E018.47.27.924
                          N054.19.48.791 E018.47.27.924 N054.19.44.543 E018.47.21.552
                          N054.19.44.543 E018.47.21.552 N054.19.40.403 E018.47.14.927
                          N054.19.40.403 E018.47.14.927 N054.19.36.407 E018.47.08.087
                          N054.19.36.407 E018.47.08.087 N054.19.32.556 E018.47.00.959
                          N054.19.32.556 E018.47.00.959 N054.19.28.848 E018.46.53.651
                          N054.19.28.848 E018.46.53.651 N054.19.25.283 E018.46.46.127
                          N054.19.25.283 E018.46.46.127 N054.19.21.864 E018.46.38.351
                          N054.19.21.864 E018.46.38.351 N054.19.18.624 E018.46.30.396
                          N054.19.18.624 E018.46.30.396 N054.19.15.564 E018.46.22.259
                          N054.19.15.564 E018.46.22.259 N054.19.12.648 E018.46.13.944
                          N054.19.12.648 E018.46.13.944 N054.19.09.912 E018.46.05.484
                          N054.19.09.912 E018.46.05.484 N054.19.07.319 E018.45.56.807
                          N054.19.07.319 E018.45.56.807 N054.19.04.944 E018.45.48.023
                          N054.19.04.944 E018.45.48.023 N054.19.02.748 E018.45.39.096
                          N054.19.02.748 E018.45.39.096 N054.19.00.695 E018.45.30.024
                          N054.19.00.695 E018.45.30.024 N054.18.58.859 E018.45.20.844
                          N054.18.58.859 E018.45.20.844 N054.18.57.204 E018.45.11.591
                          N054.18.57.204 E018.45.11.591 N054.18.55.763 E018.45.02.196
                          N054.18.55.763 E018.45.02.196 N054.18.54.468 E018.44.52.764
                          N054.18.54.468 E018.44.52.764 N054.18.53.388 E018.44.43.223
                          N054.18.53.388 E018.44.43.223 N054.18.52.524 E018.44.33.648
                          N054.18.52.524 E018.44.33.648 N054.18.51.839 E018.44.23.999
                          N054.18.51.839 E018.44.23.999 N054.18.51.335 E018.44.14.352
                          N054.18.51.335 E018.44.14.352 N054.18.51.048 E018.44.04.667
                          N054.18.51.048 E018.44.04.667 N054.18.50.939 E018.43.54.947
                          N054.18.50.939 E018.43.54.947 N054.18.51.048 E018.43.45.228
                          N054.18.51.048 E018.43.45.228 N054.18.51.335 E018.43.35.543
                          N054.18.51.335 E018.43.35.543 N054.18.51.839 E018.43.25.895
                          N054.18.51.839 E018.43.25.895 N054.18.52.524 E018.43.16.248
                          N054.18.52.524 E018.43.16.248 N054.18.53.388 E018.43.06.672
                          N054.18.53.388 E018.43.06.672 N054.18.54.468 E018.42.57.131
                          N054.18.54.468 E018.42.57.131 N054.18.55.763 E018.42.47.699
                          N054.18.55.763 E018.42.47.699 N054.18.57.204 E018.42.38.304
                          N054.18.57.204 E018.42.38.304 N054.18.58.859 E018.42.29.051
                          N054.18.58.859 E018.42.29.051 N054.19.00.695 E018.42.19.871
                          N054.19.00.695 E018.42.19.871 N054.19.02.748 E018.42.10.799
                          N054.19.02.748 E018.42.10.799 N054.19.04.944 E018.42.01.872
                          N054.24.13.355 E018.44.33.648 N054.24.12.491 E018.44.43.223
                          N054.24.12.491 E018.44.43.223 N054.24.11.412 E018.44.52.764
                          N054.24.11.412 E018.44.52.764 N054.24.10.116 E018.45.02.196
                          N054.24.10.116 E018.45.02.196 N054.24.08.676 E018.45.11.591
                          N054.24.08.676 E018.45.11.591 N054.24.07.019 E018.45.20.844
                          N054.24.07.019 E018.45.20.844 N054.24.05.184 E018.45.30.024
                          N054.24.05.184 E018.45.30.024 N054.24.03.131 E018.45.39.096
                          N054.24.03.131 E018.45.39.096 N054.24.00.936 E018.45.48.023
                          N054.24.13.355 E018.44.33.648 N054.24.36.720 E018.39.47.843
                          N054.24.36.720 E018.39.47.843 N054.47.43.000 E017.49.36.200
                          KRT KRT KEMUM KEMUM
                          
;EPPO
;by WB
EPPO 10 N052.25.05.380 E016.50.27.038 N052.22.34.140 E017.03.51.155
                          N052.22.34.140 E017.03.51.155 N052.13.54.000 E017.46.27.000
                          N052.22.34.140 E017.03.51.012 N052.22.31.548 E017.04.03.287  ;
                          N052.22.31.548 E017.04.03.287 N052.22.28.703 E017.04.15.455  ;
                          N052.22.28.703 E017.04.15.455 N052.22.25.607 E017.04.27.444  ;
                          N052.22.25.607 E017.04.27.444 N052.22.22.223 E017.04.39.252  ;
                          N052.22.22.223 E017.04.39.252 N052.22.18.623 E017.04.50.844  ;
                          N052.22.18.623 E017.04.50.844 N052.22.14.772 E017.05.02.220  ;
                          N052.22.14.772 E017.05.02.220 N052.22.10.668 E017.05.13.380  ;
                          N052.22.10.668 E017.05.13.380 N052.22.06.347 E017.05.24.288  ;
                          N052.22.06.347 E017.05.24.288 N052.22.01.775 E017.05.34.980  ;
                          N052.22.01.775 E017.05.34.980 N052.21.56.988 E017.05.45.347  ;
                          N052.21.56.988 E017.05.45.347 N052.21.51.984 E017.05.55.463  ;
                          N052.21.51.984 E017.05.55.463 N052.21.46.764 E017.06.05.291  ;
                          N052.21.46.764 E017.06.05.291 N052.21.41.328 E017.06.14.832  ;
                          N052.21.41.328 E017.06.14.832 N052.21.35.712 E017.06.24.048  ;
                          N052.21.35.712 E017.06.24.048 N052.21.29.879 E017.06.32.904  ;
                          N052.21.29.879 E017.06.32.904 N052.21.23.868 E017.06.41.435  ;
                          N052.21.23.868 E017.06.41.435 N052.21.17.675 E017.06.49.644  ;
                          N052.21.17.675 E017.06.49.644 N052.21.11.339 E017.06.57.492  ;
                          N052.21.11.339 E017.06.57.492 N052.21.04.824 E017.07.04.944  ;
                          N052.21.04.824 E017.07.04.944 N052.20.58.127 E017.07.12.036  ;
                          N052.20.58.127 E017.07.12.036 N052.20.51.323 E017.07.18.732  ;
                          N052.20.51.323 E017.07.18.732 N052.20.44.339 E017.07.25.067  ;
                          N052.20.44.339 E017.07.25.067 N052.20.37.247 E017.07.30.972  ;
                          N052.20.37.247 E017.07.30.972 N052.20.30.047 E017.07.36.479  ;
                          N052.20.30.047 E017.07.36.479 N052.20.22.739 E017.07.41.555  ;
                          N052.20.22.739 E017.07.41.555 N052.20.15.288 E017.07.46.235  ;
                          N052.20.15.288 E017.07.46.235 N052.20.07.764 E017.07.50.448  ;
                          N052.20.07.764 E017.07.50.448 N052.20.00.167 E017.07.54.264  ;
                          N052.20.00.167 E017.07.54.264 N052.19.52.464 E017.07.57.648  ;
                          N052.19.52.464 E017.07.57.648 N052.19.44.724 E017.08.00.563  ;
                          N052.19.44.724 E017.08.00.563 N052.19.36.912 E017.08.03.048  ;
                          N052.19.36.912 E017.08.03.048 N052.19.29.028 E017.08.05.064  ;
                          N052.19.29.028 E017.08.05.064 N052.19.21.143 E017.08.06.684  ;
                          N052.19.21.143 E017.08.06.684 N052.19.13.224 E017.08.07.800  ;
                          N052.19.13.224 E017.08.07.800 N052.19.05.267 E017.08.08.484  ;
                          N052.19.05.267 E017.08.08.484 N052.18.57.311 E017.08.08.700  ;
                          N052.18.57.311 E017.08.08.700 N052.18.49.356 E017.08.08.484  ;
                          N052.18.49.356 E017.08.08.484 N052.18.41.400 E017.08.07.800  ;
                          N052.18.41.400 E017.08.07.800 N052.18.33.480 E017.08.06.684  ;
                          N052.18.33.480 E017.08.06.684 N052.18.25.596 E017.08.05.064  ;
                          N052.18.25.596 E017.08.05.064 N052.18.17.712 E017.08.03.048  ;
                          N052.18.17.712 E017.08.03.048 N052.18.09.900 E017.08.00.563  ;
                          N052.18.09.900 E017.08.00.563 N052.18.02.160 E017.07.57.648  ;
                          N052.18.02.160 E017.07.57.648 N052.17.54.455 E017.07.54.264  ;
                          N052.17.54.455 E017.07.54.264 N052.17.46.859 E017.07.50.448  ;
                          N052.17.46.859 E017.07.50.448 N052.17.39.336 E017.07.46.235  ;
                          N052.17.39.336 E017.07.46.235 N052.17.31.883 E017.07.41.555  ;
                          N052.17.31.883 E017.07.41.555 N052.17.24.576 E017.07.36.479  ;
                          N052.17.24.576 E017.07.36.479 N052.17.17.375 E017.07.30.972  ;
                          N052.17.17.375 E017.07.30.972 N052.17.10.283 E017.07.25.067  ;
                          N052.17.10.283 E017.07.25.067 N052.17.03.300 E017.07.18.732  ;
                          N052.17.03.300 E017.07.18.732 N052.16.56.495 E017.07.12.036  ;
                          N052.16.56.495 E017.07.12.036 N052.16.49.800 E017.07.04.944  ;
                          N052.16.49.800 E017.07.04.944 N052.16.43.283 E017.06.57.492  ;
                          N052.16.43.283 E017.06.57.492 N052.16.36.948 E017.06.49.644  ;
                          N052.16.36.948 E017.06.49.644 N052.16.30.756 E017.06.41.435  ;
                          N052.16.30.756 E017.06.41.435 N052.16.24.743 E017.06.32.904  ;
                          N052.16.24.743 E017.06.32.904 N052.16.18.912 E017.06.24.048  ;
                          N052.16.18.912 E017.06.24.048 N052.16.13.295 E017.06.14.832  ;
                          N052.16.13.295 E017.06.14.832 N052.16.07.860 E017.06.05.291  ;
                          N052.16.07.860 E017.06.05.291 N052.16.02.640 E017.05.55.463  ;
                          N052.16.02.640 E017.05.55.463 N052.15.57.636 E017.05.45.347  ;
                          N052.15.57.636 E017.05.45.347 N052.15.52.847 E017.05.34.980  ;
                          N052.15.52.847 E017.05.34.980 N052.15.48.276 E017.05.24.288  ;
                          N052.15.48.276 E017.05.24.288 N052.15.43.956 E017.05.13.380  ;
                          N052.15.43.956 E017.05.13.380 N052.15.39.851 E017.05.02.220  ;
                          N052.15.39.851 E017.05.02.220 N052.15.35.999 E017.04.50.844  ;
                          N052.15.35.999 E017.04.50.844 N052.15.32.400 E017.04.39.252  ;
                          N052.15.32.400 E017.04.39.252 N052.15.29.016 E017.04.27.444  ;
                          N052.15.29.016 E017.04.27.444 N052.15.25.919 E017.04.15.455  ;
                          N052.15.25.919 E017.04.15.455 N052.15.23.076 E017.04.03.287  ;
                          N052.15.23.076 E017.04.03.287 N052.15.20.484 E017.03.51.012  ;
                          N052.15.20.484 E017.03.51.012 N052.15.18.144 E017.03.38.556  ;
                          N052.15.18.144 E017.03.38.556 N052.15.16.091 E017.03.25.956  ;
                          N052.15.16.091 E017.03.25.956 N052.15.14.292 E017.03.13.283  ;
                          N052.15.14.292 E017.03.13.283 N052.15.12.779 E017.03.00.503  ;
                          N052.15.12.779 E017.03.00.503 N052.15.11.519 E017.02.47.651  ;
                          N052.15.11.519 E017.02.47.651 N052.15.10.547 E017.02.34.728  ;
                          N052.15.10.547 E017.02.34.728 N052.15.09.864 E017.02.21.768  ;
                          N052.15.09.864 E017.02.21.768 N052.15.09.468 E017.02.08.771  ;
                          N052.15.09.468 E017.02.08.771 N052.15.09.323 E017.01.55.740  ;
                          N052.15.09.323 E017.01.55.740 N052.15.09.468 E017.01.42.707  ;
                          N052.15.09.468 E017.01.42.707 N052.15.09.864 E017.01.29.712  ;
                          N052.15.09.864 E017.01.29.712 N052.15.10.547 E017.01.16.751  ;
                          N052.15.10.547 E017.01.16.751 N052.15.11.519 E017.01.03.828  ;
                          N052.15.11.519 E017.01.03.828 N052.15.12.779 E017.00.50.976  ;
                          N052.15.12.779 E017.00.50.976 N052.15.14.292 E017.00.38.195  ;
                          N052.15.14.292 E017.00.38.195 N052.15.16.091 E017.00.25.524  ;
                          N052.15.16.091 E017.00.25.524 N052.15.18.144 E017.00.12.923  ;
                          N052.15.18.144 E017.00.12.923 N052.15.20.484 E017.00.00.467  ;
                          N052.15.20.484 E017.00.00.467 N052.15.23.076 E016.59.48.191  ;
                          N052.15.23.076 E016.59.48.191 N052.15.25.919 E016.59.36.023  ;
                          N052.15.25.919 E016.59.36.023 N052.15.29.016 E016.59.24.036  ;
                          N052.15.29.016 E016.59.24.036 N052.15.32.400 E016.59.12.228  ;
                          N052.15.32.400 E016.59.12.228 N052.15.35.999 E016.59.00.635  ;
                          N052.15.35.999 E016.59.00.635 N052.15.39.851 E016.58.49.260  ;
                          N052.15.39.851 E016.58.49.260 N052.15.43.956 E016.58.38.100  ;
                          N052.15.43.956 E016.58.38.100 N052.15.48.276 E016.58.27.191  ;
                          N052.15.48.276 E016.58.27.191 N052.15.52.847 E016.58.16.500  ;
                          N052.15.52.847 E016.58.16.500 N052.15.57.636 E016.58.06.132  ;
                          N052.15.57.636 E016.58.06.132 N052.16.02.640 E016.57.56.015  ;
                          N052.16.02.640 E016.57.56.015 N052.16.07.860 E016.57.46.188  ;
                          N052.16.07.860 E016.57.46.188 N052.16.13.295 E016.57.36.648  ;
                          N052.16.13.295 E016.57.36.648 N052.16.18.947 E016.57.27.431  ;
                          N052.16.18.947 E016.57.27.431 N052.16.24.743 E016.57.18.575  ;
                          N052.16.24.743 E016.57.18.575 N052.16.30.756 E016.57.10.044  ;
                          N052.16.30.756 E016.57.10.044 N052.16.36.948 E016.57.01.836  ;
                          N052.16.36.948 E016.57.01.836 N052.16.43.283 E016.56.53.987  ;
                          N052.16.43.283 E016.56.53.987 N052.16.49.800 E016.56.46.535  ;
                          N052.16.49.800 E016.56.46.535 N052.16.56.495 E016.56.39.443  ;
                          N052.16.56.495 E016.56.39.443 N052.17.03.300 E016.56.32.748  ;
                          N052.17.03.300 E016.56.32.748 N052.17.10.283 E016.56.26.412  ;
                          N052.17.10.283 E016.56.26.412 N052.17.17.375 E016.56.20.507  ;
                          N052.17.17.375 E016.56.20.507 LAW            LAW            
                          CZE            CZE            N052.15.43.956 E017.05.13.380
                          N052.26.12.192 E016.39.21.599 UBOMI          UBOMI
                          N052.26.12.192 E016.39.21.599 N052.26.55.283 E016.41.53.267
                          N052.26.55.283 E016.41.53.267 N052.26.58.380 E016.42.05.256  ;
                          N052.26.58.380 E016.42.05.256 N052.27.01.223 E016.42.17.460  ;
                          N052.27.01.223 E016.42.17.460 N052.27.03.815 E016.42.29.771  ;
                          N052.27.03.815 E016.42.29.771 N052.27.06.155 E016.42.42.227  ;
                          N052.27.06.155 E016.42.42.227 N052.27.08.208 E016.42.54.827  ;
                          N052.27.08.208 E016.42.54.827 N052.27.10.007 E016.43.07.535  ;
                          N052.27.10.007 E016.43.07.535 N052.27.11.520 E016.43.20.351  ;
                          N052.27.11.520 E016.43.20.351 N052.27.12.779 E016.43.33.239  ;
                          N052.27.12.779 E016.43.33.239 N052.27.13.752 E016.43.46.163  ;
                          N052.27.13.752 E016.43.46.163 N052.27.14.435 E016.43.59.160  ;
                          N052.27.14.435 E016.43.59.160 N052.27.14.832 E016.44.12.191  ;
                          N052.27.14.832 E016.44.12.191 N052.27.14.976 E016.44.25.223  ;
                          N052.27.14.976 E016.44.25.223 N052.27.14.832 E016.44.38.256  ;
                          N052.27.14.832 E016.44.38.256 N052.27.14.435 E016.44.51.287  ;
                          N052.27.14.435 E016.44.51.287 N052.27.13.752 E016.45.04.284  ;
                          N052.27.13.752 E016.45.04.284 N052.27.12.779 E016.45.17.208  ;
                          N052.27.12.779 E016.45.17.208 N052.27.11.520 E016.45.30.095  ;
                          N052.27.11.520 E016.45.30.095 N052.27.10.007 E016.45.42.911  ;
                          N052.27.10.007 E016.45.42.911 N052.27.08.208 E016.45.55.620  ;
                          N052.27.08.208 E016.45.55.620 N052.27.06.155 E016.46.08.220  ;
                          N052.27.06.155 E016.46.08.220 N052.27.03.815 E016.46.20.676  ;
                          N052.27.03.815 E016.46.20.676 N052.27.01.223 E016.46.32.987  ;
                          N052.27.01.223 E016.46.32.987 N052.26.58.380 E016.46.45.191  ;
                          N052.26.58.380 E016.46.45.191 N052.26.55.283 E016.46.57.180  ;
                          N052.26.55.283 E016.46.57.180 N052.26.51.899 E016.47.08.988  ;
                          N052.26.51.899 E016.47.08.988 N052.26.48.300 E016.47.20.615  ;
                          N052.26.48.300 E016.47.20.615 N052.26.44.448 E016.47.32.027  ;
                          N052.26.44.448 E016.47.32.027 N052.26.40.344 E016.47.43.187  ;
                          N052.26.40.344 E016.47.43.187 N052.26.36.023 E016.47.54.131  ;
                          N052.26.36.023 E016.47.54.131 N052.26.31.452 E016.48.04.823  ;
                          N052.26.31.452 E016.48.04.823 N052.26.26.663 E016.48.15.228  ;
                          N052.26.26.663 E016.48.15.228 N052.26.21.659 E016.48.25.380  ;
                          N052.26.21.659 E016.48.25.380 N052.26.16.439 E016.48.35.207  ;
                          N052.26.16.439 E016.48.35.207 N052.26.11.004 E016.48.44.747  ;
                          N052.26.11.004 E016.48.44.747 N052.26.05.352 E016.48.53.964  ;
                          N052.26.05.352 E016.48.53.964 N052.25.59.556 E016.49.02.856  ;
                          N052.25.59.556 E016.49.02.856 N052.25.53.543 E016.49.11.423  ;
                          N052.25.53.543 E016.49.11.423 N052.25.47.351 E016.49.19.632  ;
                          N052.25.47.351 E016.49.19.632 N052.25.41.016 E016.49.27.480  ;
                          N052.25.41.016 E016.49.27.480 N052.25.34.500 E016.49.34.968  ;
                          N052.25.34.500 E016.49.34.968 N052.25.27.804 E016.49.42.060  ;
                          N052.25.27.804 E016.49.42.060 N052.25.20.999 E016.49.48.792  ;                          
                          N052.07.50.160 E016.43.37.560 N052.01.36.000 E016.01.14.000
                          N052.07.50.160 E016.43.37.667 N052.07.48.575 E016.43.24.276
                          N052.07.48.575 E016.43.24.276 N052.07.47.243 E016.43.10.776
                          N052.07.47.243 E016.43.10.776 N052.07.46.236 E016.42.57.204
                          N052.07.46.236 E016.42.57.204 N052.07.45.515 E016.42.43.595
                          N052.07.45.515 E016.42.43.595 N052.07.45.047 E016.42.29.952
                          N052.07.45.047 E016.42.29.952 N052.07.44.903 E016.42.16.271
                          N052.07.44.903 E016.42.16.271 N052.07.45.047 E016.42.02.592
                          N052.07.45.047 E016.42.02.592 N052.07.45.515 E016.41.48.947
                          N052.07.45.515 E016.41.48.947 N052.07.46.236 E016.41.35.339
                          N052.07.46.236 E016.41.35.339 N052.07.47.243 E016.41.21.767
                          N052.07.47.243 E016.41.21.767 N052.07.48.575 E016.41.08.267
                          N052.07.48.575 E016.41.08.267 N052.07.50.160 E016.40.54.875
                          N052.07.50.160 E016.40.54.875 N052.07.52.032 E016.40.41.555
                          N052.07.52.032 E016.40.41.555 N052.07.54.227 E016.40.28.344
                          N052.07.54.227 E016.40.28.344 N052.07.56.676 E016.40.15.275
                          N052.07.56.676 E016.40.15.275 N052.07.59.375 E016.40.02.352
                          N052.07.59.375 E016.40.02.352 N052.08.02.400 E016.39.49.607
                          N052.08.02.400 E016.39.49.607 N052.08.05.675 E016.39.37.008
                          N052.08.05.675 E016.39.37.008 N052.08.09.204 E016.39.24.623
                          N052.08.09.204 E016.39.24.623 N052.08.13.019 E016.39.12.455
                          N052.08.13.019 E016.39.12.455 N052.08.17.088 E016.39.00.504
                          N052.08.17.088 E016.39.00.504 N052.08.21.372 E016.38.48.803
                          N052.08.21.372 E016.38.48.803 N052.08.25.944 E016.38.37.319
                          N052.08.25.944 E016.38.37.319 N052.08.30.768 E016.38.26.123
                          N052.08.30.768 E016.38.26.123 N052.08.35.807 E016.38.15.216
                          N052.08.35.807 E016.38.15.216 N052.08.41.063 E016.38.04.595
                          N052.08.41.063 E016.38.04.595 N052.08.46.572 E016.37.54.264
                          N052.08.46.572 E016.37.54.264 N052.08.52.259 E016.37.44.291
                          N052.08.52.259 E016.37.44.291 N052.08.58.200 E016.37.34.608
                          N052.08.58.200 E016.37.34.608 N052.09.04.320 E016.37.25.283
                          N052.09.04.320 E016.37.25.283 N052.09.10.656 E016.37.16.320
                          N052.09.10.656 E016.37.16.320 N052.09.17.171 E016.37.07.751
                          N052.09.17.171 E016.37.07.751 N052.09.23.831 E016.36.59.508
                          N052.09.23.831 E016.36.59.508 N052.09.30.707 E016.36.51.660
                          N052.09.30.707 E016.36.51.660 N052.09.37.727 E016.36.44.244
                          N052.09.37.727 E016.36.44.244 N052.09.44.928 E016.36.37.188
                          N052.09.44.928 E016.36.37.188 N052.09.52.235 E016.36.30.563
                          N052.09.52.235 E016.36.30.563 N052.09.59.723 E016.36.24.372
                          N052.09.59.723 E016.36.24.372 N052.10.07.283 E016.36.18.576
                          N052.10.07.283 E016.36.18.576 N052.10.15.023 E016.36.13.248
                          N052.10.15.023 E016.36.13.248 N052.10.22.835 E016.36.08.351
                          N052.10.22.835 E016.36.08.351 N052.10.30.755 E016.36.03.887
                          N052.10.30.755 E016.36.03.887 N052.10.38.748 E016.35.59.891
                          N052.10.38.748 E016.35.59.891 N052.10.46.847 E016.35.56.364
                          N052.10.46.847 E016.35.56.364 N052.10.55.020 E016.35.53.304
                          N052.10.55.020 E016.35.53.304 N052.14.25.403 E016.34.58.944
                          N052.14.25.403 E016.34.58.944 N052.49.01.000 E015.49.57.000
                          N052.16.16.000 E015.33.52.000 N052.08.25.944 E016.38.37.319
                          N052.01.00.300 E016.42.39.563 N052.01.05.339 E016.42.28.691
                          N052.01.05.339 E016.42.28.691 N052.01.10.596 E016.42.18.108
                          N052.01.10.596 E016.42.18.108 N052.01.16.104 E016.42.07.811
                          N052.01.16.104 E016.42.07.811 N052.01.21.791 E016.41.57.840
                          N052.01.21.791 E016.41.57.840 N052.01.27.731 E016.41.48.191
                          N052.01.27.731 E016.41.48.191 N052.01.33.851 E016.41.38.904
                          N052.01.33.851 E016.41.38.904 N052.01.40.188 E016.41.29.975
                          N052.01.40.188 E016.41.29.975 N052.01.46.704 E016.41.21.408
                          N052.01.46.704 E016.41.21.408 N052.01.53.363 E016.41.13.200
                          N052.01.53.363 E016.41.13.200 N052.02.00.240 E016.41.05.388
                          N052.02.00.240 E016.41.05.388 N052.02.07.260 E016.40.57.935
                          N052.02.07.260 E016.40.57.935 N052.02.14.460 E016.40.50.916
                          N052.02.14.460 E016.40.50.916 N052.02.21.768 E016.40.44.327
                          N052.02.21.768 E016.40.44.327 N052.02.29.256 E016.40.38.136
                          N052.02.29.256 E016.40.38.136 N052.02.36.815 E016.40.32.376
                          N052.02.36.815 E016.40.32.376 N052.02.44.555 E016.40.27.047
                          N052.02.44.555 E016.40.27.047 N052.02.52.367 E016.40.22.152
                          N052.02.52.367 E016.40.22.152 N052.03.00.288 E016.40.17.723
                          N052.03.00.288 E016.40.17.723 N052.03.08.280 E016.40.13.764
                          N052.03.08.280 E016.40.13.764 N052.03.16.379 E016.40.10.235
                          N052.03.16.379 E016.40.10.235 N052.03.24.552 E016.40.07.139
                          N052.03.24.552 E016.40.07.139 N052.03.32.760 E016.40.04.547
                          N052.03.32.760 E016.40.04.547 N052.03.41.039 E016.40.02.423
                          N052.03.41.039 E016.40.02.423 N052.03.49.356 E016.40.00.767
                          N052.03.49.356 E016.40.00.767 N052.03.57.707 E016.39.59.580
                          N052.03.57.707 E016.39.59.580 N052.04.06.060 E016.39.58.860
                          N052.04.06.060 E016.39.58.860 N052.04.14.448 E016.39.58.608
                          N052.04.14.448 E016.39.58.608 N052.04.22.835 E016.39.58.860
                          N052.04.22.835 E016.39.58.860 N052.04.31.188 E016.39.59.580
                          N052.04.31.188 E016.39.59.580 N052.04.39.539 E016.40.00.767
                          N052.04.39.539 E016.40.00.767 N052.04.47.855 E016.40.02.423
                          N052.04.47.855 E016.40.02.423 N052.04.56.135 E016.40.04.547
                          N052.04.56.135 E016.40.04.547 N052.05.04.343 E016.40.07.139
                          N052.05.04.343 E016.40.07.139 N052.05.12.515 E016.40.10.235
                          N052.05.12.515 E016.40.10.235 N052.05.20.616 E016.40.13.764
                          N052.05.20.616 E016.40.13.764 N052.05.28.607 E016.40.17.723
                          N052.05.28.607 E016.40.17.723 N052.05.36.527 E016.40.22.152
                          N052.05.36.527 E016.40.22.152 N052.05.44.339 E016.40.27.047
                          N052.05.44.339 E016.40.27.047 N052.05.52.079 E016.40.32.376
                          N052.05.52.079 E016.40.32.376 N052.05.59.639 E016.40.38.136
                          N052.05.59.639 E016.40.38.136 N052.06.07.127 E016.40.44.327
                          N052.06.07.127 E016.40.44.327 N052.06.14.436 E016.40.50.916
                          N052.06.14.436 E016.40.50.916 N052.06.21.635 E016.40.57.935
                          N052.06.21.635 E016.40.57.935 N052.06.28.655 E016.41.05.388
                          N052.06.28.655 E016.41.05.388 N052.06.35.532 E016.41.13.200
                          N052.06.35.532 E016.41.13.200 N052.06.42.191 E016.41.21.408
                          N052.06.42.191 E016.41.21.408 N052.06.48.707 E016.41.29.975
                          N052.06.48.707 E016.41.29.975 N052.06.55.044 E016.41.38.904
                          N052.06.55.044 E016.41.38.904 N052.07.01.164 E016.41.48.191
                          N052.07.01.164 E016.41.48.191 N052.07.07.103 E016.41.57.840
                          N052.07.07.103 E016.41.57.840 N052.07.12.792 E016.42.07.811
                          N052.07.12.792 E016.42.07.811 N052.07.18.299 E016.42.18.108
                          N052.07.18.299 E016.42.18.108 N052.07.23.556 E016.42.28.691
                          N052.07.23.556 E016.42.28.691 N052.07.28.595 E016.42.39.563
                          N052.07.28.595 E016.42.39.563 N052.07.33.420 E016.42.50.723
                          N052.07.33.420 E016.42.50.723 N052.07.37.992 E016.43.02.171
                          N052.07.37.992 E016.43.02.171 N052.07.42.311 E016.43.13.836
                          N052.07.42.311 E016.43.13.836 N052.07.46.343 E016.43.25.751
                          N052.07.46.343 E016.43.25.751 N052.07.50.160 E016.43.37.919
                          N052.01.00.300 E016.42.39.563 N051.57.34.488 E016.50.03.372
                          N051.57.34.488 E016.50.03.372 N051.42.00.039 E016.59.50.999
 
EPPO 28 N052.27.45.575 E016.32.11.107 N052.27.08.747 E016.28.21.359
                          N052.27.08.747 E016.28.21.359 UBOMI          UBOMI
                          N052.25.27.880 E016.48.18.506 N052.26.20.508 E016.43.36.227
                          N052.26.20.508 E016.43.36.227 N052.27.13.140 E016.38.53.951
                          N052.27.13.140 E016.38.53.951 N052.27.21.888 E016.38.06.899
                          N052.27.21.888 E016.38.06.899 N052.27.48.203 E016.35.45.780
                          N052.17.21.983 E016.33.18.864 N052.17.14.495 E016.33.22.139
                          N052.17.14.495 E016.33.22.139 N052.17.06.936 E016.33.25.020
                          N052.17.06.936 E016.33.25.020 N052.16.59.339 E016.33.27.432
                          N052.16.59.339 E016.33.27.432 N052.16.51.671 E016.33.29.412
                          N052.16.51.671 E016.33.29.412 N052.16.44.003 E016.33.30.959
                          N052.16.44.003 E016.33.30.959 N052.16.36.263 E016.33.32.040
                          N052.16.36.263 E016.33.32.040 N052.16.28.524 E016.33.32.724
                          N052.16.28.524 E016.33.32.724 N052.16.20.784 E016.33.32.939
                          N052.16.20.784 E016.33.32.939 N052.16.13.044 E016.33.32.724
                          N052.16.13.044 E016.33.32.724 N052.16.05.304 E016.33.32.040
                          N052.16.05.304 E016.33.32.040 N052.15.57.564 E016.33.30.959
                          N052.15.57.564 E016.33.30.959 N052.15.49.896 E016.33.29.412
                          N052.15.49.896 E016.33.29.412 N052.15.42.228 E016.33.27.432
                          N052.15.42.228 E016.33.27.432 N052.15.34.631 E016.33.25.020
                          N052.15.34.631 E016.33.25.020 N052.15.27.071 E016.33.22.139
                          N052.15.27.071 E016.33.22.139 N052.15.19.584 E016.33.18.864
                          N052.15.19.584 E016.33.18.864 N052.15.12.167 E016.33.15.192
                          N052.15.12.167 E016.33.15.192 N052.15.04.860 E016.33.11.052
                          N052.15.04.860 E016.33.11.052 N052.14.57.623 E016.33.06.515
                          N052.14.57.623 E016.33.06.515 N052.14.50.496 E016.33.01.583
                          N052.14.50.496 E016.33.01.583 N052.14.43.475 E016.32.56.220
                          N052.14.43.475 E016.32.56.220 N052.14.36.564 E016.32.50.460
                          N052.14.36.564 E016.32.50.460 N052.14.29.796 E016.32.44.339
                          N052.14.29.796 E016.32.44.339 N052.14.23.135 E016.32.37.787
                          N052.14.23.135 E016.32.37.787 N052.14.16.656 E016.32.30.912
                          N052.14.16.656 E016.32.30.912 N052.14.10.284 E016.32.23.639
                          N052.14.10.284 E016.32.23.639 N052.14.04.092 E016.32.16.008
                          N052.14.04.092 E016.32.16.008 N052.13.58.079 E016.32.08.051
                          N052.13.58.079 E016.32.08.051 N052.13.52.248 E016.31.59.735
                          N052.13.52.248 E016.31.59.735 N052.13.46.559 E016.31.51.096
                          N052.13.46.559 E016.31.51.096 N052.13.41.087 E016.31.42.167
                          N052.13.41.087 E016.31.42.167 N052.13.35.796 E016.31.32.880
                          N052.13.35.796 E016.31.32.880 N052.13.30.720 E016.31.23.340
                          N052.13.30.720 E016.31.23.340 N052.13.25.859 E016.31.13.475
                          N052.13.25.859 E016.31.13.475 N052.13.21.179 E016.31.03.396
                          N052.13.21.179 E016.31.03.396 N052.13.16.751 E016.30.52.992
                          N052.13.16.751 E016.30.52.992 N052.13.12.504 E016.30.42.371
                          N052.13.12.504 E016.30.42.371 N052.13.08.543 E016.30.31.535
                          N052.13.08.543 E016.30.31.535 N052.13.04.764 E016.30.20.448
                          N052.13.04.764 E016.30.20.448 N052.13.01.236 E016.30.09.179
                          N052.13.01.236 E016.30.09.179 N052.12.57.959 E016.29.57.695
                          N052.12.57.959 E016.29.57.695 N052.12.54.936 E016.29.46.032
                          N052.12.54.936 E016.29.46.032 N052.12.52.163 E016.29.34.224
                          N052.12.52.163 E016.29.34.224 N052.12.49.644 E016.29.22.235
                          N052.12.49.644 E016.29.22.235 N052.12.47.376 E016.29.10.139
                          N052.12.47.376 E016.29.10.139 N052.12.45.395 E016.28.57.899
                          N052.12.45.395 E016.28.57.899 N052.12.43.631 E016.28.45.552
                          N052.12.43.631 E016.28.45.552 N052.12.42.155 E016.28.33.132
                          N052.12.42.155 E016.28.33.132 N052.12.40.932 E016.28.20.640
                          N052.12.40.932 E016.28.20.640 N052.12.39.995 E016.28.08.040
                          N052.12.34.127 E016.23.34.044 N052.12.39.995 E016.28.08.040
                          N052.12.34.127 E016.23.34.044 N052.01.36.000 E016.01.14.000
                          N052.17.22.000 E016.33.19.000 N052.07.50.160 E016.43.37.560
                          N052.07.50.160 E016.43.37.560 N051.42.00.039 E016.59.50.999
                          N052.21.52.019 E016.28.41.339 EMPIM          EMPIM                         
                          N052.25.20.999 E016.49.49.259 N052.25.24.995 E016.50.01.031  ;
                          N052.25.24.995 E016.50.01.031 N052.25.28.739 E016.50.13.056  ;
                          N052.25.28.739 E016.50.13.056 N052.25.32.232 E016.50.25.260  ;
                          N052.25.32.232 E016.50.25.260 N052.25.35.436 E016.50.37.680  ;
                          N052.25.35.436 E016.50.37.680 N052.25.38.387 E016.50.50.244  ;
                          N052.25.38.387 E016.50.50.244 N052.25.41.051 E016.51.02.987  ;
                          N052.25.41.051 E016.51.02.987 N052.25.43.463 E016.51.15.876  ;
                          N052.25.43.463 E016.51.15.876 N052.25.45.588 E016.51.28.907  ;
                          N052.25.45.588 E016.51.28.907 N052.25.47.460 E016.51.42.047  ;
                          N052.25.47.460 E016.51.42.047 N052.25.49.008 E016.51.55.259  ;
                          N052.25.49.008 E016.51.55.259 N052.25.50.303 E016.52.08.580  ;
                          N052.25.50.303 E016.52.08.580 N052.25.51.312 E016.52.21.971  ;
                          N052.25.51.312 E016.52.21.971 N052.25.52.031 E016.52.35.400  ;
                          N052.25.52.031 E016.52.35.400 N052.25.52.464 E016.52.48.864  ;
                          N052.25.52.464 E016.52.48.864 N052.25.52.608 E016.53.02.328  ;
                          N052.25.52.608 E016.53.02.328 N052.25.52.464 E016.53.15.792  ;
                          N052.25.52.464 E016.53.15.792 N052.25.52.031 E016.53.29.255  ;
                          N052.25.52.031 E016.53.29.255 N052.25.51.312 E016.53.42.683  ;
                          N052.25.51.312 E016.53.42.683 N052.25.50.303 E016.53.56.076  ;
                          N052.25.50.303 E016.53.56.076 N052.25.49.008 E016.54.09.395  ;
                          N052.25.49.008 E016.54.09.395 N052.25.47.460 E016.54.22.607  ;
                          N052.25.47.460 E016.54.22.607 N052.25.45.588 E016.54.35.747  ;
                          N052.25.45.588 E016.54.35.747 N052.25.43.463 E016.54.48.780  ;
                          N052.25.43.463 E016.54.48.780 N052.25.41.051 E016.55.01.668  ;
                          N052.25.41.051 E016.55.01.668 N052.25.38.387 E016.55.14.412  ;
                          N052.25.38.387 E016.55.14.412 N052.25.35.436 E016.55.26.976  ;
                          N052.25.35.436 E016.55.26.976 N052.25.32.232 E016.55.39.396  ;
                          N052.25.32.232 E016.55.39.396 N052.25.28.739 E016.55.51.600  ;
                          N052.25.28.739 E016.55.51.600 N052.25.24.995 E016.56.03.623  ;
                          N052.25.24.995 E016.56.03.623 N052.25.20.999 E016.56.15.395  ;
                          N052.25.20.999 E016.56.15.395 N052.25.16.787 E016.56.26.951  ;
                          N052.25.16.787 E016.56.26.951 N052.25.12.287 E016.56.38.256  ;
                          N052.25.12.287 E016.56.38.256 N052.25.07.572 E016.56.49.308  ;
                          N052.25.07.572 E016.56.49.308 N052.25.02.603 E016.57.00.071  ;
                          N052.25.02.603 E016.57.00.071 N052.24.57.455 E016.57.10.547  ;
                          N052.24.57.455 E016.57.10.547 N052.24.52.055 E016.57.20.736  ;
                          N052.24.52.055 E016.57.20.736 N052.24.46.440 E016.57.30.564  ;
                          N052.24.46.440 E016.57.30.564 N052.23.18.924 E016.59.59.172
                          N052.23.18.924 E016.59.59.172 TENVO          TENVO
                          N052.20.12.659 E016.32.25.440 N052.20.14.927 E016.32.12.443  ;
                          N052.20.14.927 E016.32.12.443 N052.20.17.483 E016.31.59.627  ;
                          N052.20.17.483 E016.31.59.627 N052.20.20.292 E016.31.46.956  ;
                          N052.20.20.292 E016.31.46.956 N052.20.23.387 E016.31.34.428  ;
                          N052.20.23.387 E016.31.34.428 N052.20.26.736 E016.31.22.115  ;
                          N052.20.26.736 E016.31.22.115 N052.20.30.336 E016.31.09.983  ;
                          N052.20.30.336 E016.31.09.983 N052.20.34.187 E016.30.58.068  ;
                          N052.20.34.187 E016.30.58.068 N052.20.38.328 E016.30.46.403  ;
                          N052.20.38.328 E016.30.46.403 N052.20.42.684 E016.30.34.955  ;
                          N052.20.42.684 E016.30.34.955 N052.20.47.291 E016.30.23.795  ;
                          N052.20.47.291 E016.30.23.795 N052.20.52.116 E016.30.12.851  ;
                          N052.20.52.116 E016.30.12.851 N052.20.57.192 E016.30.02.232  ;
                          N052.20.57.192 E016.30.02.232 N052.21.02.484 E016.29.51.899  ;
                          N052.21.02.484 E016.29.51.899 N052.21.07.992 E016.29.41.891  ;
                          N052.21.07.992 E016.29.41.891 N052.21.13.679 E016.29.32.172  ;
                          N052.21.13.679 E016.29.32.172 N052.21.19.619 E016.29.22.812  ;                          
                          N052.21.19.619 E016.29.22.812 N052.21.25.739 E016.29.13.775  ;
                          N052.21.25.739 E016.29.13.775 N052.21.32.039 E016.29.05.099  ;
                          N052.21.32.039 E016.29.05.099 N052.21.38.520 E016.28.56.784  ;
                          N052.21.38.520 E016.28.56.784 N052.21.45.179 E016.28.48.863  ;
                          N052.21.45.179 E016.28.48.863 N052.21.52.019 E016.28.41.339  ;
                          N052.21.52.019 E016.28.41.339 N052.21.59.004 E016.28.34.176  ;
                          N052.21.59.004 E016.28.34.176 N052.22.06.131 E016.28.27.443  ;
                          N052.22.06.131 E016.28.27.443 N052.22.13.367 E016.28.21.107  ;
                          N052.22.13.367 E016.28.21.107 N052.22.20.783 E016.28.15.204  ;
                          N052.22.20.783 E016.28.15.204 N052.22.28.308 E016.28.09.696  ;
                          N052.22.28.308 E016.28.09.696 N052.22.35.939 E016.28.04.656  ;
                          N052.22.35.939 E016.28.04.656 N052.22.43.679 E016.28.00.048  ;
                          N052.22.43.679 E016.28.00.048 N052.22.51.491 E016.27.55.872  ;
                          N052.22.51.491 E016.27.55.872 N052.22.59.411 E016.27.52.164  ;
                          N052.22.59.411 E016.27.52.164 N052.23.07.404 E016.27.48.888  ;
                          N052.23.07.404 E016.27.48.888 N052.23.15.431 E016.27.46.080  ;
                          N052.23.15.431 E016.27.46.080 N052.23.23.532 E016.27.43.740  ;
                          N052.23.23.532 E016.27.43.740 N052.23.31.703 E016.27.41.867  ;
                          N052.23.31.703 E016.27.41.867 N052.23.39.876 E016.27.40.464  ;
                          N052.23.39.876 E016.27.40.464 N052.23.48.083 E016.27.39.527  ;
                          N052.23.48.083 E016.27.39.527 N052.23.56.328 E016.27.39.024  ;
                          N052.23.56.328 E016.27.39.024 N052.24.04.536 E016.27.39.024  ;
                          N052.24.04.536 E016.27.39.024 N052.24.12.780 E016.27.39.527  ;
                          N052.24.12.780 E016.27.39.527 N052.24.20.988 E016.27.40.464  ;
                          N052.24.20.988 E016.27.40.464 N052.24.29.159 E016.27.41.867  ;
                          N052.24.29.159 E016.27.41.867 N052.24.37.332 E016.27.43.740  ;
                          N052.24.37.332 E016.27.43.740 N052.24.45.431 E016.27.46.080  ;
                          N052.24.45.431 E016.27.46.080 N052.24.53.460 E016.27.48.888  ;
                          N052.24.53.460 E016.27.48.888 N052.25.01.452 E016.27.52.164  ;
                          N052.25.01.452 E016.27.52.164 N052.25.09.371 E016.27.55.872  ;
                          N052.25.09.371 E016.27.55.872 N052.25.17.183 E016.28.00.048  ;
                          N052.25.17.183 E016.28.00.048 N052.25.24.923 E016.28.04.656  ;
                          N052.25.24.923 E016.28.04.656 N052.25.32.556 E016.28.09.696  ;
                          N052.25.32.556 E016.28.09.696 N052.25.40.079 E016.28.15.204  ;
                          N052.25.40.079 E016.28.15.204 N052.25.47.495 E016.28.21.107  ;
                          N052.25.47.495 E016.28.21.107 N052.25.54.767 E016.28.27.443  ;
                          N052.25.54.767 E016.28.27.443 N052.26.01.896 E016.28.34.176  ;
                          N052.26.01.896 E016.28.34.176 N052.26.08.843 E016.28.41.339  ;
                          N052.26.08.843 E016.28.41.339 N052.26.15.684 E016.28.48.863  ;
                          N052.26.15.684 E016.28.48.863 N052.26.22.344 E016.28.56.820  ;
                          N052.26.22.344 E016.28.56.820 N052.26.28.823 E016.29.05.099  ;
                          N052.26.28.823 E016.29.05.099 N052.26.35.123 E016.29.13.775  ;
                          N052.26.35.123 E016.29.13.775 N052.26.41.243 E016.29.22.812  ;
                          N052.26.41.243 E016.29.22.812 N052.26.47.184 E016.29.32.172  ;
                          N052.26.47.184 E016.29.32.172 N052.26.52.871 E016.29.41.891  ;
                          N052.26.52.871 E016.29.41.891 N052.26.58.380 E016.29.51.899  ;
                          N052.26.58.380 E016.29.51.899 N052.27.03.671 E016.30.02.232  ;
                          N052.27.03.671 E016.30.02.232 N052.27.08.747 E016.30.12.851  ;
                          N052.27.08.747 E016.30.12.851 N052.27.13.571 E016.30.23.795  ;
                          N052.27.13.571 E016.30.23.795 N052.27.18.179 E016.30.34.955  ;
                          N052.27.18.179 E016.30.34.955 N052.27.22.536 E016.30.46.403  ;
                          N052.27.22.536 E016.30.46.403 N052.27.26.676 E016.30.58.068  ;
                          N052.27.26.676 E016.30.58.068 N052.27.30.528 E016.31.09.983  ;
                          N052.27.30.528 E016.31.09.983 N052.27.34.127 E016.31.22.115  ;
                          N052.27.34.127 E016.31.22.115 N052.27.37.476 E016.31.34.428  ;
                          N052.27.37.476 E016.31.34.428 N052.27.40.571 E016.31.46.956  ;
                          N052.27.40.571 E016.31.46.956 N052.27.43.379 E016.31.59.627  ;
                          N052.27.43.379 E016.31.59.627 N052.27.45.936 E016.32.12.443  ;
                          N052.27.45.936 E016.32.12.443 N052.27.48.203 E016.32.25.440  ;
                          N052.27.48.203 E016.32.25.440 N052.27.50.184 E016.32.38.507  ;
                          N052.27.50.184 E016.32.38.507 N052.27.51.911 E016.32.51.719  ;
                          N052.27.51.911 E016.32.51.719 N052.27.53.315 E016.33.05.004  ;
                          N052.27.53.315 E016.33.05.004 N052.27.54.468 E016.33.18.359  ;
                          N052.27.54.468 E016.33.18.359 N052.27.55.332 E016.33.31.752  ;
                          N052.27.55.332 E016.33.31.752 N052.27.55.908 E016.33.45.216  ;
                          N052.27.55.908 E016.33.45.216 N052.27.56.195 E016.33.58.716  ;
                          N052.27.56.195 E016.33.58.716 N052.27.56.195 E016.34.12.179  ;
                          N052.27.56.195 E016.34.12.179 N052.27.55.908 E016.34.25.679  ;
                          N052.27.55.908 E016.34.25.679 N052.27.55.332 E016.34.39.143  ;
                          N052.27.55.332 E016.34.39.143 N052.27.54.468 E016.34.52.536  ;
                          N052.27.54.468 E016.34.52.536 N052.27.53.315 E016.35.05.891  ;
                          N052.27.53.315 E016.35.05.891 N052.27.51.911 E016.35.19.176  ;
                          N052.27.51.911 E016.35.19.176 N052.27.50.184 E016.35.32.388  ;
                          N052.27.50.184 E016.35.32.388 N052.27.48.203 E016.35.45.456  ;
                          N052.20.30.336 E016.37.00.912 N052.20.26.736 E016.36.48.780  ;
                          N052.20.26.736 E016.36.48.780 N052.20.23.387 E016.36.36.468  ;
                          N052.20.23.387 E016.36.36.468 N052.20.20.292 E016.36.23.939  ;
                          N052.20.20.292 E016.36.23.939 N052.20.17.483 E016.36.11.268  ;
                          N052.20.17.483 E016.36.11.268 N052.20.14.927 E016.35.58.451  ;
                          N052.20.14.927 E016.35.58.451 N052.20.12.659 E016.35.45.456  ;
                          N052.20.12.659 E016.35.45.456 N052.20.10.680 E016.35.32.388  ;
                          N052.20.10.680 E016.35.32.388 N052.20.08.951 E016.35.19.176  ;
                          N052.20.08.951 E016.35.19.176 N052.20.07.548 E016.35.05.891  ;
                          N052.20.07.548 E016.35.05.891 N052.20.06.396 E016.34.52.536  ;
                          N052.20.06.396 E016.34.52.536 N052.20.05.532 E016.34.39.143  ;
                          N052.20.05.532 E016.34.39.143 N052.20.04.956 E016.34.25.679  ;
                          N052.20.04.956 E016.34.25.679 N052.20.04.667 E016.34.12.179  ;
                          N052.20.04.667 E016.34.12.179 N052.20.04.667 E016.33.58.716  ;
                          N052.20.04.667 E016.33.58.716 N052.20.04.956 E016.33.45.216  ;
                          N052.20.04.956 E016.33.45.216 N052.20.05.532 E016.33.31.752  ;
                          N052.20.05.532 E016.33.31.752 N052.20.06.396 E016.33.18.359  ;
                          N052.20.06.396 E016.33.18.359 N052.20.07.548 E016.33.05.004  ;
                          N052.20.07.548 E016.33.05.004 N052.20.08.951 E016.32.51.719  ;
                          N052.20.08.951 E016.32.51.719 N052.20.10.680 E016.32.38.507  ;
                          N052.20.10.680 E016.32.38.507 N052.20.12.659 E016.32.25.403  ;
                          N052.20.30.336 E016.37.00.912 LAW            LAW
                          N052.27.21.888 E016.38.06.756 N052.27.24.371 E016.37.54.803
                          N052.27.24.371 E016.37.54.803 N052.27.27.144 E016.37.43.032
                          N052.27.27.144 E016.37.43.032 N052.27.30.132 E016.37.31.403
                          N052.27.30.132 E016.37.31.403 N052.27.33.371 E016.37.19.955
                          N052.27.33.371 E016.37.19.955 N052.27.36.863 E016.37.08.688
                          N052.27.36.863 E016.37.08.688 N052.27.40.608 E016.36.57.635
                          N052.27.40.608 E016.36.57.635 N052.27.44.568 E016.36.46.835
                          N052.27.44.568 E016.36.46.835 N052.27.48.744 E016.36.36.252
                          N052.27.48.744 E016.36.36.252 N052.27.53.172 E016.36.25.883
                          N052.27.53.172 E016.36.25.883 N052.27.57.780 E016.36.15.803
                          N052.27.57.780 E016.36.15.803 N052.28.02.604 E016.36.05.975
                          N052.28.02.604 E016.36.05.975 N052.28.07.643 E016.35.56.471
                          N052.28.07.643 E016.35.56.471 N052.28.12.900 E016.35.47.220
                          N052.28.12.900 E016.35.47.220 N052.28.18.336 E016.35.38.291
                          N052.28.18.336 E016.35.38.291 N052.28.23.952 E016.35.29.688
                          N052.28.23.952 E016.35.29.688 N052.28.29.748 E016.35.21.371
                          N052.28.29.748 E016.35.21.371 N052.28.35.724 E016.35.13.452
                          N052.28.35.724 E016.35.13.452 N052.28.41.879 E016.35.05.855
                          N052.28.41.879 E016.35.05.855 N052.28.48.179 E016.34.58.584
                          N052.28.48.179 E016.34.58.584 N052.28.54.623 E016.34.51.707
                          N052.28.54.623 E016.34.51.707 N052.29.01.211 E016.34.45.227
                          N052.29.01.211 E016.34.45.227 N052.29.07.907 E016.34.39.107
                          N052.32.24.756 E016.32.01.464 DENKO          DENKO
                          N052.29.07.907 E016.34.39.107 N052.32.24.756 E016.32.01.464                         
                          N052.23.28.823 E016.34.07.643 N052.25.24.527 E016.37.53.759
                          N052.25.24.527 E016.37.53.759 N052.25.29.712 E016.38.02.255
                          N052.25.29.712 E016.38.02.255 N052.25.34.716 E016.38.11.039
                          N052.25.34.716 E016.38.11.039 N052.25.39.539 E016.38.20.111
                          N052.25.39.539 E016.38.20.111 N052.25.44.148 E016.38.29.436
                          N052.25.44.148 E016.38.29.436 N052.25.48.539 E016.38.39.047
                          N052.25.48.539 E016.38.39.047 N052.25.52.751 E016.38.48.875
                          N052.25.52.751 E016.38.48.875 N052.25.56.747 E016.38.58.955
                          N052.25.56.747 E016.38.58.955 N052.26.00.528 E016.39.09.252
                          N052.26.00.528 E016.39.09.252 N052.26.04.091 E016.39.19.728
                          N052.26.04.091 E016.39.19.728 N052.26.07.403 E016.39.30.456
                          N052.26.07.403 E016.39.30.456 N052.26.10.500 E016.39.41.328
                          N052.26.10.500 E016.39.41.328 N052.26.13.379 E016.39.52.379
                          N052.26.13.379 E016.39.52.379 N052.26.16.007 E016.40.03.576
                          N052.26.16.007 E016.40.03.576 N052.26.18.383 E016.40.14.951
                          N052.26.18.383 E016.40.14.951 N052.26.20.508 E016.40.26.435
                          N052.26.20.508 E016.40.26.435 N052.26.22.416 E016.40.38.028
                          N052.26.22.416 E016.40.38.028 N052.26.24.071 E016.40.49.727
                          N052.26.24.071 E016.40.49.727 N052.26.25.475 E016.41.01.499
                          N052.26.25.475 E016.41.01.499 N052.26.26.628 E016.41.13.379
                          N052.26.26.628 E016.41.13.379 N052.26.27.492 E016.41.25.295
                          N052.26.27.492 E016.41.25.295 N052.26.28.140 E016.41.37.248
                          N052.26.28.140 E016.41.37.248 N052.26.28.535 E016.41.49.235
                          N052.26.28.535 E016.41.49.235 N052.26.28.644 E016.42.01.260
                          N052.26.28.644 E016.42.01.260 N052.26.28.535 E016.42.13.284
                          N052.26.28.535 E016.42.13.284 N052.26.28.140 E016.42.25.271
                          N052.26.28.140 E016.42.25.271 N052.26.27.492 E016.42.37.223
                          N052.26.27.492 E016.42.37.223 N052.26.26.628 E016.42.49.140
                          N052.26.26.628 E016.42.49.140 N052.26.25.475 E016.43.01.020
                          N052.26.25.475 E016.43.01.020 N052.26.24.071 E016.43.12.792
                          N052.26.24.071 E016.43.12.792 N052.26.22.416 E016.43.24.491
                          N052.26.22.416 E016.43.24.491 N052.26.20.508 E016.43.36.084
                          N052.23.28.823 E016.34.07.643 BAREP          BAREP         


[LOW AIRWAY]

L23 GRU GRU UNDUK UNDUK
L23 UNDUK UNDUK TOMKO TOMKO
L23 TOMKO TOMKO BINKA BINKA

L29 ALUKA ALUKA TADAK TADAK
L29 TADAK TADAK GRU GRU
L29 GRU GRU OLKIN OLKIN
L29 OLKIN OLKIN SUW SUW
L29 SUW SUW VABER VABER

L32 SOTET SOTET SUW SUW
L32 SUW SUW GOLAD GOLAD

L87 PESEL PESEL XELOL XELOL
L87 XELOL XELOL TILAV TILAV
L87 TILAV TILAV LUSID LUSID

L132 BODLA BODLA DEMUR DEMUR

L616 DESEN DESEN PEKOT PEKOT
L616 PEKOT PEKOT MISKA MISKA
L616 MISKA MISKA VELAB VELAB
L616 VELAB VELAB DENKO DENKO

L617 REGLI REGLI DEVAK DEVAK
L617 DEVAK DEVAK NUDRO NUDRO
L617 NUDRO NUDRO GAGRO GAGRO
L617 GAGRO GAGRO ARMEX ARMEX
L617 ARMEX ARMEX XIDNA XIDNA
L617 XIDNA XIDNA GONAL GONAL
L617 GONAL GONAL CZE CZE
L617 CZE CZE GINOK GINOK
L617 GINOK GINOK RONEX RONEX
L617 RONEX RONEX MIRVO MIRVO
L617 MIRVO MIRVO VIBUL VIBUL
L617 VIBUL VIBUL BABEN BABEN
L617 BABEN BABEN KOLOB KOLOB
L617 KOLOB KOLOB ROE ROE

L619 LENOV LENOV SUDOL SUDOL
L619 SUDOL SUDOL NUDRO NUDRO
L619 NUDRO NUDRO GAGRO GAGRO
L619 GAGRO GAGRO ARMEX ARMEX
L619 ARMEX ARMEX XIDNA XIDNA
L619 XIDNA XIDNA GONAL GONAL
L619 GONAL GONAL CZE CZE
L619 CZE CZE VABAT VABAT
L619 VABAT VABAT DENKO DENKO
L619 DENKO DENKO ALUKA ALUKA
L619 ALUKA ALUKA ERGON ERGON

L621 DIBED DIBED MOSIR MOSIR 
L621 MOSIR MOSIR TELDU TELDU 
L621 TELDU TELDU SUVEK SUVEK 
L621 SUVEK SUVEK VELAX VELAX 
L621 VELAX VELAX KRASI KRASI 
L621 KRASI KRASI VENES VENES 
L621 VENES VENES OMAVA OMAVA 
L621 OMAVA OMAVA NAKER NAKER 
L621 NAKER NAKER XIMBA XIMBA 
L621 XIMBA XIMBA SORIX SORIX 
L621 SORIX SORIX UNELO UNELO
L621 UNELO UNELO LASGU LASGU
L621 LASGU LASGU GRU GRU
L621 GRU GRU BURAN BURAN 
L621 BURAN BURAN DEVEL DEVEL 
L621 DEVEL DEVEL LUSID LUSID

L623 LENOV LENOV EKVAT EKVAT
L623 EKVAT EKVAT VAVEL VAVEL
L623 VAVEL VAVEL BALOS BALOS
L623 BALOS BALOS MYSKO MYSKO 
L623 MYSKO MYSKO BAREX BAREX 
L623 BAREX BAREX BESTO BESTO
L623 BESTO BESTO CZE CZE

L730 ALUKA ALUKA CHO CHO
L730 CHO CHO NETOP NETOP 
L730 NETOP NETOP TOMKO TOMKO 
L730 TOMKO TOMKO BURAN BURAN 
L730 BURAN BURAN DEXIR DEXIR 
L730 DEXIR DEXIR KRT KRT
L730 KRT KRT KMI KMI

L733 BURAN BURAN RANOK RANOK

L741 RANOK RANOK DOMAG DOMAG 
L741 DOMAG DOMAG RUMAR RUMAR

L867 AMTEK AMTEK PEKOT PEKOT 
L867 PEKOT PEKOT SUI SUI

L979 GOVEN GOVEN BAPAS BAPAS 
L979 BAPAS BAPAS KELOD KELOD

L980 USTIL USTIL OMAVA OMAVA 
L980 OMAVA OMAVA LDZ LDZ
L980 LDZ LDZ DERAM DERAM 
L980 DERAM DERAM SUBAX SUBAX 
L980 SUBAX SUBAX UTOLU UTOLU 
L980 UTOLU UTOLU INDIG INDIG 
L980 INDIG INDIG MASIV MASIV
L980 MASIV MASIV BADUP BADUP 
L980 BADUP BADUP CZE CZE
L980 CZE CZE SOSIK SOSIK 
L980 SOSIK SOSIK OBOLA OBOLA 
L980 OBOLA OBOLA KELOD KELOD 
L980 KELOD KELOD BAREP BAREP 
L980 BAREP BAREP SUI SUI

L981 DIBED DIBED ARSOG ARSOG
L981 ARSOG ARSOG PIGAT PIGAT
L981 PIGAT PIGAT JED JED
L981 JED JED OBALU OBALU 
L981 OBALU OBALU ROGAL ROGAL 
L981 ROGAL ROGAL MAKOV MAKOV
L981 MAKOV MAKOV BADNO BADNO
L981 BADNO BADNO BUNIX BUNIX 
L981 BUNIX BUNIX CZE CZE

L984 DIBED DIBED VAREN VAREN 
L984 VAREN VAREN NATIX NATIX 
L984 NATIX NATIX LUXAR LUXAR 
L984 LUXAR LUXAR GAMRO GAMRO 
L984 GAMRO GAMRO ADOKI ADOKI 
L984 ADOKI ADOKI SKAVI SKAVI
L984 SKAVI SKAVI VAKAD VAKAD 
L984 VAKAD VAKAD NOMIX NOMIX 
L984 NOMIX NOMIX PADKA PADKA

L986 SABAB SABAB GIGAL GIGAL 

L996 DENKO DENKO PIXOR PIXOR
L996 PIXOR PIXOR DODAN DODAN
L996 DODAN DODAN DOSAL DOSAL
L996 DOSAL DOSAL CHO CHO
L996 CHO CHO MASUN MASUN
L996 MASUN MASUN GOMEX GOMEX 
L996 GOMEX GOMEX ROBOV ROBOV
L996 ROBOV ROBOV TILAV TILAV 
L996 TILAV TILAV GOSOT GOSOT

L999 SUPAK SUPAK ADOKI ADOKI 
L999 ADOKI ADOKI XEMOL XEMOL 
L999 XEMOL XEMOL RILAB RILAB
L999 RILAB RILAB TOSPO TOSPO

M66 BABKO BABKO KUKAM KUKAM
M66 KUKAM KUKAM EVINA EVINA

M602 CHO CHO IRGET IRGET
M602 IRGET IRGET BINKA BINKA

M743 KRT KRT KEMUM KEMUM 
M743 KEMUM KEMUM SUROD SUROD 
M743 SUROD SUROD PIVET PIVET 
M743 PIVET PIVET GORPI GORPI

M857 PODAN PODAN RILAB RILAB
M857 RILAB RILAB VENES VENES 
M857 VENES VENES EGLON EGLON
M857 EGLON EGLON GERVI GERVI
M857 GERVI GERVI XESNA XESNA
M857 XESNA XESNA BULEP BULEP 
M857 BULEP BULEP SUW SUW
M857 SUW SUW BOKSU BOKSU

M863 LDZ LDZ XALUR XALUR
M863 XALUR XALUR GERVI GERVI
M863 GERVI GERVI ETUBO ETUBO
M863 ETUBO ETUBO RUDKA RUDKA

M865 LARMA LARMA LATMI LATMI

M866 BABKO BABKO KRW KRW
M866 KRW KRW LUKOR LUKOR 
M866 LUKOR LUKOR JED JED
M866 JED JED LOGDA LOGDA
M866 LOGDA LOGDA GERVI GERVI

M977 DIBED DIBED OSMAT OSMAT 
M977 OSMAT OSMAT BALBA BALBA 
M977 BALBA BALBA ETUBO ETUBO 
M977 ETUBO ETUBO BESOT BESOT 
M977 BESOT BESOT EVODO EVODO
M977 EVODO EVODO SUW SUW

M984 TUSIN TUSIN IBEKA IBEKA 
M984 IBEKA IBEKA RODAK RODAK 
M984 RODAK RODAK JED JED
M984 JED JED LETKI LETKI

M985 MEBAN MEBAN JAB JAB
M985 JAB JAB NAXAR NAXAR
M985 SKAVI SKAVI VAVEL VAVEL
M985 VAVEL VAVEL ERNAP ERNAP
M985 ERNAP ERNAP POBOK POBOK 
M985 POBOK POBOK JED JED
M985 JED JED EVINA EVINA
M985 EVINA EVINA XATOG XATOG
M985 XATOG XATOG SUW SUW
M985 SUW SUW BOKSU BOKSU

M992 ADADO ADADO EMBIK EMBIK
M992 EMBIK EMBIK ORSOX ORSOX
M992 ORSOX ORSOX KTC KTC

M994 GILAS GILAS DENKO DENKO
M994 DENKO DENKO TADAK TADAK
M994 TADAK TADAK ODLOT ODLOT
M994 ODLOT ODLOT KMI KMI 
M994 KMI KMI GOMED GOMED

N133 LENOV LENOV GOSAK GOSAK 
N133 GOSAK GOSAK JED JED
N133 JED JED LUBEN LUBEN
N133 LUBEN LUBEN NUBLI NUBLI
N133 NUBLI NUBLI BAGAP BAGAP
N133 BAGAP BAGAP GIPOS GIPOS
N133 GIPOS GIPOS LDZ LDZ
N133 LDZ LDZ VALUD VALUD
N133 VALUD VALUD PENEX PENEX
N133 PENEX PENEX VAVEK VAVEK
N133 VAVEK VAVEK NASOK NASOK
N133 NASOK NASOK BIBKA BIBKA
N133 BIBKA BIBKA GRU GRU
N133 GRU GRU LODNI LODNI 
N133 LODNI LODNI KRT KRT
N133 KRT KRT VAPOS VAPOS 
N133 VAPOS VAPOS DOMAG DOMAG 
N133 DOMAG DOMAG MOTAD MOTAD 
N133 MOTAD MOTAD PENOR PENOR

N191 USTIL USTIL RUTUK RUTUK 
N191 RUTUK RUTUK LIMVI LIMVI
N191 LIMVI LIMVI OLILA OLILA
N191 OLILA OLILA SOMOR SOMOR
N191 SOMOR SOMOR GRU GRU
N191 GRU GRU KMI KMI

N195 SORIX SORIX NASOK NASOK
N195 NASOK NASOK UNDUK UNDUK
N195 UNDUK UNDUK OGRES OGRES
N195 OGRES OGRES ELPOL ELPOL
N195 ELPOL ELPOL KOLOB KOLOB

N744 TUSIN TUSIN NAVUR NAVUR 
N744 NAVUR NAVUR EVINA EVINA
N744 EVINA EVINA WAR WAR

N746 BINKA BINKA DEMUR DEMUR 
N746 DEMUR DEMUR BABEN BABEN 
N746 BABEN BABEN GORPI GORPI

N858 SUI SUI DENKO DENKO
N858 DENKO DENKO DEKUT DEKUT 
N858 DEKUT DEKUT EBOGU EBOGU 
N858 EBOGU EBOGU GRU GRU
N858 GRU GRU OSKUD OSKUD
N858 OSKUD OSKUD TUROL TUROL
N858 TORUL TORUL LIMKO LIMKO
N858 LIMKO LIMKO BOKSU BOKSU

N869 TOMTI TOMTI AGALU AGALU
N869 AGALU AGALU BAXIS BAXIS
N869 BAXIS BAXIS SUBAX SUBAX
N869 SUBAX SUBAX REGVA REGVA
N869 REGVA REGVA SOXER SOXER
N869 SOXER SOXER KUKOP KUKOP
N869 KUKOP KUKOP WAR WAR
N869 WAR WAR TOXAR TOXAR
N869 TOXAR TOXAR RUDKA RUDKA

N871 LAGAR LAGAR MISKA MISKA 
N871 MISKA MISKA VAGSA VAGSA 
N871 VAGSA VAGSA OKENO OKENO
N871 OKENO OKENO ABAKU ABAKU
N871 ABAKU ABAKU LDZ LDZ
N871 LDZ LDZ KUKOP KUKOP
N871 KUKOP KUKOP WAR WAR
N871 WAR WAR SUW SUW

N983 DIBED DIBED LDZ LDZ
N983 LDZ LDZ AMUTO AMUTO
N983 AMUTO AMUTO MAPEX MAPEX
N983 MAPEX MAPEX ELPOL ELPOL
N983 ELPOL ELPOL AMROR AMROR

P31 GOVEN GOVEN BURAN BURAN 
P31 BURAN BURAN VAPOS VAPOS 
P31 VAPOS VAPOS KUNER KUNER

P96 ODERA ODERA GUDON GUDON

P150 CZE CZE DIPKI DIPKI 
P150 DIPKI DIPKI TENVO TENVO
P150 TENVO TENVO OBOKU OBOKU
P150 OBOKU OBOKU PEVUM PEVUM
P150 PEVUM PEVUM AMUTO AMUTO 
P150 AMUTO AMUTO DOSIX DOSIX
P150 DOSIX DOSIX BIMPA BIMPA

P733 TOMTI TOMTI DIMEX DIMEX
P733 DIMEX DIMEX AKAPI AKAPI
P733 AKAPI AKAPI CZE CZE
P733 CZE CZE EBOGU EBOGU
P733 EBOGU EBOGU LODNI LODNI
P733 LODNI LODNI KMI KMI
P733 KMI KMI IPLIT IPLIT

P851 ABERO ABERO GERVI GERVI
P851 GERVI GERVI NEPOX NEPOX
P851 NEPOX NEPOX WAR WAR
P851 WAR WAR BIMPA BIMPA
P851 BIMPA BIMPA VEMAL VEMAL
P851 VEMAL VEMAL MOLIL MOLIL 
P851 MOLIL MOLIL IDEXU IDEXU 
P851 IDEXU IDEXU DENKO DENKO

P861 RASAN RASAN LATAG LATAG
P861 LATAG LATAG ERNOX ERNOX
P861 ERNOX ERNOX GINOK GINOK 
P861 GINOK GINOK DEKUT DEKUT 
P861 DEKUT DEKUT ODLOT ODLOT
P861 ODLOT ODLOT KRT KRT
P861 KRT KRT RANOK RANOK

P866 GOTIX GOTIX OSMAT OSMAT 
P866 OSMAT OSMAT UREKO UREKO 
P866 UREKO UREKO NEVAP NEVAP
P866 NEVAP NEVAP EGLON EGLON 
P866 EGLON EGLON LIMVI LIMVI

Q10 PADKA PADKA JED JED

Q99 NAKER NAKER ADIKA ADIKA
Q99 ADIKA ADIKA ABEXA ABEXA 
Q99 ABEXA ABEXA LDZ LDZ

Q258 LUXAR LUXAR MAXAM MAXAM
Q258 MAXAM MAXAM DEMIN DEMIN 
Q258 DEMIN DEMIN RZE RZE
Q258 RZE RZE KUBUK KUBUK
Q258 KUBUK KUBUK VELAX VELAX
Q258 VELAX VELAX UREKO UREKO

Q277 OKENO OKENO GOGUS GOGUS
Q277 GOGUS GOGUS AGAVA AGAVA

T674 SUROD SUROD DEVEL DEVEL 

T707 TOMTI TOMTI RASUT RASUT
T707 RASUT RASUT BANUN BANUN
T707 BANUN BANUN DODER DODER
T707 DODER DODER TRZ TRZ

T708 BAREX BAREX GOMOR GOMOR 
T708 GOMOR GOMOR TRZ TRZ
T708 TRZ TRZ SOVAM SOVAM 
T708 SOVAM SOVAM DIMEX DIMEX 
T708 DIMEX DIMEX LOLKO LOLKO 
T708 LOLKO LOLKO GOVEN GOVEN

T709 BAVOK BAVOK LURAD LURAD
T709 LURAD LURAD BANET BANET
T709 BANET BANET KTC KTC
T709 KTC KTC MOKOS MOKOS
T709 MOKOS MOKOS GIRLU GIRLU
T709 GIRLU GIRLU OKTOR OKTOR
T709 OKTOR OKTOR KURON KURON
T709 KURON KURON JED JED

T710 LOLKA LOLKA JAB JAB
T710 JAB JAB IBEKA IBEKA
T710 IBEKA IBEKA ORSOX ORSOX
T710 ORSOX ORSOX MAPIK MAPIK
T710 MAPIK MAPIK SABAB SABAB 
T710 SABAB SABAB APTAS APTAS
T710 APTAS APTAS NUDRO NUDRO 
T710 NUDRO NUDRO TRZ TRZ
T710 TRZ TRZ BUDIR BUDIR 
T710 BUDIR BUDIR VELAB VELAB 
T710 VELAB VELAB KULUV KULUV 
T710 KULUV KULUV OLUMA OLUMA 
T710 OLUMA OLUMA SUI SUI

T711 KORUP KORUP LATAG LATAG
T711 LATAG LATAG INDIG INDIG
T711 INDIG INDIG DIBLO DIBLO
T711 DIBLO DIBLO LOLSI LOLSI
T711 LOLSI LOLSI WAR WAR
T711 WAR WAR XATOG XATOG
T711 XATOG XATOG BULEP BULEP
T711 BULEP BULEP BESOT BESOT
T711 BESOT BESOT GORAT GORAT

T714 BALOS BALOS MAPIK MAPIK
T714 MAPIK MAPIK XELET XELET 
T714 XELET XELET GODLO GODLO 
T714 GODLO GODLO NOSKU NOSKU 
T714 NOSKU NOSKU LASIS LASIS

T738 KRW KRW ORSOX ORSOX
T738 ORSOX ORSOX NUMBA NUMBA
T738 NUMBA NUMBA DINOV DINOV 
T738 DINOV DINOV EKSEK EKSEK 
T738 EKSEK EKSEK LASIS LASIS

Y100 BURAN BURAN ELPOL ELPOL

Y209 KELOD KELOD ARSAP ARSAP

Y210 PEKOT PEKOT OLUMA OLUMA
Y210 OLUMA OLUMA ARSAP ARSAP

Y232 DIDUM DIDUM KELOD KELOD

Z72 KRT KRT KUNER KUNER

Z73 KTC KTC BEDUN BEDUN 
Z73 BEDUN BEDUN MAPIK MAPIK

Z80 TILAV TILAV GORPI GORPI

Z95 BDG BDG BEBAL BEBAL
Z95 BEBAL BEBAL GRU GRU

Z96 DEKUT DEKUT REDMO REDMO 
Z96 REDMO REDMO BDG BDG
Z96 BDG BDG NEREK NEREK 
Z96 NEREK NEREK BIBKA BIBKA 
Z96 BIBKA BIBKA LASGU LASGU 
Z96 LASGU LASGU SOMOR SOMOR 

Z121 NETIR NETIR GIXOL GIXOL
Z121 GIXOL GIXOL SKAVI SKAVI

Z126 TUSIN TUSIN LUPUX LUPUX
Z126 LUPUX LUPUX KTC KTC

Z127 TUSIN TUSIN RINAM RINAM
Z127 RINAM RINAM KRW KRW

Z136 LAGAR LAGAR DINOV DINOV 
Z136 DINOV DINOV ROTOL ROTOL 
Z136 ROTOL ROTOL GODLO GODLO 

Z159 REGLI REGLI OSKEX OSKEX
Z159 OSKEX OSKEX MAVOT MAVOT
Z159 MAVOT MAVOT NILPU NILPU

Z181 XIGRI XIGRI ELSUP ELSUP
Z181 ELSUP ELSUP UBOMI UBOMI

Z182 ABERO ABERO ASLUX ASLUX
Z182 ASLUX ASLUX BAMSO BAMSO

Z225 LASIS LASIS ROPIK ROPIK
Z225 ROPIK ROPIK VELAB VELAB 

Z348 NAROX NAROX EKSEK EKSEK
Z348 EKSEK EKSEK RASUT RASUT 

Z460 ASLUX ASLUX XESNA XESNA
Z460 XESNA XESNA TOXAR TOXAR 
Z460 TOXAR TOXAR BESOT BESOT

Z491 BODLA BODLA ROVEK ROVEK
Z491 ROVEK ROVEK CHO CHO
Z491 CHO CHO BEDAM BEDAM 
Z491 BEDAM BEDAM DEMUR DEMUR 
Z491 DEMUR DEMUR XELOL XELOL
Z491 XELOL XELOL EKRON EKRON
Z491 EKRON EKRON POKEN POKEN


[HIGH AIRWAY]

UL23 GORAT GORAT GONTU GONTU
UL23 GONTU GONTU GRU GRU
UL23 GRU GRU UNDUK UNDUK
UL23 UNDUK UNDUK TOMKO TOMKO
UL23 TOMKO TOMKO BINKA BINKA

UL29 ALUKA ALUKA TADAK TADAK
UL29 TADAK TADAK GRU GRU

UL32 SOTET SOTET SUW SUW

UL87 PESEL PESEL XELOL XELOL
UL87 XELOL XELOL TILAV TILAV
UL87 TILAV TILAV LUSID LUSID

UL132 BODLA BODLA DEMUR DEMUR

UL616 DESEN DESEN PEKOT PEKOT
UL616 PEKOT PEKOT MISKA MISKA
UL616 MISKA MISKA VELAB VELAB
UL616 VELAB VELAB DENKO DENKO

UL617 SOPAV SOPAV REGLI REGLI
UL617 REGLI REGLI NUDRO NUDRO
UL617 NUDRO NUDRO GAGRO GAGRO
UL617 GAGRO GAGRO XIDNA XIDNA
UL617 XIDNA XIDNA CZE CZE
UL617 CZE CZE GINOK GINOK
UL617 GINOK GINOK RONEX RONEX
UL617 RONEX RONEX MIRVO MIRVO
UL617 MIRVO MIRVO VIBUL VIBUL
UL617 VIBUL VIBUL BABEN BABEN
UL617 BABEN BABEN KOLOB KOLOB
UL617 KOLOB KOLOB ROE ROE

UL619 LENOV LENOV SUDOL SUDOL 
UL619 SUDOL SUDOL NUDRO NUDRO 
UL619 NUDRO NUDRO GAGRO GAGRO
UL619 GAGRO GAGRO XIDNA XIDNA 
UL619 XIDNA XIDNA CZE CZE
UL619 CZE CZE DENKO DENKO
UL619 DENKO DENKO ALUKA ALUKA
UL619 ALUKA ALUKA ERGON ERGON 

UL621 DIBED DIBED VENES VENES 
UL621 VENES VENES OMAVA OMAVA 
UL621 OMAVA OMAVA XIMBA XIMBA 
UL621 XIMBA XIMBA SORIX SORIX
UL621 SORIX SORIX UNELO UNELO
UL621 UNELO UNELO GRU GRU
UL621 GRU GRU BURAN BURAN 
UL621 BURAN BURAN DEVEL DEVEL 
UL621 DEVEL DEVEL LUSID LUSID

UL623 LENOV LENOV BAREX BAREX 
UL623 BAREX BAREX BESTO BESTO 
UL623 BESTO BESTO CZE CZE

UL730 ALUKA ALUKA CHO CHO
UL730 CHO CHO TOMKO TOMKO 
UL730 TOMKO TOMKO BURAN BURAN 
UL730 BURAN BURAN DEXIR DEXIR 
UL730 DEXIR DEXIR KRT KRT
UL730 KRT KRT KMI KMI

UL733 BURAN BURAN RANOK RANOK

UL735 GOVEN GOVEN IDEXU IDEXU 
UL735 IDEXU IDEXU MAGAN MAGAN 
UL735 MAGAN MAGAN KULEK KULEK 
UL735 KULEK KULEK SUW SUW
UL735 SUW SUW VABER VABER

UL741 RANOK RANOK DOMAG DOMAG 
UL741 DOMAG DOMAG RUMAR RUMAR

UL856 BABKO BABKO LDZ LDZ
UL856 LDZ LDZ ASLUX ASLUX
UL856 ASLUX ASLUX ETUBO ETUBO

UL867 SOPAV SOPAV AMTEK AMTEK
UL867 AMTEK AMTEK PEKOT PEKOT 
UL867 PEKOT PEKOT SUI SUI

UL979 GOVEN GOVEN KELOD KELOD
UL979 KELOD KELOD ENOBI ENOBI

UL980 USTIL USTIL OMAVA OMAVA 
UL980 OMAVA OMAVA LDZ LDZ
UL980 LDZ LDZ SUBAX SUBAX
UL980 SUBAX SUBAX INDIG INDIG 
UL980 INDIG INDIG CZE CZE
UL980 CZE CZE KELOD KELOD 
UL980 KELOD KELOD SUI SUI

UL981 DIBED DIBED JED JED
UL981 JED JED MAKOV MAKOV 
UL981 MAKOV MAKOV BADNO BADNO
UL981 BADNO BADNO CZE CZE

UL984 DIBED DIBED LUXAR LUXAR 
UL984 LUXAR LUXAR ADOKI ADOKI 
UL984 ADOKI ADOKI SKAVI SKAVI 
UL984 SKAVI SKAVI PADKA PADKA
UL984 PADKA PADKA SOPAV SOPAV 

UL986 TEPNA TEPNA ODRAP ODRAP
UL986 ODRAP ODRAP LUXAR LUXAR
UL986 LUXAR LUXAR SUDOL SUDOL
UL986 SUDOL SUDOL SABAB SABAB
UL986 SABAB SABAB GIGAL GIGAL
UL986 GIGAL GIGAL LASIS LASIS

UL996 DENKO DENKO CHO CHO

UL999 SUPAK SUPAK ADOKI ADOKI 
UL999 ADOKI ADOKI RILAB RILAB
UL999 RILAB RILAB TOSPO TOSPO

UM66 BABKO BABKO EVINA EVINA

UM602 CHO CHO BINKA BINKA

UM70 TOLPA TOLPA SOMOX SOMOX
UM70 SOMOX SOMOX LDZ LDZ
UM70 LDZ LDZ BABEN BABEN

UM607 BURAN BURAN AMPAK AMPAK
UM607 AMPAK AMPAK PENOR PENOR

UM743 KRT KRT SUROD SUROD 
UM743 SUROD SUROD PIVET PIVET 
UM743 PIVET PIVET GORPI GORPI

UM857 PODAN PODAN RILAB RILAB
UM857 RILAB RILAB VENES VENES 
UM857 VENES VENES EGLON EGLON
UM857 EGLON EGLON GERVI GERVI
UM857 GERVI GERVI XESNA XESNA
UM857 XESNA XESNA BULEP BULEP 
UM857 BULEP BULEP SUW SUW
UM857 SUW SUW BOKSU BOKSU

UM860 ROLKA ROLKA EGLON EGLON
UM860 EGLON EGLON XIMBA XIMBA

UM863 LDZ LDZ GERVI GERVI
UM863 GERVI GERVI ETUBO ETUBO
UM863 ETUBO ETUBO RUDKA RUDKA

UM865 LARMA LARMA LATMI LATMI

UM866 BABKO BABKO JED JED
UM866 JED JED LOGDA LOGDA
UM866 LOGDA LOGDA GERVI GERVI

UM977 DIBED DIBED OSMAT OSMAT 
UM977 OSMAT OSMAT BALBA BALBA 
UM977 BALBA BALBA ETUBO ETUBO 
UM977 ETUBO ETUBO BESOT BESOT 
UM977 BESOT BESOT EVODO EVODO
UM977 EVODO EVODO SUW SUW

UM984 TUSIN TUSIN IBEKA IBEKA 
UM984 IBEKA IBEKA JED JED
UM984 JED JED LETKI LETKI

UM985 MEBAN MEBAN JAB JAB
UM985 JAB JAB SKAVI SKAVI 
UM985 SKAVI SKAVI JED JED
UM985 JED JED EVINA EVINA
UM985 EVINA EVINA XATOG XATOG 
UM985 XATOG XATOG SUW SUW
UM985 SUW SUW BOKSU BOKSU

UM993 OLPAD OLPAD ATLOK ATLOK

UM994 GILAS GILAS DENKO DENKO
UM994 DENKO DENKO TADAK TADAK 
UM994 TADAK TADAK ODLOT ODLOT
UM994 ODLOT ODLOT KMI KMI
UM994 KMI KMI GOMED GOMED

UN5 VENES VENES LIMVI LIMVI
UN5 LIMVI LIMVI GITOV GITOV

UN133 LENOV LENOV JED JED
UN133 JED JED LDZ LDZ
UN133 LDZ LDZ GRU GRU
UN133 GRU GRU KRT KRT
UN133 KRT KRT VAPOS VAPOS 
UN133 VAPOS VAPOS DOMAG DOMAG 
UN133 DOMAG DOMAG MOTAD MOTAD 
UN133 MOTAD MOTAD PENOR PENOR

UN191 USTIL USTIL SOMOX SOMOX
UN191 SOMOX SOMOX LIMVI LIMVI
UN191 LIMVI LIMVI OLILA OLILA
UN191 OLILA OLILA GRU GRU
UN191 GRU GRU KMI KMI

UN195 LIMVI LIMVI SORIX SORIX
UN195 SORIX SORIX UNDUK UNDUK 
UN195 UNDUK UNDUK OGRES OGRES
UN195 OGRES OGRES ELPOL ELPOL
UN195 ELPOL ELPOL KOLOB KOLOB

UN744 TUSIN TUSIN EVINA EVINA
UN744 EVINA EVINA WAR WAR

UN746 BINKA BINKA DEMUR DEMUR 
UN746 DEMUR DEMUR BABEN BABEN 
UN746 BABEN BABEN GORPI GORPI

UN858 SUI SUI DENKO DENKO
UN858 DENKO DENKO DEKUT DEKUT 
UN858 DEKUT DEKUT EBOGU EBOGU 
UN858 EBOGU EBOGU GRU GRU
UN858 GRU GRU OSKUD OSKUD
UN858 OSKUD OSKUD TUROL TUROL 
UN858 TUROL TUROL LIMKO LIMKO 
UN858 LIMKO LIMKO BOKSU BOKSU

UN869 TOMTI TOMTI SUBAX SUBAX
UN869 SUBAX SUBAX SOXER SOXER
UN869 SOXER SOXER KUKOP KUKOP
UN869 KUKOP KUKOP WAR WAR
UN869 WAR WAR TOXAR TOXAR
UN869 TOXAR TOXAR RUDKA RUDKA

UN871 LAGAR LAGAR MISKA MISKA 
UN871 MISKA MISKA OKENO OKENO
UN871 OKENO OKENO LDZ LDZ
UN871 LDZ LDZ KUKOP KUKOP
UN871 KUKOP KUKOP WAR WAR
UN871 WAR WAR SUW SUW

UN983 DIBED DIBED LDZ LDZ
UN983 LDZ LDZ AMUTO AMUTO 
UN983 AMUTO AMUTO MAPEX MAPEX
UN983 MAPEX MAPEX ELPOL ELPOL
UN983 ELPOL ELPOL AMROR AMROR

UP31 GOVEN GOVEN BURAN BURAN 
UP31 BURAN BURAN VAPOS VAPOS 
UP31 VAPOS VAPOS KUNER KUNER

UP96 ODERA ODERA GUDON GUDON 

UP139 SUPAK SUPAK GERVI GERVI

UP150 CZE CZE AMUTO AMUTO 
UP150 AMUTO AMUTO BIMPA BIMPA

UP193 KELEL KELEL TRZ TRZ

UP733 TOMTI TOMTI CZE CZE
UP733 CZE CZE EBOGU EBOGU
UP733 EBOGU EBOGU LODNI LODNI
UP733 LODNI LODNI KMI KMI
UL733 KMI KMI IPLIT IPLIT

UP746 LUGOL LUGOL ODRAP ODRAP 
UP746 ODRAP ODRAP JED JED

UP851 ABERO ABERO GERVI GERVI
UP851 GERVI GERVI NEPOX NEPOX
UP851 NEPOX NEPOX WAR WAR
UP851 WAR WAR BIMPA BIMPA 
UP851 BIMPA BIMPA MOLIL MOLIL 
UP851 MOLIL MOLIL IDEXU IDEXU 
UP851 IDEXU IDEXU DENKO DENKO

UP861 RASAN RASAN LATAG LATAG 
UP861 LATAG LATAG GINOK GINOK 
UP861 GINOK GINOK ODLOT ODLOT 
UP861 ODLOT ODLOT KRT KRT
UP861 KRT KRT RANOK RANOK

UP866 GOTIX GOTIX OSMAT OSMAT 
UP866 OSMAT OSMAT NEVAP NEVAP
UP866 NEVAP NEVAP EGLON EGLON
UP866 EGLON EGLON LIMVI LIMVI

UQ10 PADKA PADKA JED JED

UQ277 OKENO OKENO GOGUS GOGUS
UQ277 GOGUS GOGUS AGAVA AGAVA

UT708 BAREX BAREX TRZ TRZ
UT708 TRZ TRZ DIMEX DIMEX 
UT708 DIMEX DIMEX GOVEN GOVEN

UT709 BAVOK BAVOK KTC KTC
UT709 KTC KTC JED JED

UT710 IBEKA IBEKA ORSOX ORSOX
UT710 ORSOX ORSOX MAPIK MAPIK 
UT710 MAPIK MAPIK SABAB SABAB 
UT710 SABAB SABAB NUDRO NUDRO 
UT710 NUDRO NUDRO TRZ TRZ
UT710 TRZ TRZ VELAB VELAB 
UT710 VELAB VELAB KULUV KULUV 
UT710 KULUV KULUV SUI SUI

UT711 KORUP KORUP LATAG LATAG
UT711 LATAG LATAG INDIG INDIG
UT711 INDIG INDIG LOLSI LOLSI
UT711 LOLSI LOLSI WAR WAR
UT711 WAR WAR XATOG XATOG 
UT711 XATOG XATOG BULEP BULEP 
UT711 BULEP BULEP BESOT BESOT 
UT711 BESOT BESOT GORAT GORAT

UT714 MAPIK MAPIK LASIS LASIS

UT720 REGLI REGLI MIXAT MIXAT
UT720 MIXAT MIXAT MOLIL MOLIL 
UT720 MOLIL MOLIL GRU GRU

UT727 DENKO DENKO DELIR DELIR 
UT727 DELIR DELIR GONTU GONTU 
UT727 GONTU GONTU ELKAR ELKAR 
UT727 ELKAR ELKAR SUW SUW

UT738 KRW KRW ORSOX ORSOX
UT738 ORSOX ORSOX NUMBA NUMBA
UT738 NUMBA NUMBA DINOV DINOV 
UT738 DINOV DINOV LASIS LASIS

UY100 BURAN BURAN ELPOL ELPOL

UY209 KELOD KELOD ARSAP ARSAP

UY210 PEKOT PEKOT OLUMA OLUMA
UY210 OLUMA OLUMA ARSAP ARSAP

UY225 BODLA BODLA OSKUD OSKUD

UZ72 KRT KRT KUNER KUNER

UZ80 TILAV TILAV GORPI GORPI

UZ121 NETIR NETIR SKAVI SKAVI

UZ159 REGLI REGLI OSKEX OSKEX
UZ159 OSKEX OSKEX MAVOT MAVOT
UZ159 MAVOT MAVOT NILPU NILPU

UZ181 XIGRI XIGRI ELSUP ELSUP
UZ181 ELSUP ELSUP UBOMI UBOMI

UZ182 ABERO ABERO ASLUX ASLUX
UZ182 ASLUX ASLUX BAMSO BAMSO

UZ460 ASLUX ASLUX XESNA XESNA
UZ460 XESNA XESNA TOXAR TOXAR
UZ460 TOXAR TOXAR BESOT BESOT

UZ491 BODLA BODLA CHO CHO
UZ491 CHO CHO DEMUR DEMUR
UZ491 DEMUR DEMUR XELOL XELOL
UZ491 XELOL XELOL EKRON EKRON
UZ491 EKRON EKRON POKEN POKEN

UZ717 BODLA BODLA KUNER KUNER

[GEO]



;CTR EPBY
CTR_ALL N053.07.15.000 E017.32.10.000 N052.57.24.000 E017.33.21.000 cctr
N052.57.24.000 E017.33.21.000 N052.58.03.000 E018.29.39.000 cctr
N052.58.03.000 E018.29.39.000 N053.15.55.000 E018.27.26.000 cctr
N053.15.55.000 E018.27.26.000 N053.15.55.000 E018.12.18.000 cctr
N053.15.55.000 E018.12.18.000 N053.07.15.000 E017.32.10.000 cctr

;CTR EPWA
N052.12.28.000 E020.42.01.000 N052.15.32.000 E020.46.15.000 cctr
N052.15.32.000 E020.46.15.000 N052.15.47.000 E020.50.10.000 cctr
N052.15.47.000 E020.50.10.000 N052.15.48.000 E020.55.56.000 cctr
N052.15.48.000 E020.55.56.000 N052.15.38.000 E020.57.05.000 cctr
N052.15.38.000 E020.57.05.000 N052.15.30.000 E020.57.30.000 cctr
N052.15.30.000 E020.57.30.000 N052.15.08.000 E021.00.53.000 cctr
N052.15.08.000 E021.00.53.000 N052.11.03.000 E021.06.13.000 cctr
N052.11.03.000 E021.06.13.000 N052.07.57.000 E021.10.36.000 cctr
N052.07.57.000 E021.10.36.000 N052.02.23.000 E021.07.19.000 cctr
N052.02.23.000 E021.07.19.000 N052.00.43.000 E021.00.38.000 cctr
N052.00.43.000 E021.00.38.000 N052.08.52.000 E020.45.47.000 cctr
N052.08.52.000 E020.45.47.000 N052.12.28.000 E020.42.01.000 cctr


;CTR EPGD
N054.29.00.000 E018.13.07.000 N054.26.56.000 E018.32.40.000 cctr
N054.26.56.000 E018.32.40.000 N054.22.33.000 E018.47.11.000 cctr
N054.22.33.000 E018.47.11.000 N054.15.24.000 E018.41.58.000 cctr
N054.15.24.000 E018.41.58.000 N054.16.00.000 E018.35.08.000 cctr
N054.16.00.000 E018.35.08.000 N054.16.30.000 E018.19.00.000 cctr
N054.16.30.000 E018.19.00.000 N054.20.00.000 E018.09.00.000 cctr
N054.20.00.000 E018.09.00.000 N054.24.24.000 E018.09.47.000 cctr
N054.24.24.000 E018.09.47.000 N054.29.00.000 E018.13.07.000 cctr


;CTR EPKK
N050.05.19.000 E019.26.22.000 N050.09.03.000 E019.40.16.000 cctr
N050.09.03.000 E019.40.16.000 N050.11.14.000 E019.52.49.000 cctr
N050.11.14.000 E019.52.49.000 N050.11.11.000 E020.09.41.000 cctr
N050.11.11.000 E020.09.41.000 N050.06.02.000 E020.11.29.000 cctr
N050.06.02.000 E020.11.29.000 N050.03.32.000 E020.04.27.000 cctr
N050.03.32.000 E020.04.27.000 N049.57.27.000 E019.29.23.000 cctr
N049.57.27.000 E019.29.23.000 N049.57.36.180 E019.28.57.828 cctr ;arc beg
N049.57.36.180 E019.28.57.828 N049.57.49.644 E019.28.34.104 cctr
N049.57.49.644 E019.28.34.104 N049.58.03.935 E019.28.11.496 cctr
N049.58.03.935 E019.28.11.496 N049.58.18.948 E019.27.50.075 cctr
N049.58.18.948 E019.27.50.075 N049.58.34.643 E019.27.29.916 cctr
N049.58.34.643 E019.27.29.916 N049.58.50.987 E019.27.11.052 cctr
N049.58.50.987 E019.27.11.052 N049.59.07.980 E019.26.53.591 cctr
N049.59.07.980 E019.26.53.591 N049.59.25.512 E019.26.37.500 cctr
N049.59.25.512 E019.26.37.500 N049.59.43.584 E019.26.22.847 cctr
N049.59.43.584 E019.26.22.847 N050.00.02.087 E019.26.09.707 cctr
N050.00.02.087 E019.26.09.707 N050.00.21.023 E019.25.58.080 cctr
N050.00.21.023 E019.25.58.080 N050.00.40.320 E019.25.48.035 cctr
N050.00.40.320 E019.25.48.035 N050.00.59.939 E019.25.39.575 cctr
N050.00.59.939 E019.25.39.575 N050.01.19.812 E019.25.32.700 cctr
N050.01.19.812 E019.25.32.700 N050.01.39.899 E019.25.27.479 cctr
N050.01.39.899 E019.25.27.479 N050.02.00.131 E019.25.23.880 cctr
N050.02.00.131 E019.25.23.880 N050.02.20.435 E019.25.21.936 cctr
N050.02.20.435 E019.25.21.936 N050.02.40.812 E019.25.21.683 cctr
N050.02.40.812 E019.25.21.683 N050.03.01.116 E019.25.23.051 cctr
N050.03.01.116 E019.25.23.051 N050.03.21.383 E019.25.26.111 cctr
N050.03.21.383 E019.25.26.111 N050.03.41.507 E019.25.30.791 cctr
N050.03.41.507 E019.25.30.791 N050.04.01.452 E019.25.37.092 cctr
N050.04.01.452 E019.25.37.092 N050.04.21.179 E019.25.45.047 cctr
N050.04.21.179 E019.25.45.047 N050.04.40.583 E019.25.54.551 cctr
N050.04.40.583 E019.25.54.551 N050.04.59.664 E019.26.05.675 cctr
N050.04.59.664 E019.26.05.675 N050.05.19.000 E019.26.22.000 cctr ;arc end

;CTR EPKT
N050.33.38.000 E018.46.03.000 N050.34.32.000 E019.00.11.000 cctr
N050.34.32.000 E019.00.11.000 N050.34.40.000 E019.13.46.000 cctr
N050.34.40.000 E019.13.46.000 N050.33.32.000 E019.28.02.000 cctr
N050.33.32.000 E019.28.02.000 N050.31.00.000 E019.29.13.000 cctr
N050.31.00.000 E019.29.13.000 N050.28.23.000 E019.29.25.000 cctr
N050.28.23.000 E019.29.25.000 N050.26.26.000 E019.29.00.000 cctr
N050.26.26.000 E019.29.00.000 N050.25.05.000 E019.21.22.000 cctr
N050.25.05.000 E019.21.22.000 N050.25.04.000 E018.46.55.000 cctr
N050.25.04.000 E018.46.55.000 N050.27.34.000 E018.43.29.000 cctr
N050.27.34.000 E018.43.29.000 N050.30.29.000 E018.43.23.000 cctr
N050.30.29.000 E018.43.23.000 N050.33.38.000 E018.46.03.000 cctr

;CTR EPLL
N051.47.18.000 E019.05.05.000 N051.54.08.000 E019.41.09.000 cctr
N051.54.08.000 E019.41.09.000 N051.42.44.000 E019.47.06.000 cctr
N051.42.44.000 E019.47.06.000 N051.41.15.000 E019.39.03.000 cctr
N051.41.15.000 E019.39.03.000 N051.42.39.000 E019.30.43.000 cctr
N051.42.39.000 E019.30.43.000 N051.37.16.000 E019.18.20.000 cctr
N051.37.16.000 E019.18.20.000 N051.39.28.000 E019.09.31.000 cctr
N051.39.28.000 E019.09.31.000 N051.47.18.000 E019.05.05.000 cctr


;CTR EPPO
N052.33.21.000 E016.31.18.000 N052.26.13.000 E016.59.20.000 cctr
N052.26.13.000 E016.59.20.000 N052.24.29.000 E017.06.02.000 cctr
N052.24.29.000 E017.06.02.000 N052.20.13.000 E017.04.15.000 cctr
N052.20.13.000 E017.04.15.000 N052.21.12.000 E016.55.25.000 cctr
N052.21.12.000 E016.55.25.000 N052.23.33.000 E016.42.47.000 cctr
N052.23.33.000 E016.42.47.000 N052.26.17.000 E016.28.09.000 cctr
N052.26.17.000 E016.28.09.000 N052.33.21.000 E016.31.18.000 cctr

;CTR POZNAN KRZESINY
N052.23.33.000 E016.42.47.000 N052.21.12.000 E016.55.25.000 cctr
N052.21.12.000 E016.55.25.000 N052.20.46.000 E016.59.08.000 cctr
N052.20.46.000 E016.59.08.000 N052.20.14.000 E017.04.05.000 cctr
N052.20.14.000 E017.04.05.000 N052.18.21.000 E017.20.45.000 cctr
N052.18.21.000 E017.20.45.000 N052.08.45.000 E017.16.09.000 cctr
N052.08.45.000 E017.16.09.000 N052.16.10.000 E016.39.41.000 cctr
N052.16.10.000 E016.39.41.000 N052.23.33.000 E016.42.47.000 cctr

;CTR EPRZ
N050.01.00.000 E021.45.00.000 N050.14.08.000 E021.45.03.000 cctr
N050.14.08.000 E021.45.03.000 N050.14.02.000 E022.17.04.000 cctr
N050.14.02.000 E022.17.04.000 N050.01.00.000 E022.17.00.000 cctr
N050.01.00.000 E022.17.00.000 N050.01.00.000 E021.45.00.000 cctr

;CTR EPSC
N053.26.55.144 E015.09.50.285 N053.26.12.266 E015.08.34.684 cctr
N053.26.12.266 E015.08.34.684 N053.25.37.844 E015.07.07.710 cctr
N053.25.37.844 E015.07.07.710 N053.25.12.927 E015.05.32.090 cctr
N053.25.12.927 E015.05.32.090 N053.24.58.270 E015.03.50.478 cctr
N053.24.58.270 E015.03.50.478 N053.24.54.319 E015.02.06.213 cctr
N053.24.54.319 E015.02.06.213 N053.25.01.193 E015.00.22.378 cctr
N053.25.01.193 E015.00.22.378 N053.25.18.685 E014.58.42.128 cctr
N053.25.18.685 E014.58.42.128 N053.25.46.263 E014.57.08.509 cctr
N053.25.46.263 E014.57.08.509 N053.26.23.896 E014.55.44.366 cctr
N053.26.23.896 E014.55.44.366 N053.27.04.370 E014.54.40.431 cctr
N053.27.04.370 E014.54.40.431 N053.37.56.150 E014.39.33.130 cctr
N053.37.56.150 E014.39.33.130 N053.46.20.600 E014.50.09.211 cctr
N053.46.20.600 E014.50.09.211 N053.45.56.599 E014.54.45.539 cctr
N053.45.56.599 E014.54.45.539 N053.34.32.480 E015.10.06.981 cctr
N053.34.32.480 E015.10.06.981 N053.33.41.479 E015.11.06.373 cctr
N053.33.41.479 E015.11.06.373 N053.32.44.570 E015.11.48.278 cctr
N053.32.44.570 E015.11.48.278 N053.31.44.199 E015.12.12.928 cctr
N053.31.44.199 E015.12.12.928 N053.30.42.200 E015.12.19.572 cctr
N053.30.42.200 E015.12.19.572 N053.29.40.457 E015.12.08.109 cctr
N053.29.40.457 E015.12.08.109 N053.28.40.846 E015.11.38.594 cctr
N053.28.40.846 E015.11.38.594 N053.27.45.178 E015.10.52.216 cctr
N053.27.45.178 E015.10.52.216 N053.26.55.144 E015.09.50.285 cctr


;CTR EPWR
N051.13.10.000 E016.34.10.000 N051.13.10.000 E016.40.29.000 cctr
N051.13.10.000 E016.40.29.000 N051.05.39.000 E017.08.31.000 cctr
N051.05.39.000 E017.08.31.000 N050.55.41.000 E017.00.17.000 cctr
N050.55.41.000 E017.00.17.000 N050.57.23.000 E016.54.44.000 cctr
N050.57.23.000 E016.54.44.000 N050.59.26.000 E016.52.17.000 cctr
N050.59.26.000 E016.52.17.000 N051.02.25.000 E016.35.10.000 cctr
N051.02.25.000 E016.35.10.000 N051.06.27.000 E016.29.38.000 cctr
N051.06.27.000 E016.29.38.000 N051.13.10.000 E016.34.10.000 cctr

;CTR EPZG
N052.16.16.000 E015.33.52.000 N052.19.11.000 E015.52.23.000 cctr
N052.19.11.000 E015.52.23.000 N052.17.17.000 E016.08.17.000 cctr
N052.17.17.000 E016.08.17.000 N052.11.44.000 E016.12.11.000 cctr
N052.11.44.000 E016.12.11.000 N052.01.52.000 E016.03.44.000 cctr
N052.01.52.000 E016.03.44.000 N052.01.40.000 E015.38.26.000 cctr
N052.01.40.000 E015.38.26.000 N052.10.42.000 E015.31.06.000 cctr
N052.10.42.000 E015.31.06.000 N052.16.16.000 E015.33.52.000 cctr


;EPWA_MRVA
MRVA_ADDITIONAL_LINES N052.09.35.855 E020.56.17.051 N052.08.18.276 E020.53.22.920 mrva
N052.08.18.276 E020.53.22.920 N052.05.21.863 E020.46.41.847 mrva
N052.09.35.855 E020.56.17.051 N052.09.37.584 E020.56.15.071 mrva
N052.09.37.584 E020.56.15.071 N052.09.39.348 E020.56.13.200 mrva
N052.09.39.348 E020.56.13.200 N052.09.41.148 E020.56.11.472 mrva
N052.09.41.148 E020.56.11.472 N052.09.42.984 E020.56.09.816 mrva
N052.09.42.984 E020.56.09.816 N052.09.44.819 E020.56.08.267 mrva
N052.09.44.819 E020.56.08.267 N052.09.46.727 E020.56.06.828 mrva
N052.09.46.727 E020.56.06.828 N052.09.48.671 E020.56.05.460 mrva
N052.09.48.671 E020.56.05.460 N052.09.50.615 E020.56.04.235 mrva
N052.09.50.615 E020.56.04.235 N052.09.52.596 E020.56.03.156 mrva
N052.09.52.596 E020.56.03.156 N052.09.54.612 E020.56.02.148 mrva
N052.09.54.612 E020.56.02.148 N052.09.56.628 E020.56.01.247 mrva
N052.09.56.628 E020.56.01.247 N052.09.58.643 E020.56.00.491 mrva
N052.09.58.643 E020.56.00.491 N052.10.00.732 E020.55.59.843 mrva
N052.10.00.732 E020.55.59.843 N052.10.02.783 E020.55.59.304 mrva
N052.10.02.783 E020.55.59.304 N052.10.04.871 E020.55.58.871 mrva
N052.10.04.871 E020.55.58.871 N052.10.06.959 E020.55.58.583 mrva
N052.10.06.959 E020.55.58.583 N052.10.09.047 E020.55.58.404 mrva
N052.10.09.047 E020.55.58.404 N052.10.11.135 E020.55.58.368 mrva
N052.10.11.135 E020.55.58.368 N052.10.13.224 E020.55.58.404 mrva
N052.10.13.224 E020.55.58.404 N052.10.15.312 E020.55.58.583 mrva
N052.10.15.312 E020.55.58.583 N052.10.17.400 E020.55.58.871 mrva
N052.10.17.400 E020.55.58.871 N052.10.19.488 E020.55.59.304 mrva
N052.10.19.488 E020.55.59.304 N052.10.21.539 E020.55.59.843 mrva
N052.10.21.539 E020.55.59.843 N052.10.23.627 E020.56.00.491 mrva
N052.10.23.627 E020.56.00.491 N052.10.25.643 E020.56.01.247 mrva
N052.10.25.643 E020.56.01.247 N052.10.27.659 E020.56.02.148 mrva
N052.10.27.659 E020.56.02.148 N052.10.29.675 E020.56.03.156 mrva
N052.10.29.675 E020.56.03.156 N052.10.31.656 E020.56.04.235 mrva
N052.10.31.656 E020.56.04.235 N052.10.33.600 E020.56.05.460 mrva
N052.10.33.600 E020.56.05.460 N052.10.35.544 E020.56.06.828 mrva
N052.10.35.544 E020.56.06.828 N052.10.37.452 E020.56.08.267 mrva
N052.10.37.452 E020.56.08.267 N052.10.39.287 E020.56.09.816 mrva
N052.10.39.287 E020.56.09.816 N052.10.41.123 E020.56.11.472 mrva
N052.10.41.123 E020.56.11.472 N052.10.42.923 E020.56.13.200 mrva
N052.10.42.923 E020.56.13.200 N052.10.44.687 E020.56.15.071 mrva
N052.10.44.687 E020.56.15.071 N052.10.46.416 E020.56.17.051 mrva
N052.10.46.416 E020.56.17.051 N052.10.48.071 E020.56.19.103 mrva
N052.10.48.071 E020.56.19.103 N052.10.49.691 E020.56.21.227 mrva
N052.10.49.691 E020.56.21.227 N052.10.51.275 E020.56.23.495 mrva
N052.10.51.275 E020.56.23.495 N052.10.52.823 E020.56.25.800 mrva
N052.10.52.823 E020.56.25.800 N052.10.54.300 E020.56.28.211 mrva
N052.10.54.300 E020.56.28.211 N052.10.55.740 E020.56.30.732 mrva
N052.10.55.740 E020.56.30.732 N052.10.57.107 E020.56.33.287 mrva
N052.10.57.107 E020.56.33.287 N052.10.58.404 E020.56.35.951 mrva
N052.10.58.404 E020.56.35.951 N052.10.59.663 E020.56.38.687 mrva
N052.10.59.663 E020.56.38.687 N052.11.00.887 E020.56.41.459 mrva
N052.11.00.887 E020.56.41.459 N052.11.02.003 E020.56.44.340 mrva
N052.11.02.003 E020.56.44.340 N052.11.03.084 E020.56.47.255 mrva
N052.11.03.084 E020.56.47.255 N052.11.04.128 E020.56.50.243 mrva
N052.11.04.128 E020.56.50.243 N052.11.05.063 E020.56.53.303 mrva
N052.11.05.063 E020.56.53.303 N052.11.05.963 E020.56.56.400 mrva
N052.11.05.963 E020.56.56.400 N052.11.06.755 E020.56.59.532 mrva
N052.11.06.755 E020.56.59.532 N052.11.07.512 E020.57.02.735 mrva
N052.11.07.512 E020.57.02.735 N052.11.08.195 E020.57.05.940 mrva
N052.11.08.195 E020.57.05.940 N052.11.08.808 E020.57.09.215 mrva
N052.11.08.808 E020.57.09.215 N052.11.09.347 E020.57.12.527 mrva
N052.11.09.347 E020.57.12.527 N052.11.09.815 E020.57.15.839 mrva
N052.11.09.815 E020.57.15.839 N052.11.10.211 E020.57.19.188 mrva
N052.11.10.211 E020.57.19.188 N052.11.10.535 E020.57.22.571 mrva
N052.11.10.535 E020.57.22.571 N052.11.10.824 E020.57.25.955 mrva
N052.11.10.824 E020.57.25.955 N052.11.11.004 E020.57.29.339 mrva
N052.11.11.004 E020.57.29.339 N052.11.11.111 E020.57.32.759 mrva
N052.11.11.111 E020.57.32.759 N052.11.11.148 E020.57.36.179 mrva
N052.11.11.148 E020.57.36.179 N052.11.11.111 E020.57.39.599 mrva
N052.11.11.111 E020.57.39.599 N052.11.11.004 E020.57.43.020 mrva
N052.11.11.004 E020.57.43.020 N052.11.10.824 E020.57.46.404 mrva
N052.11.10.824 E020.57.46.404 N052.11.10.535 E020.57.49.788 mrva
N052.11.10.535 E020.57.49.788 N052.11.10.211 E020.57.53.172 mrva
N052.11.10.211 E020.57.53.172 N052.11.09.815 E020.57.56.519 mrva
N052.11.09.815 E020.57.56.519 N052.11.09.347 E020.57.59.831 mrva
N052.11.09.347 E020.57.59.831 N052.11.08.808 E020.58.03.143 mrva
N052.11.08.808 E020.58.03.143 N052.11.08.195 E020.58.06.420 mrva
N052.11.08.195 E020.58.06.420 N052.11.07.512 E020.58.09.623 mrva
N052.11.07.512 E020.58.09.623 N052.11.06.755 E020.58.12.828 mrva
N052.11.06.755 E020.58.12.828 N052.11.05.963 E020.58.15.959 mrva
N052.11.05.963 E020.58.15.959 N052.11.05.063 E020.58.19.055 mrva
N052.11.05.063 E020.58.19.055 N052.11.04.128 E020.58.22.115 mrva
N052.11.04.128 E020.58.22.115 N052.11.03.084 E020.58.25.103 mrva
N052.11.03.084 E020.58.25.103 N052.11.02.003 E020.58.28.020 mrva
N052.11.02.003 E020.58.28.020 N052.11.00.887 E020.58.30.899 mrva
N052.11.00.887 E020.58.30.899 N052.10.59.663 E020.58.33.671 mrva
N052.10.59.663 E020.58.33.671 N052.10.58.404 E020.58.36.408 mrva
N052.10.58.404 E020.58.36.408 N052.10.57.107 E020.58.39.071 mrva
N052.10.57.107 E020.58.39.071 N052.10.55.740 E020.58.41.627 mrva
N052.10.55.740 E020.58.41.627 N052.10.54.300 E020.58.44.147 mrva
N052.10.54.300 E020.58.44.147 N052.10.52.823 E020.58.46.560 mrva
N052.10.52.823 E020.58.46.560 N052.10.51.275 E020.58.48.863 mrva
N052.10.51.275 E020.58.48.863 N052.10.49.691 E020.58.51.131 mrva
N052.10.49.691 E020.58.51.131 N052.10.48.071 E020.58.53.255 mrva
N052.10.48.071 E020.58.53.255 N052.10.46.416 E020.58.55.308 mrva
N052.10.46.416 E020.58.55.308 N052.10.44.687 E020.58.57.287 mrva
N052.10.44.687 E020.58.57.287 N052.10.42.923 E020.58.59.160 mrva
N052.10.42.923 E020.58.59.160 N052.10.41.123 E020.59.00.887 mrva
N052.10.41.123 E020.59.00.887 N052.10.39.287 E020.59.02.544 mrva
N052.10.39.287 E020.59.02.544 N052.10.37.452 E020.59.04.092 mrva
N052.10.37.452 E020.59.04.092 N052.10.35.544 E020.59.05.532 mrva
N052.10.35.544 E020.59.05.532 N052.10.33.600 E020.59.06.900 mrva
N052.10.33.600 E020.59.06.900 N052.10.31.656 E020.59.08.123 mrva
N052.10.31.656 E020.59.08.123 N052.10.29.675 E020.59.09.204 mrva
N052.10.29.675 E020.59.09.204 N052.10.27.659 E020.59.10.212 mrva
N052.10.27.659 E020.59.10.212 N052.10.25.643 E020.59.11.111 mrva
N052.10.25.643 E020.59.11.111 N052.10.23.627 E020.59.11.868 mrva
N052.10.23.627 E020.59.11.868 N052.10.21.539 E020.59.12.515 mrva
N052.10.21.539 E020.59.12.515 N052.10.19.488 E020.59.13.055 mrva
N052.10.19.488 E020.59.13.055 N052.10.17.400 E020.59.13.487 mrva
N052.10.17.400 E020.59.13.487 N052.10.15.312 E020.59.13.775 mrva
N052.10.15.312 E020.59.13.775 N052.10.13.224 E020.59.13.956 mrva
N052.10.13.224 E020.59.13.956 N052.10.11.135 E020.59.13.992 mrva
N052.10.11.135 E020.59.13.992 N052.10.09.047 E020.59.13.956 mrva
N052.10.09.047 E020.59.13.956 N052.10.06.959 E020.59.13.775 mrva
N052.10.06.959 E020.59.13.775 N052.10.04.871 E020.59.13.487 mrva
N052.10.04.871 E020.59.13.487 N052.10.02.783 E020.59.13.055 mrva
N052.10.02.783 E020.59.13.055 N052.10.00.732 E020.59.12.515 mrva
N052.10.00.732 E020.59.12.515 N052.09.58.643 E020.59.11.868 mrva
N052.09.58.643 E020.59.11.868 N052.09.56.628 E020.59.11.111 mrva
N052.09.56.628 E020.59.11.111 N052.09.54.612 E020.59.10.212 mrva
N052.09.54.612 E020.59.10.212 N052.09.52.596 E020.59.09.204 mrva
N052.09.52.596 E020.59.09.204 N052.09.50.615 E020.59.08.123 mrva
N052.09.50.615 E020.59.08.123 N052.09.48.671 E020.59.06.900 mrva
N052.09.48.671 E020.59.06.900 N052.06.25.000 E021.11.15.000 mrva
N052.06.25.000 E021.11.15.000 N051.59.39.300 E021.10.04.403 mrva
N052.11.00.887 E020.58.30.899 N052.14.07.760 E021.02.10.703 mrva
N052.06.59.255 E020.57.47.088 N052.06.59.148 E020.57.36.179 mrva
N052.06.59.148 E020.57.36.179 N052.06.59.255 E020.57.25.271 mrva
N052.06.59.255 E020.57.25.271 N052.06.59.615 E020.57.14.328 mrva
N052.06.59.615 E020.57.14.328 N052.07.00.192 E020.57.03.455 mrva
N052.07.00.192 E020.57.03.455 N052.07.01.020 E020.56.52.619 mrva
N052.07.01.020 E020.56.52.619 N052.07.02.064 E020.56.41.819 mrva
N052.07.02.064 E020.56.41.819 N052.07.03.323 E020.56.31.092 mrva
N052.07.03.323 E020.56.31.092 N052.07.04.835 E020.56.20.435 mrva
N052.07.04.835 E020.56.20.435 N052.07.06.564 E020.56.09.888 mrva
N052.07.06.564 E020.56.09.888 N052.07.08.543 E020.55.59.448 mrva
N052.07.08.543 E020.55.59.448 N052.07.10.703 E020.55.49.115 mrva
N052.07.10.703 E020.55.49.115 N052.07.13.116 E020.55.38.891 mrva
N052.07.13.116 E020.55.38.891 N052.07.15.744 E020.55.28.847 mrva
N052.07.15.744 E020.55.28.847 N052.07.18.551 E020.55.18.947 mrva
N052.07.18.551 E020.55.18.947 N052.07.21.611 E020.55.09.227 mrva
N052.07.21.611 E020.55.09.227 N052.07.24.852 E020.54.59.652 mrva
N052.07.24.852 E020.54.59.652 N052.07.28.308 E020.54.50.291 mrva
N052.07.28.308 E020.54.50.291 N052.07.31.944 E020.54.41.111 mrva
N052.07.31.944 E020.54.41.111 N052.07.35.795 E020.54.32.184 mrva
N052.07.35.795 E020.54.32.184 N052.07.39.827 E020.54.23.436 mrva
N052.07.39.827 E020.54.23.436 N052.07.44.040 E020.54.14.940 mrva
N052.07.44.040 E020.54.14.940 N052.07.48.468 E020.54.06.695 mrva
N052.07.48.468 E020.54.06.695 N052.07.53.039 E020.53.58.704 mrva
N052.07.53.039 E020.53.58.704 N052.07.57.756 E020.53.51.000 mrva
N052.07.57.756 E020.53.51.000 N052.08.02.652 E020.53.43.548 mrva
N052.08.02.652 E020.53.43.548 N052.08.07.728 E020.53.36.383 mrva
N052.08.07.728 E020.53.36.383 N052.08.12.912 E020.53.29.507 mrva
N052.08.12.912 E020.53.29.507 N052.08.18.276 E020.53.22.920 mrva
N052.06.59.255 E020.57.47.088 N051.58.40.000 E020.58.15.000 mrva

;EPKK_MRVA
;EPKK LTMA A SECTOR [950] 1050
N050.21.21.039 E020.02.11.163 N050.21.07.424 E020.02.02.693 mrva
N050.21.07.424 E020.02.02.693 N050.06.39.851 E019.51.24.696 mrva ;
N050.06.39.851 E019.51.24.696 N050.06.55.836 E019.50.31.775 mrva ;
N050.06.55.836 E019.50.31.775 N050.07.12.432 E019.49.39.288 mrva ;
N050.07.12.432 E019.49.39.288 N050.07.29.604 E019.48.47.304 mrva ;
N050.07.29.604 E019.48.47.304 N050.07.47.352 E019.47.55.787 mrva ;
N050.07.47.352 E019.47.55.787 N050.08.05.640 E019.47.04.739 mrva ;
N050.08.05.640 E019.47.04.739 N050.08.24.504 E019.46.14.232 mrva ;
N050.08.24.504 E019.46.14.232 N050.05.50.207 E019.43.48.036 mrva ;
N050.05.50.207 E019.43.48.036 N050.06.11.304 E019.42.53.820 mrva ;
N050.06.11.304 E019.42.53.820 N050.06.32.939 E019.42.00.180 mrva ;
N050.06.32.939 E019.42.00.180 N050.06.55.188 E019.41.07.188 mrva ;
N050.06.55.188 E019.41.07.188 N050.07.18.047 E019.40.14.772 mrva ;
N050.07.18.047 E019.40.14.772 N050.07.41.448 E019.39.23.003 mrva ;
N050.07.41.448 E019.39.23.003 N050.08.05.423 E019.38.31.919 mrva ;
N050.08.05.423 E019.38.31.919 N050.08.29.976 E019.37.41.448 mrva ;
N050.08.29.976 E019.37.41.448 N050.08.55.067 E019.36.51.696 mrva ;
N050.08.55.067 E019.36.51.696 N050.05.25.260 E019.32.23.747 mrva ;
N050.05.25.260 E019.32.23.747 N050.05.53.880 E019.31.28.919 mrva ;
N050.05.53.880 E019.31.28.919 N050.06.23.148 E019.30.34.919 mrva ;
N050.06.23.148 E019.30.34.919 N050.06.52.956 E019.29.41.748 mrva ;
N050.06.52.956 E019.29.41.748 N050.07.23.375 E019.28.49.403 mrva ;
N050.07.23.375 E019.28.49.403 N050.07.54.372 E019.27.57.888 mrva ;
N050.07.54.372 E019.27.57.888 N050.08.25.944 E019.27.07.236 mrva ;
N050.08.25.944 E019.27.07.236 N050.08.58.055 E019.26.17.447 mrva ;
N050.08.58.055 E019.26.17.447 N050.09.30.744 E019.25.28.560 mrva ;
N050.09.30.744 E019.25.28.560 N050.10.03.936 E019.24.40.608 mrva ;
N050.10.03.936 E019.24.40.608 N050.10.33.608 E019.23.59.222 mrva ;

;[FL130] FL150
N049.22.09.228 E019.51.58.391 N049.13.17.712 E020.06.35.720 mrva ;
N049.22.09.228 E019.51.58.391 N049.22.01.631 E019.51.47.304 mrva ;
N049.22.01.631 E019.51.47.304 N049.21.54.179 E019.51.35.999 mrva ;
N049.21.54.179 E019.51.35.999 N049.21.46.836 E019.51.24.515 mrva ;
N049.21.46.836 E019.51.24.515 N049.21.39.636 E019.51.12.816 mrva ;
N049.21.39.636 E019.51.12.816 N049.21.32.544 E019.51.00.935 mrva ;
N049.21.32.544 E019.51.00.935 N049.21.25.595 E019.50.48.840 mrva ;
N049.21.25.595 E019.50.48.840 N049.21.18.827 E019.50.36.599 mrva ;
N049.21.18.827 E019.50.36.599 N049.21.12.168 E019.50.24.143 mrva ;
N049.21.12.168 E019.50.24.143 N049.21.05.615 E019.50.11.543 mrva ;
N049.21.05.615 E019.50.11.543 N049.20.59.243 E019.49.58.763 mrva ;
N049.20.59.243 E019.49.58.763 N049.20.53.015 E019.49.45.804 mrva ;
N049.20.53.015 E019.49.45.804 N049.20.46.932 E019.49.32.663 mrva ;
N049.20.46.932 E019.49.32.663 N049.20.41.027 E019.49.19.380 mrva ;
N049.20.41.027 E019.49.19.380 N049.20.35.231 E019.49.05.951 mrva ;
N049.20.35.231 E019.49.05.951 N049.20.29.616 E019.48.52.344 mrva ;
N049.20.29.616 E019.48.52.344 N049.20.24.144 E019.48.38.627 mrva ;
N049.20.24.144 E019.48.38.627 N049.20.18.816 E019.48.24.731 mrva ;
N049.20.18.816 E019.48.24.731 N049.20.13.668 E019.48.10.691 mrva ;
N049.20.13.668 E019.48.10.691 N049.20.08.664 E019.47.56.544 mrva ;
N049.20.08.664 E019.47.56.544 N049.20.03.840 E019.47.42.251 mrva ;
N049.20.03.840 E019.47.42.251 N049.20.03.146 E019.47.40.111 mrva ;

;arc near TUSIN
N049.42.13.332 E018.40.58.993 N049.42.59.796 E018.41.24.792 mrva ;
N049.42.59.796 E018.41.24.792 N049.43.40.043 E018.41.47.940 mrva ;
N049.43.40.043 E018.41.47.940 N049.44.19.968 E018.42.12.167 mrva ;
N049.44.19.968 E018.42.12.167 N049.44.59.639 E018.42.37.475 mrva ;
N049.44.59.639 E018.42.37.475 N049.45.39.024 E018.43.03.827 mrva ;
N049.45.39.024 E018.43.03.827 N049.46.18.083 E018.43.31.223 mrva ;
N049.46.18.083 E018.43.31.223 N049.46.56.819 E018.43.59.663 mrva ;
N049.46.56.819 E018.43.59.663 N049.47.35.267 E018.44.29.148 mrva ;
N049.47.35.267 E018.44.29.148 N049.48.13.356 E018.44.59.675 mrva ;
N049.48.13.356 E018.44.59.675 N049.48.51.084 E018.45.31.211 mrva ;
N049.48.51.084 E018.45.31.211 N049.49.28.452 E018.46.03.756 mrva ;
N049.49.28.452 E018.46.03.756 N049.50.05.423 E018.46.37.307 mrva ;
N049.50.05.423 E018.46.37.307 N049.50.42.036 E018.47.11.831 mrva ;
N049.50.42.036 E018.47.11.831 N049.51.18.251 E018.47.47.327 mrva ;
N049.51.18.251 E018.47.47.327 N049.51.54.072 E018.48.23.795 mrva ;
N049.51.54.072 E018.48.23.795 N049.52.29.423 E018.49.01.235 mrva ;
N049.52.29.423 E018.49.01.235 N049.53.04.379 E018.49.39.612 mrva ;
N049.53.04.379 E018.49.39.612 N049.53.38.904 E018.50.18.923 mrva ;
N049.53.38.904 E018.50.18.923 N049.54.12.959 E018.50.59.135 mrva ;
N049.54.12.959 E018.50.59.135 N049.54.46.583 E018.51.40.284 mrva ;
N049.54.46.583 E018.51.40.284 N049.55.19.703 E018.52.22.331 mrva ;
N049.55.19.703 E018.52.22.331 N049.55.52.356 E018.53.05.243 mrva ;
N049.55.52.356 E018.53.05.243 N049.56.24.503 E018.53.49.055 mrva ;
N049.56.24.503 E018.53.49.055 N049.56.56.792 E018.54.34.743 mrva ;

;sector EPKT A
N050.19.52.960 E019.03.48.955 N050.20.29.003 E019.03.25.415 mrva
N050.20.29.003 E019.03.25.415 N050.21.16.739 E019.02.55.751 mrva
N050.21.16.739 E019.02.55.751 N050.22.04.800 E019.02.27.419 mrva
N050.22.04.800 E019.02.27.419 N050.22.53.183 E019.02.00.419 mrva
N050.22.53.183 E019.02.00.419 N050.27.22.751 E019.22.35.075 mrva
N050.27.22.751 E019.22.35.075 N050.27.57.708 E019.22.16.607 mrva
N050.27.57.708 E019.22.16.607 N050.28.32.879 E019.21.59.148 mrva
N050.28.32.879 E019.21.59.148 N050.29.08.196 E019.21.42.624 mrva
N050.29.08.196 E019.21.42.624 N050.29.43.728 E019.21.27.108 mrva
N050.29.43.728 E019.21.27.108 N050.30.19.403 E019.21.12.528 mrva
N050.30.19.403 E019.21.12.528 N050.30.55.259 E019.20.58.992 mrva
N050.30.55.259 E019.20.58.992 N050.31.31.260 E019.20.46.391 mrva
N050.31.31.260 E019.20.46.391 N050.32.07.368 E019.20.34.799 mrva
N050.32.07.368 E019.20.34.799 N050.32.43.620 E019.20.24.216 mrva
N050.32.43.620 E019.20.24.216 N050.33.19.979 E019.20.14.603 mrva
N050.33.19.979 E019.20.14.603 N050.33.56.411 E019.20.06.036 mrva
N050.33.56.411 E019.20.06.036 N050.34.32.952 E019.19.58.439 mrva
N050.34.32.952 E019.19.58.439 N050.35.09.599 E019.19.51.852 mrva
N050.35.09.599 E019.19.51.852 N050.35.46.283 E019.19.46.271 mrva
N050.35.46.283 E019.19.46.271 N050.35.32.171 E019.15.31.787 mrva
N050.35.32.171 E019.15.31.787 N050.36.11.735 E019.15.26.855 mrva
N050.36.11.735 E019.15.26.855 N050.36.51.336 E019.15.23.039 mrva
N050.36.51.336 E019.15.23.039 N050.37.31.007 E019.15.20.303 mrva
N050.37.31.007 E019.15.20.303 N050.38.10.679 E019.15.18.683 mrva
N050.38.10.679 E019.15.18.683 N050.38.50.352 E019.15.18.108 mrva
N050.38.50.352 E019.15.18.108 N050.39.30.059 E019.15.18.683 mrva
N050.39.30.059 E019.15.18.683 N050.40.09.732 E019.15.20.303 mrva
N050.40.09.732 E019.15.20.303 N050.40.49.367 E019.15.23.039 mrva
N050.40.49.367 E019.15.23.039 N050.41.34.796 E019.15.26.958 mrva

;south of EPKK CTR
N049.53.47.114 E019.15.35.869 N049.54.09.647 E019.16.29.496 mrva ;
N049.54.09.647 E019.16.29.496 N049.54.41.688 E019.17.51.540 mrva ;
N049.54.41.688 E019.17.51.540 N049.55.11.856 E019.19.15.276 mrva ;
N049.55.11.856 E019.19.15.276 N049.55.40.079 E019.20.40.595 mrva ;
N049.55.40.079 E019.20.40.595 N049.56.06.396 E019.22.07.356 mrva ;
N049.56.06.396 E019.22.07.356 N049.56.30.695 E019.23.35.484 mrva ;
N049.56.30.695 E019.23.35.484 N049.56.52.980 E019.25.04.871 mrva ;
N049.56.52.980 E019.25.04.871 N049.57.13.212 E019.26.35.411 mrva ;
N049.57.13.212 E019.26.35.411 N049.57.31.391 E019.28.06.959 mrva ;
N049.57.31.391 E019.28.06.959 N049.57.47.520 E019.29.39.443 mrva ;
N049.57.47.520 E019.29.39.443 N049.58.01.488 E019.31.12.719 mrva ;
N049.58.01.488 E019.31.12.719 N049.58.13.367 E019.32.46.715 mrva ;
N049.58.13.367 E019.32.46.715 N049.58.23.088 E019.34.21.251 mrva ;
N049.58.23.088 E019.34.21.251 N049.58.30.683 E019.35.56.292 mrva ;
N049.58.30.683 E019.35.56.292 N049.58.36.083 E019.37.31.656 mrva ;
N049.58.36.083 E019.37.31.656 N049.58.39.360 E019.39.07.272 mrva ;
N049.58.39.360 E019.39.07.272 N049.58.40.439 E019.40.42.995 mrva ;
N049.58.40.439 E019.40.42.995 N049.58.39.360 E019.42.18.720 mrva ;
N049.58.39.360 E019.42.18.720 N049.58.36.083 E019.43.54.336 mrva ;
N049.58.36.083 E019.43.54.336 N049.58.30.683 E019.45.29.700 mrva ;
N049.58.30.683 E019.45.29.700 N049.58.23.088 E019.47.04.739 mrva ;
N049.58.23.088 E019.47.04.739 N049.58.13.367 E019.48.39.311 mrva ;
N049.58.13.367 E019.48.39.311 N050.00.17.459 E019.49.12.972 mrva
N050.00.17.459 E019.49.12.972 N050.00.04.751 E019.50.53.592 mrva ;
N050.00.04.751 E019.50.53.592 N049.59.49.776 E019.52.33.491 mrva ;
N049.59.49.776 E019.52.33.491 N049.59.32.532 E019.54.12.491 mrva ;
N049.55.23.676 E019.52.22.499 N049.59.32.532 E019.54.12.491 mrva
N049.59.32.532 E019.54.12.491 N050.03.11.699 E019.55.49.224 mrva
N050.03.11.699 E019.55.49.224 N050.02.49.884 E019.57.38.988 mrva ;
N050.02.49.884 E019.57.38.988 N050.02.25.619 E019.59.27.492 mrva ;
N050.02.25.619 E019.59.27.492 N050.01.58.907 E020.01.14.628 mrva ;
N050.01.58.907 E020.01.14.628 N050.01.29.784 E020.03.00.252 mrva ;
N050.01.29.784 E020.03.00.252 N050.00.58.247 E020.04.44.255 mrva ;
N050.00.58.247 E020.04.44.255 N050.04.28.595 E020.07.22.152 mrva
N050.04.28.595 E020.07.22.152 N050.03.51.011 E020.09.15.624 mrva ;
N050.03.51.011 E020.09.15.624 N050.03.10.907 E020.11.06.971 mrva ;
N050.03.10.907 E020.11.06.971 N050.02.28.320 E020.12.56.123 mrva ;
N050.02.28.320 E020.12.56.123 N050.01.43.248 E020.14.42.935 mrva ;
N050.01.43.248 E020.14.42.935 N050.00.55.800 E020.16.27.227 mrva ;
N050.00.55.800 E020.16.27.227 N050.00.06.011 E020.18.08.927 mrva ;
N050.00.06.011 E020.18.08.927 N049.59.13.955 E020.19.47.855 mrva ;
N049.59.13.955 E020.19.47.855 N049.58.19.704 E020.21.23.976 mrva ;
N049.58.19.704 E020.21.23.976 N049.57.23.292 E020.22.57.107 mrva ;
N049.57.23.292 E020.22.57.107 N049.56.24.791 E020.24.27.144 mrva ;
N049.56.24.791 E020.24.27.144 N049.55.24.275 E020.25.53.976 mrva ;
N049.55.24.275 E020.25.53.976 N049.54.21.851 E020.27.17.496 mrva ;

;EPPO_MRVA
N052.25.20.510 E016.49.48.610 N052.22.42.010 E016.47.12.428 mrva ;
N052.25.20.510 E016.49.48.610 N052.29.05.737 E016.48.30.093 mrva ;
N052.10.57.647 E017.01.18.696 N052.10.50.448 E017.00.53.892 mrva ;
N052.10.50.448 E017.00.53.892 N052.10.43.500 E017.00.28.908 mrva ;
N052.10.43.500 E017.00.28.908 N052.10.36.804 E017.00.03.708 mrva ;
N052.10.36.804 E017.00.03.708 N052.10.30.395 E016.59.38.328 mrva ;
N052.10.30.395 E016.59.38.328 N052.10.24.275 E016.59.12.767 mrva ;
N052.10.24.275 E016.59.12.767 N052.10.18.407 E016.58.47.027 mrva ;
N052.10.18.407 E016.58.47.027 N052.10.12.792 E016.58.21.107 mrva ;
N052.10.12.792 E016.58.21.107 N052.10.07.463 E016.57.55.079 mrva ;
N052.10.07.463 E016.57.55.079 N052.10.02.459 E016.57.28.872 mrva ;
N052.10.02.459 E016.57.28.872 N052.09.57.672 E016.57.02.520 mrva ;
N052.09.57.672 E016.57.02.520 N052.09.53.208 E016.56.36.059 mrva ;
N052.09.53.208 E016.56.36.059 N052.09.48.995 E016.56.09.456 mrva ;
N052.09.48.995 E016.56.09.456 N052.09.45.107 E016.55.42.744 mrva ;
N052.09.45.107 E016.55.42.744 N052.09.41.472 E016.55.15.887 mrva ;
N052.09.41.472 E016.55.15.887 N052.09.38.123 E016.54.48.995 mrva ;
N052.09.38.123 E016.54.48.995 N052.09.35.063 E016.54.21.959 mrva ;
N052.09.35.063 E016.54.21.959 N052.09.32.327 E016.53.54.851 mrva ;
N052.10.57.647 E017.01.18.696 N052.06.30.333 E017.04.52.476 mrva ;
N052.09.32.327 E016.53.54.851 N052.07.32.168 E016.54.26.064 mrva ;

;EPGD_MRVA
N054.17.58.920 E018.12.28.799 N054.14.46.677 E017.50.27.325 mrva ;
N054.17.58.920 E018.12.28.799 N054.26.46.102 E018.33.12.161 mrva ;
N054.25.16.352 E018.18.02.538 N054.30.52.546 E018.22.18.997 mrva ;
N054.23.23.748 E018.25.14.909 N054.25.16.352 E018.18.02.538 mrva ;


;prohibited ares - wyjatkowo najpierw strefa, potem jej nazwa (przygotowal Karol Dziedzic)
PROHIBITED  	  	  N051.30.11.015 E021.25.41.987 N051.30.01.224 E021.27.10.907 PROHI 
                          N051.30.01.224 E021.27.10.907 N051.29.33.108 E021.28.29.100 PROHI 
                          N051.29.33.108 E021.28.29.100 N051.28.50.015 E021.29.27.132 PROHI 
                          N051.28.50.015 E021.29.27.132 N051.27.57.132 E021.29.58.019 PROHI 
                          N051.27.57.132 E021.29.58.019 N051.27.00.899 E021.29.58.019 PROHI 
                          N051.27.00.899 E021.29.58.019 N051.26.08.016 E021.29.27.132 PROHI 
                          N051.26.08.016 E021.29.27.132 N051.25.24.923 E021.28.29.100 PROHI 
                          N051.25.24.923 E021.28.29.100 N051.24.56.807 E021.27.10.907 PROHI 
                          N051.24.56.807 E021.27.10.907 N051.24.47.016 E021.25.41.987 PROHI 
                          N051.24.47.016 E021.25.41.987 N051.24.56.807 E021.24.13.067 PROHI 
                          N051.24.56.807 E021.24.13.067 N051.25.24.923 E021.22.54.876 PROHI 
                          N051.25.24.923 E021.22.54.876 N051.26.08.016 E021.21.56.844 PROHI 
                          N051.26.08.016 E021.21.56.844 N051.27.00.899 E021.21.25.955 PROHI 
                          N051.27.00.899 E021.21.25.955 N051.27.57.132 E021.21.25.955 PROHI 
                          N051.27.57.132 E021.21.25.955 N051.28.50.015 E021.21.56.844 PROHI 
                          N051.28.50.015 E021.21.56.844 N051.29.33.108 E021.22.54.876 PROHI 
                          N051.29.33.108 E021.22.54.876 N051.30.01.224 E021.24.13.067 PROHI 
                          N051.30.01.224 E021.24.13.067 N051.30.11.015 E021.25.41.987 PROHI 
;EP P1 PIONKI 1500m AMSL

		          N052.08.03.804 E021.20.18.492 N052.07.59.879 E021.20.54.564 PROHI 
                          N052.07.59.879 E021.20.54.564 N052.07.48.648 E021.21.26.315 PROHI 
                          N052.07.48.648 E021.21.26.315 N052.07.31.404 E021.21.49.859 PROHI 
                          N052.07.31.404 E021.21.49.859 N052.07.10.272 E021.22.02.423 PROHI 
                          N052.07.10.272 E021.22.02.423 N052.06.47.735 E021.22.02.423 PROHI 
                          N052.06.47.735 E021.22.02.423 N052.06.26.604 E021.21.49.859 PROHI 
                          N052.06.26.604 E021.21.49.859 N052.06.09.360 E021.21.26.315 PROHI 
                          N052.06.09.360 E021.21.26.315 N052.05.58.127 E021.20.54.564 PROHI 
                          N052.05.58.127 E021.20.54.564 N052.05.54.204 E021.20.18.492 PROHI 
                          N052.05.54.204 E021.20.18.492 N052.05.58.127 E021.19.42.420 PROHI 
                          N052.05.58.127 E021.19.42.420 N052.06.09.360 E021.19.10.668 PROHI 
                          N052.06.09.360 E021.19.10.668 N052.06.26.604 E021.18.47.123 PROHI 
                          N052.06.26.604 E021.18.47.123 N052.06.47.735 E021.18.34.559 PROHI 
                          N052.06.47.735 E021.18.34.559 N052.07.10.272 E021.18.34.559 PROHI 
                          N052.07.10.272 E021.18.34.559 N052.07.31.404 E021.18.47.123 PROHI 
                          N052.07.31.404 E021.18.47.123 N052.07.48.648 E021.19.10.668 PROHI 
                          N052.07.48.648 E021.19.10.668 N052.07.59.879 E021.19.42.420 PROHI 
                          N052.07.59.879 E021.19.42.420 N052.08.03.804 E021.20.18.492 PROHI  
;EP P10 SWIERK 800m AMSL

			  N051.19.40.692 E016.43.53.507 N051.19.30.899 E016.45.22.067 PROHI 
                          N051.19.30.899 E016.45.22.067 N051.19.02.783 E016.46.39.972 PROHI 
                          N051.19.02.783 E016.46.39.972 N051.18.19.691 E016.47.37.787 PROHI 
                          N051.18.19.691 E016.47.37.787 N051.17.26.807 E016.48.08.567 PROHI 
                          N051.17.26.807 E016.48.08.567 N051.16.30.575 E016.48.08.567 PROHI 
                          N051.16.30.575 E016.48.08.567 N051.15.37.691 E016.47.37.787 PROHI 
                          N051.15.37.691 E016.47.37.787 N051.14.54.599 E016.46.39.972 PROHI 
                          N051.14.54.599 E016.46.39.972 N051.14.26.484 E016.45.22.067 PROHI 
                          N051.14.26.484 E016.45.22.067 N051.14.16.691 E016.43.53.507 PROHI 
                          N051.14.16.691 E016.43.53.507 N051.14.26.484 E016.42.24.947 PROHI 
                          N051.14.26.484 E016.42.24.947 N051.14.54.599 E016.41.07.043 PROHI 
                          N051.14.54.599 E016.41.07.043 N051.15.37.691 E016.40.09.227 PROHI 
                          N051.15.37.691 E016.40.09.227 N051.16.30.575 E016.39.38.447 PROHI 
                          N051.16.30.575 E016.39.38.447 N051.17.26.807 E016.39.38.447 PROHI 
                          N051.17.26.807 E016.39.38.447 N051.18.19.691 E016.40.09.227 PROHI 
                          N051.18.19.691 E016.40.09.227 N051.19.02.783 E016.41.07.043 PROHI 
                          N051.19.02.783 E016.41.07.043 N051.19.30.899 E016.42.24.947 PROHI 
                          N051.19.30.899 E016.42.24.947 N051.19.40.692 E016.43.53.507 PROHI 
;EP P11 BRZEG D 1500m AMSL

			N050.52.58.800 E018.25.53.600 N050.47.34.500 E018.34.08.900 PROHI
			N050.47.34.500 E018.34.08.900 N050.43.56.800 E018.27.56.700 PROHI
			N050.43.56.800 E018.27.56.700 N050.40.58.800 E018.12.53.600 PROHI
			N050.40.58.800 E018.12.53.600 N050.48.58.800 E018.09.53.600 PROHI
			N050.48.58.800 E018.09.53.600 N050.51.58.800 E018.12.53.600 PROHI
			N050.51.58.800 E018.12.53.600 N050.52.58.800 E018.25.53.600 PROHI
;EP P13 OLESNO FL105


			  N051.07.50.808 E020.54.55.295 N051.07.44.940 E020.55.48.252 PROHI 
                          N051.07.44.940 E020.55.48.252 N051.07.28.055 E020.56.34.800 PROHI 
                          N051.07.28.055 E020.56.34.800 N051.07.02.208 E020.57.09.360 PROHI 
                          N051.07.02.208 E020.57.09.360 N051.06.30.491 E020.57.27.719 PROHI 
                          N051.06.30.491 E020.57.27.719 N051.05.56.723 E020.57.27.719 PROHI 
                          N051.05.56.723 E020.57.27.719 N051.05.25.007 E020.57.09.360 PROHI 
                          N051.05.25.007 E020.57.09.360 N051.04.59.160 E020.56.34.800 PROHI 
                          N051.04.59.160 E020.56.34.800 N051.04.42.275 E020.55.48.252 PROHI 
                          N051.04.42.275 E020.55.48.252 N051.04.36.407 E020.54.55.295 PROHI 
                          N051.04.36.407 E020.54.55.295 N051.04.42.275 E020.54.02.339 PROHI 
                          N051.04.42.275 E020.54.02.339 N051.04.59.160 E020.53.15.792 PROHI 
                          N051.04.59.160 E020.53.15.792 N051.05.25.007 E020.52.41.231 PROHI 
                          N051.05.25.007 E020.52.41.231 N051.05.56.723 E020.52.22.872 PROHI 
                          N051.05.56.723 E020.52.22.872 N051.06.30.491 E020.52.22.872 PROHI 
                          N051.06.30.491 E020.52.22.872 N051.07.02.208 E020.52.41.231 PROHI 
                          N051.07.02.208 E020.52.41.231 N051.07.28.055 E020.53.15.792 PROHI 
                          N051.07.28.055 E020.53.15.792 N051.07.44.940 E020.54.02.339 PROHI 
                          N051.07.44.940 E020.54.02.339 N051.07.50.808 E020.54.55.295 PROHI 
;EP P14 SKARZYSKO KAMIENNA FL100

			  N054.21.16.100 E018.43.23.700 N054.21.01.200 E018.45.38.700 PROHI 
                          N054.21.01.200 E018.45.38.700 N054.20.14.500 E018.45.22.900 PROHI 
                          N054.20.14.500 E018.45.22.900 N054.20.29.300 E018.43.10.700 PROHI 
                          N054.20.29.300 E018.43.10.700 N054.21.16.100 E018.43.23.700 PROHI 
;EP P15 GDANSK 800m AMSL

			  N050.35.35.988 E018.36.53.712 N050.35.30.120 E018.37.46.056 PROHI 
                          N050.35.30.120 E018.37.46.056 N050.35.13.235 E018.38.32.064 PROHI 
                          N050.35.13.235 E018.38.32.064 N050.34.47.388 E018.39.06.228 PROHI 
                          N050.34.47.388 E018.39.06.228 N050.34.15.671 E018.39.24.408 PROHI 
                          N050.34.15.671 E018.39.24.408 N050.33.41.903 E018.39.24.408 PROHI 
                          N050.33.41.903 E018.39.24.408 N050.33.10.188 E018.39.06.228 PROHI 
                          N050.33.10.188 E018.39.06.228 N050.32.44.340 E018.38.32.064 PROHI 
                          N050.32.44.340 E018.38.32.064 N050.32.27.455 E018.37.46.056 PROHI 
                          N050.32.27.455 E018.37.46.056 N050.32.21.587 E018.36.53.712 PROHI 
                          N050.32.21.587 E018.36.53.712 N050.32.27.455 E018.36.01.368 PROHI 
                          N050.32.27.455 E018.36.01.368 N050.32.44.340 E018.35.15.359 PROHI 
                          N050.32.44.340 E018.35.15.359 N050.33.10.188 E018.34.41.195 PROHI 
                          N050.33.10.188 E018.34.41.195 N050.33.41.903 E018.34.23.016 PROHI 
                          N050.33.41.903 E018.34.23.016 N050.34.15.671 E018.34.23.016 PROHI 
                          N050.34.15.671 E018.34.23.016 N050.34.47.388 E018.34.41.195 PROHI 
                          N050.34.47.388 E018.34.41.195 N050.35.13.235 E018.35.15.359 PROHI 
                          N050.35.13.235 E018.35.15.359 N050.35.30.120 E018.36.01.368 PROHI 
                          N050.35.30.120 E018.36.01.368 N050.35.35.988 E018.36.53.712 PROHI 
;EP P2 KRUPSKI MLYN FL100

			  N051.30.07.992 E021.58.25.787 N051.29.58.199 E021.59.54.707 PROHI 
                          N051.29.58.199 E021.59.54.707 N051.29.30.083 E022.01.12.900 PROHI 
                          N051.29.30.083 E022.01.12.900 N051.28.46.992 E022.02.10.932 PROHI 
                          N051.28.46.992 E022.02.10.932 N051.27.54.107 E022.02.41.820 PROHI 
                          N051.27.54.107 E022.02.41.820 N051.26.57.876 E022.02.41.820 PROHI 
                          N051.26.57.876 E022.02.41.820 N051.26.04.991 E022.02.10.932 PROHI 
                          N051.26.04.991 E022.02.10.932 N051.25.21.900 E022.01.12.900 PROHI 
                          N051.25.21.900 E022.01.12.900 N051.24.53.784 E021.59.54.707 PROHI 
                          N051.24.53.784 E021.59.54.707 N051.24.43.991 E021.58.25.787 PROHI 
                          N051.24.43.991 E021.58.25.787 N051.24.53.784 E021.56.56.868 PROHI 
                          N051.24.53.784 E021.56.56.868 N051.25.21.900 E021.55.38.675 PROHI 
                          N051.25.21.900 E021.55.38.675 N051.26.04.991 E021.54.40.644 PROHI 
                          N051.26.04.991 E021.54.40.644 N051.26.57.876 E021.54.09.755 PROHI 
                          N051.26.57.876 E021.54.09.755 N051.27.54.107 E021.54.09.755 PROHI 
                          N051.27.54.107 E021.54.09.755 N051.28.46.992 E021.54.40.644 PROHI 
                          N051.28.46.992 E021.54.40.644 N051.29.30.083 E021.55.38.675 PROHI 
                          N051.29.30.083 E021.55.38.675 N051.29.58.199 E021.56.56.868 PROHI 
                          N051.29.58.199 E021.56.56.868 N051.30.07.992 E021.58.25.787 PROHI 
;EP P3 PULAWY 1500m AMSL
			
			  N050.07.40.008 E019.05.53.700 N050.07.30.215 E019.07.20.027 PROHI 
                          N050.07.30.215 E019.07.20.027 N050.07.02.099 E019.08.35.951 PROHI 
                          N050.07.02.099 E019.08.35.951 N050.06.19.008 E019.09.32.327 PROHI 
                          N050.06.19.008 E019.09.32.327 N050.05.26.123 E019.10.02.316 PROHI 
                          N050.05.26.123 E019.10.02.316 N050.04.29.892 E019.10.02.316 PROHI 
                          N050.04.29.892 E019.10.02.316 N050.03.37.007 E019.09.32.327 PROHI 
                          N050.03.37.007 E019.09.32.327 N050.02.53.916 E019.08.35.951 PROHI 
                          N050.02.53.916 E019.08.35.951 N050.02.25.800 E019.07.20.027 PROHI 
                          N050.02.25.800 E019.07.20.027 N050.02.16.007 E019.05.53.700 PROHI 
                          N050.02.16.007 E019.05.53.700 N050.02.25.800 E019.04.27.371 PROHI 
                          N050.02.25.800 E019.04.27.371 N050.02.53.916 E019.03.11.448 PROHI 
                          N050.02.53.916 E019.03.11.448 N050.03.37.007 E019.02.15.072 PROHI 
                          N050.03.37.007 E019.02.15.072 N050.04.29.892 E019.01.45.083 PROHI 
                          N050.04.29.892 E019.01.45.083 N050.05.26.123 E019.01.45.083 PROHI 
                          N050.05.26.123 E019.01.45.083 N050.06.19.008 E019.02.15.072 PROHI 
                          N050.06.19.008 E019.02.15.072 N050.07.02.099 E019.03.11.448 PROHI 
                          N050.07.02.099 E019.03.11.448 N050.07.30.215 E019.04.27.371 PROHI 
                          N050.07.30.215 E019.04.27.371 N050.07.40.008 E019.05.53.700 PROHI 
;EP P4 BIERUN 1500m AMSL


			  N050.04.40.800 E019.15.53.783 N050.04.31.007 E019.17.20.040 PROHI 
                          N050.04.31.007 E019.17.20.040 N050.04.02.892 E019.18.35.891 PROHI 
                          N050.04.02.892 E019.18.35.891 N050.03.19.800 E019.19.32.196 PROHI 
                          N050.03.19.800 E019.19.32.196 N050.02.26.916 E019.20.02.147 PROHI 
                          N050.02.26.916 E019.20.02.147 N050.01.30.684 E019.20.02.147 PROHI 
                          N050.01.30.684 E019.20.02.147 N050.00.37.800 E019.19.32.196 PROHI 
                          N050.00.37.800 E019.19.32.196 N049.59.54.708 E019.18.35.891 PROHI 
                          N049.59.54.708 E019.18.35.891 N049.59.26.592 E019.17.20.040 PROHI 
                          N049.59.26.592 E019.17.20.040 N049.59.16.799 E019.15.53.783 PROHI 
                          N049.59.16.799 E019.15.53.783 N049.59.26.592 E019.14.27.528 PROHI 
                          N049.59.26.592 E019.14.27.528 N049.59.54.708 E019.13.11.675 PROHI 
                          N049.59.54.708 E019.13.11.675 N050.00.37.800 E019.12.15.372 PROHI 
                          N050.00.37.800 E019.12.15.372 N050.01.30.684 E019.11.45.419 PROHI 
                          N050.01.30.684 E019.11.45.419 N050.02.26.916 E019.11.45.419 PROHI 
                          N050.02.26.916 E019.11.45.419 N050.03.19.800 E019.12.15.372 PROHI 
                          N050.03.19.800 E019.12.15.372 N050.04.02.892 E019.13.11.675 PROHI 
                          N050.04.02.892 E019.13.11.675 N050.04.31.007 E019.14.27.528 PROHI 
                          N050.04.31.007 E019.14.27.528 N050.04.40.800 E019.15.53.783 PROHI 
;EP P5 OSWIECIM 1500m AMSL

			  N050.02.36.204 E020.57.53.783 N050.02.30.335 E020.58.45.516 PROHI 
                          N050.02.30.335 E020.58.45.516 N050.02.13.451 E020.59.31.019 PROHI 
                          N050.02.13.451 E020.59.31.019 N050.01.47.604 E021.00.04.787 PROHI 
                          N050.01.47.604 E021.00.04.787 N050.01.15.887 E021.00.22.751 PROHI 
                          N050.01.15.887 E021.00.22.751 N050.00.42.119 E021.00.22.751 PROHI 
                          N050.00.42.119 E021.00.22.751 N050.00.10.404 E021.00.04.787 PROHI 
                          N050.00.10.404 E021.00.04.787 N049.59.44.556 E020.59.31.019 PROHI 
                          N049.59.44.556 E020.59.31.019 N049.59.27.671 E020.58.45.516 PROHI 
                          N049.59.27.671 E020.58.45.516 N049.59.21.804 E020.57.53.783 PROHI 
                          N049.59.21.804 E020.57.53.783 N049.59.27.671 E020.57.02.051 PROHI 
                          N049.59.27.671 E020.57.02.051 N049.59.44.556 E020.56.16.548 PROHI 
                          N049.59.44.556 E020.56.16.548 N050.00.10.404 E020.55.42.780 PROHI 
                          N050.00.10.404 E020.55.42.780 N050.00.42.119 E020.55.24.815 PROHI 
                          N050.00.42.119 E020.55.24.815 N050.01.15.887 E020.55.24.815 PROHI 
                          N050.01.15.887 E020.55.24.815 N050.01.47.604 E020.55.42.780 PROHI 
                          N050.01.47.604 E020.55.42.780 N050.02.13.451 E020.56.16.548 PROHI 
                          N050.02.13.451 E020.56.16.548 N050.02.30.335 E020.57.02.051 PROHI
                          N050.02.30.335 E020.57.02.051 N050.02.36.204 E020.57.53.783 PROHI  
;EP P6 TARNOW 1500m AMSL

			  N052.34.21.000 E019.38.47.000 N052.36.08.000 E019.39.05.000 PROHI 
                          N052.36.08.000 E019.39.05.000 N052.36.06.000 E019.42.40.000 PROHI 
                          N052.36.06.000 E019.42.40.000 N052.35.37.000 E019.43.04.000 PROHI 
                          N052.35.37.000 E019.43.04.000 N052.34.16.000 E019.41.13.000 PROHI
                          N052.34.16.000 E019.41.13.000 N052.34.21.000 E019.38.47.000 PROHI  
;EP P7 PLOCK 1500m AMSL	

                          N053.06.01.800 E018.03.13.200 N053.06.08.900 E018.09.53.300 PROHI 
                          N053.06.08.900 E018.09.53.300 N053.01.58.900 E018.06.53.300 PROHI 
                          N053.01.58.900 E018.06.53.300 N053.04.00.300 E018.03.41.200 PROHI
                          N053.04.00.300 E018.03.41.200 N053.06.01.800 E018.03.13.200 PROHI  
;EP P8 BYDGOSZCZ 175m AMSL


;EPWA ILS33
ILS N052.08.05.000 E020.59.38.000 N052.07.12.000 E021.00.23.000 ILSRED
N052.06.20.000 E021.01.08.000 N052.05.26.000 E021.01.53.000 ILSRED
N052.04.33.000 E021.02.38.000 N052.03.40.000 E021.03.24.000 ILSRED
N052.02.47.000 E021.04.08.000 N052.01.54.000 E021.04.53.000 ILSRED
N052.01.00.000 E021.05.38.000 N052.00.08.000 E021.06.23.000 ILSRED
N051.59.15.000 E021.07.08.000 N051.58.22.000 E021.07.53.000 ILSRED
N051.57.30.000 E021.08.38.000 N051.56.36.000 E021.09.23.000 ILSRED
N051.55.43.000 E021.10.08.000 N051.54.50.000 E021.10.53.000 ILSRED
;EPLL
N051.43.46.000 E019.25.54.000 N051.44.06.000 E019.27.25.000 ILSRED
N051.44.26.000 E019.28.56.000 N051.44.46.000 E019.30.27.000 ILSRED
N051.45.07.000 E019.31.58.000 N051.45.27.000 E019.33.29.000 ILSRED
N051.45.47.000 E019.35.00.000 N051.46.08.000 E019.36.31.000 ILSRED
N051.46.28.000 E019.38.02.000 N051.46.49.000 E019.39.33.000 ILSRED
N051.47.09.000 E019.41.04.000 N051.47.30.000 E019.42.35.000 ILSRED
N051.47.50.000 E019.44.06.000 N051.48.10.000 E019.45.37.000 ILSRED
N051.48.30.000 E019.47.08.000 N051.48.50.000 E019.48.39.000 ILSRED
;EPWA ILS11
N052.10.42.000 E020.55.20.000 N052.11.07.000 E020.53.50.000 ILSRED
N052.11.32.000 E020.52.20.000 N052.11.57.000 E020.50.52.000 ILSRED
N052.12.22.000 E020.49.23.000 N052.12.47.000 E020.47.54.000 ILSRED
N052.13.12.000 E020.46.25.000 N052.13.37.000 E020.44.56.000 ILSRED
N052.14.03.000 E020.43.27.000 N052.14.27.000 E020.41.58.000 ILSRED
N052.14.52.000 E020.40.30.000 N052.15.17.000 E020.39.00.000 ILSRED
N052.15.42.000 E020.37.30.000 N052.16.07.000 E020.36.03.000 ILSRED
N052.16.32.000 E020.34.33.000 N052.16.57.000 E020.33.04.000 ILSRED
;EPKT ILS29
N050.28.30.400 E019.07.15.000 N050.28.32.000 E019.08.50.000 ILSRED
N050.28.33.000 E019.10.20.000 N050.28.35.000 E019.11.60.000 ILSRED
N050.28.37.000 E019.13.27.000 N050.28.39.000 E019.14.58.000 ILSRED
N050.28.41.000 E019.16.38.000 N050.28.44.000 E019.18.12.000 ILSRED
N050.28.46.000 E019.19.49.000 N050.28.48.000 E019.21.25.000 ILSRED
N050.28.51.000 E019.23.00.000 N050.28.53.000 E019.24.38.000 ILSRED
N050.28.54.000 E019.26.16.000 N050.28.56.000 E019.27.50.000 ILSRED
N050.28.58.000 E019.29.16.000 N050.29.01.000 E019.31.03.000 ILSRED
;EPKK ILS25
N050.04.62.000 E019.49.39.590 N050.05.16.650 E019.51.13.930 ILSRED
N050.05.32.000 E019.52.51.000 N050.05.46.000 E019.54.25.000 ILSRED
N050.06.00.000 E019.56.00.000 N050.06.14.000 E019.57.35.000 ILSRED
N050.06.29.000 E019.59.07.000 N050.06.42.000 E020.00.45.000 ILSRED
N050.06.56.000 E020.02.18.000 N050.07.12.000 E020.03.55.000 ILSRED
N050.07.25.000 E020.05.27.000 N050.07.39.000 E020.06.60.000 ILSRED
N050.07.54.000 E020.08.30.000 N050.08.08.000 E020.10.10.000 ILSRED
N050.08.22.000 E020.11.43.000 N050.08.37.000 E020.13.20.000 ILSRED
;ILS 27 EPRZ
N050.06.33.000 E022.03.44.000 N050.06.32.000 E022.05.17.000 ILSRED
N050.06.31.000 E022.06.50.000 N050.06.30.000 E022.08.24.000 ILSRED
N050.06.29.000 E022.09.54.000 N050.06.28.000 E022.11.31.000 ILSRED
N050.06.27.000 E022.12.58.000 N050.06.26.000 E022.14.38.000 ILSRED
N050.06.25.000 E022.16.02.000 N050.06.24.000 E022.17.45.000 ILSRED
N050.06.23.000 E022.19.06.000 N050.06.22.000 E022.20.53.000 ILSRED
N050.06.21.000 E022.22.10.000 N050.06.20.000 E022.24.00.000 ILSRED
N050.06.19.000 E022.25.14.000 N050.06.18.000 E022.27.07.000 ILSRED
;EPSC ILS 31
N053.34.01.000 E014.56.10.000 N053.33.21.000 E014.57.24.000 ILSRED
N053.32.40.000 E014.58.41.000 N053.31.59.000 E014.59.58.000 ILSRED
N053.31.19.000 E015.01.12.000 N053.30.37.000 E015.02.32.000 ILSRED
N053.29.58.000 E015.03.43.000 N053.29.15.000 E015.05.06.000 ILSRED
N053.28.37.000 E015.06.14.000 N053.27.53.000 E015.07.40.000 ILSRED
N053.27.16.000 E015.08.45.000 N053.26.31.000 E015.10.14.000 ILSRED
N053.25.55.000 E015.11.16.000 N053.25.09.000 E015.12.48.000 ILSRED
N053.24.34.000 E015.13.47.000 N053.23.47.000 E015.15.22.000 ILSRED
;ILS 26 EPBY
N053.06.03.000 E018.01.24.000 N053.06.12.000 E018.03.02.000 ILSRED
N053.06.22.000 E018.04.40.000 N053.06.31.000 E018.06.18.000 ILSRED
N053.06.40.000 E018.07.56.000 N053.06.49.000 E018.09.34.000 ILSRED
N053.06.58.000 E018.11.12.000 N053.07.07.000 E018.12.50.000 ILSRED
N053.07.16.000 E018.14.28.000 N053.07.26.000 E018.16.06.000 ILSRED
N053.07.34.000 E018.17.44.000 N053.07.44.000 E018.19.22.000 ILSRED
N053.07.52.000 E018.20.50.000 N053.08.02.000 E018.22.38.000 ILSRED
N053.08.10.000 E018.24.06.000 N053.08.20.000 E018.25.54.000 ILSRED
;ILS 29 EPGD
N054.21.54.000 E018.31.05.000 N054.21.31.000 E018.32.41.000 ILSRED
N054.21.09.000 E018.34.16.000 N054.20.46.000 E018.35.52.000 ILSRED
N054.20.24.000 E018.37.27.000 N054.20.01.000 E018.39.03.000 ILSRED
N054.19.38.000 E018.40.38.000 N054.19.16.000 E018.42.14.000 ILSRED
N054.18.52.000 E018.43.49.000 N054.18.30.000 E018.45.25.000 ILSRED
N054.18.08.000 E018.47.00.000 N054.17.45.000 E018.48.36.000 ILSRED
N054.17.23.000 E018.50.11.000 N054.17.00.000 E018.51.47.000 ILSRED
N054.16.38.000 E018.53.22.000 N054.16.15.000 E018.54.58.000 ILSRED
;ILS 29 EPWR
N051.05.30.000 E016.55.20.000 N051.05.03.000 E016.56.46.000 ILSRED
N051.04.36.000 E016.58.12.000 N051.04.09.000 E016.59.38.000 ILSRED
N051.03.42.000 E017.01.04.000 N051.03.15.000 E017.02.30.000 ILSRED
N051.02.48.000 E017.03.57.000 N051.02.21.000 E017.05.23.000 ILSRED
N051.01.54.000 E017.06.49.000 N051.01.27.000 E017.08.16.000 ILSRED
N051.01.00.000 E017.09.42.000 N051.00.33.000 E017.11.08.000 ILSRED
N051.00.06.000 E017.12.34.000 N050.59.39.000 E017.14.00.000 ILSRED
N050.59.12.000 E017.15.26.000 N050.58.45.000 E017.16.52.000 ILSRED
;ILS - EPPO 29
N001.39.20.999 E021.25.40.001 N001.41.44.999 E020.58.09.998 
N052.24.47.844 E016.52.01.091 N052.24.30.311 E016.53.35.160 ILSRED
N052.24.12.780 E016.55.09.227 N052.23.55.247 E016.56.43.260 ILSRED
N052.23.37.716 E016.58.17.292 N052.23.20.183 E016.59.51.323 ILSRED
N052.23.02.652 E017.01.25.356 N052.22.45.119 E017.02.59.352 ILSRED
N052.22.27.588 E017.04.33.347 N052.22.10.055 E017.06.07.343 ILSRED
N052.21.52.523 E017.07.41.303 N052.21.34.992 E017.09.15.264 ILSRED
N052.21.17.459 E017.10.49.224 N052.20.59.928 E017.12.23.184 ILSRED
N052.20.42.395 E017.13.57.108 N052.20.24.864 E017.15.31.032 ILSRED

;LOTNISKA
;EPLL
;- RWY
LOTNISKA N051.43.25.971 E019.24.22.134 N051.42.59.049 E019.22.19.018 olive
N051.42.59.049 E019.22.19.018 N051.42.57.265 E019.22.20.053 olive
N051.42.57.265 E019.22.20.053 N051.43.24.175 E019.24.23.142 olive
N051.43.24.175 E019.24.23.142 N051.43.25.971 E019.24.22.134 olive
;- TWY
N051.43.25.979 E019.24.22.122 N051.43.32.653 E019.24.18.216 teal
N051.43.32.653 E019.24.18.216 N051.43.32.687 E019.24.17.967 teal
N051.43.32.687 E019.24.17.967 N051.43.35.526 E019.24.16.132 teal
N051.43.35.526 E019.24.16.132 N051.43.37.930 E019.24.14.778 teal
N051.43.37.930 E019.24.14.778 N051.43.37.070 E019.24.10.689 teal
N051.43.37.070 E019.24.10.689 N051.43.36.454 E019.24.10.564 teal
N051.43.36.454 E019.24.10.564 N051.43.35.994 E019.24.08.456 teal
N051.43.35.994 E019.24.08.456 N051.43.30.941 E019.24.11.321 teal
N051.43.30.941 E019.24.11.321 N051.43.29.942 E019.24.06.745 teal
N051.43.29.942 E019.24.06.745 N051.43.35.081 E019.24.03.812 teal
N051.43.35.081 E019.24.03.812 N051.43.33.798 E019.23.57.772 teal
N051.43.33.798 E019.23.57.772 N051.43.27.058 E019.23.57.748 teal
N051.43.27.058 E019.23.57.748 N051.43.28.725 E019.24.05.509 teal
N051.43.28.725 E019.24.05.509 N051.43.27.155 E019.24.06.442 teal
N051.43.27.155 E019.24.06.442 N051.43.28.659 E019.24.13.470 teal
N051.43.28.659 E019.24.13.470 N051.43.29.302 E019.24.17.400 teal
N051.43.29.302 E019.24.17.400 N051.43.29.260 E019.24.17.977 teal
N051.43.29.260 E019.24.17.977 N051.43.29.146 E019.24.18.240 teal
N051.43.29.146 E019.24.18.240 N051.43.28.980 E019.24.18.629 teal
N051.43.28.980 E019.24.18.629 N051.43.27.475 E019.24.19.856 teal
N051.43.27.475 E019.24.19.856 N051.43.26.581 E019.24.20.342 teal
N051.43.26.581 E019.24.20.342 N051.43.25.778 E019.24.20.545 teal
N051.43.25.778 E019.24.20.545 N051.43.25.590 E019.24.20.361 teal
N051.43.29.098 E019.24.07.165 N051.43.30.965 E019.24.15.875 teal
N051.43.30.965 E019.24.15.875 N051.43.30.640 E019.24.16.064 teal
N051.43.30.640 E019.24.16.064 N051.43.29.750 E019.24.13.056 teal
N051.43.29.750 E019.24.13.056 N051.43.29.017 E019.24.09.866 teal
N051.43.29.017 E019.24.09.866 N051.43.28.657 E019.24.07.403 teal
N051.43.28.657 E019.24.07.403 N051.43.29.079 E019.24.07.161 teal
N051.43.24.173 E019.24.23.147 N051.43.19.612 E019.24.28.715 teal
N051.43.19.612 E019.24.28.715 N051.43.19.346 E019.24.28.111 teal
N051.43.19.346 E019.24.28.111 N051.43.23.997 E019.24.22.497 teal
;- BLD
N051.43.33.241 E019.24.18.302 N051.43.34.653 E019.24.17.397 maroon
N051.43.34.653 E019.24.17.397 N051.43.34.868 E019.24.18.165 maroon
N051.43.34.868 E019.24.18.165 N051.43.33.395 E019.24.19.070 maroon
N051.43.33.395 E019.24.19.070 N051.43.33.241 E019.24.18.302 maroon
N051.43.35.785 E019.24.16.193 N051.43.37.799 E019.24.15.050 maroon
N051.43.37.799 E019.24.15.050 N051.43.38.118 E019.24.16.525 maroon
N051.43.38.118 E019.24.16.525 N051.43.36.136 E019.24.17.671 maroon
N051.43.36.136 E019.24.17.671 N051.43.35.814 E019.24.16.183 maroon
N051.43.37.394 E019.24.10.544 N051.43.38.075 E019.24.13.765 maroon
N051.43.38.075 E019.24.13.765 N051.43.38.496 E019.24.13.502 maroon
N051.43.38.496 E019.24.13.502 N051.43.37.782 E019.24.10.313 maroon
N051.43.37.782 E019.24.10.313 N051.43.37.394 E019.24.10.551 maroon
N051.43.34.134 E019.24.09.316 N051.43.31.390 E019.24.10.853 maroon
N051.43.31.390 E019.24.10.853 N051.43.30.962 E019.24.08.874 maroon
N051.43.30.962 E019.24.08.874 N051.43.33.736 E019.24.07.344 maroon
N051.43.33.736 E019.24.07.344 N051.43.34.135 E019.24.09.286 maroon
;- LNS
N051.43.24.032 E019.24.22.846 N051.43.20.153 E019.24.27.611 olive
N051.43.25.891 E019.24.21.582 N051.43.26.711 E019.24.21.102 olive
N051.43.26.711 E019.24.21.102 N051.43.29.027 E019.24.19.698 olive
N051.43.29.027 E019.24.19.698 N051.43.29.905 E019.24.19.220 olive
N051.43.29.905 E019.24.19.220 N051.43.30.021 E019.24.19.128 olive
N051.43.30.021 E019.24.19.128 N051.43.30.352 E019.24.18.805 olive
N051.43.30.352 E019.24.18.805 N051.43.30.702 E019.24.18.224 olive
N051.43.30.702 E019.24.18.224 N051.43.31.719 E019.24.16.378 olive
N051.43.31.719 E019.24.16.378 N051.43.32.224 E019.24.15.410 olive
N051.43.32.224 E019.24.15.410 N051.43.32.567 E019.24.15.047 olive
N051.43.32.567 E019.24.15.047 N051.43.32.970 E019.24.14.735 olive
N051.43.32.970 E019.24.14.735 N051.43.33.666 E019.24.14.375 olive
N051.43.33.666 E019.24.14.375 N051.43.34.342 E019.24.13.994 olive
N051.43.34.342 E019.24.13.994 N051.43.35.276 E019.24.13.459 olive
N051.43.35.276 E019.24.13.459 N051.43.36.122 E019.24.13.000 olive
N051.43.36.122 E019.24.13.000 N051.43.36.590 E019.24.12.746 olive
N051.43.36.590 E019.24.12.746 N051.43.36.929 E019.24.14.476 olive
N051.43.36.042 E019.24.13.043 N051.43.36.402 E019.24.14.692 olive
N051.43.35.947 E019.24.13.093 N051.43.35.374 E019.24.10.429 olive
N051.43.34.934 E019.24.11.093 N051.43.35.398 E019.24.13.400 olive
N051.43.35.530 E019.24.13.366 N051.43.35.887 E019.24.15.018 olive
N051.43.34.884 E019.24.13.672 N051.43.35.287 E019.24.15.408 olive
N051.43.34.212 E019.24.14.035 N051.43.33.556 E019.24.11.123 olive
N051.43.34.160 E019.24.14.099 N051.43.34.502 E019.24.15.832 olive
N051.43.33.443 E019.24.14.516 N051.43.33.799 E019.24.16.169 olive
N051.43.32.830 E019.24.14.868 N051.43.33.200 E019.24.16.711 olive
N051.43.31.905 E019.24.15.940 N051.43.31.916 E019.24.15.235 olive
N051.43.31.916 E019.24.15.235 N051.43.31.678 E019.24.12.485 olive
N051.43.29.232 E019.24.19.589 N051.43.29.624 E019.24.19.018 olive
N051.43.29.624 E019.24.19.018 N051.43.29.740 E019.24.18.618 olive
N051.43.29.740 E019.24.18.618 N051.43.29.874 E019.24.18.081 olive
N051.43.29.874 E019.24.18.081 N051.43.29.878 E019.24.17.246 olive
N051.43.29.878 E019.24.17.246 N051.43.29.789 E019.24.16.613 olive
N051.43.29.789 E019.24.16.613 N051.43.27.990 E019.24.08.477 olive
N051.43.27.990 E019.24.08.477 N051.43.27.998 E019.24.08.064 olive
N051.43.27.998 E019.24.08.064 N051.43.28.011 E019.24.07.596 olive
N051.43.28.011 E019.24.07.596 N051.43.28.146 E019.24.07.155 olive
N051.43.28.146 E019.24.07.155 N051.43.28.300 E019.24.06.833 olive
N051.43.28.300 E019.24.06.833 N051.43.28.702 E019.24.06.465 olive
N051.43.28.702 E019.24.06.465 N051.43.29.761 E019.24.05.832 olive
N051.43.29.761 E019.24.05.832 N051.43.29.955 E019.24.05.736 olive
N051.43.29.955 E019.24.05.736 N051.43.30.324 E019.24.05.223 olive
N051.43.30.324 E019.24.05.223 N051.43.31.030 E019.24.04.045 olive
N051.43.31.030 E019.24.04.045 N051.43.31.388 E019.24.03.118 olive
N051.43.31.388 E019.24.03.118 N051.43.31.497 E019.24.02.635 olive
N051.43.31.497 E019.24.02.635 N051.43.31.316 E019.24.01.613 olive
N051.43.31.316 E019.24.01.613 N051.43.30.880 E019.23.59.425 olive
N051.43.30.880 E019.23.59.425 N051.43.28.272 E019.23.59.417 olive
N051.43.31.281 E019.24.01.252 N051.43.33.705 E019.23.59.922 olive
N051.43.30.612 E019.24.04.835 N051.43.34.324 E019.24.02.772 olive
N051.43.30.171 E019.24.05.475 N051.43.30.063 E019.24.04.270 olive
N051.43.30.063 E019.24.04.270 N051.43.29.615 E019.24.02.023 olive



;EPWAAA

;- RWY
N052.10.44.440 E020.57.20.329 N052.10.43.276 E020.57.16.945 olive
N052.10.43.276 E020.57.16.945 N052.09.59.065 E020.57.57.189 olive
N052.09.59.065 E020.57.57.189 N052.10.19.593 E020.56.40.814 olive
N052.10.19.593 E020.56.40.814 N052.10.17.814 E020.56.39.527 olive
N052.10.17.814 E020.56.39.527 N052.09.56.171 E020.57.59.882 olive
N052.09.56.171 E020.57.59.882 N052.08.56.881 E020.58.53.803 olive
N052.08.56.881 E020.58.53.803 N052.08.57.951 E020.58.56.985 olive
N052.08.57.951 E020.58.56.985 N052.09.54.690 E020.58.05.542 olive
N052.09.54.690 E020.58.05.542 N052.09.39.383 E020.59.02.970 olive
N052.09.39.383 E020.59.02.970 N052.09.41.094 E020.59.04.134 olive
N052.09.41.094 E020.59.04.134 N052.09.57.545 E020.58.02.818 olive
N052.09.57.545 E020.58.02.818 N052.10.44.410 E020.57.20.294 olive
;- TWY
N052.08.57.738 E020.58.52.853 N052.08.55.641 E020.58.46.585 teal
N052.08.55.641 E020.58.46.585 N052.08.55.273 E020.58.45.225 teal
N052.08.55.273 E020.58.45.225 N052.08.55.246 E020.58.43.847 teal
N052.08.55.246 E020.58.43.847 N052.08.55.453 E020.58.42.655 teal
N052.08.55.453 E020.58.42.655 N052.08.55.722 E020.58.41.817 teal
N052.08.55.722 E020.58.41.817 N052.08.56.035 E020.58.41.216 teal
N052.08.56.035 E020.58.41.216 N052.08.56.475 E020.58.40.594 teal
N052.08.56.475 E020.58.40.594 N052.09.14.634 E020.58.24.233 teal
N052.09.14.634 E020.58.24.233 N052.09.16.729 E020.58.30.077 teal
N052.09.16.729 E020.58.30.077 N052.09.17.745 E020.58.32.929 teal
N052.09.17.745 E020.58.32.929 N052.09.18.032 E020.58.33.379 teal
N052.09.18.032 E020.58.33.379 N052.09.18.442 E020.58.33.623 teal
N052.09.18.442 E020.58.33.623 N052.09.18.858 E020.58.33.653 teal
N052.09.17.066 E020.58.35.396 N052.09.14.862 E020.58.29.183 teal
N052.09.14.862 E020.58.29.183 N052.09.14.606 E020.58.28.662 teal
N052.09.14.606 E020.58.28.662 N052.09.14.148 E020.58.28.107 teal
N052.09.14.148 E020.58.28.107 N052.09.13.659 E020.58.27.966 teal
N052.09.13.659 E020.58.27.966 N052.09.12.907 E020.58.28.222 teal
N052.09.12.907 E020.58.28.222 N052.09.03.365 E020.58.36.744 teal
N052.09.03.365 E020.58.36.744 N052.09.02.594 E020.58.37.888 teal
N052.09.02.594 E020.58.37.888 N052.09.01.922 E020.58.39.379 teal
N052.09.01.922 E020.58.39.379 N052.08.59.775 E020.58.45.406 teal
N052.08.59.775 E020.58.45.406 N052.08.58.656 E020.58.48.758 teal
N052.08.58.656 E020.58.48.758 N052.08.58.752 E020.58.49.495 teal
N052.08.58.752 E020.58.49.495 N052.08.58.897 E020.58.49.984 teal
N052.08.58.897 E020.58.49.984 N052.08.59.191 E020.58.50.582 teal
N052.08.59.191 E020.58.50.582 N052.08.59.520 E020.58.50.831 teal
N052.08.59.520 E020.58.50.831 N052.09.00.192 E020.58.50.729 teal
N052.09.00.253 E020.58.39.224 N052.08.56.933 E020.58.42.640 teal
N052.08.56.933 E020.58.42.640 N052.08.56.678 E020.58.43.201 teal
N052.08.56.678 E020.58.43.201 N052.08.56.547 E020.58.43.751 teal
N052.08.56.547 E020.58.43.751 N052.08.56.538 E020.58.44.427 teal
N052.08.56.538 E020.58.44.427 N052.08.56.644 E020.58.45.101 teal
N052.08.56.644 E020.58.45.101 N052.08.57.326 E020.58.47.151 teal
N052.08.57.326 E020.58.47.151 N052.08.57.452 E020.58.47.284 teal
N052.08.57.452 E020.58.47.284 N052.08.57.563 E020.58.47.314 teal
N052.08.57.563 E020.58.47.314 N052.08.57.629 E020.58.47.239 teal
N052.08.57.629 E020.58.47.239 N052.09.00.294 E020.58.39.899 teal
N052.09.00.294 E020.58.39.899 N052.09.00.337 E020.58.39.431 teal
N052.09.00.337 E020.58.39.431 N052.09.00.292 E020.58.39.215 teal
N052.09.18.051 E020.58.38.792 N052.09.19.764 E020.58.43.355 teal
N052.09.19.764 E020.58.43.355 N052.09.20.055 E020.58.44.419 teal
N052.09.20.055 E020.58.44.419 N052.09.20.333 E020.58.45.817 teal
N052.09.20.333 E020.58.45.817 N052.09.20.262 E020.58.46.607 teal
N052.09.20.262 E020.58.46.607 N052.09.19.948 E020.58.47.405 teal
N052.09.19.948 E020.58.47.405 N052.09.19.422 E020.58.48.193 teal
N052.09.19.422 E020.58.48.193 N052.09.17.297 E020.58.50.237 teal
N052.09.17.297 E020.58.50.237 N052.09.13.502 E020.58.53.702 teal
N052.09.13.502 E020.58.53.702 N052.09.14.168 E020.58.55.826 teal
N052.09.14.168 E020.58.55.826 N052.09.15.649 E020.58.55.147 teal
N052.09.15.649 E020.58.55.147 N052.09.15.910 E020.58.55.380 teal
N052.09.15.910 E020.58.55.380 N052.09.17.475 E020.59.00.106 teal
N052.09.17.475 E020.59.00.106 N052.09.23.419 E020.58.54.847 teal
N052.09.23.419 E020.58.54.847 N052.09.21.491 E020.58.49.098 teal
N052.09.21.491 E020.58.49.098 N052.09.22.172 E020.58.48.351 teal
N052.09.22.172 E020.58.48.351 N052.09.24.782 E020.58.46.016 teal
N052.09.24.782 E020.58.46.016 N052.09.26.994 E020.58.44.063 teal
N052.09.26.994 E020.58.44.063 N052.09.27.175 E020.58.44.111 teal
N052.09.27.175 E020.58.44.111 N052.09.27.444 E020.58.44.341 teal
N052.09.27.444 E020.58.44.341 N052.09.27.667 E020.58.44.623 teal
N052.09.27.667 E020.58.44.623 N052.09.30.569 E020.58.52.784 teal
N052.09.30.569 E020.58.52.784 N052.09.31.084 E020.58.54.120 teal
N052.09.31.084 E020.58.54.120 N052.09.31.672 E020.58.55.231 teal
N052.09.31.672 E020.58.55.231 N052.09.32.369 E020.58.56.373 teal
N052.09.32.369 E020.58.56.373 N052.09.33.503 E020.58.57.654 teal
N052.09.33.503 E020.58.57.654 N052.09.34.574 E020.58.58.548 teal
N052.09.34.574 E020.58.58.548 N052.09.37.463 E020.59.00.618 teal
N052.09.37.463 E020.59.00.618 N052.09.39.545 E020.59.02.057 teal
N052.09.40.485 E020.58.58.466 N052.09.40.089 E020.58.58.965 teal
N052.09.40.089 E020.58.58.965 N052.09.39.791 E020.58.59.098 teal
N052.09.39.791 E020.58.59.098 N052.09.39.463 E020.58.59.154 teal
N052.09.39.463 E020.58.59.154 N052.09.38.759 E020.58.58.809 teal
N052.09.38.759 E020.58.58.809 N052.09.35.800 E020.58.56.693 teal
N052.09.35.800 E020.58.56.693 N052.09.34.140 E020.58.55.295 teal
N052.09.34.140 E020.58.55.295 N052.09.33.002 E020.58.54.062 teal
N052.09.33.002 E020.58.54.062 N052.09.32.017 E020.58.52.409 teal
N052.09.32.017 E020.58.52.409 N052.09.31.351 E020.58.50.697 teal
N052.09.31.351 E020.58.50.697 N052.09.28.817 E020.58.43.126 teal
N052.09.28.817 E020.58.43.126 N052.09.28.828 E020.58.42.736 teal
N052.09.28.828 E020.58.42.736 N052.09.29.129 E020.58.42.214 teal
N052.09.29.129 E020.58.42.214 N052.09.49.993 E020.58.23.091 teal
N052.09.39.717 E020.58.19.015 N052.09.41.421 E020.58.18.483 teal
N052.09.41.421 E020.58.18.483 N052.09.43.054 E020.58.18.190 teal
N052.09.43.054 E020.58.18.190 N052.09.44.491 E020.58.18.075 teal
N052.09.44.491 E020.58.18.075 N052.09.46.560 E020.58.18.478 teal
N052.09.46.560 E020.58.18.478 N052.09.50.307 E020.58.19.463 teal
N052.09.50.307 E020.58.19.463 N052.09.50.496 E020.58.19.693 teal
N052.09.50.496 E020.58.19.693 N052.09.50.551 E020.58.19.946 teal
N052.09.50.551 E020.58.19.946 N052.09.50.449 E020.58.20.356 teal
N052.09.50.449 E020.58.20.356 N052.09.50.234 E020.58.20.611 teal
N052.09.50.234 E020.58.20.611 N052.09.35.562 E020.58.33.811 teal
N052.09.35.562 E020.58.33.811 N052.09.28.032 E020.58.40.554 teal
N052.09.28.032 E020.58.40.554 N052.09.26.506 E020.58.41.223 teal
N052.09.26.506 E020.58.41.223 N052.09.24.336 E020.58.41.189 teal
N052.09.24.336 E020.58.41.189 N052.09.22.221 E020.58.41.032 teal
N052.09.22.221 E020.58.41.032 N052.09.20.838 E020.58.40.913 teal
N052.09.20.838 E020.58.40.913 N052.09.20.547 E020.58.40.674 teal
N052.09.20.547 E020.58.40.674 N052.09.20.215 E020.58.40.141 teal
N052.09.20.215 E020.58.40.141 N052.09.19.885 E020.58.38.832 teal
N052.09.19.885 E020.58.38.832 N052.09.19.826 E020.58.38.342 teal
N052.09.19.826 E020.58.38.342 N052.09.19.956 E020.58.37.649 teal
N052.09.19.956 E020.58.37.649 N052.09.20.363 E020.58.36.658 teal
N052.09.21.305 E020.58.43.569 N052.09.21.624 E020.58.44.519 teal
N052.09.21.624 E020.58.44.519 N052.09.21.917 E020.58.44.926 teal
N052.09.21.917 E020.58.44.926 N052.09.22.280 E020.58.45.191 teal
N052.09.22.280 E020.58.45.191 N052.09.22.726 E020.58.45.207 teal
N052.09.22.726 E020.58.45.207 N052.09.23.076 E020.58.45.207 teal
N052.09.23.076 E020.58.45.207 N052.09.25.544 E020.58.43.325 teal
N052.09.25.544 E020.58.43.325 N052.09.22.966 E020.58.43.406 teal
N052.09.22.966 E020.58.43.406 N052.09.21.266 E020.58.43.547 teal
N052.09.43.875 E020.58.15.379 N052.09.48.169 E020.58.16.801 teal
N052.09.48.169 E020.58.16.801 N052.09.50.271 E020.58.17.478 teal
N052.09.50.271 E020.58.17.478 N052.09.50.494 E020.58.17.455 teal
N052.09.50.494 E020.58.17.455 N052.09.50.687 E020.58.17.218 teal
N052.09.50.687 E020.58.17.218 N052.09.50.699 E020.58.16.993 teal
N052.09.50.699 E020.58.16.993 N052.09.50.691 E020.58.16.736 teal
N052.09.50.691 E020.58.16.736 N052.09.49.095 E020.58.12.267 teal
N052.09.49.095 E020.58.12.267 N052.09.48.799 E020.58.11.839 teal
N052.09.48.799 E020.58.11.839 N052.09.48.532 E020.58.11.718 teal
N052.09.48.532 E020.58.11.718 N052.09.47.774 E020.58.11.709 teal
N052.09.50.368 E020.58.09.323 N052.09.49.905 E020.58.10.150 teal
N052.09.49.905 E020.58.10.150 N052.09.49.924 E020.58.11.739 teal
N052.09.49.924 E020.58.11.739 N052.09.51.115 E020.58.15.676 teal
N052.09.51.115 E020.58.15.676 N052.09.51.320 E020.58.16.242 teal
N052.09.51.320 E020.58.16.242 N052.09.51.745 E020.58.16.509 teal
N052.10.15.965 E020.56.46.373 N052.10.12.823 E020.56.44.054 teal
N052.10.12.823 E020.56.44.054 N052.10.11.922 E020.56.43.735 teal
N052.10.11.922 E020.56.43.735 N052.10.11.187 E020.56.43.858 teal
N052.10.11.187 E020.56.43.858 N052.10.10.496 E020.56.44.231 teal
N052.10.10.496 E020.56.44.231 N052.10.10.035 E020.56.44.718 teal
N052.10.10.035 E020.56.44.718 N052.10.09.273 E020.56.46.050 teal
N052.10.09.273 E020.56.46.050 N052.10.02.365 E020.57.12.656 teal
N052.10.02.365 E020.57.12.656 N052.10.02.302 E020.57.13.607 teal
N052.10.02.302 E020.57.13.607 N052.10.02.425 E020.57.14.697 teal
N052.10.02.425 E020.57.14.697 N052.10.02.720 E020.57.15.878 teal
N052.10.02.720 E020.57.15.878 N052.10.03.526 E020.57.17.105 teal
N052.10.03.526 E020.57.17.105 N052.10.06.986 E020.57.19.832 teal
N052.10.07.482 E020.57.17.908 N052.10.05.054 E020.57.15.906 teal
N052.10.05.054 E020.57.15.906 N052.10.04.390 E020.57.15.112 teal
N052.10.04.390 E020.57.15.112 N052.10.04.027 E020.57.14.550 teal
N052.10.04.027 E020.57.14.550 N052.10.03.851 E020.57.13.378 teal
N052.10.03.851 E020.57.13.378 N052.10.04.012 E020.57.12.634 teal
N052.10.04.012 E020.57.12.634 N052.10.06.401 E020.57.02.847 teal
N052.10.06.401 E020.57.02.847 N052.10.09.961 E020.56.49.442 teal
N052.10.09.961 E020.56.49.442 N052.10.10.807 E020.56.46.952 teal
N052.10.10.807 E020.56.46.952 N052.10.11.014 E020.56.46.522 teal
N052.10.11.014 E020.56.46.522 N052.10.11.443 E020.56.46.322 teal
N052.10.11.443 E020.56.46.322 N052.10.11.845 E020.56.46.296 teal
N052.10.11.845 E020.56.46.296 N052.10.12.353 E020.56.46.552 teal
N052.10.12.353 E020.56.46.552 N052.10.14.201 E020.56.48.017 teal
N052.10.14.201 E020.56.48.017 N052.10.14.505 E020.56.48.775 teal
N052.10.14.505 E020.56.48.775 N052.10.14.842 E020.56.50.419 teal
N052.10.09.327 E020.57.19.262 N052.10.19.248 E020.57.26.856 teal
N052.10.19.248 E020.57.26.856 N052.10.19.550 E020.57.26.808 teal
N052.10.19.550 E020.57.26.808 N052.10.19.722 E020.57.26.642 teal
N052.10.19.722 E020.57.26.642 N052.10.21.952 E020.57.18.789 teal
N052.10.21.952 E020.57.18.789 N052.10.21.952 E020.57.18.501 teal
N052.10.21.952 E020.57.18.501 N052.10.21.796 E020.57.18.092 teal
N052.10.21.796 E020.57.18.092 N052.10.23.270 E020.57.12.877 teal
N052.10.23.270 E020.57.12.877 N052.10.22.594 E020.57.12.216 teal
N052.10.22.594 E020.57.12.216 N052.10.23.764 E020.57.08.096 teal
N052.10.23.764 E020.57.08.096 N052.10.25.528 E020.57.09.418 teal
N052.10.25.528 E020.57.09.418 N052.10.20.560 E020.57.27.434 teal
N052.10.20.560 E020.57.27.434 N052.10.20.579 E020.57.27.666 teal
N052.10.20.579 E020.57.27.666 N052.10.20.927 E020.57.28.036 teal
N052.10.20.927 E020.57.28.036 N052.10.26.521 E020.57.32.310 teal
N052.10.24.656 E020.57.33.938 N052.10.24.588 E020.57.33.030 teal
N052.10.24.588 E020.57.33.030 N052.10.08.750 E020.57.21.177 teal
N052.09.41.344 E020.59.03.108 N052.09.41.891 E020.59.03.363 teal
N052.09.41.891 E020.59.03.363 N052.09.42.245 E020.59.03.419 teal
N052.09.42.245 E020.59.03.419 N052.09.43.224 E020.59.02.941 teal
N052.09.43.224 E020.59.02.941 N052.09.46.120 E020.58.59.569 teal
N052.09.46.120 E020.58.59.569 N052.09.50.064 E020.58.59.477 teal
N052.09.50.064 E020.58.59.477 N052.09.51.328 E020.59.00.320 teal
N052.09.51.328 E020.59.00.320 N052.09.53.373 E020.58.52.926 teal
N052.09.53.373 E020.58.52.926 N052.09.52.002 E020.58.51.909 teal
N052.09.52.002 E020.58.51.909 N052.09.51.663 E020.58.51.471 teal
N052.09.51.663 E020.58.51.471 N052.09.51.327 E020.58.50.608 teal
N052.09.51.327 E020.58.50.608 N052.09.51.250 E020.58.49.951 teal
N052.09.51.250 E020.58.49.951 N052.09.51.321 E020.58.49.225 teal
N052.09.51.321 E020.58.49.225 N052.09.55.583 E020.58.33.562 teal
N052.09.55.583 E020.58.33.562 N052.09.56.553 E020.58.33.979 teal
N052.09.56.553 E020.58.33.979 N052.09.57.215 E020.58.31.583 teal
N052.09.57.215 E020.58.31.583 N052.09.58.549 E020.58.32.166 teal
N052.09.58.549 E020.58.32.166 N052.09.59.169 E020.58.32.305 teal
N052.09.59.169 E020.58.32.305 N052.10.00.577 E020.58.30.867 teal
N052.10.00.577 E020.58.30.867 N052.10.03.342 E020.58.26.272 teal
N052.10.03.342 E020.58.26.272 N052.10.05.738 E020.58.23.625 teal
N052.10.05.738 E020.58.23.625 N052.10.07.405 E020.58.23.313 teal
N052.10.23.014 E020.58.18.506 N052.10.23.481 E020.58.18.487 teal
N052.10.23.481 E020.58.18.487 N052.10.24.266 E020.58.20.582 teal
N052.10.24.266 E020.58.20.582 N052.10.24.256 E020.58.21.246 teal
N052.10.24.256 E020.58.21.246 N052.10.24.185 E020.58.22.198 teal
N052.10.24.185 E020.58.22.198 N052.10.25.929 E020.58.24.121 teal
N052.10.25.929 E020.58.24.121 N052.10.27.044 E020.58.25.236 teal
N052.10.27.044 E020.58.25.236 N052.10.27.599 E020.58.25.070 teal
N052.10.29.329 E020.58.25.033 N052.10.30.220 E020.58.24.822 teal
N052.10.32.165 E020.58.24.392 N052.10.33.299 E020.58.24.082 teal
N052.10.33.299 E020.58.24.082 N052.10.33.257 E020.58.22.276 teal
N052.10.33.257 E020.58.22.276 N052.10.37.851 E020.58.21.099 teal
N052.10.37.851 E020.58.21.099 N052.10.38.761 E020.58.20.651 teal
N052.10.38.761 E020.58.20.651 N052.10.40.146 E020.58.18.599 teal
N052.10.40.146 E020.58.18.599 N052.10.40.531 E020.58.19.620 teal
N052.10.40.531 E020.58.19.620 N052.10.41.156 E020.58.20.036 teal
N052.10.41.156 E020.58.20.036 N052.10.42.096 E020.58.18.120 teal
N052.10.43.850 E020.58.14.289 N052.10.44.593 E020.58.12.668 teal
N052.10.47.350 E020.58.06.569 N052.10.47.676 E020.58.05.876 teal
N052.10.47.676 E020.58.05.876 N052.10.47.756 E020.58.04.512 teal
N052.10.48.980 E020.57.54.492 N052.10.48.529 E020.57.54.204 teal
N052.10.48.529 E020.57.54.204 N052.10.48.298 E020.57.53.717 teal
N052.10.48.298 E020.57.53.717 N052.10.48.703 E020.57.49.910 teal
N052.10.48.703 E020.57.49.910 N052.10.49.588 E020.57.45.412 teal
N052.10.49.588 E020.57.45.412 N052.10.51.159 E020.57.43.305 teal
N052.10.49.965 E020.57.37.836 N052.10.49.375 E020.57.33.796 teal
N052.10.47.897 E020.57.30.478 N052.10.47.698 E020.57.28.361 teal
N052.10.47.698 E020.57.28.361 N052.10.46.992 E020.57.26.370 teal
N052.10.46.992 E020.57.26.370 N052.10.46.327 E020.57.26.548 teal
N052.10.46.327 E020.57.26.548 N052.10.45.832 E020.57.26.983 teal
N052.10.45.832 E020.57.26.983 N052.10.45.525 E020.57.26.897 teal
N052.10.45.525 E020.57.26.897 N052.10.45.310 E020.57.26.304 teal
N052.10.45.310 E020.57.26.304 N052.10.43.458 E020.57.21.203 teal
N052.10.41.658 E020.57.22.761 N052.10.42.427 E020.57.23.072 teal
N052.10.42.427 E020.57.23.072 N052.10.43.264 E020.57.25.555 teal
N052.10.43.264 E020.57.25.555 N052.10.43.223 E020.57.26.600 teal
N052.10.43.223 E020.57.26.600 N052.10.42.183 E020.57.29.653 teal
N052.10.42.183 E020.57.29.653 N052.10.40.778 E020.57.33.370 teal
N052.10.40.778 E020.57.33.370 N052.10.39.924 E020.57.35.157 teal
N052.10.39.924 E020.57.35.157 N052.10.38.939 E020.57.36.332 teal
N052.10.38.939 E020.57.36.332 N052.10.36.263 E020.57.38.827 teal
N052.10.36.263 E020.57.38.827 N052.10.35.319 E020.57.38.949 teal
N052.10.35.319 E020.57.38.949 N052.10.29.335 E020.57.34.243 teal
N052.10.29.335 E020.57.34.243 N052.10.29.317 E020.57.33.882 teal
N052.10.27.744 E020.57.35.380 N052.10.28.731 E020.57.36.189 teal
N052.10.28.731 E020.57.36.189 N052.10.27.035 E020.57.36.055 teal
N052.10.21.446 E020.57.41.091 N052.10.23.727 E020.57.39.667 teal
N052.10.23.727 E020.57.39.667 N052.10.26.368 E020.57.38.606 teal
N052.10.26.368 E020.57.38.606 N052.10.28.868 E020.57.38.347 teal
N052.10.28.868 E020.57.38.347 N052.10.31.040 E020.57.38.465 teal
N052.10.31.040 E020.57.38.465 N052.10.31.760 E020.57.39.059 teal
N052.10.31.760 E020.57.39.059 N052.10.32.127 E020.57.39.822 teal
N052.10.32.127 E020.57.39.822 N052.10.32.273 E020.57.40.623 teal
N052.10.32.273 E020.57.40.623 N052.10.32.314 E020.57.41.067 teal
N052.10.32.314 E020.57.41.067 N052.10.32.156 E020.57.42.017 teal
N052.10.32.156 E020.57.42.017 N052.10.31.674 E020.57.42.993 teal
N052.10.31.674 E020.57.42.993 N052.10.19.205 E020.57.54.277 teal
N052.10.19.205 E020.57.54.277 N052.10.16.852 E020.57.55.779 teal
N052.10.16.852 E020.57.55.779 N052.10.16.640 E020.57.55.745 teal
N052.10.16.640 E020.57.55.745 N052.10.16.375 E020.57.55.500 teal
N052.10.16.375 E020.57.55.500 N052.10.16.120 E020.57.55.194 teal
N052.10.16.120 E020.57.55.194 N052.10.15.420 E020.57.53.680 teal
N052.10.15.420 E020.57.53.680 N052.10.14.153 E020.57.50.018 teal
N052.10.14.153 E020.57.50.018 N052.10.14.098 E020.57.48.660 teal
N052.10.14.098 E020.57.48.660 N052.10.14.555 E020.57.47.372 teal
N052.10.08.837 E020.57.52.606 N052.10.11.370 E020.57.50.389 teal
N052.10.11.370 E020.57.50.389 N052.10.12.592 E020.57.50.387 teal
N052.10.12.592 E020.57.50.387 N052.10.13.104 E020.57.51.124 teal
N052.10.13.104 E020.57.51.124 N052.10.13.584 E020.57.52.860 teal
N052.10.13.584 E020.57.52.860 N052.10.08.868 E020.57.52.609 teal
N052.10.03.410 E020.57.57.528 N052.10.05.456 E020.57.56.259 teal
N052.10.05.456 E020.57.56.259 N052.10.07.832 E020.57.55.276 teal
N052.10.07.832 E020.57.55.276 N052.10.09.800 E020.57.54.857 teal
N052.10.09.800 E020.57.54.857 N052.10.11.950 E020.57.54.981 teal
N052.10.11.950 E020.57.54.981 N052.10.13.766 E020.57.55.273 teal
N052.10.13.766 E020.57.55.273 N052.10.14.143 E020.57.55.381 teal
N052.10.14.143 E020.57.55.381 N052.10.14.480 E020.57.55.892 teal
N052.10.14.480 E020.57.55.892 N052.10.14.674 E020.57.56.471 teal
N052.10.14.674 E020.57.56.471 N052.10.14.712 E020.57.56.941 teal
N052.10.14.712 E020.57.56.941 N052.10.14.642 E020.57.57.594 teal
N052.10.14.642 E020.57.57.594 N052.10.14.329 E020.57.58.521 teal
N052.10.14.329 E020.57.58.521 N052.10.12.675 E020.58.00.193 teal
N052.10.12.675 E020.58.00.193 N052.09.54.964 E020.58.16.387 teal
N052.09.54.964 E020.58.16.387 N052.09.54.395 E020.58.16.533 teal
N052.09.54.395 E020.58.16.533 N052.09.54.232 E020.58.16.389 teal
N052.09.54.232 E020.58.16.389 N052.09.54.043 E020.58.15.788 teal
N052.10.44.403 E020.57.27.818 N052.10.42.232 E020.57.33.391 teal
N052.10.42.232 E020.57.33.391 N052.10.44.789 E020.57.31.061 teal
N052.10.44.789 E020.57.31.061 N052.10.44.976 E020.57.30.723 teal
N052.10.44.976 E020.57.30.723 N052.10.45.005 E020.57.30.217 teal
N052.10.45.005 E020.57.30.217 N052.10.45.001 E020.57.29.723 teal
N052.10.45.001 E020.57.29.723 N052.10.44.399 E020.57.27.827 teal
N052.10.46.218 E020.57.43.299 N052.10.44.767 E020.57.33.792 teal
N052.10.44.767 E020.57.33.792 N052.10.44.504 E020.57.33.649 teal
N052.10.44.504 E020.57.33.649 N052.10.37.611 E020.57.39.888 teal
N052.10.37.611 E020.57.39.888 N052.10.37.694 E020.57.40.390 teal
N052.10.37.694 E020.57.40.390 N052.10.37.949 E020.57.40.781 teal
N052.10.37.949 E020.57.40.781 N052.10.38.353 E020.57.40.880 teal
N052.10.38.353 E020.57.40.880 N052.10.38.711 E020.57.40.744 teal
N052.10.38.711 E020.57.40.744 N052.10.38.965 E020.57.40.569 teal
N052.10.38.965 E020.57.40.569 N052.10.39.432 E020.57.39.286 teal
N052.10.39.432 E020.57.39.286 N052.10.40.307 E020.57.38.803 teal
N052.10.40.307 E020.57.38.803 N052.10.45.342 E020.57.42.450 teal
N052.10.45.342 E020.57.42.450 N052.10.45.477 E020.57.44.260 teal
N052.10.45.477 E020.57.44.260 N052.10.45.051 E020.57.46.173 teal
N052.10.45.051 E020.57.46.173 N052.10.45.891 E020.57.46.779 teal
N052.10.45.891 E020.57.46.779 N052.10.46.094 E020.57.46.650 teal
N052.10.46.094 E020.57.46.650 N052.10.46.238 E020.57.46.522 teal
N052.10.46.238 E020.57.46.522 N052.10.46.465 E020.57.46.132 teal
N052.10.46.465 E020.57.46.132 N052.10.46.515 E020.57.45.472 teal
N052.10.46.515 E020.57.45.472 N052.10.46.217 E020.57.43.343 teal
N052.10.43.247 E020.57.50.705 N052.10.39.927 E020.57.48.391 teal
N052.10.39.927 E020.57.48.391 N052.10.36.694 E020.57.51.191 teal
N052.10.36.694 E020.57.51.191 N052.10.36.548 E020.57.51.587 teal
N052.10.36.548 E020.57.51.587 N052.10.32.659 E020.57.55.121 teal
N052.10.32.659 E020.57.55.121 N052.10.32.568 E020.57.55.402 teal
N052.10.32.568 E020.57.55.402 N052.10.31.962 E020.57.56.053 teal
N052.10.31.962 E020.57.56.053 N052.10.32.697 E020.57.58.103 teal
N052.10.32.697 E020.57.58.103 N052.10.34.325 E020.57.56.690 teal
N052.10.34.325 E020.57.56.690 N052.10.36.307 E020.57.55.878 teal
N052.10.36.307 E020.57.55.878 N052.10.38.951 E020.57.55.518 teal
N052.10.38.951 E020.57.55.518 N052.10.40.970 E020.58.00.375 teal
N052.10.40.970 E020.58.00.375 N052.10.41.210 E020.58.00.438 teal
N052.10.41.210 E020.58.00.438 N052.10.41.355 E020.58.00.365 teal
N052.10.41.355 E020.58.00.365 N052.10.41.629 E020.57.59.490 teal
N052.10.41.629 E020.57.59.490 N052.10.43.289 E020.57.51.403 teal
N052.10.43.289 E020.57.51.403 N052.10.43.288 E020.57.50.682 teal
N052.10.36.843 E020.57.42.688 N052.10.36.142 E020.57.41.903 teal
N052.10.36.142 E020.57.41.903 N052.10.35.498 E020.57.41.986 teal
N052.10.35.498 E020.57.41.986 N052.10.34.459 E020.57.42.781 teal
N052.10.34.459 E020.57.42.781 N052.10.34.371 E020.57.44.169 teal
N052.10.34.371 E020.57.44.169 N052.10.36.506 E020.57.50.436 teal
N052.10.36.506 E020.57.50.436 N052.10.36.784 E020.57.50.637 teal
N052.10.36.784 E020.57.50.637 N052.10.37.505 E020.57.49.867 teal
N052.10.37.505 E020.57.49.867 N052.10.37.498 E020.57.49.528 teal
N052.10.37.498 E020.57.49.528 N052.10.36.933 E020.57.47.566 teal
N052.10.36.933 E020.57.47.566 N052.10.36.175 E020.57.48.277 teal
N052.10.36.175 E020.57.48.277 N052.10.35.203 E020.57.45.332 teal
N052.10.35.203 E020.57.45.332 N052.10.36.256 E020.57.44.348 teal
N052.10.36.256 E020.57.44.348 N052.10.36.749 E020.57.43.636 teal
N052.10.36.749 E020.57.43.636 N052.10.36.901 E020.57.43.216 teal
N052.10.36.901 E020.57.43.216 N052.10.36.865 E020.57.42.750 teal
N052.10.47.171 E020.57.50.312 N052.10.46.952 E020.57.49.982 teal
N052.10.46.952 E020.57.49.982 N052.10.46.526 E020.57.49.846 teal
N052.10.46.526 E020.57.49.846 N052.10.46.216 E020.57.50.138 teal
N052.10.46.216 E020.57.50.138 N052.10.45.971 E020.57.50.742 teal
N052.10.45.971 E020.57.50.742 N052.10.44.862 E020.57.51.270 teal
N052.10.44.862 E020.57.51.270 N052.10.44.563 E020.57.52.420 teal
N052.10.44.563 E020.57.52.420 N052.10.43.470 E020.57.56.949 teal
N052.10.43.470 E020.57.56.949 N052.10.42.813 E020.58.00.564 teal
N052.10.42.813 E020.58.00.564 N052.10.41.840 E020.58.02.515 teal
N052.10.41.840 E020.58.02.515 N052.10.42.179 E020.58.03.710 teal
N052.10.42.179 E020.58.03.710 N052.10.41.631 E020.58.06.725 teal
N052.10.41.631 E020.58.06.725 N052.10.39.338 E020.58.10.821 teal
N052.10.39.338 E020.58.10.821 N052.10.37.996 E020.58.12.884 teal
N052.10.37.996 E020.58.12.884 N052.10.38.974 E020.58.15.361 teal
N052.10.38.974 E020.58.15.361 N052.10.39.531 E020.58.15.934 teal
N052.10.39.531 E020.58.15.934 N052.10.39.869 E020.58.15.917 teal
N052.10.39.869 E020.58.15.917 N052.10.40.077 E020.58.15.580 teal
N052.10.40.077 E020.58.15.580 N052.10.40.276 E020.58.15.072 teal
N052.10.40.276 E020.58.15.072 N052.10.39.344 E020.58.13.602 teal
N052.10.39.344 E020.58.13.602 N052.10.44.526 E020.58.02.507 teal
N052.10.44.526 E020.58.02.507 N052.10.43.406 E020.58.00.020 teal
N052.10.43.406 E020.58.00.020 N052.10.43.927 E020.57.56.002 teal
N052.10.43.927 E020.57.56.002 N052.10.44.443 E020.57.54.960 teal
N052.10.44.443 E020.57.54.960 N052.10.45.337 E020.57.54.910 teal
N052.10.45.337 E020.57.54.910 N052.10.45.500 E020.57.54.385 teal
N052.10.45.500 E020.57.54.385 N052.10.45.848 E020.57.54.262 teal
N052.10.45.848 E020.57.54.262 N052.10.46.143 E020.57.52.206 teal
N052.10.46.143 E020.57.52.206 N052.10.46.876 E020.57.52.055 teal
N052.10.46.876 E020.57.52.055 N052.10.47.187 E020.57.50.307 teal
N052.10.31.427 E020.57.53.196 N052.10.29.638 E020.57.48.051 teal
N052.10.29.638 E020.57.48.051 N052.10.29.341 E020.57.48.080 teal
N052.10.29.341 E020.57.48.080 N052.10.29.125 E020.57.48.356 teal
N052.10.29.125 E020.57.48.356 N052.10.29.015 E020.57.48.928 teal
N052.10.29.015 E020.57.48.928 N052.10.29.168 E020.57.50.076 teal
N052.10.29.168 E020.57.50.076 N052.10.30.119 E020.57.52.934 teal
N052.10.30.119 E020.57.52.934 N052.10.30.587 E020.57.53.547 teal
N052.10.30.587 E020.57.53.547 N052.10.31.048 E020.57.53.613 teal
N052.10.31.048 E020.57.53.613 N052.10.31.479 E020.57.53.276 teal
N052.09.57.197 E020.58.18.644 N052.09.55.853 E020.58.18.492 teal
N052.09.55.853 E020.58.18.492 N052.09.55.824 E020.58.18.046 teal
N052.09.55.824 E020.58.18.046 N052.09.57.448 E020.58.16.589 teal
N052.09.57.448 E020.58.16.589 N052.09.57.438 E020.58.18.223 teal
N052.09.57.438 E020.58.18.223 N052.09.57.201 E020.58.18.634 teal
N052.09.52.777 E020.58.20.550 N052.09.53.425 E020.58.20.198 teal
N052.09.53.425 E020.58.20.198 N052.09.55.514 E020.58.20.552 teal
N052.09.55.514 E020.58.20.552 N052.09.56.182 E020.58.20.844 teal
N052.09.56.182 E020.58.20.844 N052.09.57.130 E020.58.21.767 teal
N052.09.57.130 E020.58.21.767 N052.09.56.993 E020.58.23.189 teal
N052.09.56.993 E020.58.23.189 N052.09.49.086 E020.58.52.126 teal
N052.09.49.086 E020.58.52.126 N052.09.48.467 E020.58.53.482 teal
N052.09.48.467 E020.58.53.482 N052.09.47.632 E020.58.54.976 teal
N052.09.47.632 E020.58.54.976 N052.09.46.813 E020.58.55.755 teal
N052.09.46.813 E020.58.55.755 N052.09.46.463 E020.58.55.890 teal
N052.09.46.463 E020.58.55.890 N052.09.46.208 E020.58.55.560 teal
N052.09.46.208 E020.58.55.560 N052.09.46.078 E020.58.55.351 teal
N052.09.46.078 E020.58.55.351 N052.09.45.940 E020.58.54.824 teal
N052.09.45.940 E020.58.54.824 N052.09.45.871 E020.58.53.589 teal
N052.09.45.871 E020.58.53.589 N052.09.45.785 E020.58.51.004 teal
N052.09.45.785 E020.58.51.004 N052.09.46.194 E020.58.46.670 teal
N052.09.46.194 E020.58.46.670 N052.09.46.528 E020.58.44.016 teal
N052.09.44.325 E020.58.52.039 N052.09.44.956 E020.58.56.645 teal
N052.09.44.956 E020.58.56.645 N052.09.45.134 E020.58.57.286 teal
N052.09.45.134 E020.58.57.286 N052.09.45.469 E020.58.57.669 teal
N052.09.45.469 E020.58.57.669 N052.09.42.960 E020.59.00.602 teal
N052.09.42.960 E020.59.00.602 N052.09.42.414 E020.59.00.889 teal
N052.09.42.414 E020.59.00.889 N052.09.41.966 E020.59.00.831 teal
;- BLD
N052.10.28.035 E020.58.04.726 N052.10.28.547 E020.58.06.328 maroon
N052.10.28.035 E020.58.04.726 N052.10.07.405 E020.58.23.313 maroon
N052.10.07.405 E020.58.23.313 N052.10.07.949 E020.58.24.948 maroon
N052.10.07.949 E020.58.24.948 N052.10.12.350 E020.58.20.909 maroon
N052.10.12.350 E020.58.20.909 N052.10.17.032 E020.58.23.086 maroon
N052.10.17.032 E020.58.23.086 N052.10.18.812 E020.58.21.512 maroon
N052.10.18.812 E020.58.21.512 N052.10.19.164 E020.58.22.558 maroon
N052.10.19.164 E020.58.22.558 N052.10.23.147 E020.58.18.961 maroon
N052.10.23.147 E020.58.18.961 N052.10.21.123 E020.58.13.036 maroon
N052.10.21.123 E020.58.13.036 N052.10.28.547 E020.58.06.328 maroon
N052.10.27.627 E020.58.24.819 N052.10.27.899 E020.58.28.431 maroon
N052.10.27.899 E020.58.28.431 N052.10.29.536 E020.58.28.088 maroon
N052.10.29.536 E020.58.28.088 N052.10.29.198 E020.58.24.455 maroon
N052.10.29.198 E020.58.24.455 N052.10.27.627 E020.58.24.814 maroon
N052.10.30.498 E020.58.27.561 N052.10.30.224 E020.58.24.699 maroon
N052.10.30.224 E020.58.24.699 N052.10.32.187 E020.58.24.301 maroon
N052.10.32.187 E020.58.24.301 N052.10.32.341 E020.58.27.174 maroon
N052.10.32.341 E020.58.27.174 N052.10.30.497 E020.58.27.571 maroon
N052.10.41.862 E020.58.17.825 N052.10.42.913 E020.58.19.129 maroon
N052.10.42.913 E020.58.19.129 N052.10.44.681 E020.58.15.445 maroon
N052.10.44.681 E020.58.15.445 N052.10.43.669 E020.58.14.142 maroon
N052.10.43.669 E020.58.14.142 N052.10.41.864 E020.58.17.826 maroon
N052.10.44.041 E020.58.11.948 N052.10.45.861 E020.58.14.306 maroon
N052.10.45.861 E020.58.14.306 N052.10.48.747 E020.58.08.231 maroon
N052.10.48.747 E020.58.08.231 N052.10.47.276 E020.58.06.497 maroon
N052.10.47.276 E020.58.06.497 N052.10.45.625 E020.58.10.058 maroon
N052.10.45.625 E020.58.10.058 N052.10.45.218 E020.58.09.509 maroon
N052.10.45.218 E020.58.09.509 N052.10.44.038 E020.58.11.958 maroon
N052.10.47.706 E020.58.04.507 N052.10.49.217 E020.58.05.022 maroon
N052.10.49.217 E020.58.05.022 N052.10.50.360 E020.57.54.946 maroon
N052.10.50.360 E020.57.54.946 N052.10.48.858 E020.57.54.475 maroon
N052.10.48.858 E020.57.54.475 N052.10.48.693 E020.57.55.166 maroon
N052.10.48.693 E020.57.55.166 N052.10.47.710 E020.58.03.978 maroon
N052.10.47.710 E020.58.03.978 N052.10.47.700 E020.58.04.507 maroon
N052.10.50.539 E020.57.43.271 N052.10.51.138 E020.57.43.048 maroon
N052.10.51.138 E020.57.43.048 N052.10.51.236 E020.57.43.684 maroon
N052.10.51.236 E020.57.43.684 N052.10.52.268 E020.57.43.264 maroon
N052.10.52.268 E020.57.43.264 N052.10.51.325 E020.57.37.358 maroon
N052.10.51.325 E020.57.37.358 N052.10.49.939 E020.57.37.882 maroon
N052.10.49.939 E020.57.37.882 N052.10.50.509 E020.57.42.144 maroon
N052.10.50.509 E020.57.42.144 N052.10.50.372 E020.57.42.220 maroon
N052.10.50.372 E020.57.42.220 N052.10.50.533 E020.57.43.256 maroon
N052.10.48.323 E020.57.34.223 N052.10.50.005 E020.57.33.497 maroon
N052.10.50.005 E020.57.33.497 N052.10.49.475 E020.57.29.962 maroon
N052.10.49.475 E020.57.29.962 N052.10.47.754 E020.57.30.626 maroon
N052.10.47.754 E020.57.30.626 N052.10.48.266 E020.57.34.246 maroon
N052.10.03.650 E020.58.27.684 N052.10.05.224 E020.58.27.972 maroon
N052.10.05.224 E020.58.27.972 N052.10.05.020 E020.58.30.741 maroon
N052.10.05.020 E020.58.30.741 N052.10.03.465 E020.58.30.503 maroon
N052.10.03.465 E020.58.30.503 N052.10.03.607 E020.58.27.714 maroon
N052.10.01.808 E020.58.31.734 N052.10.01.388 E020.58.35.823 maroon
N052.10.01.388 E020.58.35.823 N052.09.56.721 E020.58.34.742 maroon
N052.09.56.721 E020.58.34.742 N052.09.56.874 E020.58.33.228 maroon
N052.09.56.874 E020.58.33.228 N052.10.01.108 E020.58.34.169 maroon
N052.10.01.108 E020.58.34.169 N052.10.01.390 E020.58.31.605 maroon
N052.10.01.390 E020.58.31.605 N052.10.01.809 E020.58.31.658 maroon
N052.10.24.143 E020.57.08.115 N052.10.25.097 E020.57.04.935 maroon
N052.10.25.097 E020.57.04.935 N052.10.26.680 E020.57.06.154 maroon
N052.10.26.680 E020.57.06.154 N052.10.25.705 E020.57.09.360 maroon
N052.10.25.705 E020.57.09.360 N052.10.24.160 E020.57.08.171 maroon
N052.09.18.449 E020.59.01.617 N052.09.20.760 E020.58.59.530 maroon
N052.09.20.760 E020.58.59.530 N052.09.20.560 E020.58.58.855 maroon
N052.09.20.560 E020.58.58.855 N052.09.25.455 E020.58.54.397 maroon
N052.09.25.455 E020.58.54.397 N052.09.27.027 E020.58.59.067 maroon
N052.09.27.027 E020.58.59.067 N052.09.19.847 E020.59.05.638 maroon
N052.09.19.847 E020.59.05.638 N052.09.18.448 E020.59.01.617 maroon
;- LNS
N052.08.58.605 E020.58.52.203 N052.08.58.218 E020.58.51.623 olive
N052.08.58.218 E020.58.51.623 N052.08.57.957 E020.58.50.935 olive
N052.08.57.957 E020.58.50.935 N052.08.57.286 E020.58.49.084 olive
N052.08.57.286 E020.58.49.084 N052.08.56.077 E020.58.45.403 olive
N052.08.56.077 E020.58.45.403 N052.08.55.921 E020.58.44.749 olive
N052.08.55.921 E020.58.44.749 N052.08.55.919 E020.58.44.059 olive
N052.08.55.919 E020.58.44.059 N052.08.55.999 E020.58.43.055 olive
N052.08.55.999 E020.58.43.055 N052.08.56.273 E020.58.42.301 olive
N052.08.56.273 E020.58.42.301 N052.08.56.811 E020.58.41.520 olive
N052.08.56.811 E020.58.41.520 N052.09.01.931 E020.58.36.763 olive
N052.09.01.931 E020.58.36.763 N052.09.03.388 E020.58.35.439 olive
N052.09.03.388 E020.58.35.439 N052.09.13.115 E020.58.26.686 olive
N052.09.13.115 E020.58.26.686 N052.09.13.763 E020.58.26.659 olive
N052.09.13.763 E020.58.26.659 N052.09.14.197 E020.58.26.799 olive
N052.09.14.197 E020.58.26.799 N052.09.14.790 E020.58.27.289 olive
N052.09.14.790 E020.58.27.289 N052.09.15.213 E020.58.28.147 olive
N052.09.15.213 E020.58.28.147 N052.09.15.387 E020.58.28.558 olive
N052.09.15.387 E020.58.28.558 N052.09.17.576 E020.58.34.956 olive
N052.09.02.631 E020.58.36.096 N052.09.01.859 E020.58.37.262 olive
N052.09.01.859 E020.58.37.262 N052.09.00.323 E020.58.41.324 olive
N052.09.00.323 E020.58.41.324 N052.08.57.756 E020.58.48.625 olive
N052.08.57.756 E020.58.48.625 N052.08.57.688 E020.58.49.148 olive
N052.08.57.688 E020.58.49.148 N052.08.57.827 E020.58.50.548 olive
N052.09.18.662 E020.58.38.188 N052.09.19.637 E020.58.40.897 olive
N052.09.19.637 E020.58.40.897 N052.09.20.178 E020.58.42.339 olive
N052.09.20.178 E020.58.42.339 N052.09.21.950 E020.58.47.494 olive
N052.09.19.790 E020.58.41.204 N052.09.20.534 E020.58.42.097 olive
N052.09.20.534 E020.58.42.097 N052.09.21.041 E020.58.42.435 olive
N052.09.21.041 E020.58.42.435 N052.09.27.634 E020.58.42.341 olive
N052.09.27.634 E020.58.42.341 N052.09.30.982 E020.58.51.957 olive
N052.09.30.982 E020.58.51.957 N052.09.31.366 E020.58.52.957 olive
N052.09.31.366 E020.58.52.957 N052.09.31.818 E020.58.53.808 olive
N052.09.31.818 E020.58.53.808 N052.09.32.551 E020.58.54.925 olive
N052.09.32.551 E020.58.54.925 N052.09.33.282 E020.58.55.933 olive
N052.09.33.282 E020.58.55.933 N052.09.34.367 E020.58.56.941 olive
N052.09.34.367 E020.58.56.941 N052.09.36.116 E020.58.58.259 olive
N052.09.36.116 E020.58.58.259 N052.09.39.868 E020.59.00.892 olive
N052.09.14.354 E020.58.54.391 N052.09.16.665 E020.58.52.281 olive
N052.09.16.665 E020.58.52.281 N052.09.19.691 E020.58.49.576 olive
N052.09.19.691 E020.58.49.576 N052.09.23.629 E020.58.45.978 olive
N052.09.23.629 E020.58.45.978 N052.09.28.092 E020.58.41.909 olive
N052.09.28.092 E020.58.41.909 N052.09.50.354 E020.58.21.645 olive
N052.09.48.944 E020.58.10.614 N052.09.51.430 E020.58.17.829 olive
N052.09.51.132 E020.58.18.798 N052.09.45.918 E020.58.17.329 olive
N052.09.45.918 E020.58.17.329 N052.09.44.730 E020.58.17.181 olive
N052.09.44.730 E020.58.17.181 N052.09.42.968 E020.58.17.187 olive
N052.09.42.968 E020.58.17.187 N052.09.41.478 E020.58.17.456 olive
N052.09.16.085 E020.58.52.792 N052.09.17.844 E020.58.57.969 olive
N052.09.19.478 E020.58.56.316 N052.09.17.806 E020.58.51.299 olive
N052.09.20.125 E020.58.49.172 N052.09.21.870 E020.58.54.215 olive
N052.09.57.791 E020.58.22.365 N052.09.58.008 E020.58.15.989 olive
N052.09.58.008 E020.58.15.989 N052.09.58.158 E020.58.15.070 olive
N052.09.58.158 E020.58.15.070 N052.09.58.694 E020.58.14.137 olive
N052.09.41.760 E020.59.02.204 N052.09.42.273 E020.59.02.397 olive
N052.09.42.273 E020.59.02.397 N052.09.42.794 E020.59.02.267 olive
N052.09.42.794 E020.59.02.267 N052.09.45.881 E020.58.58.629 olive
N052.09.45.881 E020.58.58.629 N052.09.46.847 E020.58.57.468 olive
N052.09.46.847 E020.58.57.468 N052.09.47.607 E020.58.56.617 olive
N052.09.47.607 E020.58.56.617 N052.09.48.279 E020.58.55.417 olive
N052.09.48.279 E020.58.55.417 N052.09.49.039 E020.58.54.045 olive
N052.09.49.039 E020.58.54.045 N052.09.49.499 E020.58.52.979 olive
N052.09.49.499 E020.58.52.979 N052.09.49.954 E020.58.51.465 olive
N052.09.49.954 E020.58.51.465 N052.09.50.949 E020.58.47.903 olive
N052.09.50.949 E020.58.47.903 N052.09.55.989 E020.58.29.016 olive
N052.09.55.989 E020.58.29.016 N052.09.56.637 E020.58.26.631 olive
N052.09.56.637 E020.58.26.631 N052.09.57.621 E020.58.23.056 olive
N052.09.57.621 E020.58.23.056 N052.09.57.943 E020.58.21.709 olive
N052.09.57.943 E020.58.21.709 N052.09.58.289 E020.58.20.506 olive
N052.09.58.289 E020.58.20.506 N052.09.58.695 E020.58.19.924 olive
N052.09.53.178 E020.58.19.294 N052.09.56.503 E020.58.19.682 olive
N052.09.56.503 E020.58.19.682 N052.09.58.274 E020.58.19.884 olive
N052.09.58.274 E020.58.19.884 N052.09.59.204 E020.58.19.927 olive
N052.09.59.204 E020.58.19.927 N052.10.00.904 E020.58.19.914 olive
N052.10.00.904 E020.58.19.914 N052.10.02.632 E020.58.19.665 olive
N052.10.02.632 E020.58.19.665 N052.10.03.177 E020.58.19.565 olive
N052.10.03.177 E020.58.19.565 N052.10.03.488 E020.58.19.434 olive
N052.10.03.488 E020.58.19.434 N052.10.03.831 E020.58.19.237 olive
N052.10.03.831 E020.58.19.237 N052.10.03.992 E020.58.19.139 olive
N052.10.03.992 E020.58.19.139 N052.10.05.445 E020.58.17.727 olive
N052.10.05.445 E020.58.17.727 N052.10.07.886 E020.58.15.542 olive
N052.10.07.886 E020.58.15.542 N052.10.09.093 E020.58.14.460 olive
N052.10.09.093 E020.58.14.460 N052.10.09.195 E020.58.14.377 olive
N052.10.09.195 E020.58.14.377 N052.10.09.249 E020.58.14.223 olive
N052.10.09.249 E020.58.14.223 N052.10.09.313 E020.58.14.017 olive
N052.10.09.313 E020.58.14.017 N052.10.09.319 E020.58.13.642 olive
N052.10.09.319 E020.58.13.642 N052.10.09.351 E020.58.13.433 olive
N052.10.09.351 E020.58.13.433 N052.10.09.406 E020.58.13.259 olive
N052.10.09.406 E020.58.13.259 N052.10.09.480 E020.58.13.178 olive
N052.10.09.480 E020.58.13.178 N052.10.11.540 E020.58.11.210 olive
N052.10.11.540 E020.58.11.210 N052.10.13.940 E020.58.09.070 olive
N052.10.13.940 E020.58.09.070 N052.10.15.522 E020.58.07.654 olive
N052.10.15.522 E020.58.07.654 N052.10.17.087 E020.58.06.280 olive
N052.10.17.087 E020.58.06.280 N052.10.19.554 E020.58.04.012 olive
N052.10.19.554 E020.58.04.012 N052.10.21.447 E020.58.02.242 olive
N052.10.21.447 E020.58.02.242 N052.10.24.225 E020.57.59.730 olive
N052.10.24.225 E020.57.59.730 N052.10.29.117 E020.57.55.280 olive
N052.10.29.948 E020.57.55.217 N052.10.29.117 E020.57.55.280 olive
N052.09.53.139 E020.58.19.116 N052.10.00.190 E020.58.12.729 olive
N052.10.00.190 E020.58.12.729 N052.10.04.398 E020.58.08.957 olive
N052.10.04.398 E020.58.08.957 N052.10.13.852 E020.58.00.414 olive
N052.10.13.852 E020.58.00.414 N052.10.18.060 E020.57.56.577 olive
N052.10.18.060 E020.57.56.577 N052.10.25.925 E020.57.49.420 olive
N052.10.25.925 E020.57.49.420 N052.10.31.121 E020.57.44.764 olive
N052.10.31.121 E020.57.44.764 N052.10.37.219 E020.57.39.131 olive
N052.10.37.219 E020.57.39.131 N052.10.40.418 E020.57.36.242 olive
N052.10.40.418 E020.57.36.242 N052.10.45.125 E020.57.31.932 olive
N052.10.45.125 E020.57.31.932 N052.10.46.233 E020.57.30.851 olive
N052.10.07.338 E020.57.53.977 N052.10.09.958 E020.57.53.752 olive
N052.10.09.958 E020.57.53.752 N052.10.13.932 E020.57.53.965 olive
N052.10.13.932 E020.57.53.965 N052.10.14.554 E020.57.54.326 olive
N052.10.14.554 E020.57.54.326 N052.10.15.067 E020.57.55.071 olive
N052.10.12.925 E020.57.48.899 N052.10.14.981 E020.57.54.746 olive
N052.10.14.981 E020.57.54.746 N052.10.15.940 E020.57.57.574 olive
N052.10.15.940 E020.57.57.574 N052.10.18.192 E020.58.04.053 olive
N052.10.18.192 E020.58.04.053 N052.10.18.513 E020.58.04.991 olive
N052.10.25.480 E020.57.37.506 N052.10.27.642 E020.57.37.298 olive
N052.10.27.642 E020.57.37.298 N052.10.30.968 E020.57.37.082 olive
N052.10.30.968 E020.57.37.082 N052.10.31.757 E020.57.37.295 olive
N052.10.28.476 E020.57.34.798 N052.10.32.857 E020.57.38.116 olive
N052.10.32.857 E020.57.38.116 N052.10.35.207 E020.57.39.861 olive
N052.10.35.207 E020.57.39.861 N052.10.37.887 E020.57.41.906 olive
N052.10.37.887 E020.57.41.906 N052.10.40.499 E020.57.43.879 olive
N052.10.40.499 E020.57.43.879 N052.10.44.138 E020.57.46.627 olive
N052.10.44.138 E020.57.46.627 N052.10.46.058 E020.57.48.051 olive
N052.10.46.058 E020.57.48.051 N052.10.46.476 E020.57.48.327 olive
N052.10.46.476 E020.57.48.327 N052.10.46.863 E020.57.48.301 olive
N052.10.46.863 E020.57.48.301 N052.10.47.242 E020.57.47.895 olive
N052.10.47.242 E020.57.47.895 N052.10.47.504 E020.57.47.470 olive
N052.10.47.504 E020.57.47.470 N052.10.48.300 E020.57.45.110 olive
N052.10.48.300 E020.57.45.110 N052.10.48.878 E020.57.43.595 olive
N052.10.48.878 E020.57.43.595 N052.10.49.777 E020.57.41.016 olive
N052.10.49.777 E020.57.41.016 N052.10.49.448 E020.57.40.692 olive
N052.10.42.796 E020.57.21.904 N052.10.43.124 E020.57.22.581 olive
N052.10.43.124 E020.57.22.581 N052.10.44.339 E020.57.25.733 olive
N052.10.44.339 E020.57.25.733 N052.10.45.597 E020.57.29.064 olive
N052.10.45.597 E020.57.29.064 N052.10.46.658 E020.57.31.982 olive
N052.10.46.658 E020.57.31.982 N052.10.46.957 E020.57.32.835 olive
N052.10.46.957 E020.57.32.835 N052.10.47.115 E020.57.33.677 olive
N052.10.47.115 E020.57.33.677 N052.10.47.426 E020.57.36.102 olive
N052.10.47.426 E020.57.36.102 N052.10.47.815 E020.57.38.875 olive
N052.10.47.815 E020.57.38.875 N052.10.48.361 E020.57.42.743 olive
N052.10.48.361 E020.57.42.743 N052.10.48.528 E020.57.44.277 olive
N052.10.48.528 E020.57.44.277 N052.10.48.546 E020.57.44.548 olive
N052.10.44.021 E020.57.25.032 N052.10.44.127 E020.57.25.639 olive
N052.10.44.127 E020.57.25.639 N052.10.44.086 E020.57.26.183 olive
N052.10.44.086 E020.57.26.183 N052.10.43.933 E020.57.27.010 olive
N052.10.43.933 E020.57.27.010 N052.10.41.010 E020.57.34.733 olive
N052.10.41.010 E020.57.34.733 N052.10.40.502 E020.57.35.700 olive
N052.10.40.502 E020.57.35.700 N052.10.39.870 E020.57.36.734 olive
N052.10.44.275 E020.57.46.743 N052.10.44.493 E020.57.47.283 olive
N052.10.44.493 E020.57.47.283 N052.10.44.582 E020.57.47.868 olive
N052.10.44.582 E020.57.47.868 N052.10.44.564 E020.57.48.765 olive
N052.10.44.564 E020.57.48.765 N052.10.43.866 E020.57.51.982 olive
N052.10.43.866 E020.57.51.982 N052.10.42.114 E020.58.00.296 olive
N052.10.42.114 E020.58.00.296 N052.10.41.859 E020.58.00.989 olive
N052.10.41.859 E020.58.00.989 N052.10.41.450 E020.58.01.581 olive
N052.10.41.450 E020.58.01.581 N052.10.38.996 E020.58.04.301 olive
N052.10.38.996 E020.58.04.301 N052.10.36.626 E020.58.06.876 olive
N052.10.36.626 E020.58.06.876 N052.10.35.675 E020.58.07.871 olive
N052.10.35.675 E020.58.07.871 N052.10.34.454 E020.58.09.079 olive
N052.10.34.454 E020.58.09.079 N052.10.33.479 E020.58.09.953 olive
N052.10.33.479 E020.58.09.953 N052.10.31.829 E020.58.11.473 olive
N052.10.31.829 E020.58.11.473 N052.10.29.963 E020.58.13.166 olive
N052.10.29.963 E020.58.13.166 N052.10.26.368 E020.58.16.485 olive
N052.10.26.368 E020.58.16.485 N052.10.26.194 E020.58.16.651 olive
N052.10.26.194 E020.58.16.651 N052.10.25.964 E020.58.16.573 olive
N052.10.25.964 E020.58.16.573 N052.10.25.692 E020.58.16.253 olive
N052.10.25.692 E020.58.16.253 N052.10.25.394 E020.58.15.522 olive
N052.10.25.394 E020.58.15.522 N052.10.24.242 E020.58.12.113 olive
N052.10.27.262 E020.57.48.329 N052.10.28.406 E020.57.51.731 olive
N052.10.28.406 E020.57.51.731 N052.10.29.157 E020.57.53.829 olive
N052.10.29.157 E020.57.53.829 N052.10.29.407 E020.57.54.424 olive
N052.10.29.407 E020.57.54.424 N052.10.30.611 E020.57.56.255 olive
N052.10.30.611 E020.57.56.255 N052.10.32.018 E020.57.59.863 olive
N052.10.32.018 E020.57.59.863 N052.10.33.320 E020.58.03.264 olive
N052.10.33.320 E020.58.03.264 N052.10.34.665 E020.58.06.678 olive
N052.10.34.665 E020.58.06.678 N052.10.35.265 E020.58.08.248 olive
N052.10.40.844 E020.58.02.262 N052.10.39.059 E020.57.58.088 olive
N052.10.39.059 E020.57.58.088 N052.10.38.851 E020.57.57.994 olive
N052.10.38.851 E020.57.57.994 N052.10.38.676 E020.57.57.974 olive
N052.10.38.676 E020.57.57.974 N052.10.38.342 E020.57.58.302 olive
N052.10.38.342 E020.57.58.302 N052.10.37.340 E020.57.59.407 olive
N052.10.37.340 E020.57.59.407 N052.10.35.764 E020.58.01.062 olive
N052.10.35.764 E020.58.01.062 N052.10.34.568 E020.58.02.386 olive
N052.10.34.568 E020.58.02.386 N052.10.34.013 E020.58.02.967 olive
N052.10.26.613 E020.57.48.788 N052.10.28.739 E020.57.55.068 blu
N052.10.28.739 E020.57.55.068 N052.10.30.122 E020.57.57.070 blu
N052.10.30.122 E020.57.57.070 N052.10.33.011 E020.58.04.750 blu
N052.10.33.011 E020.58.04.750 N052.10.33.696 E020.58.06.359 blu
N052.10.33.696 E020.58.06.359 N052.10.34.352 E020.58.07.861 blu
N052.10.34.352 E020.58.07.861 N052.10.34.686 E020.58.08.830 blu
N052.10.27.834 E020.57.47.782 N052.10.29.850 E020.57.53.586 oranz
N052.10.29.850 E020.57.53.586 N052.10.31.155 E020.57.55.438 oranz
N052.10.31.155 E020.57.55.438 N052.10.32.622 E020.57.59.321 oranz
N052.10.32.622 E020.57.59.321 N052.10.33.607 E020.58.01.770 oranz
N052.10.33.607 E020.58.01.770 N052.10.34.711 E020.58.04.675 oranz
N052.10.34.711 E020.58.04.675 N052.10.35.365 E020.58.06.248 oranz
N052.10.35.365 E020.58.06.248 N052.10.35.912 E020.58.07.642 oranz
N052.09.50.300 E020.58.50.289 N052.09.50.280 E020.58.50.956 olive
N052.09.50.280 E020.58.50.956 N052.09.50.344 E020.58.51.399 olive
N052.09.50.344 E020.58.51.399 N052.09.50.695 E020.58.52.241 olive
N052.09.50.695 E020.58.52.241 N052.09.51.507 E020.58.53.923 olive
N052.09.51.507 E020.58.53.923 N052.09.51.554 E020.58.54.381 olive
N052.09.51.554 E020.58.54.381 N052.09.51.591 E020.58.55.095 olive
N052.09.51.591 E020.58.55.095 N052.09.51.532 E020.58.55.906 olive
N052.09.51.532 E020.58.55.906 N052.09.51.389 E020.58.56.560 olive
N052.09.51.389 E020.58.56.560 N052.09.51.182 E020.58.57.185 olive
N052.09.51.182 E020.58.57.185 N052.09.50.889 E020.58.57.721 olive
N052.09.50.889 E020.58.57.721 N052.09.50.477 E020.58.58.146 olive
N052.09.50.477 E020.58.58.146 N052.09.49.989 E020.58.58.567 olive
N052.09.49.989 E020.58.58.567 N052.09.49.664 E020.58.58.619 olive
N052.09.49.664 E020.58.58.619 N052.09.49.240 E020.58.58.610 olive
N052.09.49.240 E020.58.58.610 N052.09.48.633 E020.58.58.404 olive
N052.09.50.678 E020.58.52.014 N052.09.50.861 E020.58.52.224 olive
N052.09.50.861 E020.58.52.224 N052.09.52.727 E020.58.53.620 olive
N052.09.52.727 E020.58.53.620 N052.09.52.731 E020.58.53.998 olive
N052.09.52.731 E020.58.53.998 N052.09.52.661 E020.58.54.328 olive
N052.09.52.661 E020.58.54.328 N052.09.52.520 E020.58.54.608 olive
N052.09.52.520 E020.58.54.608 N052.09.52.368 E020.58.54.859 olive
N052.09.52.368 E020.58.54.859 N052.09.52.071 E020.58.55.018 olive
N052.09.52.071 E020.58.55.018 N052.09.51.803 E020.58.55.048 olive
N052.09.51.803 E020.58.55.048 N052.09.51.601 E020.58.54.990 olive
N052.09.51.601 E020.58.54.990 N052.09.51.328 E020.58.54.742 olive
N052.09.51.328 E020.58.54.742 N052.09.51.254 E020.58.54.612 olive
N052.09.51.254 E020.58.54.612 N052.09.51.160 E020.58.54.425 olive
N052.09.51.160 E020.58.54.425 N052.09.50.790 E020.58.54.445 olive
N052.09.49.274 E020.58.53.420 N052.09.49.254 E020.58.54.386 olive
N052.09.49.254 E020.58.54.386 N052.09.49.356 E020.58.54.715 olive
N052.09.49.356 E020.58.54.715 N052.09.49.593 E020.58.55.230 olive
N052.09.49.593 E020.58.55.230 N052.09.51.671 E020.58.57.900 olive
N052.09.51.671 E020.58.57.900 N052.09.51.632 E020.58.58.216 olive
N052.09.51.632 E020.58.58.216 N052.09.51.519 E020.58.58.511 olive
N052.09.51.519 E020.58.58.511 N052.09.51.352 E020.58.58.825 olive
N052.09.51.352 E020.58.58.825 N052.09.51.264 E020.58.58.871 olive
N052.09.51.264 E020.58.58.871 N052.09.51.008 E020.58.59.022 olive
N052.09.51.008 E020.58.59.022 N052.09.50.750 E020.58.59.048 olive
N052.09.50.750 E020.58.59.048 N052.09.50.461 E020.58.58.906 olive
N052.09.50.461 E020.58.58.906 N052.09.50.276 E020.58.58.665 olive
N052.09.50.276 E020.58.58.665 N052.09.50.121 E020.58.58.364 olive
N052.09.56.271 E020.58.27.989 N052.09.59.353 E020.58.30.189 olive
N052.09.59.872 E020.58.28.329 N052.09.56.809 E020.58.26.089 olive
N052.09.57.263 E020.58.24.432 N052.10.00.503 E020.58.26.653 olive
N052.10.01.171 E020.58.25.637 N052.09.57.628 E020.58.23.015 olive
N052.09.57.943 E020.58.21.691 N052.10.01.213 E020.58.23.979 olive
N052.09.57.848 E020.58.14.886 N052.10.02.929 E020.58.16.625 olive
N052.10.06.180 E020.58.13.708 N052.10.01.080 E020.58.11.921 olive
N052.10.05.477 E020.58.08.059 N052.10.08.021 E020.58.15.432 olive
N052.10.06.628 E020.58.07.040 N052.10.09.156 E020.58.14.382 olive
N052.10.09.971 E020.58.12.657 N052.10.07.617 E020.58.06.015 olive
N052.10.08.675 E020.58.05.083 N052.10.10.989 E020.58.11.705 olive
N052.10.12.068 E020.58.10.759 N052.10.09.691 E020.58.04.157 olive
N052.10.11.112 E020.58.02.897 N052.10.13.467 E020.58.09.493 olive
N052.10.14.489 E020.58.08.510 N052.10.12.193 E020.58.01.891 olive
N052.10.13.557 E020.58.00.677 N052.10.15.852 E020.58.07.311 olive
N052.10.16.749 E020.58.06.519 N052.10.14.416 E020.57.59.882 olive
N052.10.16.391 E020.57.58.059 N052.10.15.962 E020.57.59.180 olive
N052.10.15.962 E020.57.59.180 N052.10.15.191 E020.58.06.629 olive
N052.10.15.191 E020.58.06.629 N052.10.15.545 E020.58.07.608 olive
N052.10.15.811 E020.57.58.585 N052.10.16.523 E020.57.58.694 olive
N052.10.16.523 E020.57.58.694 N052.10.21.328 E020.58.00.544 olive
N052.10.21.328 E020.58.00.544 N052.10.21.811 E020.58.01.930 olive
N052.10.17.963 E020.57.56.632 N052.10.20.275 E020.58.03.337 olive
N052.10.19.071 E020.57.55.604 N052.10.21.347 E020.58.02.344 olive
N052.10.20.294 E020.57.54.514 N052.10.22.577 E020.58.01.237 olive
N052.10.21.283 E020.57.53.594 N052.10.23.661 E020.58.00.252 olive
N052.10.22.351 E020.57.52.653 N052.10.24.644 E020.57.59.332 olive
N052.10.23.393 E020.57.51.675 N052.10.25.657 E020.57.58.379 olive
N052.10.24.582 E020.57.50.671 N052.10.26.854 E020.57.57.244 olive
N052.10.32.742 E020.57.43.237 N052.10.34.753 E020.57.49.200 olive
N052.10.34.753 E020.57.49.200 N052.10.34.828 E020.57.49.789 olive
N052.10.34.828 E020.57.49.789 N052.10.34.852 E020.57.50.507 olive
N052.10.34.852 E020.57.50.507 N052.10.34.727 E020.57.51.111 olive
N052.10.34.727 E020.57.51.111 N052.10.34.491 E020.57.51.829 olive
N052.10.34.491 E020.57.51.829 N052.10.34.073 E020.57.52.260 olive
N052.10.34.073 E020.57.52.260 N052.10.32.792 E020.57.53.393 olive
N052.10.32.792 E020.57.53.393 N052.10.31.616 E020.57.54.464 olive
N052.10.31.616 E020.57.54.464 N052.10.31.193 E020.57.54.885 olive
N052.10.31.193 E020.57.54.885 N052.10.30.658 E020.57.55.171 olive
N052.10.30.658 E020.57.55.171 N052.10.29.948 E020.57.55.217 olive
N052.10.32.577 E020.57.43.437 N052.10.34.575 E020.57.49.394 olive
N052.10.34.575 E020.57.49.394 N052.10.34.677 E020.57.49.917 olive
N052.10.34.677 E020.57.49.917 N052.10.34.694 E020.57.50.557 olive
N052.10.34.694 E020.57.50.557 N052.10.34.603 E020.57.51.127 olive
N052.10.34.603 E020.57.51.127 N052.10.34.377 E020.57.51.765 olive
N052.10.34.377 E020.57.51.765 N052.10.34.083 E020.57.52.215 olive
N052.10.31.518 E020.57.44.433 N052.10.33.610 E020.57.50.440 olive
N052.10.33.610 E020.57.50.440 N052.10.33.682 E020.57.51.260 olive
N052.10.33.682 E020.57.51.260 N052.10.33.645 E020.57.51.890 olive
N052.10.33.645 E020.57.51.890 N052.10.33.436 E020.57.52.502 olive
N052.10.33.436 E020.57.52.502 N052.10.33.126 E020.57.53.118 olive
N052.10.30.534 E020.57.45.290 N052.10.32.551 E020.57.51.225 olive
N052.10.32.551 E020.57.51.225 N052.10.32.637 E020.57.51.919 olive
N052.10.32.637 E020.57.51.919 N052.10.32.625 E020.57.52.504 olive
N052.10.32.625 E020.57.52.504 N052.10.32.538 E020.57.53.188 olive
N052.10.32.538 E020.57.53.188 N052.10.32.344 E020.57.53.702 olive
N052.10.32.344 E020.57.53.702 N052.10.32.159 E020.57.54.016 olive
N052.10.30.329 E020.57.45.397 N052.10.32.365 E020.57.51.392 olive
N052.10.32.365 E020.57.51.392 N052.10.32.481 E020.57.52.001 olive
N052.10.32.481 E020.57.52.001 N052.10.32.512 E020.57.52.573 olive
N052.10.32.512 E020.57.52.573 N052.10.32.367 E020.57.53.265 olive
N052.10.32.367 E020.57.53.265 N052.10.32.054 E020.57.53.917 olive
N052.10.32.054 E020.57.53.917 N052.10.31.920 E020.57.54.179 olive
N052.10.31.803 E020.58.07.250 N052.10.32.908 E020.58.10.487 olive
N052.10.31.795 E020.58.11.519 N052.10.30.695 E020.58.08.309 olive
N052.10.29.511 E020.58.09.435 N052.10.30.615 E020.58.12.567 olive
N052.10.04.513 E020.58.18.615 N052.10.05.751 E020.58.22.191 sch
N052.10.06.881 E020.58.21.127 N052.10.05.645 E020.58.17.573 sch
N052.10.06.798 E020.58.16.537 N052.10.08.017 E020.58.20.029 sch
N052.10.07.953 E020.58.15.493 N052.10.09.160 E020.58.19.032 sch
N052.10.28.174 E020.58.14.742 N052.10.26.488 E020.58.09.834 nonsch
N052.10.25.321 E020.58.10.877 N052.10.26.991 E020.58.15.913 nonsch
N052.10.21.210 E020.58.02.525 N052.10.22.947 E020.58.07.520 nonsch
N052.10.22.321 E020.58.08.065 N052.10.20.568 E020.58.03.070 nonsch
N052.10.20.030 E020.58.03.589 N052.10.21.795 E020.58.08.551 nonsch
N052.10.18.920 E020.58.04.627 N052.10.20.627 E020.58.09.591 sch
N052.10.18.327 E020.58.05.157 N052.10.20.041 E020.58.10.158 sch
N052.10.17.755 E020.58.05.674 N052.10.19.467 E020.58.10.667 sch
N052.10.16.610 E020.58.06.690 N052.10.18.320 E020.58.11.687 maroon
N052.10.16.590 E020.58.13.191 N052.10.14.910 E020.58.08.173 maroon
N052.10.13.208 E020.58.09.722 N052.10.14.945 E020.58.14.741 maroon
N052.10.13.208 E020.58.16.192 N052.10.11.550 E020.58.11.250 sch
N052.10.09.831 E020.58.12.810 N052.10.11.549 E020.58.17.836 sch
N052.10.22.239 E020.58.01.549 N052.10.23.986 E020.58.06.549 nonsch
N052.10.22.751 E020.58.01.055 N052.10.24.524 E020.58.06.100 nonsch
N052.10.23.379 E020.58.00.513 N052.10.25.115 E020.58.05.507 nonsch
N052.10.24.464 E020.57.59.509 N052.10.26.260 E020.58.04.533 nonsch
N052.10.26.978 E020.57.57.178 N052.10.26.726 E020.58.03.070 nonsch
N052.10.29.537 E020.57.56.230 N052.10.28.260 E020.58.02.556 nonsch
N052.10.31.349 E020.57.58.133 N052.10.28.552 E020.58.02.663 nonsch
N052.10.31.037 E020.57.59.489 N052.10.29.311 E020.58.02.983 nonsch
N052.10.33.548 E020.58.03.853 N052.10.29.594 E020.58.04.742 nonsch
N052.10.29.508 E020.58.13.580 N052.10.27.706 E020.58.08.711 nonsch
N052.10.37.486 E020.57.59.227 N052.10.36.465 E020.57.56.751 olive
N052.10.36.544 E020.58.00.231 N052.10.35.449 E020.57.57.758 olive
N052.10.35.542 E020.58.01.320 N052.10.34.524 E020.57.58.932 olive
N052.10.37.915 E020.58.05.433 N052.10.36.029 E020.58.00.826 olive
N052.10.39.158 E020.58.04.111 N052.10.37.229 E020.57.59.498 olive
N052.10.40.016 E020.58.03.109 N052.10.38.140 E020.57.58.543 olive
N052.10.39.933 E020.57.43.483 N052.10.37.191 E020.57.45.119 olive
N052.10.41.655 E020.57.44.781 N052.10.38.900 E020.57.46.450 olive
N052.10.43.367 E020.57.46.103 N052.10.40.605 E020.57.47.733 olive
N052.10.44.521 E020.57.47.560 N052.10.42.128 E020.57.48.954 olive
N052.10.43.862 E020.57.46.420 N052.10.44.894 E020.57.42.853 olive
N052.10.43.796 E020.57.42.054 N052.10.42.786 E020.57.45.603 olive
N052.10.41.648 E020.57.44.732 N052.10.42.674 E020.57.41.157 olive
N052.10.40.579 E020.57.43.883 N052.10.41.584 E020.57.40.323 olive
N052.10.39.468 E020.57.43.064 N052.10.40.477 E020.57.39.506 olive
N052.10.25.868 E020.57.32.889 N052.10.19.103 E020.57.27.783 olive
N052.10.19.103 E020.57.27.783 N052.10.09.010 E020.57.20.158 olive
N052.10.07.194 E020.57.18.807 N052.10.03.800 E020.57.16.237 olive
N052.10.03.800 E020.57.16.237 N052.10.03.425 E020.57.15.811 olive
N052.10.03.425 E020.57.15.811 N052.10.03.188 E020.57.15.287 olive
N052.10.03.188 E020.57.15.287 N052.10.02.949 E020.57.14.323 olive
N052.10.02.949 E020.57.14.323 N052.10.02.890 E020.57.13.356 olive
N052.10.02.890 E020.57.13.356 N052.10.02.992 E020.57.12.819 olive
N052.10.02.992 E020.57.12.819 N052.10.05.673 E020.57.02.649 olive
N052.10.05.673 E020.57.02.649 N052.10.09.949 E020.56.46.650 olive
N052.10.09.949 E020.56.46.650 N052.10.10.389 E020.56.45.810 olive
N052.10.10.389 E020.56.45.810 N052.10.10.748 E020.56.45.384 olive
N052.10.10.748 E020.56.45.384 N052.10.11.161 E020.56.45.025 olive
N052.10.11.161 E020.56.45.025 N052.10.11.631 E020.56.44.922 olive
N052.10.11.631 E020.56.44.922 N052.10.12.026 E020.56.45.032 olive
N052.10.12.026 E020.56.45.032 N052.10.12.362 E020.56.45.123 olive
N052.10.12.362 E020.56.45.123 N052.10.12.656 E020.56.45.291 olive
N052.10.12.656 E020.56.45.291 N052.10.15.061 E020.56.47.130 olive
N052.10.15.061 E020.56.47.130 N052.10.15.580 E020.56.47.717 olive
N052.10.19.734 E020.57.28.252 N052.10.24.150 E020.57.12.770 olive
N052.10.24.150 E020.57.12.770 N052.10.24.158 E020.57.10.772 olive
N052.10.24.158 E020.57.10.772 N052.10.24.591 E020.57.09.106 olive
N052.09.47.176 E020.58.57.007 N052.09.46.734 E020.58.57.298 olive
N052.09.46.734 E020.58.57.298 N052.09.46.310 E020.58.57.236 olive
N052.09.46.310 E020.58.57.236 N052.09.46.006 E020.58.57.117 olive
N052.09.46.006 E020.58.57.117 N052.09.45.790 E020.58.56.889 olive
N052.09.45.790 E020.58.56.889 N052.09.45.564 E020.58.56.341 olive
N052.09.45.564 E020.58.56.341 N052.09.45.465 E020.58.55.935 olive
N052.09.45.465 E020.58.55.935 N052.09.45.332 E020.58.54.563 olive
N052.09.45.332 E020.58.54.563 N052.09.45.286 E020.58.53.127 olive
N052.09.45.286 E020.58.53.127 N052.09.45.243 E020.58.50.673 olive
N052.09.45.243 E020.58.50.673 N052.09.45.305 E020.58.48.468 olive
N052.10.32.131 E020.57.43.778 N052.10.32.465 E020.57.43.208 olive
N052.10.32.465 E020.57.43.208 N052.10.32.726 E020.57.42.441 olive
N052.10.32.726 E020.57.42.441 N052.10.32.827 E020.57.41.828 olive
N052.10.32.827 E020.57.41.828 N052.10.32.853 E020.57.40.556 olive
N052.10.32.853 E020.57.40.556 N052.10.32.795 E020.57.39.526 olive
N052.10.32.795 E020.57.39.526 N052.10.32.463 E020.57.38.222 olive
N052.10.32.463 E020.57.38.222 N052.10.32.166 E020.57.37.619 olive
N052.10.48.197 E020.57.41.325 N052.10.49.545 E020.57.39.547 olive
N052.10.49.545 E020.57.39.547 N052.10.49.107 E020.57.39.100 olive
N052.10.47.935 E020.57.39.383 N052.10.49.264 E020.57.37.602 olive
N052.10.49.264 E020.57.37.602 N052.10.48.846 E020.57.37.135 olive
N052.10.47.687 E020.57.37.422 N052.10.48.855 E020.57.35.849 olive
N052.10.48.855 E020.57.35.849 N052.10.48.588 E020.57.35.243 olive
N052.10.47.142 E020.57.34.285 N052.10.45.715 E020.57.34.795 olive
N052.10.47.606 E020.57.37.300 N052.10.46.129 E020.57.37.793 olive
N052.10.47.965 E020.57.39.754 N052.10.46.509 E020.57.40.269 olive
N052.10.48.320 E020.57.42.242 N052.10.46.887 E020.57.42.707 olive
N052.10.48.522 E020.57.44.197 N052.10.47.368 E020.57.44.628 olive
N052.10.35.265 E020.58.08.248 N052.10.36.307 E020.58.10.990 oliwe
N052.10.36.307 E020.58.10.990 N052.10.36.667 E020.58.11.411 oliwe
N052.10.36.667 E020.58.11.411 N052.10.36.933 E020.58.12.107 oliwe
N052.10.36.933 E020.58.12.107 N052.10.37.062 E020.58.12.813 oliwe
N052.10.37.062 E020.58.12.813 N052.10.37.011 E020.58.13.169 oliwe
N052.10.37.011 E020.58.13.169 N052.10.36.585 E020.58.14.030 oliwe
N052.10.36.585 E020.58.14.030 N052.10.35.998 E020.58.14.577 oliwe
N052.10.35.998 E020.58.14.577 N052.10.34.738 E020.58.15.720 oliwe
N052.10.34.738 E020.58.15.720 N052.10.33.398 E020.58.16.949 oliwe
N052.10.33.398 E020.58.16.949 N052.10.32.013 E020.58.18.180 oliwe
N052.10.32.013 E020.58.18.180 N052.10.30.783 E020.58.19.304 oliwe
N052.10.30.783 E020.58.19.304 N052.10.29.119 E020.58.20.769 oliwe
N052.10.29.119 E020.58.20.769 N052.10.28.286 E020.58.21.521 oliwe
N052.10.26.810 E020.58.18.955 N052.10.27.571 E020.58.21.158 oliwe
N052.10.27.571 E020.58.21.158 N052.10.27.751 E020.58.21.380 oliwe
N052.10.27.751 E020.58.21.380 N052.10.27.945 E020.58.21.514 oliwe
N052.10.27.945 E020.58.21.514 N052.10.28.084 E020.58.21.556 oliwe
N052.10.28.084 E020.58.21.556 N052.10.28.343 E020.58.21.532 oliwe
N052.10.28.343 E020.58.21.532 N052.10.30.448 E020.58.21.335 oliwe
N052.10.30.448 E020.58.21.335 N052.10.34.667 E020.58.20.131 oliwe
N052.10.34.667 E020.58.20.131 N052.10.36.546 E020.58.19.649 oliwe
N052.10.36.546 E020.58.19.649 N052.10.37.747 E020.58.19.341 oliwe
N052.10.37.747 E020.58.19.341 N052.10.38.094 E020.58.19.109 oliwe
N052.10.38.094 E020.58.19.109 N052.10.38.447 E020.58.18.658 oliwe
N052.10.38.447 E020.58.18.658 N052.10.38.626 E020.58.18.243 oliwe
N052.10.38.626 E020.58.18.243 N052.10.38.687 E020.58.17.848 oliwe
N052.10.38.687 E020.58.17.848 N052.10.38.753 E020.58.17.286 oliwe
N052.10.38.753 E020.58.17.286 N052.10.38.745 E020.58.16.765 oliwe
N052.10.38.745 E020.58.16.765 N052.10.38.701 E020.58.16.348 oliwe
N052.10.38.701 E020.58.16.348 N052.10.38.545 E020.58.15.917 oliwe
N052.10.38.545 E020.58.15.917 N052.10.38.240 E020.58.15.308 oliwe
N052.10.38.240 E020.58.15.308 N052.10.37.516 E020.58.14.297 oliwe
N052.10.37.516 E020.58.14.297 N052.10.37.209 E020.58.13.749 oliwe
N052.10.37.209 E020.58.13.749 N052.10.37.106 E020.58.13.288 oliwe
N052.10.37.106 E020.58.13.288 N052.10.37.039 E020.58.12.768 oliwe
N052.10.34.189 E020.58.11.789 N052.10.35.375 E020.58.15.156 oliwe
N052.10.34.271 E020.58.16.141 N052.10.33.041 E020.58.12.748 oliwe
N052.10.32.190 E020.58.13.627 N052.10.33.413 E020.58.16.951 oliwe
N052.10.32.349 E020.58.17.918 N052.10.31.112 E020.58.14.493 oliwe
N052.10.30.159 E020.58.15.397 N052.10.31.388 E020.58.18.780 oliwe
N052.10.30.263 E020.58.19.762 N052.10.29.056 E020.58.16.427 oliwe
N052.10.28.152 E020.58.17.210 N052.10.29.397 E020.58.20.536 oliwe
N052.10.34.501 E020.58.15.965 N052.10.34.849 E020.58.20.065 oliwe
N052.10.35.748 E020.58.19.842 N052.10.35.323 E020.58.15.255 oliwe
N052.10.36.197 E020.58.14.462 N052.10.36.703 E020.58.19.624 oliwe
N052.10.36.047 E020.58.10.172 N052.10.37.444 E020.58.08.587 oliwe
N052.10.36.681 E020.58.11.427 N052.10.38.002 E020.58.09.890 oliwe
N052.10.37.317 E020.58.06.085 N052.10.38.191 E020.58.08.318 oliwe
N052.10.39.034 E020.58.07.380 N052.10.38.172 E020.58.05.168 oliwe
N052.10.38.973 E020.58.04.295 N052.10.39.823 E020.58.06.460 oliwe
N052.10.40.676 E020.58.05.589 N052.10.39.824 E020.58.03.362 oliwe
N052.10.40.561 E020.58.02.576 N052.10.41.459 E020.58.04.742 oliwe
N052.10.31.657 E020.58.18.508 N052.10.31.407 E020.58.18.463 oliwe
N052.10.31.407 E020.58.18.463 N052.10.31.140 E020.58.18.410 oliwe
N052.10.31.140 E020.58.18.410 N052.10.30.892 E020.58.18.423 oliwe
N052.10.30.892 E020.58.18.423 N052.10.30.765 E020.58.18.517 oliwe
N052.10.30.765 E020.58.18.517 N052.10.30.638 E020.58.18.655 oliwe
N052.10.30.638 E020.58.18.655 N052.10.30.443 E020.58.18.953 oliwe
N052.10.30.443 E020.58.18.953 N052.10.30.285 E020.58.19.361 oliwe
N052.10.30.285 E020.58.19.361 N052.10.30.225 E020.58.19.754 oliwe
N052.10.30.225 E020.58.19.754 N052.10.30.274 E020.58.20.079 oliwe
N052.10.30.274 E020.58.20.079 N052.10.30.322 E020.58.20.550 oliwe
N052.10.30.322 E020.58.20.550 N052.10.30.442 E020.58.20.876 oliwe
N052.10.30.442 E020.58.20.876 N052.10.30.667 E020.58.21.170 oliwe
N052.10.30.667 E020.58.21.170 N052.10.30.836 E020.58.21.227 oliwe


;EPKT
;- RWY
N050.28.26.565 E019.03.16.923 N050.28.28.455 E019.03.16.920 olive
N050.28.28.455 E019.03.16.920 N050.28.28.126 E019.05.39.115 olive
N050.28.28.126 E019.05.39.115 N050.28.26.314 E019.05.39.093 olive
N050.28.26.314 E019.05.39.093 N050.28.26.566 E019.03.16.926 olive
;- TWY
N050.28.26.273 E019.05.38.763 N050.28.24.818 E019.05.38.723 teal
N050.28.24.818 E019.05.38.723 N050.28.23.209 E019.05.41.273 teal
N050.28.23.209 E019.05.41.273 N050.28.21.070 E019.05.41.282 teal
N050.28.21.070 E019.05.41.282 N050.28.20.407 E019.05.42.285 teal
N050.28.20.407 E019.05.42.285 N050.28.20.370 E019.05.59.989 teal
N050.28.20.370 E019.05.59.989 N050.28.18.252 E019.05.59.992 teal
N050.28.18.252 E019.05.59.992 N050.28.18.230 E019.05.41.748 teal
N050.28.18.230 E019.05.41.748 N050.28.19.740 E019.05.41.777 teal
N050.28.19.740 E019.05.41.777 N050.28.19.806 E019.05.41.757 teal
N050.28.19.806 E019.05.41.757 N050.28.19.908 E019.05.41.626 teal
N050.28.19.908 E019.05.41.626 N050.28.19.973 E019.05.41.528 teal
N050.28.19.973 E019.05.41.528 N050.28.19.983 E019.05.41.242 teal
N050.28.19.983 E019.05.41.242 N050.28.20.030 E019.05.33.869 teal
N050.28.20.030 E019.05.33.869 N050.28.20.044 E019.05.16.352 teal
N050.28.20.044 E019.05.16.352 N050.28.18.228 E019.05.13.399 teal
N050.28.18.228 E019.05.13.399 N050.28.18.073 E019.05.13.322 teal
N050.28.18.073 E019.05.13.322 N050.28.17.858 E019.05.13.321 teal
N050.28.17.858 E019.05.13.321 N050.28.17.789 E019.05.13.324 teal
N050.28.17.789 E019.05.13.324 N050.28.17.694 E019.05.13.448 teal
N050.28.17.694 E019.05.13.448 N050.28.17.668 E019.05.13.554 teal
N050.28.17.668 E019.05.13.554 N050.28.17.666 E019.05.14.696 teal
N050.28.17.666 E019.05.14.696 N050.28.16.104 E019.05.14.683 teal
N050.28.16.104 E019.05.14.683 N050.28.16.155 E019.05.06.064 teal
N050.28.16.155 E019.05.06.064 N050.28.14.754 E019.05.06.063 teal
N050.28.14.754 E019.05.06.063 N050.28.14.763 E019.05.01.554 teal
N050.28.14.763 E019.05.01.554 N050.28.16.140 E019.05.01.561 teal
N050.28.16.140 E019.05.01.561 N050.28.16.176 E019.04.59.861 teal
N050.28.16.176 E019.04.59.861 N050.28.13.471 E019.04.59.849 teal
N050.28.13.471 E019.04.59.849 N050.28.13.501 E019.05.01.138 teal
N050.28.13.501 E019.05.01.138 N050.28.09.826 E019.05.01.135 teal
N050.28.09.826 E019.05.01.135 N050.28.09.830 E019.04.59.148 teal
N050.28.09.830 E019.04.59.148 N050.28.16.141 E019.04.59.177 teal
N050.28.16.141 E019.04.59.177 N050.28.17.692 E019.04.59.165 teal
N050.28.17.692 E019.04.59.165 N050.28.17.684 E019.05.03.006 teal
N050.28.17.684 E019.05.03.006 N050.28.18.082 E019.05.03.001 teal
N050.28.18.082 E019.05.03.001 N050.28.18.457 E019.05.02.586 teal
N050.28.18.457 E019.05.02.586 N050.28.20.067 E019.04.59.906 teal
N050.28.20.067 E019.04.59.906 N050.28.20.088 E019.04.34.592 teal
N050.28.20.088 E019.04.34.592 N050.28.20.061 E019.04.34.408 teal
N050.28.20.061 E019.04.34.408 N050.28.19.992 E019.04.34.260 teal
N050.28.19.992 E019.04.34.260 N050.28.19.914 E019.04.34.173 teal
N050.28.19.914 E019.04.34.173 N050.28.19.871 E019.04.34.106 teal
N050.28.19.871 E019.04.34.106 N050.28.19.705 E019.04.34.111 teal
N050.28.19.705 E019.04.34.111 N050.28.18.099 E019.04.34.075 teal
N050.28.18.099 E019.04.34.075 N050.28.18.071 E019.04.24.617 teal
N050.28.18.071 E019.04.24.617 N050.28.18.122 E019.04.15.876 teal
N050.28.18.122 E019.04.15.876 N050.28.17.219 E019.04.15.892 teal
N050.28.17.219 E019.04.15.892 N050.28.17.204 E019.04.07.523 teal
N050.28.17.204 E019.04.07.523 N050.28.20.113 E019.04.07.521 teal
N050.28.20.113 E019.04.07.521 N050.28.20.258 E019.04.07.485 teal
N050.28.20.258 E019.04.07.485 N050.28.20.318 E019.04.07.404 teal
N050.28.20.318 E019.04.07.404 N050.28.20.377 E019.04.07.249 teal
N050.28.20.377 E019.04.07.249 N050.28.20.454 E019.04.07.106 teal
N050.28.20.454 E019.04.07.106 N050.28.20.494 E019.04.06.926 teal
N050.28.20.494 E019.04.06.926 N050.28.20.535 E019.03.58.083 teal
N050.28.20.535 E019.03.58.083 N050.28.23.979 E019.03.58.110 teal
N050.28.23.979 E019.03.58.110 N050.28.25.465 E019.03.57.886 teal
N050.28.25.465 E019.03.57.886 N050.28.25.779 E019.03.57.736 teal
N050.28.25.779 E019.03.57.736 N050.28.26.051 E019.03.57.407 teal
N050.28.26.051 E019.03.57.407 N050.28.26.247 E019.03.57.050 teal
N050.28.26.247 E019.03.57.050 N050.28.26.516 E019.03.56.400 teal
N050.28.26.511 E019.04.01.157 N050.28.26.254 E019.04.00.331 teal
N050.28.26.254 E019.04.00.331 N050.28.26.093 E019.04.00.068 teal
N050.28.26.093 E019.04.00.068 N050.28.25.753 E019.03.59.804 teal
N050.28.25.753 E019.03.59.804 N050.28.25.437 E019.03.59.603 teal
N050.28.25.437 E019.03.59.603 N050.28.25.151 E019.03.59.563 teal
N050.28.25.151 E019.03.59.563 N050.28.22.329 E019.03.59.589 teal
N050.28.22.329 E019.03.59.589 N050.28.22.052 E019.03.59.645 teal
N050.28.22.052 E019.03.59.645 N050.28.21.941 E019.03.59.787 teal
N050.28.21.941 E019.03.59.787 N050.28.21.721 E019.04.00.020 teal
N050.28.21.721 E019.04.00.020 N050.28.21.557 E019.04.00.255 teal
N050.28.21.557 E019.04.00.255 N050.28.21.461 E019.04.00.513 teal
N050.28.21.461 E019.04.00.513 N050.28.21.351 E019.04.00.859 teal
N050.28.21.351 E019.04.00.859 N050.28.21.231 E019.04.03.688 teal
N050.28.21.231 E019.04.03.688 N050.28.21.209 E019.04.14.387 teal
N050.28.21.209 E019.04.14.387 N050.28.22.364 E019.04.16.273 teal
N050.28.22.364 E019.04.16.273 N050.28.26.457 E019.04.23.037 teal
N050.28.26.334 E019.04.26.433 N050.28.23.922 E019.04.22.447 teal
N050.28.23.922 E019.04.22.447 N050.28.22.831 E019.04.20.650 teal
N050.28.22.831 E019.04.20.650 N050.28.21.618 E019.04.18.653 teal
N050.28.21.618 E019.04.18.653 N050.28.21.211 E019.04.19.728 teal
N050.28.21.211 E019.04.19.728 N050.28.21.202 E019.04.24.428 teal
N050.28.21.202 E019.04.24.428 N050.28.21.262 E019.04.26.205 teal
N050.28.21.262 E019.04.26.205 N050.28.21.826 E019.04.27.603 teal
N050.28.21.826 E019.04.27.603 N050.28.25.193 E019.04.27.597 teal
N050.28.25.193 E019.04.27.597 N050.28.25.847 E019.04.27.209 teal
N050.28.25.847 E019.04.27.209 N050.28.26.341 E019.04.26.430 teal
N050.28.26.453 E019.04.30.826 N050.28.26.322 E019.04.30.232 teal
N050.28.26.322 E019.04.30.232 N050.28.26.247 E019.04.29.917 teal
N050.28.26.247 E019.04.29.917 N050.28.26.098 E019.04.29.521 teal
N050.28.26.098 E019.04.29.521 N050.28.25.939 E019.04.29.254 teal
N050.28.25.939 E019.04.29.254 N050.28.25.712 E019.04.29.033 teal
N050.28.25.712 E019.04.29.033 N050.28.25.383 E019.04.28.809 teal
N050.28.25.383 E019.04.28.809 N050.28.24.940 E019.04.28.660 teal
N050.28.24.940 E019.04.28.660 N050.28.21.833 E019.04.28.628 teal
N050.28.21.833 E019.04.28.628 N050.28.21.576 E019.04.28.760 teal
N050.28.21.576 E019.04.28.760 N050.28.21.374 E019.04.28.916 teal
N050.28.21.374 E019.04.28.916 N050.28.21.051 E019.04.29.199 teal
N050.28.21.051 E019.04.29.199 N050.28.20.911 E019.04.29.469 teal
N050.28.20.911 E019.04.29.469 N050.28.20.761 E019.04.29.753 teal
N050.28.20.761 E019.04.29.753 N050.28.20.695 E019.05.07.499 teal
N050.28.20.695 E019.05.07.499 N050.28.21.099 E019.05.07.985 teal
N050.28.21.099 E019.05.07.985 N050.28.21.544 E019.05.08.154 teal
N050.28.21.544 E019.05.08.154 N050.28.25.274 E019.05.08.187 teal
N050.28.25.274 E019.05.08.187 N050.28.25.941 E019.05.07.491 teal
N050.28.25.941 E019.05.07.491 N050.28.26.391 E019.05.06.699 teal
N050.28.26.347 E019.05.08.621 N050.28.21.569 E019.05.08.605 teal
N050.28.21.569 E019.05.08.605 N050.28.21.233 E019.05.08.881 teal
N050.28.21.233 E019.05.08.881 N050.28.20.964 E019.05.09.143 teal
N050.28.20.964 E019.05.09.143 N050.28.20.787 E019.05.09.502 teal
N050.28.20.787 E019.05.09.502 N050.28.20.682 E019.05.09.913 teal
N050.28.20.682 E019.05.09.913 N050.28.20.608 E019.05.35.983 teal
N050.28.20.608 E019.05.35.983 N050.28.20.720 E019.05.36.323 teal
N050.28.20.720 E019.05.36.323 N050.28.20.870 E019.05.36.655 teal
N050.28.20.870 E019.05.36.655 N050.28.21.172 E019.05.36.932 teal
N050.28.21.172 E019.05.36.932 N050.28.21.555 E019.05.36.918 teal
N050.28.21.555 E019.05.36.918 N050.28.21.555 E019.05.37.256 teal
N050.28.21.555 E019.05.37.256 N050.28.25.004 E019.05.37.281 teal
N050.28.25.004 E019.05.37.281 N050.28.25.382 E019.05.37.113 teal
N050.28.25.382 E019.05.37.113 N050.28.25.532 E019.05.36.951 teal
N050.28.25.532 E019.05.36.951 N050.28.25.931 E019.05.36.515 teal
N050.28.25.931 E019.05.36.515 N050.28.26.156 E019.05.35.990 teal
N050.28.26.156 E019.05.35.990 N050.28.26.320 E019.05.35.424 teal
N050.28.19.983 E019.05.10.245 N050.28.19.839 E019.05.10.197 teal
N050.28.19.839 E019.05.10.197 N050.28.19.605 E019.05.10.326 teal
N050.28.19.605 E019.05.10.326 N050.28.18.405 E019.05.12.247 teal
N050.28.18.405 E019.05.12.247 N050.28.18.416 E019.05.12.391 teal
N050.28.18.416 E019.05.12.391 N050.28.18.478 E019.05.12.663 teal
N050.28.18.478 E019.05.12.663 N050.28.18.462 E019.05.12.761 teal
N050.28.18.462 E019.05.12.761 N050.28.19.662 E019.05.14.727 teal
N050.28.19.662 E019.05.14.727 N050.28.19.717 E019.05.14.707 teal
N050.28.19.717 E019.05.14.707 N050.28.19.839 E019.05.14.767 teal
N050.28.19.839 E019.05.14.767 N050.28.20.011 E019.05.14.655 teal
N050.28.20.011 E019.05.14.655 N050.28.19.988 E019.05.10.244 teal
N050.28.19.997 E019.05.01.650 N050.28.19.946 E019.05.01.519 teal
N050.28.19.946 E019.05.01.519 N050.28.19.769 E019.05.01.497 teal
N050.28.19.769 E019.05.01.497 N050.28.19.710 E019.05.01.532 teal
N050.28.19.710 E019.05.01.532 N050.28.19.594 E019.05.01.654 teal
N050.28.19.594 E019.05.01.654 N050.28.18.449 E019.05.03.648 teal
N050.28.18.449 E019.05.03.648 N050.28.18.406 E019.05.03.799 teal
N050.28.18.406 E019.05.03.799 N050.28.18.405 E019.05.03.857 teal
N050.28.18.405 E019.05.03.857 N050.28.18.484 E019.05.04.009 teal
N050.28.18.484 E019.05.04.009 N050.28.19.637 E019.05.06.008 teal
N050.28.19.637 E019.05.06.008 N050.28.19.782 E019.05.06.063 teal
N050.28.19.782 E019.05.06.063 N050.28.19.844 E019.05.06.111 teal
N050.28.19.844 E019.05.06.111 N050.28.19.928 E019.05.06.035 teal
N050.28.19.928 E019.05.06.035 N050.28.19.982 E019.05.05.904 teal
N050.28.19.982 E019.05.05.904 N050.28.19.995 E019.05.01.609 teal
N050.28.17.711 E019.05.04.639 N050.28.17.660 E019.05.11.594 teal
N050.28.17.660 E019.05.11.594 N050.28.18.193 E019.05.11.557 teal
N050.28.18.193 E019.05.11.557 N050.28.18.980 E019.05.10.239 teal
N050.28.18.980 E019.05.10.239 N050.28.19.125 E019.05.09.965 teal
N050.28.19.125 E019.05.09.965 N050.28.19.154 E019.05.09.658 teal
N050.28.19.154 E019.05.09.658 N050.28.19.222 E019.05.09.312 teal
N050.28.19.222 E019.05.09.312 N050.28.19.227 E019.05.06.898 teal
N050.28.19.227 E019.05.06.898 N050.28.19.151 E019.05.06.508 teal
N050.28.19.151 E019.05.06.508 N050.28.19.064 E019.05.06.151 teal
N050.28.19.064 E019.05.06.151 N050.28.18.900 E019.05.05.804 teal
N050.28.18.900 E019.05.05.804 N050.28.18.262 E019.05.04.727 teal
N050.28.18.262 E019.05.04.727 N050.28.18.080 E019.05.04.624 teal
N050.28.18.080 E019.05.04.624 N050.28.17.712 E019.05.04.628 teal
;- LNS
N050.28.26.274 E019.05.37.272 N050.28.24.776 E019.05.38.111 olive
N050.28.24.776 E019.05.38.111 N050.28.20.277 E019.05.38.104 olive
N050.28.18.332 E019.05.58.340 N050.28.20.195 E019.05.58.304 olive
N050.28.20.195 E019.05.58.304 N050.28.20.205 E019.05.56.225 olive
N050.28.20.205 E019.05.56.225 N050.28.20.181 E019.05.54.476 olive
N050.28.20.181 E019.05.54.476 N050.28.20.188 E019.05.51.395 olive
N050.28.20.188 E019.05.51.395 N050.28.20.224 E019.05.49.283 olive
N050.28.20.224 E019.05.49.283 N050.28.20.232 E019.05.45.808 olive
N050.28.20.232 E019.05.45.808 N050.28.20.218 E019.05.43.023 olive
N050.28.20.218 E019.05.43.023 N050.28.20.246 E019.05.40.742 olive
N050.28.20.246 E019.05.40.742 N050.28.20.300 E019.05.38.908 olive
N050.28.20.300 E019.05.38.908 N050.28.20.330 E019.05.36.845 olive
N050.28.20.330 E019.05.36.845 N050.28.20.338 E019.05.17.666 olive
N050.28.20.338 E019.05.17.666 N050.28.20.343 E019.05.15.346 olive
N050.28.20.343 E019.05.15.346 N050.28.20.386 E019.05.09.067 olive
N050.28.20.386 E019.05.09.067 N050.28.20.391 E019.05.06.625 olive
N050.28.20.391 E019.05.06.625 N050.28.20.398 E019.05.00.137 olive
N050.28.20.398 E019.05.00.137 N050.28.20.376 E019.04.55.078 olive
N050.28.20.376 E019.04.55.078 N050.28.20.415 E019.04.33.907 olive
N050.28.20.415 E019.04.33.907 N050.28.20.413 E019.04.31.763 olive
N050.28.20.413 E019.04.31.763 N050.28.20.417 E019.04.29.872 olive
N050.28.20.417 E019.04.29.872 N050.28.20.446 E019.04.29.506 olive
N050.28.20.446 E019.04.29.506 N050.28.20.624 E019.04.28.208 olive
N050.28.20.624 E019.04.28.208 N050.28.20.624 E019.04.28.208 olive
N050.28.20.624 E019.04.28.208 N050.28.20.783 E019.04.26.996 olive
N050.28.20.783 E019.04.26.996 N050.28.20.853 E019.04.26.285 olive
N050.28.20.853 E019.04.26.285 N050.28.20.825 E019.04.24.252 olive
N050.28.20.825 E019.04.24.252 N050.28.20.829 E019.04.22.455 olive
N050.28.20.829 E019.04.22.455 N050.28.20.824 E019.04.20.369 olive
N050.28.20.824 E019.04.20.369 N050.28.20.846 E019.04.18.906 olive
N050.28.20.846 E019.04.18.906 N050.28.20.851 E019.04.16.513 olive
N050.28.20.851 E019.04.16.513 N050.28.20.855 E019.04.14.568 olive
N050.28.20.855 E019.04.14.568 N050.28.20.827 E019.04.12.692 olive
N050.28.20.827 E019.04.12.692 N050.28.20.823 E019.04.10.057 olive
N050.28.20.823 E019.04.10.057 N050.28.20.828 E019.04.07.555 olive
N050.28.20.828 E019.04.07.555 N050.28.20.837 E019.04.00.156 olive
N050.28.20.837 E019.04.00.156 N050.28.20.924 E019.03.59.597 olive
N050.28.20.924 E019.03.59.597 N050.28.21.019 E019.03.59.356 olive
N050.28.21.019 E019.03.59.356 N050.28.21.294 E019.03.59.049 olive
N050.28.21.294 E019.03.59.049 N050.28.21.479 E019.03.58.867 olive
N050.28.21.479 E019.03.58.867 N050.28.21.855 E019.03.58.790 olive
N050.28.21.855 E019.03.58.790 N050.28.26.514 E019.03.58.777 olive
N050.28.17.599 E019.04.08.567 N050.28.20.854 E019.04.08.577 olive
N050.28.17.645 E019.04.09.799 N050.28.20.824 E019.04.09.803 olive
N050.28.17.594 E019.04.11.024 N050.28.20.853 E019.04.11.037 olive
N050.28.17.619 E019.04.12.951 N050.28.20.846 E019.04.12.979 olive
N050.28.17.637 E019.04.13.886 N050.28.20.854 E019.04.13.926 olive
N050.28.17.628 E019.04.15.029 N050.28.20.828 E019.04.15.027 olive
N050.28.18.197 E019.04.17.030 N050.28.20.826 E019.04.17.053 olive
N050.28.18.175 E019.04.19.198 N050.28.20.847 E019.04.19.208 olive
N050.28.18.189 E019.04.21.375 N050.28.20.849 E019.04.21.397 olive
N050.28.18.183 E019.04.23.560 N050.28.20.845 E019.04.23.583 olive
N050.28.18.548 E019.04.25.605 N050.28.20.852 E019.04.25.623 olive
N050.28.18.499 E019.04.27.435 N050.28.20.575 E019.04.27.455 olive
N050.28.20.575 E019.04.27.455 N050.28.21.495 E019.04.28.102 olive
N050.28.26.457 E019.04.28.141 N050.28.21.095 E019.04.28.124 olive
N050.28.21.095 E019.04.28.124 N050.28.20.922 E019.04.28.212 olive
N050.28.20.922 E019.04.28.212 N050.28.20.794 E019.04.28.312 olive
N050.28.20.794 E019.04.28.312 N050.28.20.653 E019.04.28.534 olive
N050.28.20.653 E019.04.28.534 N050.28.20.562 E019.04.28.838 olive
N050.28.21.876 E019.04.28.113 N050.28.21.646 E019.04.28.030 olive
N050.28.21.646 E019.04.28.030 N050.28.21.424 E019.04.27.856 olive
N050.28.21.424 E019.04.27.856 N050.28.21.208 E019.04.27.587 olive
N050.28.21.208 E019.04.27.587 N050.28.20.987 E019.04.27.225 olive
N050.28.20.987 E019.04.27.225 N050.28.20.896 E019.04.26.851 olive
N050.28.20.896 E019.04.26.851 N050.28.20.850 E019.04.26.343 olive
N050.28.18.497 E019.04.29.327 N050.28.20.492 E019.04.29.349 olive
N050.28.18.540 E019.04.31.254 N050.28.20.412 E019.04.31.244 olive
N050.28.18.519 E019.04.33.177 N050.28.20.415 E019.04.33.180 olive
N050.28.20.296 E019.05.40.077 N050.28.22.791 E019.05.40.077 olive
N050.28.20.205 E019.05.43.706 N050.28.18.448 E019.05.43.700 olive
N050.28.19.172 E019.05.43.700 N050.28.18.498 E019.05.42.414 olive
N050.28.19.216 E019.05.42.425 N050.28.19.904 E019.05.43.689 olive
N050.28.20.235 E019.05.44.748 N050.28.18.434 E019.05.44.768 olive
N050.28.18.481 E019.05.45.731 N050.28.20.225 E019.05.48.844 olive
N050.28.18.426 E019.05.48.801 N050.28.20.186 E019.05.51.858 olive
N050.28.18.443 E019.05.51.940 N050.28.20.203 E019.05.55.041 olive
N050.28.18.368 E019.05.55.018 N050.28.20.203 E019.05.57.676 olive
N050.28.26.404 E019.04.24.816 N050.28.22.342 E019.04.18.044 olive
N050.28.22.342 E019.04.18.044 N050.28.21.108 E019.04.16.026 olive
N050.28.21.108 E019.04.16.026 N050.28.20.850 E019.04.15.200 olive
N050.28.20.852 E019.04.18.907 N050.28.20.911 E019.04.18.545 olive
N050.28.20.911 E019.04.18.545 N050.28.21.043 E019.04.18.195 olive
N050.28.21.043 E019.04.18.195 N050.28.21.202 E019.04.17.947 olive
N050.28.21.202 E019.04.17.947 N050.28.21.398 E019.04.17.792 olive
N050.28.21.398 E019.04.17.792 N050.28.21.781 E019.04.17.764 olive
N050.28.21.781 E019.04.17.764 N050.28.22.142 E019.04.17.926 olive
N050.28.22.142 E019.04.17.926 N050.28.22.370 E019.04.18.109 olive
N050.28.26.359 E019.05.07.608 N050.28.25.761 E019.05.08.137 olive
N050.28.25.761 E019.05.08.137 N050.28.25.064 E019.05.08.393 olive
N050.28.25.064 E019.05.08.393 N050.28.20.738 E019.05.08.393 olive
N050.28.20.738 E019.05.08.393 N050.28.20.342 E019.05.08.388 olive
N050.28.16.292 E019.05.13.798 N050.28.17.187 E019.05.13.741 olive
N050.28.17.187 E019.05.13.741 N050.28.18.175 E019.05.12.135 olive
N050.28.18.175 E019.05.12.135 N050.28.19.328 E019.05.10.305 olive
N050.28.19.328 E019.05.10.305 N050.28.20.349 E019.05.08.549 olive
N050.28.20.367 E019.05.16.857 N050.28.20.211 E019.05.16.333 olive
N050.28.20.211 E019.05.16.333 N050.28.19.909 E019.05.15.648 olive
N050.28.19.909 E019.05.15.648 N050.28.18.067 E019.05.12.563 olive
N050.28.18.067 E019.05.12.563 N050.28.17.582 E019.05.12.091 olive
N050.28.16.240 E019.05.12.067 N050.28.17.962 E019.05.12.066 olive
N050.28.17.962 E019.05.12.066 N050.28.18.375 E019.05.11.830 olive
N050.28.16.416 E019.05.09.674 N050.28.17.413 E019.05.09.653 olive
N050.28.17.413 E019.05.09.653 N050.28.17.411 E019.05.07.718 olive
N050.28.17.411 E019.05.07.718 N050.28.17.411 E019.05.05.083 olive
N050.28.17.411 E019.05.05.083 N050.28.17.548 E019.05.04.565 olive
N050.28.17.548 E019.05.04.565 N050.28.20.185 E019.05.00.249 olive
N050.28.20.185 E019.05.00.249 N050.28.20.390 E019.04.59.753 olive
N050.28.20.343 E019.05.07.779 N050.28.19.859 E019.05.06.820 olive
N050.28.19.859 E019.05.06.820 N050.28.18.187 E019.05.04.120 olive
N050.28.18.187 E019.05.04.120 N050.28.17.795 E019.05.03.795 olive
N050.28.17.795 E019.05.03.795 N050.28.16.941 E019.05.03.650 olive
N050.28.16.941 E019.05.03.650 N050.28.16.964 E019.05.01.693 olive
N050.28.16.964 E019.05.01.693 N050.28.16.963 E019.04.59.323 olive
N050.28.16.333 E019.04.59.349 N050.28.17.535 E019.04.59.334 olive
N050.28.17.441 E019.05.00.450 N050.28.16.375 E019.05.00.449 olive
N050.28.16.936 E019.05.01.588 N050.28.17.542 E019.05.01.617 olive
N050.28.16.410 E019.05.07.725 N050.28.17.410 E019.05.07.736 olive
;- BLD
N050.28.17.331 E019.04.35.097 N050.28.17.348 E019.04.27.890 maroon
N050.28.17.348 E019.04.27.890 N050.28.17.748 E019.04.27.889 maroon
N050.28.17.748 E019.04.27.889 N050.28.17.729 E019.04.24.954 maroon
N050.28.17.729 E019.04.24.954 N050.28.17.495 E019.04.24.956 maroon
N050.28.17.495 E019.04.24.956 N050.28.17.491 E019.04.16.424 maroon
N050.28.17.491 E019.04.16.424 N050.28.15.673 E019.04.16.458 maroon
N050.28.15.673 E019.04.16.458 N050.28.15.680 E019.04.27.918 maroon
N050.28.15.680 E019.04.27.918 N050.28.16.834 E019.04.27.911 maroon
N050.28.16.834 E019.04.27.911 N050.28.16.837 E019.04.34.351 maroon
N050.28.16.837 E019.04.34.351 N050.28.16.452 E019.04.34.339 maroon
N050.28.16.452 E019.04.34.339 N050.28.16.482 E019.04.35.113 maroon
N050.28.16.482 E019.04.35.113 N050.28.17.331 E019.04.35.097 maroon
;EPWR
;- RWY
N051.05.53.246 E016.53.59.009 N051.06.28.777 E016.52.02.978 olive
N051.06.28.777 E016.52.02.978 N051.06.30.354 E016.52.04.172 olive
N051.06.30.354 E016.52.04.172 N051.05.54.750 E016.54.00.176 olive
N051.05.54.750 E016.54.00.176 N051.05.53.239 E016.53.58.967 olive
;- TWY
N051.05.55.061 E016.53.59.063 N051.06.03.055 E016.54.05.975 teal
N051.06.03.055 E016.54.05.975 N051.06.07.497 E016.54.09.807 teal
N051.06.07.497 E016.54.09.807 N051.06.10.357 E016.54.12.269 teal
N051.06.10.357 E016.54.12.269 N051.06.10.522 E016.54.12.489 teal
N051.06.10.522 E016.54.12.489 N051.06.10.760 E016.54.13.036 teal
N051.06.10.760 E016.54.13.036 N051.06.10.837 E016.54.13.542 teal
N051.06.10.837 E016.54.13.542 N051.06.10.575 E016.54.20.993 teal
N051.06.10.575 E016.54.20.993 N051.06.10.491 E016.54.25.262 teal
N051.06.10.491 E016.54.25.262 N051.06.13.418 E016.54.25.425 teal
N051.06.13.418 E016.54.25.425 N051.06.13.494 E016.54.22.594 teal
N051.06.13.494 E016.54.22.594 N051.06.13.694 E016.54.22.605 teal
N051.06.13.694 E016.54.22.605 N051.06.13.811 E016.54.09.189 teal
N051.06.13.811 E016.54.09.189 N051.06.13.839 E016.54.07.602 teal
N051.06.13.839 E016.54.07.602 N051.06.12.159 E016.54.06.500 teal
N051.06.12.159 E016.54.06.500 N051.06.12.141 E016.54.06.559 teal
N051.06.12.141 E016.54.06.559 N051.06.12.027 E016.54.06.808 teal
N051.06.12.027 E016.54.06.808 N051.06.12.048 E016.54.07.384 teal
N051.06.12.048 E016.54.07.384 N051.06.11.005 E016.54.09.167 teal
N051.06.11.005 E016.54.09.167 N051.06.08.772 E016.54.09.068 teal
N051.06.08.772 E016.54.09.068 N051.06.08.677 E016.54.08.967 teal
N051.06.08.677 E016.54.08.967 N051.06.05.035 E016.54.05.960 teal
N051.06.05.035 E016.54.05.960 N051.06.04.671 E016.54.05.306 teal
N051.06.04.671 E016.54.05.306 N051.06.04.648 E016.54.04.482 teal
N051.06.04.648 E016.54.04.482 N051.06.04.847 E016.54.03.674 teal
N051.06.04.847 E016.54.03.674 N051.06.22.746 E016.53.05.319 teal
N051.06.22.746 E016.53.05.319 N051.06.25.997 E016.53.07.807 teal
N051.06.25.997 E016.53.07.807 N051.06.28.315 E016.53.00.249 teal
N051.06.28.315 E016.53.00.249 N051.06.25.194 E016.52.57.397 teal
N051.06.25.194 E016.52.57.397 N051.06.31.309 E016.52.37.315 teal
N051.06.31.309 E016.52.37.315 N051.06.31.563 E016.52.36.845 teal
N051.06.31.563 E016.52.36.845 N051.06.31.865 E016.52.36.783 teal
N051.06.31.865 E016.52.36.783 N051.06.32.009 E016.52.36.851 teal
N051.06.32.009 E016.52.36.851 N051.06.32.871 E016.52.37.438 teal
N051.06.32.871 E016.52.37.438 N051.06.32.978 E016.52.37.084 teal
N051.06.32.978 E016.52.37.084 N051.06.34.124 E016.52.38.095 teal
N051.06.34.124 E016.52.38.095 N051.06.34.502 E016.52.36.955 teal
N051.06.34.502 E016.52.36.955 N051.06.30.554 E016.52.33.504 teal
N051.06.30.554 E016.52.33.504 N051.06.28.891 E016.52.31.234 teal
N051.06.28.891 E016.52.31.234 N051.06.26.252 E016.52.28.757 teal
N051.06.26.252 E016.52.28.757 N051.06.24.702 E016.52.28.406 teal
N051.06.24.702 E016.52.28.406 N051.06.24.442 E016.52.28.242 teal
N051.06.24.442 E016.52.28.242 N051.06.24.076 E016.52.27.897 teal
N051.06.24.076 E016.52.27.897 N051.06.23.889 E016.52.27.584 teal
N051.06.23.889 E016.52.27.584 N051.06.23.723 E016.52.27.129 teal
N051.06.23.723 E016.52.27.129 N051.06.23.676 E016.52.26.012 teal
;- TWY2
N051.06.22.486 E016.52.29.850 N051.06.23.337 E016.52.29.494 teal
N051.06.23.337 E016.52.29.494 N051.06.23.337 E016.52.29.494 teal
N051.06.23.337 E016.52.29.494 N051.06.23.702 E016.52.29.527 teal
N051.06.23.702 E016.52.29.527 N051.06.23.881 E016.52.29.615 teal
N051.06.23.881 E016.52.29.615 N051.06.29.539 E016.52.34.576 teal
N051.06.29.539 E016.52.34.576 N051.06.30.083 E016.52.35.248 teal
N051.06.30.083 E016.52.35.248 N051.06.30.209 E016.52.35.610 teal
N051.06.30.209 E016.52.35.610 N051.06.30.246 E016.52.36.492 teal
N051.06.30.246 E016.52.36.492 N051.06.30.123 E016.52.37.283 teal
N051.06.30.123 E016.52.37.283 N051.06.29.698 E016.52.38.673 teal
N051.06.29.698 E016.52.38.673 N051.06.04.004 E016.54.03.006 teal
N051.06.04.004 E016.54.03.006 N051.06.03.630 E016.54.03.525 teal
N051.06.03.630 E016.54.03.525 N051.06.03.298 E016.54.03.771 teal
N051.06.03.298 E016.54.03.771 N051.06.02.694 E016.54.03.728 teal
N051.06.02.694 E016.54.03.728 N051.06.02.608 E016.54.03.670 teal
N051.06.02.608 E016.54.03.670 N051.05.56.914 E016.53.58.790 teal
N051.05.56.914 E016.53.58.790 N051.05.56.558 E016.53.58.400 teal
N051.05.56.558 E016.53.58.400 N051.05.56.371 E016.53.58.040 teal
N051.05.56.371 E016.53.58.040 N051.05.56.193 E016.53.57.772 teal
N051.05.56.193 E016.53.57.772 N051.05.56.050 E016.53.56.968 teal
N051.05.56.050 E016.53.56.968 N051.05.56.073 E016.53.55.988 teal
;- LNS
N051.05.55.389 E016.53.58.387 N051.06.03.358 E016.54.05.353 olive
N051.06.03.358 E016.54.05.353 N051.06.04.502 E016.54.06.338 olive
N051.06.04.502 E016.54.06.338 N051.06.08.964 E016.54.10.196 olive
N051.06.08.964 E016.54.10.196 N051.06.10.181 E016.54.11.280 olive
N051.06.10.181 E016.54.11.280 N051.06.10.625 E016.54.11.668 olive
N051.06.10.625 E016.54.11.668 N051.06.10.770 E016.54.11.871 olive
N051.06.10.770 E016.54.11.871 N051.06.10.984 E016.54.12.190 olive
N051.06.10.984 E016.54.12.190 N051.06.11.057 E016.54.12.512 olive
N051.06.11.057 E016.54.12.512 N051.06.11.158 E016.54.12.938 olive
N051.06.11.158 E016.54.12.938 N051.06.11.206 E016.54.13.591 olive
N051.06.11.206 E016.54.13.591 N051.06.11.097 E016.54.16.416 olive
N051.06.11.097 E016.54.16.416 N051.06.11.047 E016.54.19.580 olive
N051.06.11.047 E016.54.19.580 N051.06.10.927 E016.54.22.700 olive
N051.06.10.927 E016.54.22.700 N051.06.10.942 E016.54.23.616 olive
N051.06.10.942 E016.54.23.616 N051.06.10.934 E016.54.23.952 olive
N051.06.10.934 E016.54.23.952 N051.06.11.021 E016.54.24.211 olive
N051.06.11.021 E016.54.24.211 N051.06.11.200 E016.54.24.352 olive
N051.06.11.200 E016.54.24.352 N051.06.13.016 E016.54.24.471 olive
N051.06.10.968 E016.54.21.398 N051.06.13.090 E016.54.21.525 olive
N051.06.11.090 E016.54.18.597 N051.06.13.126 E016.54.18.717 olive
N051.06.11.159 E016.54.15.734 N051.06.13.216 E016.54.15.857 olive
N051.06.10.033 E016.54.11.141 N051.06.12.908 E016.54.11.430 olive
N051.06.09.317 E016.54.10.447 N051.06.12.901 E016.54.08.855 olive
N051.06.03.729 E016.54.05.708 N051.06.09.721 E016.53.46.143 olive
N051.06.09.721 E016.53.46.143 N051.06.22.511 E016.53.04.139 olive
N051.06.22.511 E016.53.04.139 N051.06.24.321 E016.52.58.162 olive
N051.06.24.321 E016.52.58.162 N051.06.30.924 E016.52.36.536 olive
N051.06.30.924 E016.52.36.536 N051.06.30.948 E016.52.36.274 olive
N051.06.30.948 E016.52.36.274 N051.06.30.974 E016.52.35.942 olive
N051.06.30.974 E016.52.35.942 N051.06.30.956 E016.52.35.567 olive
N051.06.30.956 E016.52.35.567 N051.06.30.729 E016.52.34.984 olive
N051.06.30.729 E016.52.34.984 N051.06.30.599 E016.52.34.732 olive
N051.06.30.599 E016.52.34.732 N051.06.30.378 E016.52.34.458 olive
N051.06.30.378 E016.52.34.458 N051.06.29.696 E016.52.33.775 olive
N051.06.29.696 E016.52.33.775 N051.06.23.054 E016.52.27.942 olive
N051.06.24.150 E016.52.58.668 N051.06.27.181 E016.53.00.980 olive
N051.06.23.393 E016.53.01.180 N051.06.26.354 E016.53.03.497 olive
N051.06.22.701 E016.53.03.515 N051.06.25.659 E016.53.05.766 olive
;- BLD
N051.06.24.445 E016.53.13.036 N051.06.23.236 E016.53.16.951 maroon
N051.06.23.236 E016.53.16.951 N051.06.21.574 E016.53.15.647 maroon
N051.06.21.574 E016.53.15.647 N051.06.22.836 E016.53.11.761 maroon
N051.06.22.836 E016.53.11.761 N051.06.24.441 E016.53.13.046 maroon
N051.06.21.478 E016.53.18.784 N051.06.20.851 E016.53.20.826 maroon
N051.06.20.851 E016.53.20.826 N051.06.20.439 E016.53.20.439 maroon
N051.06.20.439 E016.53.20.439 N051.06.21.028 E016.53.18.446 maroon
N051.06.21.028 E016.53.18.446 N051.06.21.455 E016.53.18.764 maroon
N051.06.20.941 E016.53.22.057 N051.06.20.722 E016.53.22.898 maroon
N051.06.20.722 E016.53.22.898 N051.06.19.870 E016.53.22.260 maroon
N051.06.19.870 E016.53.22.260 N051.06.20.153 E016.53.21.414 maroon
N051.06.20.153 E016.53.21.414 N051.06.20.940 E016.53.22.055 maroon
N051.06.15.032 E016.54.05.420 N051.06.14.387 E016.54.07.429 maroon
N051.06.14.387 E016.54.07.429 N051.06.12.373 E016.54.05.822 maroon
N051.06.12.373 E016.54.05.822 N051.06.12.201 E016.54.05.424 maroon
N051.06.12.201 E016.54.05.424 N051.06.11.566 E016.54.05.348 maroon
N051.06.11.566 E016.54.05.348 N051.06.11.482 E016.54.06.414 maroon
N051.06.11.482 E016.54.06.414 N051.06.09.694 E016.54.06.211 maroon
N051.06.09.694 E016.54.06.211 N051.06.09.804 E016.54.04.393 maroon
N051.06.09.804 E016.54.04.393 N051.06.11.547 E016.54.04.579 maroon
N051.06.11.547 E016.54.04.579 N051.06.11.694 E016.54.02.863 maroon
N051.06.11.694 E016.54.02.863 N051.06.12.111 E016.54.02.450 maroon
N051.06.12.111 E016.54.02.450 N051.06.12.174 E016.54.01.857 maroon
N051.06.12.174 E016.54.01.857 N051.06.12.761 E016.54.02.180 maroon
N051.06.12.761 E016.54.02.180 N051.06.12.555 E016.54.03.060 maroon
N051.06.12.555 E016.54.03.060 N051.06.12.862 E016.54.03.099 maroon
N051.06.12.862 E016.54.03.099 N051.06.12.990 E016.54.03.854 maroon
N051.06.12.990 E016.54.03.854 N051.06.15.028 E016.54.05.410 maroon
;EPRZ
;- RWY
N050.06.35.942 E022.00.05.520 N050.06.33.874 E022.02.46.661 olive
N050.06.33.874 E022.02.46.661 N050.06.35.360 E022.02.46.703 olive
N050.06.35.360 E022.02.46.703 N050.06.37.399 E022.00.05.588 olive
N050.06.37.399 E022.00.05.588 N050.06.35.945 E022.00.05.533 olive
;- TWY
N050.06.37.393 E022.00.05.588 N050.06.37.946 E022.00.05.586 teal
N050.06.37.946 E022.00.05.586 N050.06.37.951 E022.00.05.192 teal
N050.06.37.951 E022.00.05.192 N050.06.44.967 E022.00.05.443 teal
N050.06.44.967 E022.00.05.443 N050.06.44.945 E022.00.09.957 teal
N050.06.44.945 E022.00.09.957 N050.06.42.894 E022.00.09.882 teal
N050.06.42.894 E022.00.09.882 N050.06.42.887 E022.00.09.188 teal
N050.06.42.887 E022.00.09.188 N050.06.42.831 E022.00.08.454 teal
N050.06.42.831 E022.00.08.454 N050.06.42.613 E022.00.07.831 teal
N050.06.42.613 E022.00.07.831 N050.06.42.166 E022.00.07.404 teal
N050.06.42.166 E022.00.07.404 N050.06.41.746 E022.00.07.286 teal
N050.06.41.746 E022.00.07.286 N050.06.38.554 E022.00.07.194 teal
N050.06.38.554 E022.00.07.194 N050.06.38.184 E022.00.07.379 teal
N050.06.38.184 E022.00.07.379 N050.06.37.909 E022.00.07.798 teal
N050.06.37.909 E022.00.07.798 N050.06.37.362 E022.00.09.129 teal
N050.06.36.266 E022.01.35.629 N050.06.36.564 E022.01.36.539 teal
N050.06.36.564 E022.01.36.539 N050.06.36.926 E022.01.37.066 teal
N050.06.36.926 E022.01.37.066 N050.06.37.615 E022.01.37.436 teal
N050.06.37.615 E022.01.37.436 N050.06.48.359 E022.01.37.851 teal
N050.06.48.359 E022.01.37.851 N050.06.49.253 E022.01.36.736 teal
N050.06.49.253 E022.01.36.736 N050.06.49.240 E022.01.35.156 teal
N050.06.49.240 E022.01.35.156 N050.06.51.756 E022.01.35.214 teal
N050.06.51.756 E022.01.35.214 N050.06.51.667 E022.01.42.491 teal
N050.06.51.667 E022.01.42.491 N050.06.52.400 E022.01.43.461 teal
N050.06.52.400 E022.01.43.461 N050.06.52.340 E022.01.45.668 teal
N050.06.52.340 E022.01.45.668 N050.06.52.692 E022.01.46.233 teal
N050.06.52.692 E022.01.46.233 N050.06.52.680 E022.01.47.239 teal
N050.06.52.680 E022.01.47.239 N050.06.50.497 E022.01.47.198 teal
N050.06.50.497 E022.01.47.198 N050.06.50.674 E022.01.42.845 teal
N050.06.50.674 E022.01.42.845 N050.06.50.432 E022.01.42.406 teal
N050.06.50.432 E022.01.42.406 N050.06.49.185 E022.01.42.372 teal
N050.06.49.185 E022.01.42.372 N050.06.49.193 E022.01.40.854 teal
N050.06.49.193 E022.01.40.854 N050.06.48.542 E022.01.39.815 teal
N050.06.48.542 E022.01.39.815 N050.06.37.513 E022.01.39.458 teal
N050.06.37.513 E022.01.39.458 N050.06.37.112 E022.01.39.747 teal
N050.06.37.112 E022.01.39.747 N050.06.36.148 E022.01.41.600 teal
;- LNS
N050.06.36.229 E022.01.38.367 N050.06.48.161 E022.01.38.819 olive
N050.06.48.161 E022.01.38.819 N050.06.48.706 E022.01.38.856 olive
N050.06.48.706 E022.01.38.856 N050.06.51.508 E022.01.39.251 olive
N050.06.48.290 E022.01.38.812 N050.06.50.889 E022.01.36.448 olive
N050.06.48.311 E022.01.38.865 N050.06.48.643 E022.01.39.050 olive
N050.06.48.643 E022.01.39.050 N050.06.49.701 E022.01.40.437 olive
N050.06.49.701 E022.01.40.437 N050.06.50.775 E022.01.41.845 olive
N050.06.50.775 E022.01.41.845 N050.06.50.987 E022.01.42.399 olive
N050.06.50.987 E022.01.42.399 N050.06.51.848 E022.01.44.569 olive
N050.06.48.767 E022.01.39.217 N050.06.50.381 E022.01.42.106 olive
N050.06.50.763 E022.01.41.854 N050.06.50.823 E022.01.42.406 olive
N050.06.50.823 E022.01.42.406 N050.06.50.655 E022.01.46.527 olive
N050.06.50.810 E022.01.42.994 N050.06.51.520 E022.01.45.879 olive
N050.06.50.814 E022.01.42.694 N050.06.51.641 E022.01.45.246 olive
;- LNS2
N050.06.37.393 E022.00.06.540 N050.06.38.174 E022.00.06.161 olive
N050.06.38.174 E022.00.06.161 N050.06.42.429 E022.00.06.333 olive
N050.06.42.429 E022.00.06.333 N050.06.44.676 E022.00.06.397 olive
N050.06.42.579 E022.00.06.343 N050.06.43.206 E022.00.06.656 olive
N050.06.43.206 E022.00.06.656 N050.06.44.413 E022.00.07.701 olive
N050.06.42.593 E022.00.06.328 N050.06.42.921 E022.00.06.743 olive
N050.06.42.921 E022.00.06.743 N050.06.43.111 E022.00.07.277 olive
N050.06.43.111 E022.00.07.277 N050.06.43.168 E022.00.09.405 olive
;- BLD
N050.06.53.500 E022.01.39.630 N050.06.53.498 E022.01.41.368 maroon
N050.06.53.498 E022.01.41.368 N050.06.53.714 E022.01.41.376 maroon
N050.06.53.714 E022.01.41.376 N050.06.53.712 E022.01.44.151 maroon
N050.06.53.712 E022.01.44.151 N050.06.53.626 E022.01.44.154 maroon
N050.06.53.626 E022.01.44.154 N050.06.53.624 E022.01.46.178 maroon
N050.06.53.624 E022.01.46.178 N050.06.54.137 E022.01.46.172 maroon
N050.06.54.137 E022.01.46.172 N050.06.54.142 E022.01.41.350 maroon
N050.06.54.142 E022.01.41.350 N050.06.54.335 E022.01.41.332 maroon
N050.06.54.335 E022.01.41.332 N050.06.54.336 E022.01.39.619 maroon
N050.06.54.336 E022.01.39.619 N050.06.53.500 E022.01.39.644 maroon

;EPBY
;- PAS
N053.05.43.827 E017.57.32.843 N053.05.55.031 E017.59.45.885 white
N053.05.55.031 E017.59.45.885 N053.05.53.103 E017.59.46.333 white
N053.05.53.103 E017.59.46.333 N053.05.41.897 E017.57.33.283 white
N053.05.41.897 E017.57.33.283 N053.05.43.822 E017.57.32.843 white
;- TAXIWAYS
N053.05.43.827 E017.57.32.841 N053.05.44.435 E017.57.32.685 blue
N053.05.44.435 E017.57.32.685 N053.05.45.885 E017.57.31.486 blue
N053.05.45.885 E017.57.31.486 N053.05.51.863 E017.57.30.135 blue
N053.05.51.863 E017.57.30.135 N053.05.51.919 E017.57.30.838 blue
N053.05.51.919 E017.57.30.838 N053.05.52.480 E017.57.30.719 blue
N053.05.52.480 E017.57.30.719 N053.06.02.677 E017.57.45.518 blue
N053.06.06.215 E017.57.45.106 N053.06.07.079 E017.57.46.286 blue
N053.06.07.079 E017.57.46.286 N053.06.06.738 E017.57.46.971 blue
N053.06.06.738 E017.57.46.971 N053.06.05.836 E017.57.45.813 blue
N053.06.05.836 E017.57.45.813 N053.06.06.208 E017.57.45.114 blue
N053.06.05.333 E017.57.46.970 N053.06.06.133 E017.57.48.075 blue
N053.06.06.133 E017.57.48.075 N053.06.05.684 E017.57.49.011 blue
N053.06.05.684 E017.57.49.011 N053.06.04.914 E017.57.47.846 blue
N053.06.04.914 E017.57.47.846 N053.06.05.336 E017.57.46.977 blue
N053.06.04.367 E017.57.48.994 N053.06.05.149 E017.57.50.118 blue
N053.06.05.149 E017.57.50.118 N053.06.04.879 E017.57.50.685 blue
N053.06.04.879 E017.57.50.685 N053.06.04.060 E017.57.49.572 blue
N053.06.04.060 E017.57.49.572 N053.06.04.343 E017.57.49.012 blue
N053.06.06.714 E017.57.43.968 N053.06.08.276 E017.57.46.045 blue
N053.06.08.276 E017.57.46.045 N053.06.04.961 E017.57.52.727 blue
N053.06.04.961 E017.57.52.727 N053.06.03.562 E017.57.50.755 blue
N053.06.03.562 E017.57.50.755 N053.06.03.342 E017.57.51.135 blue
N053.06.03.342 E017.57.51.135 N053.06.03.088 E017.57.50.114 blue
N053.06.03.088 E017.57.50.114 N053.06.02.785 E017.57.49.652 blue
N053.06.02.785 E017.57.49.652 N053.06.02.892 E017.57.49.345 blue
N053.06.02.892 E017.57.49.345 N053.06.02.598 E017.57.48.246 blue
N053.06.02.598 E017.57.48.246 N053.05.52.040 E017.57.32.912 blue
N053.05.52.040 E017.57.32.912 N053.05.52.178 E017.57.34.281 blue
N053.05.52.178 E017.57.34.281 N053.05.44.074 E017.57.36.027 blue
;- TAXI2
N053.05.41.895 E017.57.33.243 N053.05.39.029 E017.57.33.918 blue
N053.05.39.029 E017.57.33.918 N053.05.33.386 E017.57.34.959 blue
N053.05.33.386 E017.57.34.959 N053.05.36.089 E017.58.05.449 blue
N053.05.36.089 E017.58.05.449 N053.05.35.906 E017.58.06.004 blue
N053.05.35.906 E017.58.06.004 N053.05.33.038 E017.58.08.469 blue
N053.05.33.146 E017.58.11.514 N053.05.33.181 E017.58.10.703 blue
N053.05.33.181 E017.58.10.703 N053.05.36.316 E017.58.08.062 blue
N053.05.36.316 E017.58.08.062 N053.05.36.588 E017.58.11.583 blue
N053.05.36.588 E017.58.11.583 N053.05.36.388 E017.58.12.007 blue
N053.05.36.388 E017.58.12.007 N053.05.33.177 E017.58.11.514 blue
N053.05.33.177 E017.58.11.514 N053.05.33.177 E017.58.11.514 blue
N053.05.32.120 E017.58.13.000 N053.05.32.129 E017.58.13.463 blue
N053.05.32.129 E017.58.13.463 N053.05.36.062 E017.58.14.059 blue
N053.05.36.062 E017.58.14.059 N053.05.36.937 E017.58.15.399 blue
N053.05.36.937 E017.58.15.399 N053.05.43.858 E017.59.36.740 blue
N053.05.43.858 E017.59.36.740 N053.05.43.477 E017.59.37.333 blue
N053.05.43.777 E017.59.41.787 N053.05.44.330 E017.59.42.643 blue
N053.05.44.330 E017.59.42.643 N053.05.44.486 E017.59.44.526 blue
N053.05.44.486 E017.59.44.526 N053.05.43.888 E017.59.46.191 blue
N053.05.43.888 E017.59.46.191 N053.05.42.694 E017.59.46.541 blue
N053.05.42.694 E017.59.46.541 N053.05.41.888 E017.59.46.160 blue
N053.05.41.582 E017.59.52.144 N053.05.41.741 E017.59.54.089 blue
N053.05.41.741 E017.59.54.089 N053.05.41.404 E017.59.55.472 blue
N053.05.41.404 E017.59.55.472 N053.05.39.405 E017.59.56.520 blue
N053.05.39.405 E017.59.56.520 N053.05.39.668 E017.59.55.006 blue
N053.05.39.201 E017.59.54.804 N053.05.38.872 E017.59.56.785 blue
N053.05.38.872 E017.59.56.785 N053.05.36.839 E017.59.57.186 blue
N053.05.36.839 E017.59.57.186 N053.05.36.905 E017.59.57.991 blue
N053.05.36.905 E017.59.57.991 N053.05.37.601 E017.59.57.858 blue
N053.05.38.526 E017.59.57.683 N053.05.38.933 E017.59.57.620 blue
N053.05.38.933 E017.59.57.620 N053.05.39.778 E017.59.59.993 blue
N053.05.39.778 E017.59.59.993 N053.05.42.296 E017.59.59.690 blue
N053.05.42.296 E017.59.59.690 N053.05.42.390 E018.00.00.593 blue
N053.05.42.564 E018.00.02.098 N053.05.42.652 E018.00.03.224 blue
N053.05.42.652 E018.00.03.224 N053.05.43.123 E018.00.03.146 blue
N053.05.43.123 E018.00.03.146 N053.05.42.873 E018.00.00.305 blue
N053.05.42.873 E018.00.00.305 N053.05.43.120 E017.59.58.450 blue
N053.05.43.120 E017.59.58.450 N053.05.43.184 E017.59.58.253 blue
N053.05.43.184 E017.59.58.253 N053.05.42.852 E017.59.54.518 blue
N053.05.42.852 E017.59.54.518 N053.05.42.273 E017.59.53.926 blue
N053.05.42.273 E017.59.53.926 N053.05.42.077 E017.59.51.797 blue
N053.05.41.698 E017.59.56.170 N053.05.39.403 E017.59.57.388 blue
N053.05.39.403 E017.59.57.388 N053.05.40.037 E017.59.59.159 blue
N053.05.40.037 E017.59.59.159 N053.05.42.380 E017.59.58.820 blue
N053.05.42.380 E017.59.58.820 N053.05.42.620 E017.59.58.153 blue
N053.05.42.620 E017.59.58.153 N053.05.41.701 E017.59.56.197 blue
N053.05.42.193 E017.59.49.025 N053.05.42.747 E017.59.47.963 blue
N053.05.42.747 E017.59.47.963 N053.05.44.014 E017.59.47.675 blue
N053.05.44.014 E017.59.47.675 N053.05.44.910 E017.59.48.675 blue
N053.05.44.910 E017.59.48.675 N053.05.45.128 E017.59.50.626 blue
N053.05.45.128 E017.59.50.626 N053.05.50.117 E017.59.49.368 blue
N053.05.50.117 E017.59.49.368 N053.05.52.114 E017.59.46.627 blue
N053.05.52.114 E017.59.46.627 N053.05.53.101 E017.59.46.395 blue
N053.05.52.726 E017.59.41.918 N053.05.51.576 E017.59.44.630 blue
N053.05.51.576 E017.59.44.630 N053.05.45.892 E017.59.45.924 blue
N053.05.45.892 E017.59.45.924 N053.05.42.681 E017.59.08.498 blue
N053.05.42.681 E017.59.08.498 N053.05.43.021 E017.59.07.614 blue
N053.05.43.021 E017.59.07.614 N053.05.48.637 E017.59.06.295 blue
N053.05.48.637 E017.59.06.295 N053.05.49.844 E017.59.07.712 blue
N053.05.49.462 E017.59.02.739 N053.05.48.706 E017.59.04.182 blue
N053.05.48.706 E017.59.04.182 N053.05.42.642 E017.59.05.561 blue
N053.05.42.642 E017.59.05.561 N053.05.42.464 E017.59.05.245 blue
N053.05.42.464 E017.59.05.245 N053.05.38.185 E017.58.14.798 blue
N053.05.38.185 E017.58.14.798 N053.05.38.333 E017.58.14.106 blue
N053.05.38.333 E017.58.14.106 N053.05.44.335 E017.58.12.815 blue
N053.05.44.335 E017.58.12.815 N053.05.45.350 E017.58.13.982 blue
N053.05.44.849 E017.58.08.380 N053.05.43.827 E017.58.10.781 blue
N053.05.43.827 E017.58.10.781 N053.05.38.189 E017.58.12.009 blue
N053.05.38.189 E017.58.12.009 N053.05.37.886 E017.58.11.717 blue
N053.05.37.886 E017.58.11.717 N053.05.37.513 E017.58.07.015 blue
N053.05.37.513 E017.58.07.015 N053.05.37.629 E017.58.06.875 blue
N053.05.37.629 E017.58.06.875 N053.05.37.442 E017.58.06.134 blue
N053.05.37.442 E017.58.06.134 N053.05.34.916 E017.57.37.618 blue
N053.05.34.916 E017.57.37.618 N053.05.35.472 E017.57.36.665 blue
N053.05.35.472 E017.57.36.665 N053.05.42.058 E017.57.35.342 blue
;- APRONY
N053.06.02.682 E017.57.45.527 N053.06.13.680 E017.57.21.501 white
N053.06.13.680 E017.57.21.501 N053.06.15.902 E017.57.24.481 white
N053.06.15.902 E017.57.24.481 N053.06.06.711 E017.57.43.953 white
N053.05.33.071 E017.58.08.469 N053.05.22.619 E017.58.05.567 white
N053.05.22.619 E017.58.05.567 N053.05.22.303 E017.58.10.593 white
N053.05.22.303 E017.58.10.593 N053.05.32.118 E017.58.13.001 white
N053.05.43.470 E017.59.37.335 N053.05.42.040 E017.59.37.705 white
N053.05.42.040 E017.59.37.705 N053.05.42.274 E017.59.39.556 white
N053.05.42.274 E017.59.39.556 N053.05.42.123 E017.59.41.273 white
N053.05.42.123 E017.59.41.273 N053.05.42.956 E017.59.42.489 white
N053.05.42.956 E017.59.42.489 N053.05.43.800 E017.59.41.811 white
N053.05.41.889 E017.59.46.158 N053.05.41.640 E017.59.44.264 white
N053.05.41.640 E017.59.44.264 N053.05.40.970 E017.59.43.848 white
N053.05.40.970 E017.59.43.848 N053.05.39.725 E017.59.44.185 white
N053.05.39.725 E017.59.44.185 N053.05.40.555 E017.59.52.404 white
N053.05.40.555 E017.59.52.404 N053.05.41.568 E017.59.52.159 white
N053.05.42.073 E017.59.51.772 N053.05.42.411 E017.59.51.225 white
N053.05.42.411 E017.59.51.225 N053.05.42.197 E017.59.49.045 white
N053.05.39.667 E017.59.54.976 N053.05.41.268 E017.59.54.652 white
N053.05.41.268 E017.59.54.652 N053.05.41.132 E017.59.53.306 white
N053.05.41.132 E017.59.53.306 N053.05.39.133 E017.59.53.747 white
N053.05.39.133 E017.59.53.747 N053.05.39.226 E017.59.54.764 white
N053.05.37.604 E017.59.57.861 N053.05.37.654 E017.59.59.256 white
N053.05.37.654 E017.59.59.256 N053.05.38.644 E017.59.59.124 white
N053.05.38.644 E017.59.59.124 N053.05.38.550 E017.59.57.699 white
N053.05.42.388 E018.00.00.579 N053.05.41.878 E018.00.00.715 white
N053.05.41.878 E018.00.00.715 N053.05.42.016 E018.00.02.177 white
N053.05.42.016 E018.00.02.177 N053.05.42.564 E018.00.02.107 white
;- PALIWO
N053.05.46.149 E017.59.48.559 N053.05.47.150 E017.59.48.341 yellow
N053.05.47.150 E017.59.48.341 N053.05.47.300 E017.59.50.031 yellow
N053.05.47.300 E017.59.50.031 N053.05.46.276 E017.59.50.213 yellow
N053.05.46.269 E017.59.50.211 N053.05.46.144 E017.59.48.544 yellow
;- BUILD
N053.05.39.385 E017.59.53.113 N053.05.40.631 E017.59.52.868 build
N053.05.40.631 E017.59.52.868 N053.05.40.709 E017.59.53.935 build
N053.05.40.709 E017.59.53.935 N053.05.40.267 E017.59.54.015 build
N053.05.40.267 E017.59.54.015 N053.05.40.303 E017.59.54.534 build
N053.05.40.303 E017.59.54.534 N053.05.39.956 E017.59.54.576 build
N053.05.39.956 E017.59.54.576 N053.05.39.920 E017.59.54.080 build
N053.05.39.920 E017.59.54.080 N053.05.39.431 E017.59.54.187 build
N053.05.39.431 E017.59.54.187 N053.05.39.385 E017.59.53.119 build
N053.05.41.689 E018.00.01.307 N053.05.41.958 E018.00.01.241 build
N053.05.41.958 E018.00.01.241 N053.05.42.031 E018.00.02.280 build
N053.05.42.031 E018.00.02.280 N053.05.41.732 E018.00.02.358 build
N053.05.41.732 E018.00.02.358 N053.05.41.688 E018.00.01.306 build
N053.05.43.122 E017.59.56.637 N053.05.43.390 E017.59.56.606 build
N053.05.43.390 E017.59.56.606 N053.05.43.451 E017.59.57.424 build
N053.05.43.451 E017.59.57.424 N053.05.43.182 E017.59.57.482 build
N053.05.43.182 E017.59.57.482 N053.05.43.121 E017.59.56.636 build
N053.05.42.938 E017.59.54.789 N053.05.43.271 E017.59.54.730 build
N053.05.43.271 E017.59.54.730 N053.05.43.309 E017.59.55.234 build
N053.05.43.309 E017.59.55.234 N053.05.42.976 E017.59.55.277 build
N053.05.42.976 E017.59.55.277 N053.05.42.939 E017.59.54.785 build
N053.06.14.165 E017.58.44.606 N053.06.14.536 E017.58.44.502 build
N053.06.14.536 E017.58.44.502 N053.06.14.470 E017.58.43.923 build
N053.06.14.470 E017.58.43.923 N053.06.14.099 E017.58.44.043 build
N053.06.14.099 E017.58.44.043 N053.06.14.166 E017.58.44.619 build




;EPGD
;- RWY
N054.22.17.139 E018.29.32.019 N054.22.17.139 E018.29.32.019 yellow
N054.22.17.139 E018.29.32.019 N054.22.17.139 E018.29.32.019 yellow
N054.22.17.139 E018.29.32.019 N054.22.17.139 E018.29.32.019 yellow
N054.22.17.139 E018.29.32.019 N054.22.17.259 E018.29.31.547 yellow
N054.22.17.259 E018.29.31.547 N054.22.17.259 E018.29.31.547 yellow
N054.22.17.259 E018.29.31.547 N054.22.17.259 E018.29.31.547 yellow
N054.22.17.259 E018.29.31.547 N054.22.17.259 E018.29.31.547 yellow
N054.22.17.259 E018.29.31.547 N054.22.17.259 E018.29.31.547 yellow
N054.22.17.259 E018.29.31.547 N054.22.17.259 E018.29.31.547 yellow
N054.22.17.259 E018.29.31.547 N054.22.17.430 E018.29.31.186 yellow
N054.22.17.430 E018.29.31.186 N054.22.17.577 E018.29.31.064 yellow
N054.22.17.577 E018.29.31.064 N054.22.17.577 E018.29.31.064 yellow
N054.22.17.577 E018.29.31.064 N054.22.17.662 E018.29.31.018 yellow
N054.22.17.662 E018.29.31.018 N054.22.17.708 E018.29.31.013 yellow
N054.22.17.708 E018.29.31.013 N054.22.17.774 E018.29.31.055 yellow
N054.22.17.774 E018.29.31.055 N054.22.17.841 E018.29.31.107 yellow
N054.22.17.841 E018.29.31.107 N054.22.17.916 E018.29.31.236 yellow
N054.22.17.916 E018.29.31.236 N054.22.18.748 E018.29.32.899 yellow
N054.22.18.748 E018.29.32.899 N054.22.18.881 E018.29.32.521 yellow
N054.22.18.881 E018.29.32.521 N054.22.19.409 E018.29.31.089 yellow
N054.22.19.409 E018.29.31.089 N054.22.18.981 E018.29.30.337 yellow
N054.22.18.981 E018.29.30.337 N054.22.18.981 E018.29.30.337 yellow
N054.22.18.981 E018.29.30.337 N054.22.18.899 E018.29.30.058 yellow
N054.22.18.899 E018.29.30.058 N054.22.18.786 E018.29.29.800 yellow
N054.22.18.786 E018.29.29.800 N054.22.18.767 E018.29.29.502 yellow
N054.22.18.767 E018.29.29.502 N054.22.18.718 E018.29.28.587 yellow
N054.22.18.718 E018.29.28.587 N054.22.18.718 E018.29.28.587 yellow
N054.22.18.718 E018.29.28.587 N054.22.18.840 E018.29.25.299 yellow
N054.22.18.840 E018.29.25.299 N054.22.32.502 E018.28.30.095 yellow
N054.22.32.502 E018.28.30.095 N054.22.32.547 E018.28.30.059 yellow
N054.22.32.547 E018.28.30.059 N054.22.32.613 E018.28.30.051 yellow
N054.22.32.613 E018.28.30.051 N054.22.32.692 E018.28.30.132 yellow
N054.22.32.692 E018.28.30.132 N054.22.32.689 E018.28.30.190 yellow
N054.22.32.689 E018.28.30.190 N054.22.32.735 E018.28.30.288 yellow
N054.22.32.735 E018.28.30.288 N054.22.32.990 E018.28.33.918 yellow
N054.22.32.990 E018.28.33.918 N054.22.34.096 E018.28.33.720 yellow
N054.22.34.096 E018.28.33.720 N054.22.33.997 E018.28.28.660 yellow
N054.22.33.997 E018.28.28.660 N054.22.34.082 E018.28.26.109 yellow
N054.22.34.082 E018.28.26.109 N054.22.34.189 E018.28.25.227 yellow
N054.22.34.189 E018.28.25.227 N054.22.34.249 E018.28.24.523 yellow
N054.22.34.249 E018.28.24.523 N054.22.34.339 E018.28.23.482 yellow
N054.22.34.339 E018.28.23.482 N054.22.34.402 E018.28.22.993 yellow
N054.22.34.402 E018.28.22.993 N054.22.34.628 E018.28.21.383 yellow
N054.22.34.628 E018.28.21.383 N054.22.36.675 E018.28.13.109 yellow
N054.22.36.675 E018.28.13.109 N054.22.38.670 E018.28.05.045 yellow
N054.22.38.670 E018.28.05.045 N054.22.42.091 E018.27.51.340 yellow
N054.22.42.091 E018.27.51.340 N054.22.45.387 E018.27.37.893 yellow
N054.22.45.387 E018.27.37.893 N054.22.45.387 E018.27.37.893 yellow
N054.22.45.387 E018.27.37.893 N054.22.46.093 E018.27.35.970 yellow
N054.22.46.093 E018.27.35.970 N054.22.47.519 E018.27.32.542 yellow
N054.22.47.519 E018.27.32.542 N054.22.48.221 E018.27.31.281 yellow
N054.22.48.221 E018.27.31.281 N054.22.48.945 E018.27.30.090 yellow
N054.22.48.945 E018.27.30.090 N054.22.50.238 E018.27.28.188 yellow
N054.22.50.238 E018.27.28.188 N054.22.49.555 E018.27.26.782 yellow
N054.22.49.555 E018.27.26.782 N054.22.47.854 E018.27.28.927 yellow
N054.22.47.854 E018.27.28.927 N054.22.47.796 E018.27.28.937 yellow
N054.22.47.796 E018.27.28.937 N054.22.47.763 E018.27.28.902 yellow
N054.22.47.763 E018.27.28.902 N054.22.47.727 E018.27.28.877 yellow
N054.22.47.727 E018.27.28.877 N054.22.47.676 E018.27.28.819 yellow
N054.22.47.676 E018.27.28.819 N054.22.47.699 E018.27.28.751 yellow
N054.22.47.699 E018.27.28.751 N054.22.47.719 E018.27.28.460 yellow
N054.22.47.719 E018.27.28.460 N054.22.51.658 E018.27.12.589 yellow
N054.22.51.658 E018.27.12.589 N054.22.53.272 E018.27.09.766 yellow
N054.22.53.272 E018.27.09.766 N054.22.53.380 E018.27.09.534 yellow
N054.22.53.380 E018.27.09.534 N054.22.53.536 E018.27.09.383 yellow
N054.22.53.536 E018.27.09.383 N054.22.53.709 E018.27.09.282 yellow
N054.22.53.709 E018.27.09.282 N054.22.53.709 E018.27.09.282 yellow
N054.22.53.709 E018.27.09.282 N054.22.54.731 E018.27.09.180 yellow
N054.22.54.731 E018.27.09.180 N054.22.54.788 E018.27.07.101 yellow
N054.22.54.788 E018.27.07.101 N054.22.53.520 E018.27.07.270 yellow
N054.22.53.520 E018.27.07.270 N054.22.53.301 E018.27.07.066 yellow
N054.22.53.301 E018.27.07.066 N054.22.53.166 E018.27.06.583 yellow
N054.22.53.166 E018.27.06.583 N054.22.53.359 E018.27.05.775 yellow
N054.22.53.359 E018.27.05.775 N054.22.51.621 E018.27.04.524 yellow
N054.22.51.621 E018.27.04.524 N054.22.15.450 E018.29.30.806 yellow
N054.22.15.450 E018.29.30.806 N054.22.17.178 E018.29.32.019 yellow
;- TWY1
N054.22.18.881 E018.29.32.511 N054.22.18.881 E018.29.32.511 olive
N054.22.18.881 E018.29.32.511 N054.22.19.611 E018.29.32.641 olive
N054.22.19.611 E018.29.32.641 N054.22.22.555 E018.29.34.836 olive
N054.22.22.555 E018.29.34.836 N054.22.22.703 E018.29.35.018 olive
N054.22.22.703 E018.29.35.018 N054.22.22.860 E018.29.35.273 olive
N054.22.22.860 E018.29.35.273 N054.22.22.970 E018.29.35.548 olive
N054.22.22.970 E018.29.35.548 N054.22.23.081 E018.29.35.881 olive
N054.22.23.081 E018.29.35.881 N054.22.23.110 E018.29.36.342 olive
N054.22.23.110 E018.29.36.342 N054.22.23.060 E018.29.36.641 olive
N054.22.23.060 E018.29.36.641 N054.22.23.002 E018.29.36.967 olive
N054.22.23.002 E018.29.36.967 N054.22.23.002 E018.29.36.967 olive
N054.22.23.002 E018.29.36.967 N054.22.22.875 E018.29.37.558 olive
N054.22.22.875 E018.29.37.558 N054.22.22.302 E018.29.37.157 olive
N054.22.22.302 E018.29.37.157 N054.22.19.933 E018.29.46.505 olive
N054.22.19.933 E018.29.46.505 N054.22.21.489 E018.29.47.652 olive
N054.22.21.489 E018.29.47.652 N054.22.23.848 E018.29.38.291 olive
N054.22.23.848 E018.29.38.291 N054.22.23.209 E018.29.37.817 olive
N054.22.23.209 E018.29.37.817 N054.22.23.389 E018.29.37.019 olive
N054.22.23.389 E018.29.37.019 N054.22.23.526 E018.29.36.768 olive
N054.22.23.526 E018.29.36.768 N054.22.23.663 E018.29.36.555 olive
N054.22.23.663 E018.29.36.555 N054.22.23.855 E018.29.36.365 olive
N054.22.23.855 E018.29.36.365 N054.22.24.079 E018.29.36.257 olive
N054.22.24.079 E018.29.36.257 N054.22.24.307 E018.29.36.224 olive
N054.22.24.307 E018.29.36.224 N054.22.24.495 E018.29.36.279 olive
N054.22.24.495 E018.29.36.279 N054.22.24.623 E018.29.36.405 olive
N054.22.24.623 E018.29.36.405 N054.22.24.846 E018.29.36.665 olive
N054.22.24.846 E018.29.36.665 N054.22.25.017 E018.29.36.957 olive
N054.22.25.017 E018.29.36.957 N054.22.25.082 E018.29.37.276 olive
N054.22.25.082 E018.29.37.276 N054.22.25.074 E018.29.37.582 olive
N054.22.25.074 E018.29.37.582 N054.22.25.052 E018.29.38.108 olive
N054.22.25.052 E018.29.38.108 N054.22.24.260 E018.29.41.135 olive
N054.22.24.260 E018.29.41.135 N054.22.24.228 E018.29.43.301 olive
N054.22.24.228 E018.29.43.301 N054.22.24.525 E018.29.43.382 olive
N054.22.24.525 E018.29.43.382 N054.22.24.615 E018.29.41.337 olive
N054.22.24.615 E018.29.41.337 N054.22.25.037 E018.29.39.668 olive
N054.22.25.037 E018.29.39.668 N054.22.25.226 E018.29.39.393 olive
N054.22.25.226 E018.29.39.393 N054.22.25.393 E018.29.39.304 olive
N054.22.25.393 E018.29.39.304 N054.22.25.518 E018.29.39.332 olive
N054.22.25.518 E018.29.39.332 N054.22.26.119 E018.29.39.753 olive
N054.22.26.119 E018.29.39.753 N054.22.26.944 E018.29.36.374 olive
N054.22.26.944 E018.29.36.374 N054.22.25.817 E018.29.35.564 olive
N054.22.25.817 E018.29.35.564 N054.22.25.778 E018.29.35.729 olive
N054.22.25.778 E018.29.35.729 N054.22.25.653 E018.29.35.944 olive
N054.22.25.653 E018.29.35.944 N054.22.25.653 E018.29.35.944 olive
N054.22.25.653 E018.29.35.944 N054.22.25.502 E018.29.36.126 olive
N054.22.25.502 E018.29.36.126 N054.22.25.262 E018.29.36.161 olive
N054.22.25.262 E018.29.36.161 N054.22.25.100 E018.29.36.065 olive
N054.22.25.100 E018.29.36.065 N054.22.24.549 E018.29.35.688 olive
N054.22.24.549 E018.29.35.688 N054.22.19.775 E018.29.32.080 olive
N054.22.19.775 E018.29.32.080 N054.22.19.314 E018.29.31.386 olive
;- TWY2
N054.22.23.211 E018.29.07.636 N054.22.23.211 E018.29.07.636 olive
N054.22.23.211 E018.29.07.636 N054.22.27.492 E018.29.10.842 olive
N054.22.27.492 E018.29.10.842 N054.22.27.554 E018.29.10.719 olive
N054.22.27.554 E018.29.10.719 N054.22.28.982 E018.29.11.812 olive
N054.22.28.982 E018.29.11.812 N054.22.27.017 E018.29.19.556 olive
N054.22.27.017 E018.29.19.556 N054.22.25.574 E018.29.18.465 olive
N054.22.25.574 E018.29.18.465 N054.22.27.133 E018.29.12.313 olive
N054.22.27.133 E018.29.12.313 N054.22.26.712 E018.29.11.020 olive
N054.22.26.712 E018.29.11.020 N054.22.23.029 E018.29.08.246 olive
;- APRON1
N054.22.36.709 E018.28.13.099 N054.22.36.709 E018.28.13.099 olive
N054.22.36.709 E018.28.13.099 N054.22.39.718 E018.28.06.788 olive
N054.22.39.718 E018.28.06.788 N054.22.40.709 E018.28.05.367 olive
N054.22.40.709 E018.28.05.367 N054.22.41.252 E018.28.09.688 olive
N054.22.41.252 E018.28.09.688 N054.22.41.741 E018.28.10.784 olive
N054.22.41.741 E018.28.10.784 N054.22.42.029 E018.28.11.194 olive
N054.22.42.029 E018.28.11.194 N054.22.42.373 E018.28.11.571 olive
N054.22.42.373 E018.28.11.571 N054.22.42.950 E018.28.12.094 olive
N054.22.42.950 E018.28.12.094 N054.22.43.190 E018.28.12.358 olive
N054.22.43.190 E018.28.12.358 N054.22.43.394 E018.28.12.842 olive
N054.22.43.394 E018.28.12.842 N054.22.43.488 E018.28.13.519 olive
N054.22.43.488 E018.28.13.519 N054.22.43.434 E018.28.13.878 olive
N054.22.43.434 E018.28.13.878 N054.22.40.570 E018.28.25.518 olive
N054.22.40.570 E018.28.25.518 N054.22.41.620 E018.28.26.286 olive
N054.22.41.620 E018.28.26.286 N054.22.41.570 E018.28.26.638 olive
N054.22.41.570 E018.28.26.638 N054.22.43.004 E018.28.27.671 olive
N054.22.43.004 E018.28.27.671 N054.22.43.122 E018.28.27.819 olive
N054.22.43.122 E018.28.27.819 N054.22.43.143 E018.28.27.980 olive
N054.22.43.143 E018.28.27.980 N054.22.43.186 E018.28.28.222 olive
N054.22.43.186 E018.28.28.222 N054.22.43.197 E018.28.28.457 olive
N054.22.43.197 E018.28.28.457 N054.22.44.605 E018.28.29.490 olive
N054.22.44.605 E018.28.29.490 N054.22.44.737 E018.28.29.269 olive
N054.22.44.737 E018.28.29.269 N054.22.44.863 E018.28.29.218 olive
N054.22.44.863 E018.28.29.218 N054.22.44.993 E018.28.29.195 olive
N054.22.44.993 E018.28.29.195 N054.22.46.428 E018.28.30.206 olive
N054.22.46.428 E018.28.30.206 N054.22.46.924 E018.28.30.966 olive
N054.22.46.924 E018.28.30.966 N054.22.47.015 E018.28.30.593 olive
N054.22.47.015 E018.28.30.593 N054.22.46.530 E018.28.29.929 olive
N054.22.46.530 E018.28.29.929 N054.22.46.983 E018.28.28.171 olive
N054.22.46.983 E018.28.28.171 N054.22.47.248 E018.28.28.044 olive
N054.22.47.248 E018.28.28.044 N054.22.47.387 E018.28.28.189 olive
N054.22.47.387 E018.28.28.189 N054.22.47.819 E018.28.27.467 olive
N054.22.47.819 E018.28.27.467 N054.22.47.628 E018.28.27.733 olive
N054.22.47.628 E018.28.27.733 N054.22.47.334 E018.28.27.629 olive
N054.22.47.334 E018.28.27.629 N054.22.47.245 E018.28.27.309 olive
N054.22.47.245 E018.28.27.309 N054.22.49.126 E018.28.19.678 olive
N054.22.49.126 E018.28.19.678 N054.22.49.718 E018.28.20.493 olive
N054.22.49.718 E018.28.20.493 N054.22.49.786 E018.28.20.090 olive
N054.22.49.786 E018.28.20.090 N054.22.50.512 E018.28.18.599 olive
N054.22.50.512 E018.28.18.599 N054.22.50.730 E018.28.18.338 olive
N054.22.50.730 E018.28.18.338 N054.22.51.324 E018.28.16.157 olive
N054.22.51.324 E018.28.16.157 N054.22.49.520 E018.28.09.903 olive
N054.22.49.520 E018.28.09.903 N054.22.51.311 E018.28.02.944 olive
N054.22.51.311 E018.28.02.944 N054.22.51.983 E018.28.03.454 olive
N054.22.51.983 E018.28.03.454 N054.22.51.752 E018.28.00.295 olive
N054.22.51.752 E018.28.00.295 N054.22.52.530 E018.27.57.037 olive
N054.22.52.530 E018.27.57.037 N054.22.52.494 E018.27.56.906 olive
N054.22.52.494 E018.27.56.906 N054.22.52.431 E018.27.56.800 olive
N054.22.52.431 E018.27.56.800 N054.22.48.377 E018.27.54.181 olive
N054.22.48.377 E018.27.54.181 N054.22.46.954 E018.27.59.791 olive
N054.22.46.954 E018.27.59.791 N054.22.46.082 E018.27.59.711 olive
N054.22.46.082 E018.27.59.711 N054.22.44.877 E018.27.59.143 olive
N054.22.44.877 E018.27.59.143 N054.22.44.301 E018.27.59.102 olive
N054.22.44.301 E018.27.59.102 N054.22.41.630 E018.28.01.615 olive
N054.22.41.630 E018.28.01.615 N054.22.41.570 E018.27.59.123 olive
N054.22.41.570 E018.27.59.123 N054.22.42.088 E018.27.51.341 olive
;- APRON2
N054.22.40.298 E018.27.59.361 N054.22.40.522 E018.28.03.076 olive
N054.22.40.522 E018.28.03.076 N054.22.38.796 E018.28.05.309 olive
N054.22.38.796 E018.28.05.309 N054.22.38.667 E018.28.05.032 olive
;- APRON3
N054.22.41.808 E018.28.04.007 N054.22.43.783 E018.28.01.489 olive
N054.22.43.783 E018.28.01.489 N054.22.44.667 E018.28.01.128 olive
N054.22.44.667 E018.28.01.128 N054.22.45.700 E018.28.02.315 olive
N054.22.45.700 E018.28.02.315 N054.22.45.840 E018.28.03.805 olive
N054.22.45.840 E018.28.03.805 N054.22.45.783 E018.28.04.437 olive
N054.22.45.783 E018.28.04.437 N054.22.44.706 E018.28.08.586 olive
N054.22.44.706 E018.28.08.586 N054.22.44.541 E018.28.09.089 olive
N054.22.44.750 E018.28.08.556 N054.22.44.750 E018.28.08.556 olive
N054.22.44.750 E018.28.08.556 N054.22.44.750 E018.28.08.556 olive
N054.22.44.750 E018.28.08.556 N054.22.44.522 E018.28.09.172 olive
N054.22.44.522 E018.28.09.172 N054.22.44.082 E018.28.09.748 olive
N054.22.44.082 E018.28.09.748 N054.22.43.015 E018.28.09.831 olive
N054.22.43.015 E018.28.09.831 N054.22.42.698 E018.28.09.589 olive
N054.22.42.698 E018.28.09.589 N054.22.42.332 E018.28.08.986 olive
N054.22.42.332 E018.28.08.986 N054.22.42.186 E018.28.08.344 olive
N054.22.42.186 E018.28.08.344 N054.22.41.806 E018.28.04.011 olive
;- terminal
N054.22.51.380 E018.28.02.961 N054.22.51.380 E018.28.02.961 blue
N054.22.51.380 E018.28.02.961 N054.22.51.380 E018.28.02.961 blue
N054.22.51.380 E018.28.02.961 N054.22.51.485 E018.28.03.031 blue
N054.22.51.485 E018.28.03.031 N054.22.52.092 E018.28.03.512 blue
N054.22.52.092 E018.28.03.512 N054.22.52.068 E018.28.03.441 blue
N054.22.52.068 E018.28.03.441 N054.22.52.036 E018.28.03.436 blue
N054.22.51.950 E018.28.03.640 N054.22.52.203 E018.28.03.807 blue
N054.22.52.203 E018.28.03.807 N054.22.52.082 E018.28.04.154 blue
N054.22.52.082 E018.28.04.154 N054.22.52.407 E018.28.04.395 blue
N054.22.52.407 E018.28.04.395 N054.22.52.074 E018.28.06.473 blue
N054.22.52.074 E018.28.06.473 N054.22.51.974 E018.28.07.006 blue
N054.22.51.974 E018.28.07.006 N054.22.51.868 E018.28.07.484 blue
N054.22.51.868 E018.28.07.484 N054.22.51.241 E018.28.09.231 blue
N054.22.51.241 E018.28.09.231 N054.22.50.993 E018.28.09.863 blue
N054.22.50.993 E018.28.09.863 N054.22.50.899 E018.28.10.323 blue
N054.22.50.899 E018.28.10.323 N054.22.50.246 E018.28.10.210 blue
N054.22.50.246 E018.28.10.210 N054.22.50.168 E018.28.10.528 blue
N054.22.50.168 E018.28.10.528 N054.22.49.518 E018.28.10.014 blue
N054.22.49.518 E018.28.10.014 N054.22.49.906 E018.28.08.573 blue
N054.22.49.906 E018.28.08.573 N054.22.50.141 E018.28.08.766 blue
N054.22.50.141 E018.28.08.766 N054.22.50.526 E018.28.07.248 blue
N054.22.50.526 E018.28.07.248 N054.22.50.285 E018.28.07.049 blue
N054.22.50.285 E018.28.07.049 N054.22.50.536 E018.28.05.962 blue
N054.22.50.536 E018.28.05.962 N054.22.50.985 E018.28.04.509 blue
N054.22.50.985 E018.28.04.509 N054.22.51.380 E018.28.02.950 blue
N054.22.52.056 E018.28.17.153 N054.22.52.423 E018.28.16.752 blue
N054.22.52.423 E018.28.16.752 N054.22.52.835 E018.28.16.998 blue
N054.22.52.835 E018.28.16.998 N054.22.53.033 E018.28.20.108 blue
N054.22.53.033 E018.28.20.108 N054.22.49.742 E018.28.25.796 blue
N054.22.49.742 E018.28.25.796 N054.22.49.299 E018.28.24.927 blue
N054.22.49.299 E018.28.24.927 N054.22.50.504 E018.28.21.712 blue
N054.22.50.504 E018.28.21.712 N054.22.52.232 E018.28.19.490 blue
N054.22.52.232 E018.28.19.490 N054.22.52.048 E018.28.17.142 blue
N054.22.49.477 E018.28.26.910 N054.22.48.858 E018.28.26.455 blue
N054.22.48.858 E018.28.26.455 N054.22.48.555 E018.28.27.513 blue
N054.22.48.555 E018.28.27.513 N054.22.48.986 E018.28.27.801 blue
N054.22.48.986 E018.28.27.801 N054.22.48.881 E018.28.28.082 blue
N054.22.48.881 E018.28.28.082 N054.22.48.725 E018.28.27.960 blue
N054.22.48.725 E018.28.27.960 N054.22.48.646 E018.28.28.122 blue
N054.22.48.646 E018.28.28.122 N054.22.48.777 E018.28.28.484 blue
N054.22.48.777 E018.28.28.484 N054.22.48.428 E018.28.30.818 blue
N054.22.48.428 E018.28.30.818 N054.22.49.217 E018.28.27.974 blue
N054.22.48.925 E018.28.33.655 N054.22.47.339 E018.28.37.131 blue
N054.22.47.339 E018.28.37.131 N054.22.47.154 E018.28.34.274 blue
N054.22.47.154 E018.28.34.274 N054.22.48.461 E018.28.32.619 blue
N054.22.49.477 E018.28.26.910 N054.22.48.858 E018.28.26.455 blue
N054.22.48.858 E018.28.26.455 N054.22.48.555 E018.28.27.513 blue
N054.22.48.555 E018.28.27.513 N054.22.48.986 E018.28.27.801 blue
N054.22.48.986 E018.28.27.801 N054.22.48.881 E018.28.28.082 blue
N054.22.48.881 E018.28.28.082 N054.22.48.725 E018.28.27.960 blue
N054.22.48.725 E018.28.27.960 N054.22.48.646 E018.28.28.122 blue
N054.22.48.646 E018.28.28.122 N054.22.48.777 E018.28.28.484 blue
N054.22.48.777 E018.28.28.484 N054.22.48.428 E018.28.30.818 blue
N054.22.48.428 E018.28.30.818 N054.22.49.217 E018.28.27.974 blue
N054.22.44.387 E018.28.30.736 N054.22.44.387 E018.28.30.736 blue
N054.22.44.387 E018.28.30.736 N054.22.42.769 E018.28.29.553 blue
N054.22.42.769 E018.28.29.553 N054.22.42.017 E018.28.32.435 blue
N054.22.42.017 E018.28.32.435 N054.22.43.632 E018.28.33.611 blue
N054.22.43.632 E018.28.33.611 N054.22.44.388 E018.28.30.729 blue
N054.22.26.367 E018.29.33.413 N054.22.26.367 E018.29.33.413 blue
N054.22.26.367 E018.29.33.413 N054.22.25.834 E018.29.35.678 blue
N054.22.25.834 E018.29.35.678 N054.22.26.918 E018.29.36.485 blue
N054.22.26.918 E018.29.36.485 N054.22.27.514 E018.29.34.240 blue
N054.22.27.514 E018.29.34.240 N054.22.26.362 E018.29.33.423 blue
;- TWY LINE1
N054.22.34.484 E018.28.18.010 N054.22.35.130 E018.28.15.374 yellow
N054.22.35.130 E018.28.15.374 N054.22.35.791 E018.28.13.122 yellow
N054.22.35.791 E018.28.13.122 N054.22.36.502 E018.28.11.197 yellow
N054.22.36.502 E018.28.11.197 N054.22.36.974 E018.28.10.173 yellow
N054.22.36.974 E018.28.10.173 N054.22.37.997 E018.28.08.112 yellow
N054.22.37.997 E018.28.08.112 N054.22.38.590 E018.28.07.136 yellow
N054.22.38.590 E018.28.07.136 N054.22.38.590 E018.28.07.136 yellow
N054.22.38.590 E018.28.07.136 N054.22.39.412 E018.28.05.896 yellow
N054.22.39.412 E018.28.05.896 N054.22.43.479 E018.28.00.578 yellow
N054.22.43.479 E018.28.00.578 N054.22.43.650 E018.28.00.397 yellow
N054.22.43.650 E018.28.00.397 N054.22.44.068 E018.28.00.147 yellow
N054.22.44.068 E018.28.00.147 N054.22.44.657 E018.28.00.060 yellow
N054.22.44.657 E018.28.00.060 N054.22.45.008 E018.28.00.170 yellow
N054.22.45.008 E018.28.00.170 N054.22.45.938 E018.28.00.912 yellow
N054.22.45.981 E018.28.00.902 N054.22.45.981 E018.28.00.902 yellow
N054.22.45.981 E018.28.00.902 N054.22.46.365 E018.28.01.413 yellow
N054.22.46.365 E018.28.01.413 N054.22.46.568 E018.28.01.882 yellow
N054.22.46.568 E018.28.01.882 N054.22.46.671 E018.28.02.497 yellow
N054.22.46.671 E018.28.02.497 N054.22.46.714 E018.28.03.110 yellow
N054.22.46.714 E018.28.03.110 N054.22.46.672 E018.28.03.801 yellow
N054.22.46.672 E018.28.03.801 N054.22.46.626 E018.28.04.186 yellow
N054.22.46.626 E018.28.04.186 N054.22.47.810 E018.27.59.379 yellow
N054.22.47.810 E018.27.59.379 N054.22.46.988 E018.28.00.813 yellow
N054.22.46.988 E018.28.00.813 N054.22.46.649 E018.28.00.976 yellow
N054.22.46.649 E018.28.00.976 N054.22.46.291 E018.28.01.004 yellow
N054.22.46.291 E018.28.01.004 N054.22.45.897 E018.28.00.860 yellow
;- TWY LINE2
N054.22.43.055 E018.27.43.219 N054.22.42.091 E018.27.47.262 yellow
N054.22.42.091 E018.27.47.262 N054.22.41.392 E018.27.50.897 yellow
N054.22.41.392 E018.27.50.897 N054.22.41.179 E018.27.52.978 yellow
N054.22.41.179 E018.27.52.978 N054.22.41.024 E018.27.54.997 yellow
N054.22.41.024 E018.27.54.997 N054.22.40.940 E018.28.00.052 yellow
N054.22.40.940 E018.28.00.052 N054.22.41.275 E018.28.04.532 yellow
N054.22.41.275 E018.28.04.532 N054.22.41.575 E018.28.08.503 yellow
N054.22.41.575 E018.28.08.503 N054.22.41.793 E018.28.09.498 yellow
N054.22.41.793 E018.28.09.498 N054.22.42.166 E018.28.10.243 yellow
N054.22.42.166 E018.28.10.243 N054.22.42.528 E018.28.10.595 yellow
N054.22.42.528 E018.28.10.595 N054.22.43.043 E018.28.10.979 yellow
N054.22.43.043 E018.28.10.979 N054.22.43.486 E018.28.11.243 yellow
N054.22.43.486 E018.28.11.243 N054.22.43.775 E018.28.11.308 yellow
N054.22.43.775 E018.28.11.308 N054.22.44.464 E018.28.11.050 yellow
N054.22.44.464 E018.28.11.050 N054.22.44.695 E018.28.10.755 yellow
N054.22.44.695 E018.28.10.755 N054.22.44.962 E018.28.10.288 yellow
N054.22.44.962 E018.28.10.288 N054.22.45.225 E018.28.09.578 yellow
N054.22.45.225 E018.28.09.578 N054.22.46.646 E018.28.03.936 yellow
;- TWY LINE3
N054.22.47.825 E018.27.59.445 N054.22.48.715 E018.27.55.832 yellow
N054.22.48.715 E018.27.55.832 N054.22.48.936 E018.27.55.840 yellow
N054.22.48.936 E018.27.55.840 N054.22.49.093 E018.27.55.913 yellow
N054.22.49.093 E018.27.55.913 N054.22.49.206 E018.27.56.046 yellow
N054.22.49.206 E018.27.56.046 N054.22.49.364 E018.27.56.297 yellow
N054.22.49.364 E018.27.56.297 N054.22.49.483 E018.27.56.525 yellow
N054.22.49.483 E018.27.56.525 N054.22.49.543 E018.27.56.821 yellow
N054.22.49.543 E018.27.56.821 N054.22.49.523 E018.27.56.878 yellow
N054.22.49.523 E018.27.56.878 N054.22.51.251 E018.27.58.172 yellow
;- TWY LINE4
N054.22.48.134 E018.27.58.106 N054.22.48.380 E018.27.58.125 yellow
N054.22.48.380 E018.27.58.125 N054.22.48.497 E018.27.58.199 yellow
N054.22.48.497 E018.27.58.199 N054.22.48.676 E018.27.58.338 yellow
N054.22.48.676 E018.27.58.338 N054.22.48.776 E018.27.58.554 yellow
N054.22.48.776 E018.27.58.554 N054.22.48.881 E018.27.58.875 yellow
N054.22.48.881 E018.27.58.875 N054.22.48.941 E018.27.59.175 yellow
N054.22.48.941 E018.27.59.175 N054.22.50.686 E018.28.00.463 yellow
;- TWY LINE5
N054.22.47.558 E018.28.00.404 N054.22.47.778 E018.28.00.400 yellow
N054.22.47.778 E018.28.00.400 N054.22.48.000 E018.28.00.531 yellow
N054.22.48.000 E018.28.00.531 N054.22.48.179 E018.28.00.719 yellow
N054.22.48.179 E018.28.00.719 N054.22.48.307 E018.28.01.000 yellow
N054.22.48.307 E018.28.01.000 N054.22.48.334 E018.28.01.264 yellow
N054.22.48.334 E018.28.01.264 N054.22.48.363 E018.28.01.425 yellow
N054.22.48.363 E018.28.01.425 N054.22.48.359 E018.28.01.421 yellow
N054.22.48.359 E018.28.01.421 N054.22.50.133 E018.28.02.746 yellow
;- TWY LINE6
N054.22.49.570 E018.28.04.996 N054.22.49.570 E018.28.04.996 yellow
N054.22.49.570 E018.28.04.996 N054.22.47.783 E018.28.03.691 yellow
;- TWY LINE7
N054.22.47.241 E018.28.06.020 N054.22.47.241 E018.28.06.020 yellow
N054.22.47.241 E018.28.06.020 N054.22.48.943 E018.28.07.297 yellow
;- TWY LINE8
N054.22.48.412 E018.28.09.525 N054.22.46.667 E018.28.08.246 yellow
;- TWY LINE9
N054.22.43.428 E018.28.11.254 N054.22.46.627 E018.28.13.724 yellow
N054.22.46.627 E018.28.13.724 N054.22.46.737 E018.28.13.978 yellow
N054.22.46.737 E018.28.13.978 N054.22.46.879 E018.28.14.202 yellow
N054.22.46.879 E018.28.14.202 N054.22.47.012 E018.28.14.613 yellow
N054.22.47.012 E018.28.14.613 N054.22.47.042 E018.28.14.753 yellow
N054.22.47.042 E018.28.14.753 N054.22.47.092 E018.28.15.342 yellow
N054.22.47.092 E018.28.15.342 N054.22.47.100 E018.28.15.838 yellow
N054.22.47.100 E018.28.15.838 N054.22.47.088 E018.28.16.242 yellow
N054.22.47.088 E018.28.16.242 N054.22.46.967 E018.28.16.673 yellow
N054.22.46.967 E018.28.16.673 N054.22.46.682 E018.28.17.774 yellow
N054.22.46.682 E018.28.17.774 N054.22.46.682 E018.28.17.774 yellow
N054.22.46.682 E018.28.17.774 N054.22.43.579 E018.28.30.152 yellow
;- BB
N054.22.18.256 E018.29.23.498 N054.22.17.627 E018.29.25.825 yellow
N054.22.17.627 E018.29.25.825 N054.22.16.478 E018.29.28.199 yellow
N054.22.16.478 E018.29.28.199 N054.22.16.470 E018.29.28.364 yellow
N054.22.16.470 E018.29.28.364 N054.22.16.470 E018.29.28.364 yellow
N054.22.16.470 E018.29.28.364 N054.22.16.394 E018.29.28.666 yellow
N054.22.16.394 E018.29.28.666 N054.22.16.478 E018.29.29.009 yellow
N054.22.16.478 E018.29.29.009 N054.22.16.633 E018.29.29.335 yellow
N054.22.16.633 E018.29.29.335 N054.22.16.794 E018.29.29.581 yellow
N054.22.16.794 E018.29.29.581 N054.22.16.980 E018.29.29.759 yellow
N054.22.16.980 E018.29.29.759 N054.22.17.169 E018.29.29.879 yellow
N054.22.17.169 E018.29.29.879 N054.22.17.413 E018.29.29.889 yellow
N054.22.17.629 E018.29.29.829 N054.22.17.781 E018.29.29.691 yellow
N054.22.17.781 E018.29.29.691 N054.22.17.996 E018.29.29.497 yellow
N054.22.17.996 E018.29.29.497 N054.22.17.996 E018.29.29.497 yellow
N054.22.17.996 E018.29.29.497 N054.22.18.107 E018.29.29.224 yellow
N054.22.18.107 E018.29.29.224 N054.22.18.257 E018.29.28.860 yellow
N054.22.18.257 E018.29.28.860 N054.22.18.272 E018.29.28.513 yellow
N054.22.18.272 E018.29.28.513 N054.22.18.319 E018.29.28.175 yellow
N054.22.18.319 E018.29.28.175 N054.22.18.290 E018.29.27.799 yellow
N054.22.18.290 E018.29.27.799 N054.22.18.175 E018.29.27.452 yellow
N054.22.18.175 E018.29.27.452 N054.22.18.084 E018.29.27.136 yellow
N054.22.18.084 E018.29.27.136 N054.22.17.976 E018.29.26.971 yellow
;- VB
N054.22.17.948 E018.29.26.849 N054.22.17.950 E018.29.26.597 yellow
N054.22.17.984 E018.29.26.380 N054.22.17.986 E018.29.26.135 yellow
N054.22.17.987 E018.29.25.964 N054.22.17.989 E018.29.25.748 yellow
N054.22.18.228 E018.29.23.515 N054.22.17.859 E018.29.25.338 yellow
N054.22.17.859 E018.29.25.338 N054.22.17.731 E018.29.26.073 yellow
N054.22.17.731 E018.29.26.073 N054.22.17.665 E018.29.26.875 yellow
N054.22.17.665 E018.29.26.875 N054.22.17.660 E018.29.27.541 yellow
N054.22.17.660 E018.29.27.541 N054.22.17.660 E018.29.27.541 yellow
N054.22.17.660 E018.29.27.541 N054.22.17.689 E018.29.28.310 yellow
N054.22.17.689 E018.29.28.310 N054.22.17.831 E018.29.29.025 yellow
N054.22.17.831 E018.29.29.025 N054.22.17.993 E018.29.29.684 yellow
N054.22.17.993 E018.29.29.684 N054.22.18.208 E018.29.30.396 yellow
N054.22.18.208 E018.29.30.396 N054.22.18.453 E018.29.30.924 yellow
N054.22.18.453 E018.29.30.924 N054.22.18.453 E018.29.30.924 yellow
N054.22.18.453 E018.29.30.924 N054.22.18.749 E018.29.31.425 yellow
N054.22.18.749 E018.29.31.425 N054.22.19.152 E018.29.31.873 yellow
N054.22.19.152 E018.29.31.873 N054.22.19.550 E018.29.32.260 yellow
N054.22.19.550 E018.29.32.260 N054.22.23.138 E018.29.34.947 yellow
N054.22.23.138 E018.29.34.947 N054.22.25.147 E018.29.36.437 yellow
N054.22.25.147 E018.29.36.437 N054.22.25.234 E018.29.36.519 yellow
N054.22.25.234 E018.29.36.519 N054.22.25.293 E018.29.36.613 yellow
N054.22.25.293 E018.29.36.613 N054.22.25.409 E018.29.36.779 yellow
N054.22.25.409 E018.29.36.779 N054.22.25.422 E018.29.36.992 yellow
N054.22.25.422 E018.29.36.992 N054.22.25.467 E018.29.37.214 yellow
N054.22.25.467 E018.29.37.214 N054.22.25.449 E018.29.37.354 yellow
N054.22.25.449 E018.29.37.354 N054.22.24.880 E018.29.39.493 yellow
N054.22.24.880 E018.29.39.493 N054.22.24.418 E018.29.41.309 yellow
;- FF12
N054.22.22.929 E018.29.34.820 N054.22.23.108 E018.29.34.972 yellow
N054.22.23.108 E018.29.34.972 N054.22.23.197 E018.29.35.151 yellow
N054.22.23.197 E018.29.35.151 N054.22.23.332 E018.29.35.408 yellow
N054.22.23.332 E018.29.35.408 N054.22.23.359 E018.29.35.680 yellow
N054.22.23.359 E018.29.35.680 N054.22.23.384 E018.29.35.945 yellow
N054.22.23.384 E018.29.35.945 N054.22.23.397 E018.29.36.247 yellow
N054.22.23.397 E018.29.36.247 N054.22.23.319 E018.29.36.505 yellow
N054.22.23.319 E018.29.36.505 N054.22.23.037 E018.29.37.761 yellow
N054.22.23.037 E018.29.37.761 N054.22.23.005 E018.29.37.885 yellow
N054.22.23.005 E018.29.37.885 N054.22.22.906 E018.29.38.028 yellow
N054.22.22.906 E018.29.38.028 N054.22.22.875 E018.29.38.124 yellow
N054.22.22.875 E018.29.38.124 N054.22.22.776 E018.29.38.196 yellow
N054.22.22.776 E018.29.38.196 N054.22.22.299 E018.29.38.493 yellow
N054.22.22.299 E018.29.38.493 N054.22.22.190 E018.29.38.566 yellow
N054.22.22.190 E018.29.38.566 N054.22.22.122 E018.29.38.672 yellow
N054.22.22.122 E018.29.38.672 N054.22.22.062 E018.29.38.774 yellow
N054.22.22.062 E018.29.38.774 N054.22.22.071 E018.29.38.845 yellow
N054.22.22.071 E018.29.38.845 N054.22.21.955 E018.29.39.106 yellow
N054.22.21.955 E018.29.39.106 N054.22.21.346 E018.29.41.511 yellow
N054.22.21.346 E018.29.41.511 N054.22.20.342 E018.29.45.476 yellow
N054.22.20.342 E018.29.45.476 N054.22.20.360 E018.29.45.619 yellow
N054.22.20.360 E018.29.45.619 N054.22.20.340 E018.29.45.753 yellow
N054.22.20.340 E018.29.45.753 N054.22.20.375 E018.29.45.868 yellow
N054.22.20.375 E018.29.45.868 N054.22.20.436 E018.29.45.978 yellow
N054.22.20.436 E018.29.45.978 N054.22.20.499 E018.29.46.042 yellow
N054.22.20.499 E018.29.46.042 N054.22.21.073 E018.29.46.527 yellow
N054.22.21.073 E018.29.46.527 N054.22.21.138 E018.29.46.561 yellow
N054.22.21.138 E018.29.46.561 N054.22.21.202 E018.29.46.557 yellow
N054.22.21.202 E018.29.46.557 N054.22.21.270 E018.29.46.549 yellow
N054.22.21.270 E018.29.46.549 N054.22.21.313 E018.29.46.468 yellow
N054.22.21.313 E018.29.46.468 N054.22.21.381 E018.29.46.325 yellow
N054.22.21.381 E018.29.46.325 N054.22.21.413 E018.29.46.167 yellow
N054.22.21.413 E018.29.46.167 N054.22.21.409 E018.29.45.979 yellow
N054.22.21.409 E018.29.45.979 N054.22.21.409 E018.29.45.979 yellow
N054.22.21.409 E018.29.45.979 N054.22.21.372 E018.29.45.835 yellow
N054.22.21.372 E018.29.45.835 N054.22.21.303 E018.29.45.691 yellow
N054.22.21.303 E018.29.45.691 N054.22.21.212 E018.29.45.654 yellow
N054.22.21.212 E018.29.45.654 N054.22.21.183 E018.29.45.611 yellow
;- FF13
N054.22.21.160 E018.29.45.425 N054.22.20.920 E018.29.44.633 yellow
N054.22.20.920 E018.29.44.633 N054.22.20.920 E018.29.44.633 yellow
;- FF14
N054.22.20.872 E018.29.43.503 N054.22.20.830 E018.29.43.667 yellow
N054.22.20.830 E018.29.43.667 N054.22.20.880 E018.29.43.804 yellow
N054.22.20.880 E018.29.43.804 N054.22.20.880 E018.29.43.804 yellow
N054.22.20.880 E018.29.43.804 N054.22.20.932 E018.29.43.955 yellow
N054.22.20.932 E018.29.43.955 N054.22.20.951 E018.29.44.001 yellow
N054.22.20.951 E018.29.44.001 N054.22.20.951 E018.29.44.001 yellow
N054.22.20.951 E018.29.44.001 N054.22.21.545 E018.29.44.562 yellow
N054.22.21.545 E018.29.44.562 N054.22.21.650 E018.29.44.570 yellow
N054.22.21.650 E018.29.44.570 N054.22.21.650 E018.29.44.570 yellow
N054.22.21.650 E018.29.44.570 N054.22.21.712 E018.29.44.593 yellow
N054.22.21.712 E018.29.44.593 N054.22.21.765 E018.29.44.551 yellow
N054.22.21.765 E018.29.44.551 N054.22.21.835 E018.29.44.450 yellow
N054.22.21.835 E018.29.44.450 N054.22.21.890 E018.29.44.319 yellow
N054.22.21.890 E018.29.44.319 N054.22.21.890 E018.29.44.319 yellow
N054.22.21.890 E018.29.44.319 N054.22.21.923 E018.29.44.099 yellow
N054.22.21.923 E018.29.44.099 N054.22.21.890 E018.29.43.925 yellow
N054.22.21.890 E018.29.43.925 N054.22.21.890 E018.29.43.925 yellow
N054.22.21.890 E018.29.43.925 N054.22.21.845 E018.29.43.764 yellow
N054.22.21.845 E018.29.43.764 N054.22.21.729 E018.29.43.697 yellow
N054.22.21.729 E018.29.43.697 N054.22.21.722 E018.29.43.621 yellow
N054.22.21.685 E018.29.43.518 N054.22.21.448 E018.29.42.734 yellow
;- FF15
N054.22.21.349 E018.29.41.494 N054.22.21.349 E018.29.41.494 yellow
N054.22.21.349 E018.29.41.494 N054.22.21.350 E018.29.41.753 yellow
N054.22.21.350 E018.29.41.753 N054.22.21.483 E018.29.41.996 yellow
N054.22.21.483 E018.29.41.996 N054.22.22.056 E018.29.42.526 yellow
N054.22.22.056 E018.29.42.526 N054.22.22.159 E018.29.42.578 yellow
N054.22.22.159 E018.29.42.578 N054.22.22.298 E018.29.42.540 yellow
N054.22.22.298 E018.29.42.540 N054.22.22.404 E018.29.42.386 yellow
N054.22.22.404 E018.29.42.386 N054.22.22.418 E018.29.42.194 yellow
N054.22.22.418 E018.29.42.194 N054.22.22.459 E018.29.42.015 yellow
N054.22.22.459 E018.29.42.015 N054.22.22.459 E018.29.42.015 yellow
N054.22.22.459 E018.29.42.015 N054.22.22.385 E018.29.41.840 yellow
N054.22.22.385 E018.29.41.840 N054.22.22.331 E018.29.41.718 yellow
N054.22.22.331 E018.29.41.718 N054.22.22.331 E018.29.41.718 yellow
N054.22.22.331 E018.29.41.718 N054.22.22.272 E018.29.41.670 yellow
N054.22.22.272 E018.29.41.670 N054.22.22.272 E018.29.41.670 yellow
N054.22.22.272 E018.29.41.670 N054.22.22.236 E018.29.41.627 yellow
N054.22.22.203 E018.29.41.510 N054.22.21.964 E018.29.40.737 yellow
;- FF16
N054.22.21.876 E018.29.39.560 N054.22.21.876 E018.29.39.560 yellow
N054.22.21.876 E018.29.39.560 N054.22.21.836 E018.29.39.757 yellow
N054.22.21.836 E018.29.39.757 N054.22.21.948 E018.29.40.015 yellow
N054.22.21.948 E018.29.40.015 N054.22.22.042 E018.29.40.118 yellow
N054.22.22.042 E018.29.40.118 N054.22.22.575 E018.29.40.528 yellow
N054.22.22.575 E018.29.40.528 N054.22.22.668 E018.29.40.547 yellow
N054.22.22.668 E018.29.40.547 N054.22.22.776 E018.29.40.491 yellow
N054.22.22.776 E018.29.40.491 N054.22.22.859 E018.29.40.332 yellow
N054.22.22.859 E018.29.40.332 N054.22.22.900 E018.29.40.173 yellow
N054.22.22.900 E018.29.40.173 N054.22.22.905 E018.29.39.985 yellow
N054.22.22.905 E018.29.39.985 N054.22.22.905 E018.29.39.985 yellow
N054.22.22.905 E018.29.39.985 N054.22.22.905 E018.29.39.985 yellow
N054.22.22.905 E018.29.39.985 N054.22.22.885 E018.29.39.791 yellow
N054.22.22.885 E018.29.39.791 N054.22.22.771 E018.29.39.698 yellow
N054.22.22.771 E018.29.39.698 N054.22.22.751 E018.29.39.634 yellow
N054.22.22.751 E018.29.39.634 N054.22.22.688 E018.29.39.526 yellow
N054.22.22.688 E018.29.39.526 N054.22.22.659 E018.29.39.449 yellow
N054.22.22.659 E018.29.39.449 N054.22.22.662 E018.29.39.242 yellow
N054.22.22.662 E018.29.39.242 N054.22.22.913 E018.29.38.268 yellow
;- FF17
N054.22.22.836 E018.29.07.741 N054.22.26.525 E018.29.10.477 yellow
N054.22.26.525 E018.29.10.477 N054.22.26.726 E018.29.10.709 yellow
N054.22.26.726 E018.29.10.709 N054.22.26.958 E018.29.10.978 yellow
N054.22.26.958 E018.29.10.978 N054.22.27.065 E018.29.11.177 yellow
N054.22.27.065 E018.29.11.177 N054.22.27.248 E018.29.11.577 yellow
N054.22.27.248 E018.29.11.577 N054.22.27.334 E018.29.11.977 yellow
N054.22.27.334 E018.29.11.977 N054.22.27.363 E018.29.12.333 yellow
N054.22.27.363 E018.29.12.333 N054.22.27.341 E018.29.12.662 yellow
N054.22.27.341 E018.29.12.662 N054.22.27.314 E018.29.12.907 yellow
N054.22.27.314 E018.29.12.907 N054.22.27.217 E018.29.13.292 yellow
N054.22.27.217 E018.29.13.292 N054.22.26.692 E018.29.15.199 yellow
N054.22.26.692 E018.29.15.199 N054.22.26.710 E018.29.15.531 yellow
N054.22.26.710 E018.29.15.531 N054.22.26.710 E018.29.15.531 yellow
N054.22.26.710 E018.29.15.531 N054.22.26.697 E018.29.15.803 yellow
N054.22.26.697 E018.29.15.803 N054.22.27.063 E018.29.17.397 yellow
N054.22.27.063 E018.29.17.397 N054.22.27.063 E018.29.17.397 yellow
N054.22.27.063 E018.29.17.397 N054.22.27.144 E018.29.17.572 yellow
N054.22.27.144 E018.29.17.572 N054.22.27.325 E018.29.17.644 yellow
N054.22.27.325 E018.29.17.644 N054.22.27.454 E018.29.17.571 yellow
N054.22.27.454 E018.29.17.571 N054.22.27.454 E018.29.17.571 yellow
N054.22.27.454 E018.29.17.571 N054.22.27.549 E018.29.17.398 yellow
N054.22.27.549 E018.29.17.398 N054.22.27.501 E018.29.17.093 yellow
N054.22.27.501 E018.29.17.093 N054.22.27.392 E018.29.16.833 yellow
;- FF18
N054.22.27.220 E018.29.13.284 N054.22.27.220 E018.29.13.284 yellow
N054.22.27.220 E018.29.13.284 N054.22.27.178 E018.29.13.773 yellow
N054.22.27.178 E018.29.13.773 N054.22.27.240 E018.29.14.124 yellow
N054.22.27.240 E018.29.14.124 N054.22.27.544 E018.29.15.410 yellow
N054.22.27.544 E018.29.15.410 N054.22.27.642 E018.29.15.617 yellow
N054.22.27.642 E018.29.15.617 N054.22.27.757 E018.29.15.700 yellow
N054.22.27.757 E018.29.15.700 N054.22.27.941 E018.29.15.668 yellow
N054.22.27.941 E018.29.15.668 N054.22.28.029 E018.29.15.504 yellow
N054.22.28.029 E018.29.15.504 N054.22.28.039 E018.29.15.205 yellow
N054.22.28.039 E018.29.15.205 N054.22.27.820 E018.29.14.832 yellow
;- FF19
N054.22.27.313 E018.29.11.730 N054.22.28.038 E018.29.13.533 yellow
N054.22.28.038 E018.29.13.533 N054.22.28.122 E018.29.13.658 yellow
N054.22.28.122 E018.29.13.658 N054.22.28.269 E018.29.13.724 yellow
N054.22.28.269 E018.29.13.724 N054.22.28.405 E018.29.13.620 yellow
N054.22.28.405 E018.29.13.620 N054.22.28.475 E018.29.13.340 yellow
N054.22.28.475 E018.29.13.340 N054.22.28.426 E018.29.13.043 yellow
N054.22.28.426 E018.29.13.043 N054.22.28.293 E018.29.12.885 yellow
;- R1
N054.22.28.670 E018.29.11.735 N054.22.28.547 E018.29.12.335 red
N054.22.28.547 E018.29.12.335 N054.22.28.178 E018.29.12.412 red
N054.22.28.178 E018.29.12.412 N054.22.26.578 E018.29.19.111 red
;- FF20
N054.22.47.016 E018.28.02.657 N054.22.47.016 E018.28.02.657 yellow
N054.22.47.191 E018.28.02.687 N054.22.47.474 E018.28.02.840 yellow
N054.22.47.474 E018.28.02.840 N054.22.47.656 E018.28.03.092 yellow
N054.22.47.656 E018.28.03.092 N054.22.47.758 E018.28.03.395 yellow
N054.22.47.758 E018.28.03.395 N054.22.47.820 E018.28.03.729 yellow
N054.22.47.820 E018.28.03.729 N054.22.47.525 E018.28.03.902 yellow
N054.22.47.525 E018.28.03.902 N054.22.47.040 E018.28.03.798 yellow
N054.22.47.040 E018.28.03.798 N054.22.46.892 E018.28.03.587 yellow
N054.22.46.892 E018.28.03.587 N054.22.46.817 E018.28.03.434 yellow
;- FF21
N054.22.46.432 E018.28.04.948 N054.22.46.432 E018.28.04.948 yellow
N054.22.46.432 E018.28.04.948 N054.22.46.623 E018.28.04.966 yellow
N054.22.46.623 E018.28.04.966 N054.22.46.951 E018.28.05.204 yellow
N054.22.46.951 E018.28.05.204 N054.22.47.069 E018.28.05.480 yellow
N054.22.47.069 E018.28.05.480 N054.22.47.208 E018.28.05.849 yellow
N054.22.47.208 E018.28.05.849 N054.22.47.237 E018.28.06.003 yellow
N054.22.47.237 E018.28.06.003 N054.22.46.973 E018.28.06.172 yellow
N054.22.46.973 E018.28.06.172 N054.22.46.815 E018.28.06.247 yellow
N054.22.46.815 E018.28.06.247 N054.22.46.621 E018.28.06.186 yellow
N054.22.46.621 E018.28.06.186 N054.22.46.377 E018.28.05.976 yellow
N054.22.46.377 E018.28.05.976 N054.22.46.194 E018.28.05.740 yellow
;- FF22
N054.22.45.829 E018.28.07.180 N054.22.45.829 E018.28.07.180 yellow
N054.22.45.829 E018.28.07.180 N054.22.46.137 E018.28.07.235 yellow
N054.22.46.137 E018.28.07.235 N054.22.46.344 E018.28.07.382 yellow
N054.22.46.344 E018.28.07.382 N054.22.46.500 E018.28.07.630 yellow
N054.22.46.500 E018.28.07.630 N054.22.46.586 E018.28.07.961 yellow
N054.22.46.586 E018.28.07.961 N054.22.46.586 E018.28.07.969 yellow
N054.22.46.586 E018.28.07.969 N054.22.46.635 E018.28.08.032 yellow
N054.22.46.635 E018.28.08.032 N054.22.46.663 E018.28.08.199 yellow
N054.22.46.663 E018.28.08.199 N054.22.46.639 E018.28.08.233 yellow
N054.22.46.639 E018.28.08.233 N054.22.46.641 E018.28.08.259 yellow
N054.22.46.641 E018.28.08.259 N054.22.46.642 E018.28.08.258 yellow
N054.22.46.642 E018.28.08.258 N054.22.46.385 E018.28.08.427 yellow
N054.22.46.385 E018.28.08.427 N054.22.46.137 E018.28.08.467 yellow
N054.22.46.137 E018.28.08.467 N054.22.45.859 E018.28.08.304 yellow
N054.22.45.859 E018.28.08.304 N054.22.45.859 E018.28.08.304 yellow
N054.22.45.859 E018.28.08.304 N054.22.45.754 E018.28.08.156 yellow
N054.22.45.754 E018.28.08.156 N054.22.45.754 E018.28.08.156 yellow
N054.22.45.754 E018.28.08.156 N054.22.45.632 E018.28.07.990 yellow
;- FF23
N054.22.46.541 E018.28.13.449 N054.22.46.541 E018.28.13.449 yellow
N054.22.46.541 E018.28.13.449 N054.22.46.814 E018.28.13.349 yellow
N054.22.46.814 E018.28.13.349 N054.22.46.975 E018.28.13.136 yellow
N054.22.46.975 E018.28.13.136 N054.22.47.092 E018.28.12.940 yellow
N054.22.47.092 E018.28.12.940 N054.22.47.195 E018.28.12.663 yellow
N054.22.47.195 E018.28.12.663 N054.22.49.071 E018.28.12.189 yellow
;- FF24
N054.22.49.061 E018.28.14.515 N054.22.49.061 E018.28.14.515 yellow
N054.22.49.061 E018.28.14.515 N054.22.47.776 E018.28.14.828 yellow
N054.22.47.776 E018.28.14.828 N054.22.47.667 E018.28.14.642 yellow
N054.22.47.667 E018.28.14.642 N054.22.47.508 E018.28.14.519 yellow
N054.22.47.508 E018.28.14.519 N054.22.47.291 E018.28.14.533 yellow
N054.22.47.291 E018.28.14.533 N054.22.47.130 E018.28.14.637 yellow
N054.22.47.130 E018.28.14.637 N054.22.47.046 E018.28.14.736 yellow
N054.22.47.046 E018.28.14.736 N054.22.47.085 E018.28.14.982 yellow
N054.22.47.085 E018.28.14.982 N054.22.47.085 E018.28.14.982 yellow
N054.22.47.085 E018.28.14.982 N054.22.47.120 E018.28.15.265 yellow
N054.22.47.120 E018.28.15.265 N054.22.47.092 E018.28.15.350 yellow
N054.22.47.092 E018.28.15.350 N054.22.47.272 E018.28.15.378 yellow
N054.22.47.272 E018.28.15.378 N054.22.47.387 E018.28.15.392 yellow
N054.22.47.387 E018.28.15.392 N054.22.47.599 E018.28.15.261 yellow
N054.22.47.599 E018.28.15.261 N054.22.47.688 E018.28.15.109 yellow
N054.22.47.688 E018.28.15.109 N054.22.47.825 E018.28.14.834 yellow
;- FF25
N054.22.46.981 E018.28.19.772 N054.22.48.425 E018.28.19.375 yellow
N054.22.46.941 E018.28.19.776 N054.22.46.884 E018.28.20.027 yellow
N054.22.46.884 E018.28.20.027 N054.22.46.676 E018.28.20.327 yellow
N054.22.46.676 E018.28.20.327 N054.22.46.467 E018.28.20.504 yellow
N054.22.46.467 E018.28.20.504 N054.22.46.224 E018.28.20.511 yellow
N054.22.46.224 E018.28.20.511 N054.22.46.043 E018.28.20.446 yellow
N054.22.46.043 E018.28.20.446 N054.22.45.840 E018.28.20.426 yellow
N054.22.45.840 E018.28.20.426 N054.22.45.568 E018.28.20.305 yellow
N054.22.45.568 E018.28.20.305 N054.22.45.431 E018.28.20.076 yellow
N054.22.45.431 E018.28.20.076 N054.22.45.254 E018.28.19.681 yellow
N054.22.45.254 E018.28.19.681 N054.22.45.235 E018.28.19.414 yellow
N054.22.45.235 E018.28.19.414 N054.22.43.465 E018.28.18.106 yellow
;- FF26
N054.22.46.332 E018.28.19.329 N054.22.46.332 E018.28.19.329 yellow
N054.22.46.332 E018.28.19.329 N054.22.46.504 E018.28.19.376 yellow
N054.22.46.504 E018.28.19.376 N054.22.46.691 E018.28.19.427 yellow
N054.22.46.691 E018.28.19.427 N054.22.46.829 E018.28.19.574 yellow
N054.22.46.829 E018.28.19.574 N054.22.46.877 E018.28.19.663 yellow
N054.22.46.877 E018.28.19.663 N054.22.46.981 E018.28.19.772 yellow
;- FF27
N054.22.47.739 E018.28.22.060 N054.22.46.300 E018.28.22.450 yellow
N054.22.46.300 E018.28.22.450 N054.22.46.149 E018.28.22.822 yellow
N054.22.46.149 E018.28.22.822 N054.22.46.010 E018.28.23.008 yellow
N054.22.46.010 E018.28.23.008 N054.22.45.765 E018.28.23.186 yellow
N054.22.45.765 E018.28.23.186 N054.22.45.630 E018.28.23.195 yellow
N054.22.45.630 E018.28.23.195 N054.22.45.630 E018.28.23.195 yellow
N054.22.45.630 E018.28.23.195 N054.22.45.463 E018.28.23.165 yellow
N054.22.45.463 E018.28.23.165 N054.22.45.366 E018.28.23.112 yellow
N054.22.45.366 E018.28.23.112 N054.22.45.453 E018.28.22.635 yellow
N054.22.45.453 E018.28.22.635 N054.22.45.282 E018.28.22.648 yellow
N054.22.45.282 E018.28.22.648 N054.22.45.282 E018.28.22.648 yellow
N054.22.45.282 E018.28.22.648 N054.22.45.131 E018.28.22.541 yellow
N054.22.45.131 E018.28.22.541 N054.22.44.976 E018.28.22.408 yellow
N054.22.44.976 E018.28.22.408 N054.22.44.812 E018.28.22.130 yellow
N054.22.44.812 E018.28.22.130 N054.22.44.711 E018.28.21.775 yellow
N054.22.44.711 E018.28.21.775 N054.22.44.681 E018.28.21.578 yellow
N054.22.44.681 E018.28.21.578 N054.22.42.938 E018.28.20.276 yellow
;- FF28
N054.22.46.299 E018.28.22.426 N054.22.46.299 E018.28.22.426 yellow
N054.22.46.299 E018.28.22.426 N054.22.46.123 E018.28.22.229 yellow
N054.22.46.123 E018.28.22.229 N054.22.45.959 E018.28.22.061 yellow
N054.22.45.959 E018.28.22.061 N054.22.45.805 E018.28.22.019 yellow
N054.22.45.805 E018.28.22.019 N054.22.45.725 E018.28.22.007 yellow
N054.22.45.725 E018.28.22.007 N054.22.45.612 E018.28.22.014 yellow
;- FF29
N054.22.47.146 E018.28.24.549 N054.22.45.642 E018.28.24.918 yellow
N054.22.45.642 E018.28.24.918 N054.22.45.417 E018.28.24.621 yellow
N054.22.45.417 E018.28.24.621 N054.22.45.243 E018.28.24.515 yellow
N054.22.45.243 E018.28.24.515 N054.22.44.989 E018.28.24.485 yellow
N054.22.44.989 E018.28.24.485 N054.22.44.975 E018.28.24.643 yellow
N054.22.44.975 E018.28.24.643 N054.22.44.729 E018.28.24.631 yellow
N054.22.44.729 E018.28.24.631 N054.22.44.559 E018.28.24.481 yellow
N054.22.44.559 E018.28.24.481 N054.22.44.424 E018.28.24.212 yellow
N054.22.44.424 E018.28.24.212 N054.22.44.343 E018.28.24.050 yellow
N054.22.44.343 E018.28.24.050 N054.22.44.310 E018.28.23.881 yellow
N054.22.44.310 E018.28.23.881 N054.22.42.364 E018.28.22.479 yellow
;- FF30
N054.22.44.706 E018.28.25.595 N054.22.44.706 E018.28.25.595 yellow
N054.22.44.706 E018.28.25.595 N054.22.44.914 E018.28.25.685 yellow
N054.22.44.914 E018.28.25.685 N054.22.45.144 E018.28.25.666 yellow
N054.22.45.144 E018.28.25.666 N054.22.45.400 E018.28.25.478 yellow
N054.22.45.400 E018.28.25.478 N054.22.45.565 E018.28.25.219 yellow
N054.22.45.565 E018.28.25.219 N054.22.45.644 E018.28.24.901 yellow
;- FF31
N054.22.46.523 E018.28.27.079 N054.22.45.103 E018.28.27.420 yellow
N054.22.45.103 E018.28.27.420 N054.22.44.933 E018.28.27.538 yellow
N054.22.44.933 E018.28.27.538 N054.22.44.774 E018.28.27.611 yellow
N054.22.44.774 E018.28.27.611 N054.22.44.576 E018.28.27.503 yellow
N054.22.44.576 E018.28.27.503 N054.22.44.486 E018.28.27.256 yellow
N054.22.44.486 E018.28.27.256 N054.22.44.415 E018.28.26.873 yellow
N054.22.44.415 E018.28.26.873 N054.22.44.463 E018.28.26.672 yellow
N054.22.44.463 E018.28.26.672 N054.22.44.252 E018.28.26.669 yellow
N054.22.44.252 E018.28.26.669 N054.22.44.106 E018.28.26.544 yellow
N054.22.44.106 E018.28.26.544 N054.22.43.975 E018.28.26.380 yellow
N054.22.43.975 E018.28.26.380 N054.22.43.861 E018.28.26.173 yellow
N054.22.43.861 E018.28.26.173 N054.22.43.834 E018.28.25.922 yellow
N054.22.43.834 E018.28.25.922 N054.22.41.842 E018.28.24.469 yellow
;- FF32
N054.22.41.628 E018.28.24.913 N054.22.41.736 E018.28.24.622 yellow
N054.22.42.136 E018.28.22.892 N054.22.42.249 E018.28.22.598 yellow
N054.22.42.633 E018.28.20.828 N054.22.42.732 E018.28.20.411 yellow
;- FF33
N054.22.44.473 E018.28.14.015 N054.22.44.473 E018.28.14.015 yellow
N054.22.44.473 E018.28.14.015 N054.22.46.594 E018.28.15.583 yellow
N054.22.46.594 E018.28.15.583 N054.22.46.642 E018.28.15.956 yellow
N054.22.46.642 E018.28.15.956 N054.22.46.642 E018.28.15.956 yellow
N054.22.46.642 E018.28.15.956 N054.22.46.771 E018.28.16.274 yellow
N054.22.46.771 E018.28.16.274 N054.22.46.907 E018.28.16.452 yellow
N054.22.46.907 E018.28.16.452 N054.22.46.996 E018.28.16.516 yellow
N054.22.47.085 E018.28.15.336 N054.22.47.085 E018.28.15.336 yellow
N054.22.47.085 E018.28.15.336 N054.22.46.923 E018.28.15.328 yellow
N054.22.46.804 E018.28.15.358 N054.22.46.692 E018.28.15.468 yellow
N054.22.47.109 E018.28.12.533 N054.22.46.900 E018.28.12.376 yellow
N054.22.46.778 E018.28.12.320 N054.22.46.614 E018.28.12.300 yellow
N054.22.46.529 E018.28.12.331 N054.22.46.387 E018.28.12.389 yellow
N054.22.46.255 E018.28.12.519 N054.22.46.123 E018.28.12.700 yellow
N054.22.46.744 E018.28.17.201 N054.22.46.588 E018.28.17.149 yellow
N054.22.46.426 E018.28.17.183 N054.22.46.258 E018.28.17.238 yellow
N054.22.46.119 E018.28.19.513 N054.22.46.005 E018.28.19.313 yellow
N054.22.45.831 E018.28.19.217 N054.22.45.831 E018.28.19.217 yellow
N054.22.45.831 E018.28.19.217 N054.22.45.691 E018.28.19.162 yellow
N054.22.45.561 E018.28.19.193 N054.22.45.374 E018.28.19.236 yellow
;- FF34
N054.22.46.540 E018.28.18.326 N054.22.46.410 E018.28.18.230 yellow
N054.22.46.410 E018.28.18.230 N054.22.46.304 E018.28.18.012 yellow
N054.22.46.304 E018.28.18.012 N054.22.46.169 E018.28.17.614 yellow
N054.22.46.169 E018.28.17.614 N054.22.46.097 E018.28.17.396 yellow
N054.22.46.097 E018.28.17.396 N054.22.44.043 E018.28.15.815 yellow
N054.22.43.828 E018.28.15.986 N054.22.43.725 E018.28.16.407 yellow
N054.22.46.718 E018.28.17.788 N054.22.46.957 E018.28.17.870 yellow
N054.22.46.957 E018.28.17.870 N054.22.47.134 E018.28.17.847 yellow
N054.22.47.134 E018.28.17.847 N054.22.47.398 E018.28.17.641 yellow
N054.22.47.398 E018.28.17.641 N054.22.47.565 E018.28.17.342 yellow
N054.22.47.565 E018.28.17.342 N054.22.47.659 E018.28.17.107 yellow
N054.22.47.659 E018.28.17.107 N054.22.49.099 E018.28.16.748 yellow
N054.22.47.660 E018.28.17.108 N054.22.47.477 E018.28.16.863 yellow
N054.22.47.477 E018.28.16.863 N054.22.47.333 E018.28.16.727 yellow
N054.22.47.333 E018.28.16.727 N054.22.47.184 E018.28.16.681 yellow
N054.22.47.184 E018.28.16.681 N054.22.47.184 E018.28.16.681 yellow
N054.22.47.184 E018.28.16.681 N054.22.46.973 E018.28.16.689 yellow
;- FF35
N054.22.44.328 E018.28.14.146 N054.22.44.223 E018.28.14.549 yellow
N054.22.43.317 E018.28.18.232 N054.22.43.179 E018.28.18.665 yellow
N054.22.43.179 E018.28.18.665 N054.22.43.179 E018.28.18.665 yellow
N054.22.46.604 E018.28.26.738 N054.22.46.593 E018.28.26.292 yellow
N054.22.47.234 E018.28.24.237 N054.22.47.234 E018.28.24.237 yellow
N054.22.47.234 E018.28.24.237 N054.22.47.194 E018.28.23.772 yellow
N054.22.47.887 E018.28.21.753 N054.22.47.855 E018.28.21.288 yellow
N054.22.48.577 E018.28.19.054 N054.22.48.533 E018.28.18.615 yellow
N054.22.49.249 E018.28.16.399 N054.22.49.172 E018.28.15.960 yellow
N054.22.49.151 E018.28.14.289 N054.22.49.120 E018.28.13.979 yellow
N054.22.49.214 E018.28.11.859 N054.22.49.140 E018.28.11.398 yellow
N054.22.48.608 E018.28.09.382 N054.22.48.681 E018.28.08.980 yellow
N054.22.49.129 E018.28.07.242 N054.22.49.222 E018.28.06.824 yellow
N054.22.49.694 E018.28.04.820 N054.22.49.832 E018.28.04.424 yellow
N054.22.50.294 E018.28.02.581 N054.22.50.370 E018.28.02.155 yellow
N054.22.50.860 E018.28.00.298 N054.22.50.956 E018.27.59.904 yellow
N054.22.51.408 E018.27.58.043 N054.22.51.552 E018.27.57.597 yellow
;- FF36
N054.22.49.443 E018.27.56.979 N054.22.49.274 E018.27.57.073 yellow
N054.22.49.171 E018.27.57.105 N054.22.49.011 E018.27.57.082 yellow
N054.22.48.925 E018.27.57.051 N054.22.48.767 E018.27.56.951 yellow
N054.22.48.185 E018.27.59.218 N054.22.48.327 E018.27.59.352 yellow
N054.22.48.508 E018.27.59.405 N054.22.48.613 E018.27.59.379 yellow
N054.22.48.747 E018.27.59.341 N054.22.48.747 E018.27.59.341 yellow
N054.22.48.747 E018.27.59.341 N054.22.48.871 E018.27.59.228 yellow
N054.22.47.629 E018.28.01.520 N054.22.47.753 E018.28.01.641 yellow
N054.22.47.874 E018.28.01.662 N054.22.48.029 E018.28.01.649 yellow
N054.22.48.135 E018.28.01.607 N054.22.48.265 E018.28.01.540 yellow
N054.22.44.407 E018.28.25.885 N054.22.44.250 E018.28.25.773 yellow
N054.22.44.091 E018.28.25.722 N054.22.43.963 E018.28.25.769 yellow
N054.22.44.447 E018.28.23.777 N054.22.44.620 E018.28.23.715 yellow
N054.22.44.776 E018.28.23.752 N054.22.44.924 E018.28.23.873 yellow
N054.22.45.486 E018.28.21.541 N054.22.45.295 E018.28.21.400 yellow
N054.22.45.068 E018.28.21.356 N054.22.44.764 E018.28.21.442 yellow
;- FF37
N054.22.50.561 E018.27.12.921 N054.22.51.057 E018.27.10.622 yellow
N054.22.51.057 E018.27.10.622 N054.22.51.268 E018.27.07.667 yellow
N054.22.51.268 E018.27.07.667 N054.22.51.443 E018.27.07.261 yellow
N054.22.51.443 E018.27.07.261 N054.22.51.794 E018.27.07.060 yellow
N054.22.51.794 E018.27.07.060 N054.22.52.174 E018.27.07.087 yellow
N054.22.52.174 E018.27.07.087 N054.22.52.469 E018.27.07.387 yellow
N054.22.52.469 E018.27.07.387 N054.22.52.737 E018.27.07.901 yellow
N054.22.52.737 E018.27.07.901 N054.22.52.837 E018.27.08.668 yellow
N054.22.52.837 E018.27.08.668 N054.22.52.766 E018.27.09.279 yellow
N054.22.52.766 E018.27.09.279 N054.22.52.500 E018.27.09.866 yellow
N054.22.52.500 E018.27.09.866 N054.22.52.159 E018.27.10.206 yellow
N054.22.52.159 E018.27.10.206 N054.22.51.849 E018.27.10.270 yellow
;- FF38
N054.22.51.652 E018.27.09.196 N054.22.51.491 E018.27.09.867 white
N054.22.51.491 E018.27.09.867 N054.22.51.582 E018.27.09.779 white
N054.22.51.341 E018.27.09.608 N054.22.51.261 E018.27.09.674 white
N054.22.51.261 E018.27.09.674 N054.22.51.426 E018.27.09.009 white
N054.22.17.233 E018.29.27.313 N054.22.17.069 E018.29.27.169 white
N054.22.17.069 E018.29.27.169 N054.22.17.370 E018.29.26.847 white
N054.22.17.370 E018.29.26.847 N054.22.17.370 E018.29.26.847 white
N054.22.17.370 E018.29.26.847 N054.22.17.200 E018.29.26.741 white
N054.22.17.200 E018.29.26.741 N054.22.17.170 E018.29.26.726 white
N054.22.17.358 E018.29.27.375 N054.22.17.512 E018.29.27.400 white
N054.22.17.512 E018.29.27.400 N054.22.17.598 E018.29.27.035 white
N054.22.17.598 E018.29.27.035 N054.22.17.474 E018.29.26.933 white
N054.22.17.474 E018.29.26.933 N054.22.17.412 E018.29.27.199 white
N054.22.17.412 E018.29.27.199 N054.22.17.514 E018.29.27.282 white
;- LAS
N054.22.13.731 E018.29.08.670 N054.22.11.132 E018.29.17.110 green
N054.22.11.132 E018.29.17.110 N054.22.09.228 E018.29.10.697 green
N054.22.09.228 E018.29.10.697 N054.22.05.950 E018.29.13.539 green
N054.22.05.950 E018.29.13.539 N054.22.05.034 E018.29.10.258 green
N054.22.05.034 E018.29.10.258 N054.22.05.034 E018.29.10.258 green
N054.22.05.034 E018.29.10.258 N054.22.02.826 E018.29.12.126 green
N054.22.02.826 E018.29.12.126 N054.21.59.593 E018.29.07.744 green
N054.21.59.593 E018.29.07.744 N054.21.59.593 E018.29.07.744 green
N054.21.59.593 E018.29.07.744 N054.22.00.738 E018.29.06.779 green
N054.22.00.738 E018.29.06.779 N054.22.00.509 E018.29.05.957 green
N054.22.00.509 E018.29.05.957 N054.22.02.618 E018.29.04.177 green
N054.22.02.618 E018.29.04.177 N054.22.03.654 E018.29.05.570 green
N054.22.03.654 E018.29.05.570 N054.22.03.560 E018.29.04.308 green
N054.22.03.560 E018.29.04.308 N054.22.08.193 E018.29.00.453 green
N054.22.08.193 E018.29.00.453 N054.22.10.710 E018.29.09.479 green
N054.22.10.710 E018.29.09.479 N054.22.13.731 E018.29.08.670 green
;- LAS2
N054.22.18.942 E018.28.56.887 N054.22.20.902 E018.28.46.051 green
N054.22.20.902 E018.28.46.051 N054.22.26.501 E018.28.28.426 green
N054.22.26.501 E018.28.28.426 N054.22.31.273 E018.28.07.921 green
N054.22.31.273 E018.28.07.921 N054.22.31.612 E018.28.01.843 green
N054.22.31.612 E018.28.01.843 N054.22.29.393 E018.28.00.013 green
N054.22.29.393 E018.28.00.013 N054.22.31.190 E018.27.52.173 green
N054.22.31.190 E018.27.52.173 N054.22.31.707 E018.27.47.406 green
N054.22.31.707 E018.27.47.406 N054.22.25.138 E018.27.47.666 green
N054.22.25.138 E018.27.47.666 N054.22.16.923 E018.27.55.533 green
N054.22.16.923 E018.27.55.533 N054.22.10.823 E018.28.12.410 green
N054.22.10.823 E018.28.12.410 N054.22.12.811 E018.28.14.861 green
N054.22.12.811 E018.28.14.861 N054.22.11.712 E018.28.22.492 green
N054.22.11.712 E018.28.22.492 N054.22.05.765 E018.28.21.033 green
N054.22.05.765 E018.28.21.033 N054.22.03.303 E018.28.26.821 green
N054.22.03.303 E018.28.26.821 N054.22.09.026 E018.28.31.721 green
N054.22.09.026 E018.28.31.721 N054.22.14.029 E018.28.37.958 green
N054.22.14.029 E018.28.37.958 N054.22.13.346 E018.28.45.811 green
N054.22.13.346 E018.28.45.811 N054.22.15.675 E018.28.51.684 green
N054.22.15.675 E018.28.51.684 N054.22.16.603 E018.28.56.673 green
N054.22.16.603 E018.28.56.673 N054.22.18.942 E018.28.56.887 green
;- LAS3
N054.22.35.131 E018.27.49.137 N054.22.39.862 E018.27.30.746 green
N054.22.39.862 E018.27.30.746 N054.22.43.121 E018.27.16.702 green
N054.22.43.121 E018.27.16.702 N054.22.46.806 E018.27.03.307 green
N054.22.46.806 E018.27.03.307 N054.22.49.273 E018.26.52.780 green
N054.22.49.273 E018.26.52.780 N054.22.51.101 E018.26.49.183 green
N054.22.51.101 E018.26.49.183 N054.22.49.796 E018.26.47.263 green
N054.22.49.796 E018.26.47.263 N054.22.48.573 E018.26.47.349 green
N054.22.48.573 E018.26.47.349 N054.22.47.590 E018.26.45.510 green
N054.22.47.590 E018.26.45.510 N054.22.44.279 E018.27.02.390 green
N054.22.44.279 E018.27.02.390 N054.22.40.215 E018.27.19.274 green
N054.22.40.215 E018.27.19.274 N054.22.38.569 E018.27.21.753 green
N054.22.38.569 E018.27.21.753 N054.22.33.755 E018.27.41.258 green
N054.22.33.755 E018.27.41.258 N054.22.33.510 E018.27.46.137 green
N054.22.33.510 E018.27.46.137 N054.22.35.131 E018.27.49.137 green
;- WATER
N054.22.46.595 E018.26.15.084 N054.22.47.418 E018.26.16.029 blue
N054.22.47.418 E018.26.16.029 N054.22.48.406 E018.26.12.106 blue
N054.22.48.406 E018.26.12.106 N054.22.46.588 E018.26.11.011 blue
N054.22.46.588 E018.26.11.011 N054.22.44.729 E018.26.10.995 blue
N054.22.44.729 E018.26.10.995 N054.22.44.002 E018.26.13.539 blue
N054.22.44.002 E018.26.13.539 N054.22.43.389 E018.26.14.015 blue
N054.22.43.389 E018.26.14.015 N054.22.42.953 E018.26.16.779 blue
N054.22.42.953 E018.26.16.779 N054.22.42.953 E018.26.16.779 blue
N054.22.42.953 E018.26.16.779 N054.22.43.919 E018.26.17.003 blue
N054.22.43.919 E018.26.17.003 N054.22.45.023 E018.26.15.477 blue
N054.22.45.023 E018.26.15.477 N054.22.46.595 E018.26.15.084 blue
;- WATER2
N054.21.48.969 E018.29.12.586 N054.21.50.456 E018.29.10.760 blue
N054.21.50.456 E018.29.10.760 N054.21.50.456 E018.29.10.760 blue
N054.21.50.456 E018.29.10.760 N054.21.50.695 E018.29.05.793 blue
N054.21.50.695 E018.29.05.793 N054.21.49.592 E018.29.01.738 blue
N054.21.49.592 E018.29.01.738 N054.21.47.827 E018.29.00.633 blue
N054.21.47.827 E018.29.00.633 N054.21.45.899 E018.29.01.029 blue
N054.21.45.899 E018.29.01.029 N054.21.45.981 E018.29.04.626 blue
N054.21.45.981 E018.29.04.626 N054.21.47.027 E018.29.09.585 blue
N054.21.47.027 E018.29.09.585 N054.21.48.310 E018.29.12.055 blue
N054.21.48.310 E018.29.12.055 N054.21.48.969 E018.29.12.586 blue
;- WATER3
N054.22.03.415 E018.30.28.954 N054.22.03.415 E018.30.28.954 blue
N054.22.03.415 E018.30.28.954 N054.22.04.629 E018.30.31.239 blue
N054.22.04.629 E018.30.31.239 N054.22.04.814 E018.30.33.253 blue
N054.22.04.814 E018.30.33.253 N054.22.04.814 E018.30.33.253 blue
N054.22.04.814 E018.30.33.253 N054.22.03.880 E018.30.33.066 blue
N054.22.03.880 E018.30.33.066 N054.22.03.880 E018.30.33.066 blue
N054.22.03.880 E018.30.33.066 N054.22.02.821 E018.30.29.311 blue
N054.22.02.821 E018.30.29.311 N054.22.03.415 E018.30.28.954 blue
;- LAS4
N054.22.21.916 E018.29.58.412 N054.22.34.055 E018.29.10.156 green
N054.22.34.055 E018.29.10.156 N054.22.36.338 E018.29.05.332 green
N054.22.36.338 E018.29.05.332 N054.22.36.338 E018.29.05.332 green
N054.22.36.338 E018.29.05.332 N054.22.40.238 E018.29.06.289 green
N054.22.40.238 E018.29.06.289 N054.22.40.238 E018.29.06.289 green
N054.22.40.238 E018.29.06.289 N054.22.45.284 E018.29.09.870 green
N054.22.45.284 E018.29.09.870 N054.22.45.284 E018.29.09.870 green
N054.22.45.284 E018.29.09.870 N054.22.45.645 E018.29.15.138 green
N054.22.45.645 E018.29.15.138 N054.22.49.852 E018.29.11.934 green
N054.22.49.852 E018.29.11.934 N054.22.52.820 E018.29.14.029 green
N054.22.52.820 E018.29.14.029 N054.22.52.820 E018.29.14.029 green
N054.22.52.820 E018.29.14.029 N054.22.57.509 E018.29.27.292 green
N054.22.57.509 E018.29.27.292 N054.22.54.329 E018.29.34.236 green
N054.22.54.329 E018.29.34.236 N054.22.54.329 E018.29.34.236 green
N054.22.54.329 E018.29.34.236 N054.22.52.483 E018.29.42.691 green
N054.22.52.483 E018.29.42.691 N054.22.52.483 E018.29.42.691 green
N054.22.52.483 E018.29.42.691 N054.22.55.739 E018.29.49.124 green
N054.22.55.739 E018.29.49.124 N054.23.06.293 E018.29.58.607 green
N054.23.06.293 E018.29.58.607 N054.23.07.651 E018.30.05.087 green
N054.23.07.651 E018.30.05.087 N054.23.07.651 E018.30.05.087 green
N054.23.07.651 E018.30.05.087 N054.23.00.318 E018.30.17.992 green
N054.23.00.318 E018.30.17.992 N054.23.00.318 E018.30.17.992 green
N054.23.00.318 E018.30.17.992 N054.22.49.712 E018.30.35.472 green
N054.22.49.712 E018.30.35.472 N054.22.47.392 E018.30.32.106 green
N054.22.47.392 E018.30.32.106 N054.22.47.392 E018.30.32.106 green
N054.22.47.392 E018.30.32.106 N054.22.48.554 E018.30.26.857 green
N054.22.48.554 E018.30.26.857 N054.22.51.257 E018.30.14.819 green
N054.22.51.257 E018.30.14.819 N054.22.39.049 E018.30.07.634 green
N054.22.39.049 E018.30.07.634 N054.22.36.575 E018.30.26.314 green
N054.22.36.575 E018.30.26.314 N054.22.36.575 E018.30.26.314 green
N054.22.36.575 E018.30.26.314 N054.22.29.942 E018.30.21.974 green
N054.22.29.942 E018.30.21.974 N054.22.29.942 E018.30.21.974 green
N054.22.29.942 E018.30.21.974 N054.22.27.593 E018.30.23.388 green
N054.22.27.593 E018.30.23.388 N054.22.26.156 E018.30.22.433 green
N054.22.26.156 E018.30.22.433 N054.22.21.916 E018.29.58.412 green

;EPSY
;- PAS 2/20
N053.29.17.170 E020.56.29.845 N053.29.17.780 E020.56.26.943 white
N053.29.17.780 E020.56.26.943 N053.28.16.764 E020.55.52.826 white
N053.28.16.764 E020.55.52.826 N053.28.16.195 E020.55.55.855 white
N053.28.16.195 E020.55.55.855 N053.29.17.139 E020.56.29.966 white
;- TAXIWAYS
N053.29.17.767 E020.56.26.851 N053.29.18.875 E020.56.21.806 blue
N053.29.18.875 E020.56.21.806 N053.29.19.976 E020.56.22.324 blue
N053.29.19.976 E020.56.22.324 N053.29.21.120 E020.56.16.624 blue
N053.29.21.120 E020.56.16.624 N053.29.20.039 E020.56.15.878 blue
N053.29.20.039 E020.56.15.878 N053.29.20.330 E020.56.14.457 blue
N053.29.20.330 E020.56.14.457 N053.29.18.067 E020.56.12.780 blue
N053.29.01.445 E020.56.03.645 N053.28.26.806 E020.55.43.995 blue
N053.28.26.806 E020.55.43.995 N053.28.26.544 E020.55.39.926 blue
N053.28.26.544 E020.55.39.926 N053.28.22.251 E020.55.37.480 blue
N053.28.22.251 E020.55.37.480 N053.28.19.932 E020.55.40.100 blue
N053.28.19.932 E020.55.40.100 N053.28.19.610 E020.55.39.917 blue
N053.28.19.610 E020.55.39.917 N053.28.19.126 E020.55.42.197 blue
N053.28.19.126 E020.55.42.197 N053.28.18.002 E020.55.41.541 blue
N053.28.18.002 E020.55.41.541 N053.28.16.753 E020.55.47.380 blue
N053.28.16.753 E020.55.47.380 N053.28.17.805 E020.55.48.080 blue
N053.28.17.805 E020.55.48.080 N053.28.16.790 E020.55.52.837 blue
N053.28.17.702 E020.55.53.302 N053.28.20.269 E020.55.41.923 blue
N053.28.20.269 E020.55.41.923 N053.28.25.955 E020.55.45.594 blue
N053.28.25.955 E020.55.45.594 N053.28.23.604 E020.55.56.573 blue
N053.28.26.080 E020.55.43.551 N053.28.21.077 E020.55.40.790 blue
N053.28.21.077 E020.55.40.790 N053.28.22.421 E020.55.39.367 blue
N053.28.22.421 E020.55.39.367 N053.28.25.736 E020.55.41.335 blue
N053.28.25.736 E020.55.41.335 N053.28.26.058 E020.55.43.538 blue
N053.28.24.577 E020.55.56.989 N053.28.26.965 E020.55.45.882 blue
N053.28.26.965 E020.55.45.882 N053.29.12.313 E020.56.11.694 blue
N053.29.12.313 E020.56.11.694 N053.29.10.095 E020.56.22.581 blue
N053.29.10.958 E020.56.23.037 N053.29.13.358 E020.56.12.251 blue
N053.29.13.358 E020.56.12.251 N053.29.19.043 E020.56.15.607 blue
N053.29.19.043 E020.56.15.607 N053.29.16.849 E020.56.26.333 blue
;- PLYTA
N053.29.17.964 E020.56.13.040 N053.29.18.388 E020.56.10.282 white
N053.29.18.388 E020.56.10.282 N053.29.02.007 E020.56.00.805 white
N053.29.02.007 E020.56.00.805 N053.29.01.413 E020.56.03.691 white
;- BUILD
N053.29.03.093 E020.56.02.976 N053.29.03.541 E020.56.01.847 build
N053.29.03.541 E020.56.01.847 N053.29.04.293 E020.56.02.241 build
N053.29.04.293 E020.56.02.241 N053.29.03.925 E020.56.03.811 build
N053.29.03.925 E020.56.03.811 N053.29.03.028 E020.56.03.299 build
N053.29.00.604 E020.55.55.263 N053.29.00.794 E020.55.54.759 build
N053.29.00.794 E020.55.54.759 N053.29.00.918 E020.55.55.339 build
N053.29.00.918 E020.55.55.339 N053.29.00.931 E020.55.55.443 build
N053.29.00.931 E020.55.55.443 N053.29.00.607 E020.55.55.248 build
;EPZG
;- PAS 06/24
N052.08.02.208 E015.46.54.750 N052.08.36.787 E015.48.53.524 white
N052.08.36.787 E015.48.53.524 N052.08.35.064 E015.48.54.845 white
N052.08.35.064 E015.48.54.845 N052.08.00.482 E015.46.56.064 white
N052.08.00.482 E015.46.56.064 N052.08.02.202 E015.46.54.741 white
;- TAXIWAY
N052.08.02.191 E015.46.54.743 N052.08.06.929 E015.46.51.219 blue
N052.08.06.929 E015.46.51.219 N052.08.06.634 E015.46.50.197 blue
N052.08.06.634 E015.46.50.197 N052.08.06.475 E015.46.49.242 blue
N052.08.06.475 E015.46.49.242 N052.08.06.518 E015.46.48.249 blue
N052.08.06.518 E015.46.48.249 N052.08.06.840 E015.46.47.578 blue
N052.08.06.840 E015.46.47.578 N052.08.07.545 E015.46.47.135 blue
N052.08.07.545 E015.46.47.135 N052.08.08.054 E015.46.47.414 blue
N052.08.08.054 E015.46.47.414 N052.08.08.508 E015.46.47.962 blue
N052.08.08.508 E015.46.47.962 N052.08.09.059 E015.46.49.538 blue
N052.08.09.059 E015.46.49.538 N052.08.12.606 E015.46.46.924 blue
N052.08.12.606 E015.46.46.924 N052.08.12.664 E015.46.47.124 blue
N052.08.12.664 E015.46.47.124 N052.08.14.932 E015.46.45.359 blue
N052.08.15.332 E015.46.46.820 N052.08.13.045 E015.46.48.558 blue
N052.08.13.045 E015.46.48.558 N052.08.29.529 E015.47.46.140 blue
N052.08.29.529 E015.47.46.140 N052.08.32.622 E015.47.43.922 blue
N052.08.32.622 E015.47.43.922 N052.08.40.676 E015.48.11.812 blue
N052.08.41.697 E015.48.15.225 N052.08.42.318 E015.48.17.503 blue
N052.08.42.318 E015.48.17.503 N052.08.42.135 E015.48.17.663 blue
N052.08.40.755 E015.48.16.863 N052.08.36.880 E015.48.03.544 blue
N052.08.36.880 E015.48.03.544 N052.08.36.438 E015.48.03.115 blue
N052.08.36.438 E015.48.03.115 N052.08.35.072 E015.48.04.058 blue
N052.08.35.072 E015.48.04.058 N052.08.34.925 E015.48.04.890 blue
N052.08.34.925 E015.48.04.890 N052.08.38.103 E015.48.15.991 blue
N052.08.38.103 E015.48.15.991 N052.08.40.694 E015.48.16.784 blue
N052.08.37.096 E015.48.17.268 N052.08.36.387 E015.48.16.833 blue
N052.08.36.387 E015.48.16.833 N052.08.28.385 E015.48.22.936 blue
N052.08.28.385 E015.48.22.936 N052.08.28.193 E015.48.23.988 blue
N052.08.37.085 E015.48.17.235 N052.08.45.123 E015.48.45.276 blue
N052.08.45.123 E015.48.45.276 N052.08.36.704 E015.48.51.337 blue
N052.08.36.704 E015.48.51.337 N052.08.36.113 E015.48.51.079 blue
N052.08.36.827 E015.48.53.507 N052.08.37.760 E015.48.52.823 blue
N052.08.37.760 E015.48.52.823 N052.08.39.551 E015.48.53.815 blue
N052.08.39.551 E015.48.53.815 N052.08.42.921 E015.48.51.511 blue
N052.08.42.921 E015.48.51.511 N052.08.43.298 E015.48.53.095 blue
N052.08.43.298 E015.48.53.095 N052.08.43.750 E015.48.53.756 blue
N052.08.43.750 E015.48.53.756 N052.08.44.601 E015.48.54.131 blue
N052.08.44.601 E015.48.54.131 N052.08.45.104 E015.48.53.974 blue
N052.08.45.104 E015.48.53.974 N052.08.45.474 E015.48.53.425 blue
N052.08.45.474 E015.48.53.425 N052.08.45.750 E015.48.52.234 blue
N052.08.45.750 E015.48.52.234 N052.08.45.593 E015.48.50.922 blue
N052.08.45.593 E015.48.50.922 N052.08.45.271 E015.48.49.788 blue
N052.08.45.271 E015.48.49.788 N052.08.46.529 E015.48.48.832 blue
N052.08.03.112 E015.46.57.855 N052.08.03.629 E015.46.55.982 blue
N052.08.03.629 E015.46.55.982 N052.08.11.610 E015.46.49.919 blue
N052.08.11.610 E015.46.49.919 N052.08.12.172 E015.46.50.292 blue
N052.08.12.172 E015.46.50.292 N052.08.17.533 E015.47.09.250 blue
N052.08.17.533 E015.47.09.250 N052.08.17.363 E015.47.11.204 blue
N052.08.17.363 E015.47.11.204 N052.08.15.308 E015.47.12.780 blue
N052.08.15.308 E015.47.12.780 N052.08.14.563 E015.47.10.262 blue
N052.08.14.563 E015.47.10.262 N052.08.12.630 E015.47.11.782 blue
N052.08.12.630 E015.47.11.782 N052.08.13.373 E015.47.14.351 blue
N052.08.13.373 E015.47.14.351 N052.08.09.525 E015.47.17.357 blue
N052.08.09.525 E015.47.17.357 N052.08.08.613 E015.47.16.668 blue
N052.08.09.759 E015.47.20.699 N052.08.09.957 E015.47.19.312 blue
N052.08.09.957 E015.47.19.312 N052.08.13.955 E015.47.16.201 blue
N052.08.13.955 E015.47.16.201 N052.08.14.084 E015.47.16.668 blue
N052.08.14.084 E015.47.16.668 N052.08.16.094 E015.47.15.286 blue
N052.08.16.094 E015.47.15.286 N052.08.15.893 E015.47.14.630 blue
N052.08.15.893 E015.47.14.630 N052.08.18.046 E015.47.12.974 blue
N052.08.18.046 E015.47.12.974 N052.08.18.923 E015.47.13.776 blue
N052.08.18.923 E015.47.13.776 N052.08.25.123 E015.47.35.644 blue
N052.08.25.123 E015.47.35.644 N052.08.24.916 E015.47.37.569 blue
N052.08.24.916 E015.47.37.569 N052.08.17.676 E015.47.45.384 blue
N052.08.17.676 E015.47.45.384 N052.08.16.829 E015.47.44.923 blue
N052.08.17.865 E015.47.48.521 N052.08.18.042 E015.47.47.496 blue
N052.08.18.042 E015.47.47.496 N052.08.25.516 E015.47.39.439 blue
N052.08.25.516 E015.47.39.439 N052.08.26.407 E015.47.39.948 blue
N052.08.26.407 E015.47.39.948 N052.08.35.995 E015.48.13.497 blue
N052.08.35.995 E015.48.13.497 N052.08.35.654 E015.48.15.103 blue
N052.08.35.654 E015.48.15.103 N052.08.27.879 E015.48.21.052 blue
N052.08.27.879 E015.48.21.052 N052.08.27.221 E015.48.20.595 blue
N052.08.32.012 E015.47.46.601 N052.08.34.857 E015.47.56.448 blue
N052.08.34.857 E015.47.56.448 N052.08.34.816 E015.47.57.145 blue
N052.08.34.816 E015.47.57.145 N052.08.33.286 E015.47.58.203 blue
N052.08.33.286 E015.47.58.203 N052.08.32.936 E015.47.57.888 blue
N052.08.32.936 E015.47.57.888 N052.08.30.073 E015.47.48.032 blue
N052.08.30.073 E015.47.48.032 N052.08.31.981 E015.47.46.644 blue
;- APRON
N052.08.46.529 E015.48.48.832 N052.08.48.800 E015.48.49.453 white
N052.08.48.800 E015.48.49.453 N052.08.50.735 E015.48.47.970 white
N052.08.50.735 E015.48.47.970 N052.08.42.182 E015.48.17.692 white
N052.08.41.689 E015.48.15.249 N052.08.43.347 E015.48.13.935 white
N052.08.43.347 E015.48.13.935 N052.08.42.321 E015.48.10.577 white
N052.08.42.321 E015.48.10.577 N052.08.40.717 E015.48.11.856 white
N052.08.15.332 E015.46.46.831 N052.08.15.893 E015.46.48.492 white
N052.08.15.893 E015.46.48.492 N052.08.17.061 E015.46.47.595 white
N052.08.17.061 E015.46.47.595 N052.08.15.969 E015.46.43.768 white
N052.08.15.969 E015.46.43.768 N052.08.16.967 E015.46.43.041 white
N052.08.16.967 E015.46.43.041 N052.08.16.580 E015.46.41.741 white
N052.08.16.580 E015.46.41.741 N052.08.18.524 E015.46.40.325 white
N052.08.18.524 E015.46.40.325 N052.08.18.095 E015.46.39.241 white
N052.08.18.095 E015.46.39.241 N052.08.17.762 E015.46.39.472 white
N052.08.17.762 E015.46.39.472 N052.08.17.378 E015.46.38.274 white
N052.08.17.378 E015.46.38.274 N052.08.16.099 E015.46.39.196 white
N052.08.16.099 E015.46.39.196 N052.08.15.786 E015.46.38.158 white
N052.08.15.786 E015.46.38.158 N052.08.13.985 E015.46.39.583 white
N052.08.13.985 E015.46.39.583 N052.08.15.293 E015.46.44.304 white
N052.08.15.293 E015.46.44.304 N052.08.14.743 E015.46.44.750 white
N052.08.14.743 E015.46.44.750 N052.08.14.939 E015.46.45.408 white
;- PALIWO
N052.08.41.366 E015.48.12.491 N052.08.42.273 E015.48.11.773 yellow
N052.08.42.273 E015.48.11.773 N052.08.42.673 E015.48.13.250 yellow
N052.08.42.673 E015.48.13.250 N052.08.41.793 E015.48.13.944 yellow
N052.08.41.793 E015.48.13.944 N052.08.41.366 E015.48.12.491 yellow
;- BUILD
N052.08.46.942 E015.48.00.879 N052.08.47.263 E015.48.00.645 build
N052.08.47.263 E015.48.00.645 N052.08.47.078 E015.48.00.120 build
N052.08.47.078 E015.48.00.120 N052.08.46.758 E015.48.00.382 build
N052.08.46.758 E015.48.00.382 N052.08.46.942 E015.48.00.870 build
N052.08.34.770 E015.47.52.464 N052.08.35.935 E015.47.51.569 build
N052.08.35.935 E015.47.51.569 N052.08.35.149 E015.47.48.716 build
N052.08.35.149 E015.47.48.716 N052.08.33.965 E015.47.49.609 build
N052.08.33.965 E015.47.49.609 N052.08.34.772 E015.47.52.448 build
N052.08.33.570 E015.47.48.221 N052.08.34.739 E015.47.47.336 build
N052.08.34.739 E015.47.47.336 N052.08.33.950 E015.47.44.461 build
N052.08.33.950 E015.47.44.461 N052.08.32.786 E015.47.45.368 build
N052.08.32.786 E015.47.45.368 N052.08.33.573 E015.47.48.201 build
N052.08.14.619 E015.46.41.348 N052.08.16.084 E015.46.40.241 build
N052.08.16.084 E015.46.40.241 N052.08.15.842 E015.46.39.305 build
N052.08.15.842 E015.46.39.305 N052.08.14.953 E015.46.39.936 build
N052.08.14.953 E015.46.39.936 N052.08.14.689 E015.46.39.022 build
N052.08.14.689 E015.46.39.022 N052.08.14.113 E015.46.39.483 build
N052.08.14.113 E015.46.39.483 N052.08.14.626 E015.46.41.321 build
N052.08.16.028 E015.46.38.833 N052.08.16.347 E015.46.38.563 build
N052.08.16.347 E015.46.38.563 N052.08.16.185 E015.46.37.969 build
N052.08.16.185 E015.46.37.969 N052.08.15.865 E015.46.38.249 build
N052.08.15.865 E015.46.38.249 N052.08.16.030 E015.46.38.806 build
N052.08.16.249 E015.46.39.511 N052.08.16.834 E015.46.39.052 build
N052.08.16.834 E015.46.39.052 N052.08.17.002 E015.46.39.546 build
N052.08.17.002 E015.46.39.546 N052.08.16.416 E015.46.39.977 build
N052.08.16.416 E015.46.39.977 N052.08.16.249 E015.46.39.493 build
N052.08.17.141 E015.46.38.890 N052.08.17.433 E015.46.38.668 build
N052.08.17.433 E015.46.38.668 N052.08.17.536 E015.46.39.151 build
N052.08.17.536 E015.46.39.151 N052.08.17.244 E015.46.39.364 build
N052.08.17.244 E015.46.39.364 N052.08.17.141 E015.46.38.881 build
N052.08.16.443 E015.46.41.469 N052.08.17.027 E015.46.41.032 build
N052.08.17.027 E015.46.41.032 N052.08.17.195 E015.46.41.500 build
N052.08.17.195 E015.46.41.500 N052.08.16.611 E015.46.41.974 build
N052.08.16.611 E015.46.41.974 N052.08.16.443 E015.46.41.477 build
;EPSC
;- PAS 13/31
;- RWY
N053.34.37.620 E014.54.58.575 N053.34.39.086 E014.55.00.700 olive
N053.34.39.086 E014.55.00.700 N053.35.32.294 E014.53.17.414 olive
N053.35.32.294 E014.53.17.414 N053.35.30.829 E014.53.15.349 olive
N053.35.30.829 E014.53.15.349 N053.34.37.621 E014.54.58.542 olive
;- TWY
N053.34.43.616 E014.54.51.899 N053.34.44.401 E014.54.51.455 teal
N053.34.44.401 E014.54.51.455 N053.34.45.228 E014.54.51.656 teal
N053.34.45.228 E014.54.51.656 N053.34.45.519 E014.54.51.819 teal
N053.34.45.519 E014.54.51.819 N053.34.46.616 E014.54.53.352 teal
N053.34.46.616 E014.54.53.352 N053.34.46.595 E014.54.54.313 teal
N053.34.46.595 E014.54.54.313 N053.34.45.999 E014.54.55.526 teal
N053.34.45.999 E014.54.55.526 N053.34.50.412 E014.55.02.049 teal
N053.34.50.412 E014.55.02.049 N053.34.51.030 E014.55.00.837 teal
N053.34.51.030 E014.55.00.837 N053.34.51.496 E014.55.00.902 teal
N053.34.51.496 E014.55.00.902 N053.34.52.403 E014.55.00.579 teal
N053.34.52.403 E014.55.00.579 N053.34.53.636 E014.54.58.251 teal
N053.34.53.636 E014.54.58.251 N053.34.55.735 E014.54.58.011 teal
N053.34.55.735 E014.54.58.011 N053.34.59.497 E014.54.50.772 teal
N053.34.59.497 E014.54.50.772 N053.34.59.356 E014.54.47.405 teal
N053.34.59.356 E014.54.47.405 N053.34.59.830 E014.54.46.574 teal
N053.34.59.830 E014.54.46.574 N053.34.59.822 E014.54.46.141 teal
N053.34.59.822 E014.54.46.141 N053.35.14.355 E014.54.17.902 teal
N053.35.14.355 E014.54.17.902 N053.35.14.781 E014.54.17.584 teal
N053.35.14.781 E014.54.17.584 N053.35.15.042 E014.54.17.733 teal
N053.35.15.042 E014.54.17.733 N053.35.16.170 E014.54.19.364 teal
N053.35.16.170 E014.54.19.364 N053.35.15.526 E014.54.20.851 teal
N053.35.15.526 E014.54.20.851 N053.35.16.306 E014.54.21.980 teal
N053.35.16.306 E014.54.21.980 N053.35.17.214 E014.54.20.177 teal
N053.35.17.214 E014.54.20.177 N053.35.15.075 E014.54.17.093 teal
N053.35.15.075 E014.54.17.093 N053.35.15.062 E014.54.16.498 teal
N053.35.15.062 E014.54.16.498 N053.35.21.304 E014.54.04.439 teal
N053.35.21.304 E014.54.04.439 N053.35.22.069 E014.54.04.594 teal
N053.35.22.069 E014.54.04.594 N053.35.22.756 E014.54.05.529 teal
N053.35.22.756 E014.54.05.529 N053.35.34.528 E014.53.42.655 teal
N053.35.34.528 E014.53.42.655 N053.35.34.274 E014.53.39.997 teal
N053.35.34.274 E014.53.39.997 N053.35.35.934 E014.53.36.754 teal
N053.35.35.934 E014.53.36.754 N053.35.30.670 E014.53.29.015 teal
N053.35.30.670 E014.53.29.015 N053.35.29.940 E014.53.30.059 teal
N053.35.29.940 E014.53.30.059 N053.35.29.613 E014.53.30.226 teal
N053.35.29.613 E014.53.30.226 N053.35.29.026 E014.53.29.974 teal
N053.35.29.026 E014.53.29.974 N053.35.27.890 E014.53.28.308 teal
N053.35.27.890 E014.53.28.308 N053.35.27.770 E014.53.27.177 teal
N053.35.27.770 E014.53.27.177 N053.35.27.947 E014.53.25.922 teal
N053.35.25.935 E014.53.29.858 N053.35.26.594 E014.53.29.632 teal
N053.35.26.594 E014.53.29.632 N053.35.27.023 E014.53.29.849 teal
N053.35.27.023 E014.53.29.849 N053.35.33.060 E014.53.38.589 teal
N053.35.33.060 E014.53.38.589 N053.35.33.192 E014.53.39.020 teal
N053.35.33.192 E014.53.39.020 N053.35.33.205 E014.53.39.454 teal
N053.35.33.205 E014.53.39.454 N053.35.33.177 E014.53.39.949 teal
N053.35.33.177 E014.53.39.949 N053.35.33.078 E014.53.40.370 teal
N053.35.33.078 E014.53.40.370 N053.35.20.934 E014.54.03.939 teal
N053.35.20.934 E014.54.03.939 N053.35.20.426 E014.54.04.255 teal
N053.35.20.426 E014.54.04.255 N053.35.19.828 E014.54.03.885 teal
N053.35.19.828 E014.54.03.885 N053.35.13.883 E014.53.55.175 teal
N053.35.13.883 E014.53.55.175 N053.35.13.684 E014.53.54.339 teal
N053.35.13.684 E014.53.54.339 N053.35.13.869 E014.53.53.239 teal
N053.35.12.463 E014.53.56.018 N053.35.12.958 E014.53.55.582 teal
N053.35.12.958 E014.53.55.582 N053.35.13.642 E014.53.55.854 teal
N053.35.13.642 E014.53.55.854 N053.35.19.569 E014.54.04.483 teal
N053.35.19.569 E014.54.04.483 N053.35.19.804 E014.54.05.357 teal
N053.35.19.804 E014.54.05.357 N053.35.19.622 E014.54.06.477 teal
N053.35.19.622 E014.54.06.477 N053.35.06.069 E014.54.32.745 teal
N053.35.06.069 E014.54.32.745 N053.35.05.656 E014.54.33.034 teal
N053.35.05.656 E014.54.33.034 N053.35.05.192 E014.54.32.960 teal
N053.35.05.192 E014.54.32.960 N053.35.04.730 E014.54.32.472 teal
N053.35.04.730 E014.54.32.472 N053.34.59.017 E014.54.24.054 teal
N053.34.59.017 E014.54.24.054 N053.34.58.805 E014.54.23.225 teal
N053.34.58.805 E014.54.23.225 N053.34.59.038 E014.54.21.972 teal
N053.34.57.567 E014.54.24.914 N053.34.58.120 E014.54.24.346 teal
N053.34.58.120 E014.54.24.346 N053.34.58.801 E014.54.24.696 teal
N053.34.58.801 E014.54.24.696 N053.35.04.745 E014.54.33.316 teal
N053.35.04.745 E014.54.33.316 N053.35.04.979 E014.54.34.175 teal
N053.35.04.979 E014.54.34.175 N053.35.04.918 E014.54.35.073 teal
N053.35.04.918 E014.54.35.073 N053.34.52.385 E014.54.59.210 teal
N053.34.52.385 E014.54.59.210 N053.34.52.176 E014.54.59.465 teal
N053.34.52.176 E014.54.59.465 N053.34.51.799 E014.54.59.537 teal
N053.34.51.799 E014.54.59.537 N053.34.51.221 E014.54.59.082 teal
N053.34.51.221 E014.54.59.082 N053.34.45.394 E014.54.50.605 teal
N053.34.45.394 E014.54.50.605 N053.34.45.169 E014.54.49.748 teal
N053.34.45.169 E014.54.49.748 N053.34.45.201 E014.54.48.833 teal
;- LNS
N053.34.44.617 E014.54.49.962 N053.34.51.466 E014.54.59.905 olive
N053.34.51.466 E014.54.59.905 N053.34.51.994 E014.55.00.136 olive
N053.34.51.994 E014.55.00.136 N053.34.52.350 E014.54.59.936 olive
N053.34.52.350 E014.54.59.936 N053.34.52.595 E014.54.59.592 olive
N053.34.52.595 E014.54.59.592 N053.35.05.242 E014.54.35.042 olive
N053.35.05.242 E014.54.35.042 N053.35.06.368 E014.54.32.852 olive
N053.35.06.368 E014.54.32.852 N053.35.14.517 E014.54.16.982 olive
N053.35.14.517 E014.54.16.982 N053.35.15.057 E014.54.15.969 olive
N053.35.15.057 E014.54.15.969 N053.35.20.386 E014.54.05.579 olive
N053.35.20.386 E014.54.05.579 N053.35.20.888 E014.54.04.659 olive
N053.35.20.888 E014.54.04.659 N053.35.32.465 E014.53.42.133 olive
N053.35.32.465 E014.53.42.133 N053.35.32.732 E014.53.41.898 olive
N053.35.32.732 E014.53.41.898 N053.35.32.943 E014.53.41.885 olive
N053.35.32.943 E014.53.41.885 N053.35.33.253 E014.53.42.155 olive
N053.35.33.253 E014.53.42.155 N053.35.33.409 E014.53.42.671 olive
N053.35.33.409 E014.53.42.671 N053.35.33.458 E014.53.43.261 olive
N053.35.33.458 E014.53.43.261 N053.35.33.325 E014.53.43.734 olive
N053.35.33.325 E014.53.43.734 N053.35.32.353 E014.53.45.583 olive
N053.35.13.203 E014.53.54.629 N053.35.20.535 E014.54.05.352 olive
N053.35.14.649 E014.54.16.889 N053.35.16.504 E014.54.19.504 olive
N053.35.16.504 E014.54.19.504 N053.35.16.619 E014.54.20.033 olive
N053.34.58.295 E014.54.23.446 N053.35.05.647 E014.54.34.190 olive
N053.35.26.818 E014.53.28.226 N053.35.29.003 E014.53.31.436 olive
N053.35.29.003 E014.53.31.436 N053.35.30.410 E014.53.33.388 olive
N053.35.30.410 E014.53.33.388 N053.35.31.786 E014.53.35.418 olive
N053.35.31.786 E014.53.35.418 N053.35.33.177 E014.53.37.340 olive
N053.35.33.177 E014.53.37.340 N053.35.34.410 E014.53.35.314 olive
N053.35.34.410 E014.53.35.314 N053.35.33.297 E014.53.35.233 olive
N053.35.31.904 E014.53.35.334 N053.35.33.062 E014.53.33.427 olive
N053.35.33.062 E014.53.33.427 N053.35.31.948 E014.53.33.312 olive
N053.35.30.568 E014.53.33.491 N053.35.31.766 E014.53.31.501 olive
N053.35.31.766 E014.53.31.501 N053.35.30.644 E014.53.31.412 olive
;- BLD
N053.35.37.539 E014.53.37.377 N053.35.37.283 E014.53.37.817 maroon
N053.35.37.283 E014.53.37.817 N053.35.37.721 E014.53.38.865 maroon
N053.35.37.721 E014.53.38.865 N053.35.36.227 E014.53.41.875 maroon
N053.35.36.227 E014.53.41.875 N053.35.36.686 E014.53.42.499 maroon
N053.35.36.686 E014.53.42.499 N053.35.35.744 E014.53.44.222 maroon
N053.35.35.744 E014.53.44.222 N053.35.34.817 E014.53.42.862 maroon
N053.35.34.817 E014.53.42.862 N053.35.34.521 E014.53.41.613 maroon
N053.35.34.521 E014.53.41.613 N053.35.34.498 E014.53.40.294 maroon
N053.35.34.498 E014.53.40.294 N053.35.34.730 E014.53.39.590 maroon
N053.35.34.730 E014.53.39.590 N053.35.36.589 E014.53.36.006 maroon
N053.35.36.589 E014.53.36.006 N053.35.37.541 E014.53.37.373 maroon
N053.35.16.589 E014.54.21.506 N053.35.17.194 E014.54.22.329 maroon
N053.35.17.194 E014.54.22.329 N053.35.17.719 E014.54.21.211 maroon
N053.35.17.719 E014.54.21.211 N053.35.17.181 E014.54.20.416 maroon
N053.35.17.181 E014.54.20.416 N053.35.16.590 E014.54.21.529 maroon


;EPPO
;- RWY
N052.25.28.778 E016.48.18.914 N052.25.06.228 E016.50.27.458 olive
N052.25.06.228 E016.50.27.458 N052.25.04.484 E016.50.26.649 olive
N052.25.04.484 E016.50.26.649 N052.25.27.020 E016.48.18.126 olive
N052.25.27.020 E016.48.18.126 N052.25.28.803 E016.48.18.913 olive
;- TWY
N052.25.06.479 E016.50.26.258 N052.25.08.057 E016.50.27.159 teal
N052.25.08.057 E016.50.27.159 N052.25.10.192 E016.50.28.030 teal
N052.25.10.192 E016.50.28.030 N052.25.11.681 E016.50.28.237 teal
N052.25.11.681 E016.50.28.237 N052.25.14.871 E016.50.28.547 teal
N052.25.14.871 E016.50.28.547 N052.25.20.236 E016.50.28.710 teal
N052.25.20.236 E016.50.28.710 N052.25.27.817 E016.50.29.009 teal
N052.25.27.817 E016.50.29.009 N052.25.28.272 E016.50.28.510 teal
N052.25.28.272 E016.50.28.510 N052.25.28.746 E016.50.26.036 teal
N052.25.28.746 E016.50.26.036 N052.25.28.874 E016.50.25.758 teal
N052.25.28.874 E016.50.25.758 N052.25.29.113 E016.50.25.463 teal
N052.25.29.113 E016.50.25.463 N052.25.29.388 E016.50.25.133 teal
N052.25.29.388 E016.50.25.133 N052.25.29.677 E016.50.24.889 teal
N052.25.29.677 E016.50.24.889 N052.25.29.978 E016.50.24.764 teal
N052.25.29.978 E016.50.24.764 N052.25.30.358 E016.50.24.884 teal
N052.25.30.358 E016.50.24.884 N052.25.30.939 E016.50.25.169 teal
N052.25.30.939 E016.50.25.169 N052.25.33.707 E016.50.27.213 teal
N052.25.33.707 E016.50.27.213 N052.25.30.506 E016.50.38.654 teal
N052.25.30.506 E016.50.38.654 N052.25.26.540 E016.50.36.314 teal
N052.25.26.540 E016.50.36.314 N052.25.27.763 E016.50.30.554 teal
N052.25.27.763 E016.50.30.554 N052.25.27.563 E016.50.30.022 teal
N052.25.27.563 E016.50.30.022 N052.25.23.025 E016.50.29.663 teal
N052.25.23.025 E016.50.29.663 N052.25.22.698 E016.50.31.489 teal
N052.25.22.698 E016.50.31.489 N052.25.23.000 E016.50.32.798 teal
N052.25.23.000 E016.50.32.798 N052.25.22.948 E016.50.33.473 teal
N052.25.22.948 E016.50.33.473 N052.25.22.340 E016.50.36.238 teal
N052.25.22.340 E016.50.36.238 N052.25.18.660 E016.50.34.249 teal
N052.25.18.660 E016.50.34.249 N052.25.19.085 E016.50.32.350 teal
N052.25.19.085 E016.50.32.350 N052.25.19.289 E016.50.31.205 teal
N052.25.19.289 E016.50.31.205 N052.25.19.781 E016.50.30.400 teal
N052.25.19.781 E016.50.30.400 N052.25.19.710 E016.50.29.988 teal
N052.25.19.710 E016.50.29.988 N052.25.18.631 E016.50.29.337 teal
N052.25.18.631 E016.50.29.337 N052.25.11.014 E016.50.28.907 teal
N052.25.11.014 E016.50.28.907 N052.25.10.631 E016.50.28.857 teal
N052.25.10.631 E016.50.28.857 N052.25.10.081 E016.50.28.703 teal
N052.25.10.081 E016.50.28.703 N052.25.08.076 E016.50.27.871 teal
N052.25.08.076 E016.50.27.871 N052.25.06.412 E016.50.27.177 teal
N052.25.06.412 E016.50.27.177 N052.25.06.297 E016.50.27.169 teal
N052.25.04.531 E016.50.26.573 N052.25.03.024 E016.50.25.765 teal
N052.25.03.024 E016.50.25.765 N052.24.59.458 E016.50.23.788 teal
N052.24.59.458 E016.50.23.788 N052.24.56.062 E016.50.21.929 teal
N052.24.56.062 E016.50.21.929 N052.24.54.064 E016.50.20.737 teal
N052.24.54.064 E016.50.20.737 N052.24.52.102 E016.50.20.725 teal
N052.24.52.102 E016.50.20.725 N052.24.52.094 E016.50.17.490 teal
N052.24.52.094 E016.50.17.490 N052.24.52.937 E016.50.17.477 teal
N052.24.52.937 E016.50.17.477 N052.24.53.044 E016.50.09.280 teal
N052.24.53.044 E016.50.09.280 N052.24.53.265 E016.50.03.162 teal
N052.24.53.265 E016.50.03.162 N052.24.54.185 E016.49.57.829 teal
N052.24.54.185 E016.49.57.829 N052.24.54.374 E016.49.56.520 teal
N052.24.54.374 E016.49.56.520 N052.24.54.590 E016.49.49.267 teal
N052.24.54.590 E016.49.49.267 N052.24.54.701 E016.49.44.377 teal
N052.24.54.701 E016.49.44.377 N052.24.54.788 E016.49.40.797 teal
N052.24.54.788 E016.49.40.797 N052.24.54.887 E016.49.38.107 teal
N052.24.54.887 E016.49.38.107 N052.24.55.899 E016.49.38.395 teal
N052.24.55.899 E016.49.38.395 N052.24.59.975 E016.49.39.681 teal
N052.24.59.975 E016.49.39.681 N052.25.10.871 E016.49.44.762 teal
N052.25.10.871 E016.49.44.762 N052.25.11.493 E016.49.44.656 teal
N052.25.11.493 E016.49.44.656 N052.25.11.801 E016.49.44.331 teal
N052.25.11.801 E016.49.44.331 N052.25.11.904 E016.49.44.144 teal
N052.25.11.134 E016.49.48.558 N052.25.11.070 E016.49.47.952 teal
N052.25.11.070 E016.49.47.952 N052.25.10.787 E016.49.47.208 teal
N052.25.10.787 E016.49.47.208 N052.25.10.291 E016.49.46.869 teal
N052.25.10.291 E016.49.46.869 N052.25.00.692 E016.49.42.387 teal
N052.25.00.692 E016.49.42.387 N052.25.00.185 E016.49.42.550 teal
N052.25.00.185 E016.49.42.550 N052.24.59.770 E016.49.42.851 teal
N052.24.59.770 E016.49.42.851 N052.24.59.560 E016.49.43.414 teal
N052.24.59.560 E016.49.43.414 N052.24.58.338 E016.49.53.257 teal
N052.24.58.338 E016.49.53.257 N052.24.56.799 E016.50.06.078 teal
N052.24.56.799 E016.50.06.078 N052.24.56.629 E016.50.18.223 teal
N052.24.56.629 E016.50.18.223 N052.24.58.819 E016.50.21.730 teal
N052.24.58.819 E016.50.21.730 N052.25.03.456 E016.50.24.395 teal
N052.25.03.456 E016.50.24.395 N052.25.04.235 E016.50.24.253 teal
N052.25.04.235 E016.50.24.253 N052.25.04.545 E016.50.24.132 teal
N052.25.04.545 E016.50.24.132 N052.25.05.000 E016.50.23.539 teal
N052.25.26.437 E016.48.21.165 N052.25.26.398 E016.48.20.632 teal
N052.25.26.398 E016.48.20.632 N052.25.26.246 E016.48.19.983 teal
N052.25.26.246 E016.48.19.983 N052.25.26.105 E016.48.19.585 teal
N052.25.26.105 E016.48.19.585 N052.25.25.748 E016.48.19.221 teal
N052.25.25.748 E016.48.19.221 N052.25.25.403 E016.48.18.773 teal
N052.25.25.403 E016.48.18.773 N052.25.25.614 E016.48.17.385 teal
N052.25.25.614 E016.48.17.385 N052.25.27.001 E016.48.18.071 teal
N052.25.23.795 E016.48.36.253 N052.25.22.692 E016.48.35.728 teal
N052.25.22.692 E016.48.35.728 N052.25.22.568 E016.48.36.958 teal
N052.25.22.568 E016.48.36.958 N052.25.22.786 E016.48.37.219 teal
N052.25.22.786 E016.48.37.219 N052.25.23.159 E016.48.37.812 teal
N052.25.23.159 E016.48.37.812 N052.25.23.256 E016.48.38.181 teal
N052.25.23.256 E016.48.38.181 N052.25.23.304 E016.48.39.056 teal
N052.25.14.994 E016.49.26.661 N052.25.14.890 E016.49.25.446 teal
N052.25.14.890 E016.49.25.446 N052.25.14.800 E016.49.25.058 teal
N052.25.14.800 E016.49.25.058 N052.25.14.800 E016.49.25.058 teal
N052.25.14.800 E016.49.25.058 N052.25.14.265 E016.49.24.163 teal
N052.25.14.265 E016.49.24.163 N052.25.13.987 E016.49.23.820 teal
N052.25.13.987 E016.49.23.820 N052.25.14.222 E016.49.22.856 teal
N052.25.14.222 E016.49.22.856 N052.25.14.533 E016.49.22.815 teal
N052.25.14.533 E016.49.22.815 N052.25.14.880 E016.49.22.835 teal
N052.25.14.880 E016.49.22.835 N052.25.15.346 E016.49.22.569 teal
N052.25.15.346 E016.49.22.569 N052.25.15.830 E016.49.21.701 teal
;- LNS
N052.25.04.687 E016.50.25.514 N052.25.04.278 E016.50.25.442 olive
N052.25.04.278 E016.50.25.442 N052.25.03.493 E016.50.25.185 olive
N052.25.03.493 E016.50.25.185 N052.25.01.136 E016.50.23.973 olive
N052.25.01.136 E016.50.23.973 N052.24.58.635 E016.50.22.550 olive
N052.24.58.635 E016.50.22.550 N052.24.57.860 E016.50.21.985 olive
N052.24.57.860 E016.50.21.985 N052.24.57.226 E016.50.21.220 olive
N052.24.57.226 E016.50.21.220 N052.24.56.797 E016.50.20.190 olive
N052.24.56.797 E016.50.20.190 N052.24.56.314 E016.50.19.152 olive
N052.24.56.314 E016.50.19.152 N052.24.56.010 E016.50.18.233 olive
N052.24.56.010 E016.50.18.233 N052.24.55.889 E016.50.17.415 olive
N052.24.55.889 E016.50.17.415 N052.24.55.893 E016.50.15.679 olive
N052.24.55.893 E016.50.15.679 N052.24.55.928 E016.50.14.043 olive
N052.24.55.928 E016.50.14.043 N052.24.55.965 E016.50.11.547 olive
N052.24.55.965 E016.50.11.547 N052.24.55.994 E016.50.09.426 olive
N052.24.55.994 E016.50.09.426 N052.24.56.036 E016.50.06.050 olive
N052.24.56.036 E016.50.06.050 N052.24.56.035 E016.50.05.269 olive
N052.24.56.035 E016.50.05.269 N052.24.56.217 E016.50.04.205 olive
N052.24.56.217 E016.50.04.205 N052.24.56.744 E016.49.59.704 olive
N052.24.56.744 E016.49.59.704 N052.24.57.491 E016.49.53.713 olive
N052.24.57.491 E016.49.53.713 N052.24.58.510 E016.49.45.752 olive
N052.24.58.510 E016.49.45.752 N052.24.58.774 E016.49.43.725 olive
N052.24.58.774 E016.49.43.725 N052.24.58.895 E016.49.42.691 olive
N052.24.58.895 E016.49.42.691 N052.24.59.264 E016.49.41.745 olive
N052.24.59.264 E016.49.41.745 N052.24.59.553 E016.49.41.455 olive
N052.24.59.553 E016.49.41.455 N052.24.59.934 E016.49.41.170 olive
N052.24.59.934 E016.49.41.170 N052.25.00.116 E016.49.41.094 olive
N052.25.00.116 E016.49.41.094 N052.25.00.409 E016.49.41.070 olive
N052.25.11.513 E016.49.46.230 N052.25.01.661 E016.49.41.617 olive
N052.25.01.661 E016.49.41.617 N052.25.00.749 E016.49.41.190 olive
N052.25.00.749 E016.49.41.190 N052.24.58.906 E016.49.40.592 olive
N052.24.58.906 E016.49.40.592 N052.24.58.188 E016.49.40.332 olive
N052.24.58.188 E016.49.40.332 N052.24.55.625 E016.49.39.533 olive
N052.24.58.570 E016.49.40.467 N052.24.58.816 E016.49.40.621 olive
N052.24.58.816 E016.49.40.621 N052.24.58.961 E016.49.40.812 olive
N052.24.58.961 E016.49.40.812 N052.24.58.980 E016.49.41.086 olive
N052.24.58.980 E016.49.41.086 N052.24.59.029 E016.49.41.397 olive
N052.24.59.029 E016.49.41.397 N052.24.58.943 E016.49.41.931 olive
N052.24.58.943 E016.49.41.931 N052.24.58.853 E016.49.42.717 olive
N052.24.58.654 E016.49.44.421 N052.24.55.645 E016.49.43.571 olive
N052.24.58.604 E016.49.44.959 N052.24.55.860 E016.49.47.045 olive
N052.24.55.423 E016.49.46.302 N052.24.58.351 E016.49.47.127 olive
N052.24.58.005 E016.49.49.638 N052.24.55.267 E016.49.48.854 olive
N052.24.54.944 E016.49.51.320 N052.24.57.681 E016.49.52.112 olive
N052.24.57.387 E016.49.54.628 N052.24.54.769 E016.49.53.828 olive
N052.24.54.668 E016.49.56.257 N052.24.57.115 E016.49.57.006 olive
N052.24.56.840 E016.49.59.097 N052.24.54.464 E016.49.58.357 olive
N052.24.54.201 E016.50.00.817 N052.24.56.515 E016.50.01.555 olive
N052.24.56.272 E016.50.03.827 N052.24.53.759 E016.50.03.029 olive
N052.24.54.132 E016.50.05.863 N052.24.56.037 E016.50.06.452 olive
N052.24.55.999 E016.50.08.623 N052.24.53.844 E016.50.08.452 olive
N052.24.53.588 E016.50.10.738 N052.24.55.983 E016.50.10.899 olive
N052.24.55.924 E016.50.13.125 N052.24.53.477 E016.50.12.998 olive
N052.24.53.456 E016.50.15.269 N052.24.55.907 E016.50.15.391 olive
N052.24.55.839 E016.50.17.620 N052.24.53.416 E016.50.17.470 olive
N052.24.56.573 E016.50.19.820 N052.24.52.996 E016.50.19.771 olive
N052.24.55.642 E016.50.19.856 N052.24.55.763 E016.50.19.707 olive
N052.24.55.763 E016.50.19.707 N052.24.55.825 E016.50.19.555 olive
N052.24.55.825 E016.50.19.555 N052.24.55.853 E016.50.19.470 olive
N052.24.55.853 E016.50.19.470 N052.24.55.871 E016.50.17.360 olive
;- LNS2
N052.24.54.595 E016.50.17.534 N052.24.54.498 E016.50.17.443 olive
N052.24.54.498 E016.50.17.443 N052.24.54.343 E016.50.17.261 olive
N052.24.54.343 E016.50.17.261 N052.24.54.312 E016.50.16.916 olive
N052.24.54.312 E016.50.16.916 N052.24.54.253 E016.50.16.756 olive
N052.24.54.253 E016.50.16.756 N052.24.54.305 E016.50.15.794 olive
N052.24.54.305 E016.50.15.794 N052.24.54.365 E016.50.15.600 olive
N052.24.54.365 E016.50.15.600 N052.24.54.490 E016.50.15.372 olive
N052.24.54.490 E016.50.15.372 N052.24.54.531 E016.50.15.365 olive
N052.24.54.531 E016.50.15.365 N052.24.54.574 E016.50.15.279 olive
N052.24.54.574 E016.50.15.279 N052.24.54.528 E016.50.15.192 olive
N052.24.54.528 E016.50.15.192 N052.24.54.398 E016.50.14.946 olive
N052.24.54.398 E016.50.14.946 N052.24.54.317 E016.50.14.838 olive
N052.24.54.317 E016.50.14.838 N052.24.54.332 E016.50.14.621 olive
N052.24.54.332 E016.50.14.621 N052.24.54.366 E016.50.13.451 olive
N052.24.54.366 E016.50.13.451 N052.24.54.384 E016.50.13.288 olive
N052.24.54.384 E016.50.13.288 N052.24.54.485 E016.50.13.187 olive
N052.24.54.485 E016.50.13.187 N052.24.54.588 E016.50.13.129 olive
N052.24.54.588 E016.50.13.129 N052.24.54.684 E016.50.13.050 olive
N052.24.54.684 E016.50.13.050 N052.24.54.521 E016.50.12.859 olive
N052.24.54.521 E016.50.12.859 N052.24.54.448 E016.50.12.783 olive
N052.24.54.448 E016.50.12.783 N052.24.54.339 E016.50.12.530 olive
N052.24.54.339 E016.50.12.530 N052.24.54.340 E016.50.12.479 olive
N052.24.54.340 E016.50.12.479 N052.24.54.396 E016.50.11.363 olive
N052.24.54.396 E016.50.11.363 N052.24.54.452 E016.50.11.162 olive
N052.24.54.452 E016.50.11.162 N052.24.54.545 E016.50.10.926 olive
N052.24.54.545 E016.50.10.926 N052.24.54.545 E016.50.10.926 olive
N052.24.54.545 E016.50.10.926 N052.24.54.651 E016.50.10.863 olive
N052.24.54.651 E016.50.10.863 N052.24.54.677 E016.50.10.820 olive
N052.24.53.739 E016.50.17.501 N052.24.53.543 E016.50.17.294 olive
N052.24.53.543 E016.50.17.294 N052.24.53.470 E016.50.17.129 olive
N052.24.53.470 E016.50.17.129 N052.24.53.457 E016.50.16.837 olive
N052.24.53.457 E016.50.16.837 N052.24.53.444 E016.50.15.877 olive
N052.24.53.444 E016.50.15.877 N052.24.53.504 E016.50.15.648 olive
N052.24.53.504 E016.50.15.648 N052.24.53.609 E016.50.15.459 olive
N052.24.53.609 E016.50.15.459 N052.24.53.809 E016.50.15.256 olive
N052.24.53.809 E016.50.15.256 N052.24.53.813 E016.50.15.261 olive
N052.24.53.813 E016.50.15.261 N052.24.53.599 E016.50.15.081 olive
N052.24.53.599 E016.50.15.081 N052.24.53.500 E016.50.14.790 olive
N052.24.53.500 E016.50.14.790 N052.24.53.501 E016.50.14.736 olive
N052.24.53.501 E016.50.14.736 N052.24.53.474 E016.50.14.545 olive
N052.24.53.474 E016.50.14.545 N052.24.53.527 E016.50.13.616 olive
N052.24.53.527 E016.50.13.616 N052.24.53.585 E016.50.13.395 olive
N052.24.53.585 E016.50.13.395 N052.24.53.636 E016.50.13.240 olive
N052.24.53.636 E016.50.13.240 N052.24.53.748 E016.50.13.104 olive
N052.24.53.748 E016.50.13.104 N052.24.53.862 E016.50.13.035 olive
N052.24.53.862 E016.50.13.035 N052.24.53.723 E016.50.12.970 olive
N052.24.53.723 E016.50.12.970 N052.24.53.653 E016.50.12.781 olive
N052.24.53.653 E016.50.12.781 N052.24.53.539 E016.50.12.479 olive
N052.24.53.539 E016.50.12.479 N052.24.53.498 E016.50.12.288 olive
N052.24.53.498 E016.50.12.288 N052.24.53.556 E016.50.11.279 olive
N052.24.53.556 E016.50.11.279 N052.24.53.636 E016.50.11.097 olive
N052.24.53.636 E016.50.11.097 N052.24.53.699 E016.50.10.922 olive
N052.24.53.699 E016.50.10.922 N052.24.53.767 E016.50.10.845 olive
N052.24.53.767 E016.50.10.845 N052.24.53.923 E016.50.10.791 olive
;- BLD
N052.24.51.756 E016.50.17.581 N052.24.51.178 E016.50.17.534 maroon
N052.24.51.178 E016.50.17.534 N052.24.51.182 E016.50.16.412 maroon
N052.24.51.182 E016.50.16.412 N052.24.50.530 E016.50.15.027 maroon
N052.24.50.530 E016.50.15.027 N052.24.50.532 E016.50.14.034 maroon
N052.24.50.532 E016.50.14.034 N052.24.50.214 E016.50.13.994 maroon
N052.24.50.214 E016.50.13.994 N052.24.50.194 E016.50.12.748 maroon
N052.24.50.194 E016.50.12.748 N052.24.50.429 E016.50.12.694 maroon
N052.24.50.429 E016.50.12.694 N052.24.50.503 E016.50.12.029 maroon
N052.24.50.503 E016.50.12.029 N052.24.51.091 E016.50.12.076 maroon
N052.24.51.091 E016.50.12.076 N052.24.51.094 E016.50.14.723 maroon
N052.24.51.094 E016.50.14.723 N052.24.52.445 E016.50.14.810 maroon
N052.24.52.445 E016.50.14.810 N052.24.52.408 E016.50.15.511 maroon
N052.24.52.408 E016.50.15.511 N052.24.51.439 E016.50.15.513 maroon
N052.24.51.439 E016.50.15.513 N052.24.51.849 E016.50.16.378 maroon
N052.24.51.849 E016.50.16.378 N052.24.51.902 E016.50.17.572 maroon
N052.24.51.902 E016.50.17.572 N052.24.51.758 E016.50.17.562 maroon
N052.24.51.762 E016.50.07.156 N052.24.51.613 E016.50.04.040 maroon
N052.24.51.613 E016.50.04.040 N052.24.50.499 E016.50.04.211 maroon
N052.24.50.499 E016.50.04.211 N052.24.50.653 E016.50.07.346 maroon
N052.24.50.653 E016.50.07.346 N052.24.51.756 E016.50.07.181 maroon
N052.24.50.179 E016.49.52.132 N052.24.49.399 E016.49.52.202 maroon
N052.24.49.399 E016.49.52.202 N052.24.49.467 E016.49.54.047 maroon
N052.24.49.467 E016.49.54.047 N052.24.50.253 E016.49.53.967 maroon
N052.24.50.253 E016.49.53.967 N052.24.50.163 E016.49.52.121 maroon
N052.24.54.411 E016.49.39.239 N052.24.54.442 E016.49.45.590 maroon
N052.24.54.442 E016.49.45.590 N052.24.52.069 E016.49.45.630 maroon
N052.24.52.069 E016.49.45.630 N052.24.52.064 E016.49.39.867 maroon
N052.24.52.064 E016.49.39.867 N052.24.53.367 E016.49.39.832 maroon
N052.24.53.367 E016.49.39.832 N052.24.53.420 E016.49.39.242 maroon
N052.24.53.420 E016.49.39.242 N052.24.54.452 E016.49.39.227 maroon


EPKK_NEW N000.00.00.000 E000.00.00.000 N000.00.00.000 E000.00.00.000
N050.04.28.735 E019.48.11.709 N050.04.29.068 E019.48.12.105 Color_251ACI
N050.04.28.480 E019.48.08.664 N050.04.28.186 E019.48.09.833 Color_251ACI
N050.04.28.186 E019.48.09.833 N050.04.28.787 E019.48.10.393 Color_251ACI
N050.04.28.787 E019.48.10.393 N050.04.28.434 E019.48.11.429 Color_251ACI
N050.04.28.434 E019.48.11.429 N050.04.28.735 E019.48.11.709 Color_251ACI
N050.04.29.042 E019.48.06.550 N050.04.28.737 E019.48.07.761 Color_251ACI
N050.04.29.694 E019.48.06.659 N050.04.29.042 E019.48.06.550 Color_251ACI
N050.04.31.098 E019.48.08.333 N050.04.31.380 E019.48.06.964 Color_251ACI
N050.04.31.380 E019.48.06.964 N050.04.29.694 E019.48.06.659 Color_251ACI
N050.04.40.129 E019.48.15.573 N050.04.40.162 E019.48.15.690 Color_251ACI
N050.04.40.162 E019.48.15.690 N050.04.39.062 E019.48.16.127 Color_251ACI
N050.04.39.062 E019.48.16.127 N050.04.39.102 E019.48.16.585 Color_251ACI
N050.04.39.102 E019.48.16.585 N050.04.39.001 E019.48.16.620 Color_251ACI
N050.04.39.001 E019.48.16.620 N050.04.39.033 E019.48.16.736 Color_251ACI
N050.04.39.033 E019.48.16.736 N050.04.38.895 E019.48.16.796 Color_251ACI
N050.04.38.895 E019.48.16.796 N050.04.38.862 E019.48.16.679 Color_251ACI
N050.04.38.862 E019.48.16.679 N050.04.36.540 E019.48.17.431 Color_251ACI
N050.04.36.540 E019.48.17.431 N050.04.36.501 E019.48.16.974 Color_251ACI
N050.04.36.501 E019.48.16.974 N050.04.32.391 E019.48.18.321 Color_251ACI
N050.04.32.391 E019.48.18.321 N050.04.30.811 E019.48.17.599 Color_251ACI
N050.04.27.997 E019.48.09.477 N050.04.28.071 E019.48.09.185 Color_251ACI
N050.04.28.071 E019.48.09.185 N050.04.28.075 E019.48.09.043 Color_251ACI
N050.04.28.075 E019.48.09.043 N050.04.28.070 E019.48.08.943 Color_251ACI
N050.04.28.070 E019.48.08.943 N050.04.28.058 E019.48.08.744 Color_251ACI
N050.04.28.058 E019.48.08.744 N050.04.28.068 E019.48.08.702 Color_251ACI
N050.04.27.949 E019.48.10.652 N050.04.27.866 E019.48.09.879 Color_251ACI
N050.04.28.243 E019.48.11.698 N050.04.28.142 E019.48.11.733 Color_251ACI
N050.04.28.142 E019.48.11.733 N050.04.28.043 E019.48.11.143 Color_251ACI
N050.04.39.652 E019.48.12.056 N050.04.39.418 E019.48.12.250 Color_251ACI
N050.04.39.418 E019.48.12.250 N050.04.38.559 E019.48.12.593 Color_251ACI
N050.04.38.559 E019.48.12.593 N050.04.38.138 E019.48.09.591 Color_251ACI
N050.04.38.138 E019.48.09.591 N050.04.33.042 E019.48.11.300 Color_251ACI
N050.04.33.042 E019.48.11.300 N050.04.33.434 E019.48.14.044 Color_251ACI
N050.04.33.434 E019.48.14.044 N050.04.32.420 E019.48.14.390 Color_251ACI
N050.04.32.420 E019.48.14.390 N050.04.31.209 E019.48.13.796 Color_251ACI
N050.04.31.209 E019.48.13.796 N050.04.31.094 E019.48.14.255 Color_251ACI
N050.04.31.094 E019.48.14.255 N050.04.30.007 E019.48.13.785 Color_251ACI
N050.04.22.729 E019.47.58.944 N050.04.22.744 E019.47.58.761 Color_251ACI
N050.04.22.744 E019.47.58.761 N050.04.22.541 E019.47.58.830 Color_251ACI
N050.04.22.541 E019.47.58.830 N050.04.22.458 E019.47.58.298 Color_251ACI
N050.04.22.458 E019.47.58.298 N050.04.22.256 E019.47.58.367 Color_251ACI
N050.04.22.256 E019.47.58.367 N050.04.22.090 E019.47.58.410 Color_251ACI
N050.04.22.090 E019.47.58.410 N050.04.21.845 E019.47.58.646 Color_251ACI
N050.04.21.845 E019.47.58.646 N050.04.21.785 E019.47.58.272 Color_251ACI
N050.04.21.785 E019.47.58.272 N050.04.21.513 E019.47.58.492 Color_251ACI
N050.04.21.513 E019.47.58.492 N050.04.21.601 E019.47.58.883 Color_251ACI
N050.04.21.601 E019.47.58.883 N050.04.21.777 E019.47.58.797 Color_251ACI
N050.04.21.777 E019.47.58.797 N050.04.21.877 E019.47.59.629 Color_251ACI
N050.04.22.904 E019.47.58.617 N050.04.22.841 E019.47.58.868 Color_251ACI
N050.04.22.841 E019.47.58.868 N050.04.22.803 E019.47.58.893 Color_251ACI
N050.04.22.803 E019.47.58.893 N050.04.22.793 E019.47.58.935 Color_251ACI
N050.04.22.793 E019.47.58.935 N050.04.22.729 E019.47.58.944 Color_251ACI
N050.04.22.960 E019.47.58.025 N050.04.22.821 E019.47.58.085 Color_251ACI
N050.04.22.821 E019.47.58.085 N050.04.22.877 E019.47.58.601 Color_251ACI
N050.04.29.589 E019.47.58.214 N050.04.24.530 E019.47.59.898 Color_251ACI
N050.04.24.530 E019.47.59.898 N050.04.24.304 E019.47.59.567 Color_251ACI
N050.04.24.304 E019.47.59.567 N050.04.24.260 E019.47.59.493 Color_251ACI
N050.04.24.260 E019.47.59.493 N050.04.24.222 E019.47.59.277 Color_251ACI
N050.04.24.222 E019.47.59.277 N050.04.24.343 E019.47.58.917 Color_251ACI
N050.04.24.343 E019.47.58.917 N050.04.24.898 E019.47.58.677 Color_251ACI
N050.04.24.898 E019.47.58.677 N050.04.24.727 E019.47.57.513 Color_251ACI
N050.04.24.727 E019.47.57.513 N050.04.22.960 E019.47.58.025 Color_251ACI
N050.04.23.115 E019.47.59.131 N050.04.23.153 E019.47.59.347 Color_251ACI
N050.04.23.153 E019.47.59.347 N050.04.23.697 E019.47.59.149 Color_251ACI
N050.04.23.697 E019.47.59.149 N050.04.23.891 E019.47.59.364 Color_251ACI
N050.04.23.891 E019.47.59.364 N050.04.23.929 E019.47.59.580 Color_251ACI
N050.04.23.929 E019.47.59.580 N050.04.23.952 E019.47.59.738 Color_251ACI
N050.04.23.952 E019.47.59.738 N050.04.23.783 E019.48.00.165 Color_251ACI
N050.04.23.783 E019.48.00.165 N050.04.22.982 E019.48.00.399 Color_251ACI
N050.04.22.784 E019.47.59.218 N050.04.23.115 E019.47.59.131 Color_251ACI
N050.04.35.411 E019.47.49.433 N050.04.33.123 E019.47.54.974 Color_251ACI
N050.04.33.123 E019.47.54.974 N050.04.32.817 E019.47.55.702 Color_251ACI
N050.04.32.817 E019.47.55.702 N050.04.32.192 E019.47.56.959 Color_251ACI
N050.04.32.192 E019.47.56.959 N050.04.32.069 E019.47.57.077 Color_251ACI
N050.04.35.738 E019.47.45.298 N050.04.35.811 E019.47.45.872 Color_251ACI
N050.04.35.811 E019.47.45.872 N050.04.35.830 E019.47.46.655 Color_251ACI
N050.04.35.830 E019.47.46.655 N050.04.35.908 E019.47.47.328 Color_251ACI
N050.04.35.908 E019.47.47.328 N050.04.35.811 E019.47.48.088 Color_251ACI
N050.04.35.811 E019.47.48.088 N050.04.35.411 E019.47.49.433 Color_251ACI
N050.04.23.627 E019.48.15.434 N050.04.23.898 E019.48.17.430 Color_251ACI
N050.04.23.554 E019.48.14.860 N050.04.23.610 E019.48.15.376 Color_251ACI
N050.04.23.610 E019.48.15.376 N050.04.23.627 E019.48.15.434 Color_251ACI
N050.04.23.178 E019.48.12.174 N050.04.23.460 E019.48.14.128 Color_251ACI
N050.04.23.460 E019.48.14.128 N050.04.23.554 E019.48.14.860 Color_251ACI
N050.04.23.101 E019.48.11.742 N050.04.23.178 E019.48.12.174 Color_251ACI
N050.04.22.707 E019.48.08.756 N050.04.22.996 E019.48.11.052 Color_251ACI
N050.04.22.996 E019.48.11.052 N050.04.23.101 E019.48.11.742 Color_251ACI
N050.04.21.610 E019.48.00.815 N050.04.21.837 E019.48.02.495 Color_251ACI
N050.04.21.837 E019.48.02.495 N050.04.22.285 E019.48.05.513 Color_251ACI
N050.04.22.285 E019.48.05.513 N050.04.22.524 E019.48.07.393 Color_251ACI
N050.04.22.524 E019.48.07.393 N050.04.22.707 E019.48.08.756 Color_251ACI
N050.04.32.451 E019.48.02.945 N050.04.32.306 E019.48.02.905 Color_251ACI
N050.04.32.306 E019.48.02.905 N050.04.32.420 E019.48.02.204 Color_251ACI
N050.04.32.420 E019.48.02.204 N050.04.32.482 E019.48.01.712 Color_251ACI
N050.04.32.482 E019.48.01.712 N050.04.32.596 E019.48.01.011 Color_251ACI
N050.04.32.596 E019.48.01.011 N050.04.32.680 E019.48.00.677 Color_251ACI
N050.04.32.680 E019.48.00.677 N050.04.32.610 E019.48.00.586 Color_251ACI
N050.04.32.610 E019.48.00.586 N050.04.32.679 E019.48.00.435 Color_251ACI
N050.04.32.679 E019.48.00.435 N050.04.32.706 E019.48.00.451 Color_251ACI
N050.04.32.706 E019.48.00.451 N050.04.32.743 E019.48.00.426 Color_251ACI
N050.04.32.743 E019.48.00.426 N050.04.32.807 E019.48.00.417 Color_251ACI
N050.04.32.807 E019.48.00.417 N050.04.32.818 E019.48.00.375 Color_251ACI
N050.04.32.818 E019.48.00.375 N050.04.32.828 E019.48.00.333 Color_251ACI
N050.04.32.828 E019.48.00.333 N050.04.32.860 E019.48.00.208 Color_251ACI
N050.04.32.860 E019.48.00.208 N050.04.32.843 E019.48.00.150 Color_251ACI
N050.04.32.843 E019.48.00.150 N050.04.32.891 E019.48.00.083 Color_251ACI
N050.04.32.891 E019.48.00.083 N050.04.32.891 E019.48.00.083 Color_251ACI
N050.04.32.891 E019.48.00.083 N050.04.32.918 E019.48.00.099 Color_251ACI
N050.04.32.918 E019.48.00.099 N050.04.32.961 E019.48.00.173 Color_251ACI
N050.04.32.961 E019.48.00.173 N050.04.33.031 E019.48.00.264 Color_251ACI
N050.04.33.031 E019.48.00.264 N050.04.33.205 E019.47.59.696 Color_251ACI
N050.04.33.205 E019.47.59.696 N050.04.33.215 E019.47.59.654 Color_251ACI
N050.04.33.215 E019.47.59.654 N050.04.33.236 E019.47.59.571 Color_251ACI
N050.04.33.236 E019.47.59.571 N050.04.33.220 E019.47.59.512 Color_251ACI
N050.04.33.220 E019.47.59.512 N050.04.33.220 E019.47.59.512 Color_251ACI
N050.04.33.220 E019.47.59.512 N050.04.33.187 E019.47.59.396 Color_251ACI
N050.04.33.686 E019.47.59.749 N050.04.33.590 E019.47.59.883 Color_251ACI
N050.04.33.590 E019.47.59.883 N050.04.33.522 E019.48.00.034 Color_251ACI
N050.04.33.522 E019.48.00.034 N050.04.33.380 E019.48.00.477 Color_251ACI
N050.04.33.380 E019.48.00.477 N050.04.34.066 E019.48.00.943 Color_251ACI
N050.04.34.066 E019.48.00.943 N050.04.34.132 E019.48.01.417 Color_251ACI
N050.04.34.132 E019.48.01.417 N050.04.34.090 E019.48.01.585 Color_251ACI
N050.04.34.090 E019.48.01.585 N050.04.33.931 E019.48.01.728 Color_251ACI
N050.04.33.931 E019.48.01.728 N050.04.33.658 E019.48.02.814 Color_251ACI
N050.04.33.658 E019.48.02.814 N050.04.33.165 E019.48.02.562 Color_251ACI
N050.04.33.165 E019.48.02.562 N050.04.33.018 E019.48.03.146 Color_251ACI
N050.04.33.018 E019.48.03.146 N050.04.32.874 E019.48.03.106 Color_251ACI
N050.04.32.874 E019.48.03.106 N050.04.32.793 E019.48.03.057 Color_251ACI
N050.04.36.656 E019.47.59.247 N050.04.37.245 E019.47.58.499 Color_251ACI
N050.04.37.245 E019.47.58.499 N050.04.37.384 E019.47.57.331 Color_251ACI
N050.04.37.384 E019.47.57.331 N050.04.37.036 E019.47.54.903 Color_251ACI
N050.04.33.745 E019.47.57.665 N050.04.35.848 E019.47.59.140 Color_251ACI
N050.04.35.848 E019.47.59.140 N050.04.36.656 E019.47.59.247 Color_251ACI
N050.04.37.596 E019.48.02.518 N050.04.33.686 E019.47.59.749 Color_251ACI
N050.04.39.418 E019.48.12.250 N050.04.38.243 E019.48.03.635 Color_251ACI
N050.04.38.243 E019.48.03.635 N050.04.38.026 E019.48.03.021 Color_251ACI
N050.04.38.026 E019.48.03.021 N050.04.37.596 E019.48.02.518 Color_251ACI
N050.04.36.342 E019.47.50.772 N050.04.33.669 E019.47.57.233 Color_251ACI
N050.04.33.669 E019.47.57.233 N050.04.33.745 E019.47.57.665 Color_251ACI
N050.04.31.798 E019.47.57.297 N050.04.31.110 E019.47.57.696 Color_251ACI
N050.04.31.110 E019.47.57.696 N050.04.29.589 E019.47.58.214 Color_251ACI
N050.04.33.960 E019.47.32.317 N050.04.33.865 E019.47.31.585 Color_251ACI
N050.04.35.738 E019.47.45.298 N050.04.33.960 E019.47.32.317 Color_251ACI
N050.04.34.772 E019.47.28.959 N050.04.34.447 E019.47.28.038 Color_251ACI
N050.04.34.447 E019.47.28.038 N050.04.34.393 E019.47.28.006 Color_251ACI
N050.04.41.793 E019.47.25.004 N050.04.41.772 E019.47.26.195 Color_251ACI
N050.04.41.772 E019.47.26.195 N050.04.41.296 E019.47.27.350 Color_251ACI
N050.04.41.296 E019.47.27.350 N050.04.40.503 E019.47.27.926 Color_251ACI
N050.04.40.503 E019.47.27.926 N050.04.35.940 E019.47.29.478 Color_251ACI
N050.04.35.940 E019.47.29.478 N050.04.35.239 E019.47.29.437 Color_251ACI
N050.04.35.239 E019.47.29.437 N050.04.34.772 E019.47.28.959 Color_251ACI
N050.04.33.532 E019.47.28.974 N050.04.33.232 E019.47.27.828 Color_251ACI
N050.04.33.232 E019.47.27.828 N050.04.32.858 E019.47.27.840 Color_251ACI
N050.04.32.858 E019.47.27.840 N050.04.31.665 E019.47.28.654 Color_251ACI
N050.04.31.665 E019.47.28.654 N050.04.31.479 E019.47.29.023 Color_251ACI
N050.04.31.479 E019.47.29.023 N050.04.31.583 E019.47.29.471 Color_251ACI
N050.04.31.583 E019.47.29.471 N050.04.31.803 E019.47.29.702 Color_251ACI
N050.04.31.803 E019.47.29.702 N050.04.32.110 E019.47.30.081 Color_251ACI
N050.04.32.110 E019.47.30.081 N050.04.32.636 E019.47.30.450 Color_251ACI
N050.04.32.636 E019.47.30.450 N050.04.33.228 E019.47.30.185 Color_251ACI
N050.04.33.228 E019.47.30.185 N050.04.33.460 E019.47.29.508 Color_251ACI
N050.04.33.460 E019.47.29.508 N050.04.33.532 E019.47.28.974 Color_251ACI
N050.04.31.345 E019.47.32.264 N050.04.31.070 E019.47.31.760 Color_251ACI
N050.04.31.070 E019.47.31.760 N050.04.30.871 E019.47.31.445 Color_251ACI
N050.04.30.871 E019.47.31.445 N050.04.30.463 E019.47.31.100 Color_251ACI
N050.04.30.463 E019.47.31.100 N050.04.30.120 E019.47.30.988 Color_251ACI
N050.04.30.120 E019.47.30.988 N050.04.29.736 E019.47.31.042 Color_251ACI
N050.04.29.736 E019.47.31.042 N050.04.29.523 E019.47.31.153 Color_251ACI
N050.04.29.523 E019.47.31.153 N050.04.29.272 E019.47.31.289 Color_251ACI
N050.04.29.272 E019.47.31.289 N050.04.28.991 E019.47.31.792 Color_251ACI
N050.04.28.991 E019.47.31.792 N050.04.29.249 E019.47.33.105 Color_251ACI
N050.04.29.249 E019.47.33.105 N050.04.27.713 E019.47.33.806 Color_251ACI
N050.04.33.251 E019.47.46.094 N050.04.31.345 E019.47.32.264 Color_251ACI
N050.04.22.284 E019.46.54.614 N050.04.23.357 E019.46.58.591 Color_251ACI
N050.04.23.357 E019.46.58.591 N050.04.23.693 E019.46.59.712 Color_251ACI
N050.04.21.332 E019.46.52.251 N050.04.21.487 E019.46.52.250 Color_251ACI
N050.04.21.487 E019.46.52.250 N050.04.21.740 E019.46.52.596 Color_251ACI
N050.04.21.740 E019.46.52.596 N050.04.22.284 E019.46.54.614 Color_251ACI
N050.04.27.324 E019.47.28.705 N050.04.26.887 E019.47.26.753 Color_251ACI
N050.04.29.439 E019.47.30.379 N050.04.28.520 E019.47.29.482 Color_251ACI
N050.04.28.520 E019.47.29.482 N050.04.28.289 E019.47.28.186 Color_251ACI
N050.04.28.289 E019.47.28.186 N050.04.27.324 E019.47.28.705 Color_251ACI
N050.04.26.858 E019.47.29.577 N050.04.25.701 E019.47.30.123 Color_251ACI
N050.04.29.936 E019.47.24.951 N050.04.31.041 E019.47.29.045 Color_251ACI
N050.04.31.041 E019.47.29.045 N050.04.31.329 E019.47.29.991 Color_251ACI
N050.04.31.329 E019.47.29.991 N050.04.31.160 E019.47.30.417 Color_251ACI
N050.04.31.160 E019.47.30.417 N050.04.30.385 E019.47.30.427 Color_251ACI
N050.04.28.411 E019.47.26.718 N050.04.29.161 E019.47.29.391 Color_251ACI
N050.04.29.161 E019.47.29.391 N050.04.29.385 E019.47.29.239 Color_251ACI
N050.04.29.385 E019.47.29.239 N050.04.29.423 E019.47.29.455 Color_251ACI
N050.04.29.423 E019.47.29.455 N050.04.29.674 E019.47.29.319 Color_251ACI
N050.04.29.674 E019.47.29.319 N050.04.29.810 E019.47.29.884 Color_251ACI
N050.04.29.810 E019.47.29.884 N050.04.29.758 E019.47.30.092 Color_251ACI
N050.04.29.758 E019.47.30.092 N050.04.29.636 E019.47.30.210 Color_251ACI
N050.04.29.636 E019.47.30.210 N050.04.29.439 E019.47.30.379 Color_251ACI
N050.04.28.986 E019.47.25.287 N050.04.29.045 E019.47.25.178 Color_251ACI
N050.04.29.045 E019.47.25.178 N050.04.29.103 E019.47.25.069 Color_251ACI
N050.04.29.103 E019.47.25.069 N050.04.29.374 E019.47.24.849 Color_251ACI
N050.04.29.374 E019.47.24.849 N050.04.29.513 E019.47.24.790 Color_251ACI
N050.04.29.513 E019.47.24.790 N050.04.29.550 E019.47.24.764 Color_251ACI
N050.04.29.550 E019.47.24.764 N050.04.29.652 E019.47.24.730 Color_251ACI
N050.04.29.652 E019.47.24.730 N050.04.29.759 E019.47.24.795 Color_251ACI
N050.04.29.759 E019.47.24.795 N050.04.29.936 E019.47.24.951 Color_251ACI
N050.04.30.806 E019.47.19.027 N050.04.30.774 E019.47.19.152 Color_251ACI
N050.04.30.774 E019.47.19.152 N050.04.30.177 E019.47.19.559 Color_251ACI
N050.04.30.177 E019.47.19.559 N050.04.30.259 E019.47.19.850 Color_251ACI
N050.04.30.259 E019.47.19.850 N050.04.30.845 E019.47.19.485 Color_251ACI
N050.04.30.845 E019.47.19.485 N050.04.30.920 E019.47.19.434 Color_251ACI
N050.04.30.512 E019.47.17.981 N050.04.30.279 E019.47.18.417 Color_251ACI
N050.04.30.279 E019.47.18.417 N050.04.29.106 E019.47.19.147 Color_251ACI
N050.04.29.106 E019.47.19.147 N050.04.28.743 E019.47.19.118 Color_251ACI
N050.04.28.743 E019.47.19.118 N050.04.28.531 E019.47.18.363 Color_251ACI
N050.04.28.531 E019.47.18.363 N050.04.28.764 E019.47.17.927 Color_251ACI
N050.04.28.764 E019.47.17.927 N050.04.29.930 E019.47.17.097 Color_251ACI
N050.04.29.930 E019.47.17.097 N050.04.30.294 E019.47.17.126 Color_251ACI
N050.04.30.294 E019.47.17.126 N050.04.30.310 E019.47.17.184 Color_251ACI
N050.04.30.457 E019.47.17.707 N050.04.30.512 E019.47.17.981 Color_251ACI
N050.04.30.310 E019.47.17.184 N050.04.30.268 E019.47.17.351 Color_251ACI
N050.04.30.268 E019.47.17.351 N050.04.29.698 E019.47.17.774 Color_251ACI
N050.04.29.698 E019.47.17.774 N050.04.29.737 E019.47.17.990 Color_251ACI
N050.04.29.737 E019.47.17.990 N050.04.30.350 E019.47.17.642 Color_251ACI
N050.04.30.350 E019.47.17.642 N050.04.30.457 E019.47.17.707 Color_251ACI
N050.04.30.017 E019.47.16.138 N050.04.29.757 E019.47.16.557 Color_251ACI
N050.04.29.757 E019.47.16.557 N050.04.28.601 E019.47.17.346 Color_251ACI
N050.04.28.601 E019.47.17.346 N050.04.28.237 E019.47.17.316 Color_251ACI
N050.04.28.237 E019.47.17.316 N050.04.28.041 E019.47.16.619 Color_251ACI
N050.04.28.041 E019.47.16.619 N050.04.28.285 E019.47.16.141 Color_251ACI
N050.04.28.285 E019.47.16.141 N050.04.29.468 E019.47.15.370 Color_251ACI
N050.04.29.468 E019.47.15.370 N050.04.29.821 E019.47.15.440 Color_251ACI
N050.04.29.973 E019.47.16.063 N050.04.30.017 E019.47.16.138 Color_251ACI
N050.04.29.821 E019.47.15.440 N050.04.29.870 E019.47.15.615 Color_251ACI
N050.04.28.869 E019.47.11.970 N050.04.28.934 E019.47.12.202 Color_251ACI
N050.04.29.064 E019.47.12.667 N050.04.28.831 E019.47.13.103 Color_251ACI
N050.04.28.831 E019.47.13.103 N050.04.27.659 E019.47.13.833 Color_251ACI
N050.04.27.659 E019.47.13.833 N050.04.27.285 E019.47.13.846 Color_251ACI
N050.04.27.285 E019.47.13.846 N050.04.27.089 E019.47.13.149 Color_251ACI
N050.04.27.089 E019.47.13.149 N050.04.27.349 E019.47.12.729 Color_251ACI
N050.04.27.349 E019.47.12.729 N050.04.28.505 E019.47.11.941 Color_251ACI
N050.04.28.505 E019.47.11.941 N050.04.28.869 E019.47.11.970 Color_251ACI
N050.04.28.575 E019.47.10.924 N050.04.28.438 E019.47.10.359 Color_251ACI
N050.04.28.438 E019.47.10.359 N050.04.28.170 E019.47.10.196 Color_251ACI
N050.04.26.674 E019.47.10.247 N050.04.26.822 E019.47.12.119 Color_251ACI
N050.04.26.822 E019.47.12.119 N050.04.26.924 E019.47.12.326 Color_251ACI
N050.04.26.924 E019.47.12.326 N050.04.27.670 E019.47.11.817 Color_251ACI
N050.04.27.670 E019.47.11.817 N050.04.28.342 E019.47.11.360 Color_251ACI
N050.04.28.342 E019.47.11.360 N050.04.28.575 E019.47.10.924 Color_251ACI
N050.04.27.704 E019.47.07.744 N050.04.27.516 E019.47.07.630 Color_251ACI
N050.04.27.516 E019.47.07.630 N050.04.27.388 E019.47.07.648 Color_251ACI
N050.04.27.388 E019.47.07.648 N050.04.26.578 E019.47.08.165 Color_251ACI
N050.04.26.578 E019.47.08.165 N050.04.26.520 E019.47.08.274 Color_251ACI
N050.04.26.520 E019.47.08.274 N050.04.26.447 E019.47.08.567 Color_251ACI
N050.04.26.447 E019.47.08.567 N050.04.26.463 E019.47.08.625 Color_251ACI
N050.04.26.463 E019.47.08.625 N050.04.26.586 E019.47.08.748 Color_251ACI
N050.04.27.726 E019.47.07.902 N050.04.27.704 E019.47.07.744 Color_251ACI
N050.04.27.459 E019.47.06.872 N050.04.27.359 E019.47.07.148 Color_251ACI
N050.04.27.359 E019.47.07.148 N050.04.27.301 E019.47.07.257 Color_251ACI
N050.04.27.301 E019.47.07.257 N050.04.26.491 E019.47.07.775 Color_251ACI
N050.04.26.491 E019.47.07.775 N050.04.26.389 E019.47.07.809 Color_251ACI
N050.04.26.389 E019.47.07.809 N050.04.26.229 E019.47.07.711 Color_251ACI
N050.04.26.229 E019.47.07.711 N050.04.26.169 E019.47.07.579 Color_251ACI
N050.04.26.169 E019.47.07.579 N050.04.26.147 E019.47.07.421 Color_251ACI
N050.04.26.147 E019.47.07.421 N050.04.26.210 E019.47.07.170 Color_251ACI
N050.04.26.210 E019.47.07.170 N050.04.26.268 E019.47.07.061 Color_251ACI
N050.04.26.268 E019.47.07.061 N050.04.27.078 E019.47.06.544 Color_251ACI
N050.04.27.078 E019.47.06.544 N050.04.27.180 E019.47.06.509 Color_251ACI
N050.04.27.180 E019.47.06.509 N050.04.27.297 E019.47.06.533 Color_251ACI
N050.04.27.297 E019.47.06.533 N050.04.27.405 E019.47.06.598 Color_251ACI
N050.04.27.405 E019.47.06.598 N050.04.27.459 E019.47.06.872 Color_251ACI
N050.04.27.160 E019.47.05.726 N050.04.27.118 E019.47.05.894 Color_251ACI
N050.04.27.118 E019.47.05.894 N050.04.27.049 E019.47.06.044 Color_251ACI
N050.04.27.049 E019.47.06.044 N050.04.26.991 E019.47.06.153 Color_251ACI
N050.04.26.991 E019.47.06.153 N050.04.26.282 E019.47.06.636 Color_251ACI
N050.04.26.282 E019.47.06.636 N050.04.26.181 E019.47.06.671 Color_251ACI
N050.04.26.181 E019.47.06.671 N050.04.26.117 E019.47.06.680 Color_251ACI
N050.04.26.117 E019.47.06.680 N050.04.26.090 E019.47.06.664 Color_251ACI
N050.04.26.090 E019.47.06.664 N050.04.25.929 E019.47.06.565 Color_251ACI
N050.04.25.929 E019.47.06.565 N050.04.25.859 E019.47.06.475 Color_251ACI
N050.04.25.859 E019.47.06.475 N050.04.25.837 E019.47.06.317 Color_251ACI
N050.04.25.837 E019.47.06.317 N050.04.25.910 E019.47.06.024 Color_251ACI
N050.04.25.910 E019.47.06.024 N050.04.25.995 E019.47.05.932 Color_251ACI
N050.04.25.995 E019.47.05.932 N050.04.26.779 E019.47.05.398 Color_251ACI
N050.04.26.779 E019.47.05.398 N050.04.26.816 E019.47.05.372 Color_251ACI
N050.04.26.816 E019.47.05.372 N050.04.26.870 E019.47.05.405 Color_251ACI
N050.04.26.870 E019.47.05.405 N050.04.27.068 E019.47.05.478 Color_251ACI
N050.04.27.068 E019.47.05.478 N050.04.27.160 E019.47.05.726 Color_251ACI
N050.04.26.850 E019.47.04.622 N050.04.26.750 E019.47.04.898 Color_251ACI
N050.04.26.750 E019.47.04.898 N050.04.26.691 E019.47.05.007 Color_251ACI
N050.04.26.691 E019.47.05.007 N050.04.26.057 E019.47.05.440 Color_251ACI
N050.04.26.057 E019.47.05.440 N050.04.25.881 E019.47.05.525 Color_251ACI
N050.04.25.881 E019.47.05.525 N050.04.25.780 E019.47.05.559 Color_251ACI
N050.04.25.780 E019.47.05.559 N050.04.25.619 E019.47.05.461 Color_251ACI
N050.04.25.619 E019.47.05.461 N050.04.25.533 E019.47.05.312 Color_251ACI
N050.04.25.533 E019.47.05.312 N050.04.25.537 E019.47.05.171 Color_251ACI
N050.04.25.537 E019.47.05.171 N050.04.25.579 E019.47.05.004 Color_251ACI
N050.04.25.579 E019.47.05.004 N050.04.26.352 E019.47.04.512 Color_251ACI
N050.04.26.352 E019.47.04.512 N050.04.26.624 E019.47.04.292 Color_251ACI
N050.04.26.624 E019.47.04.292 N050.04.26.768 E019.47.04.332 Color_251ACI
N050.04.26.768 E019.47.04.332 N050.04.26.850 E019.47.04.622 Color_251ACI
N050.04.26.540 E019.47.03.518 N050.04.26.471 E019.47.03.669 Color_251ACI
N050.04.26.471 E019.47.03.669 N050.04.26.460 E019.47.03.711 Color_251ACI
N050.04.26.460 E019.47.03.711 N050.04.25.443 E019.47.04.439 Color_251ACI
N050.04.25.443 E019.47.04.439 N050.04.25.282 E019.47.04.341 Color_251ACI
N050.04.25.282 E019.47.04.341 N050.04.25.223 E019.47.04.208 Color_251ACI
N050.04.25.223 E019.47.04.208 N050.04.25.227 E019.47.04.067 Color_251ACI
N050.04.25.227 E019.47.04.067 N050.04.25.290 E019.47.03.816 Color_251ACI
N050.04.25.290 E019.47.03.816 N050.04.25.349 E019.47.03.707 Color_251ACI
N050.04.25.349 E019.47.03.707 N050.04.26.169 E019.47.03.148 Color_251ACI
N050.04.26.169 E019.47.03.148 N050.04.26.260 E019.47.03.155 Color_251ACI
N050.04.26.260 E019.47.03.155 N050.04.26.458 E019.47.03.228 Color_251ACI
N050.04.26.458 E019.47.03.228 N050.04.26.540 E019.47.03.518 Color_251ACI
N050.04.26.240 E019.47.02.372 N050.04.26.140 E019.47.02.648 Color_251ACI
N050.04.26.140 E019.47.02.648 N050.04.26.071 E019.47.02.799 Color_251ACI
N050.04.26.071 E019.47.02.799 N050.04.25.661 E019.47.03.079 Color_251ACI
N050.04.25.661 E019.47.03.079 N050.04.25.261 E019.47.03.317 Color_251ACI
N050.04.25.261 E019.47.03.317 N050.04.25.160 E019.47.03.351 Color_251ACI
N050.04.25.160 E019.47.03.351 N050.04.24.999 E019.47.03.253 Color_251ACI
N050.04.24.999 E019.47.03.253 N050.04.24.939 E019.47.03.120 Color_251ACI
N050.04.24.939 E019.47.03.120 N050.04.24.917 E019.47.02.962 Color_251ACI
N050.04.24.917 E019.47.02.962 N050.04.24.970 E019.47.02.754 Color_251ACI
N050.04.24.970 E019.47.02.754 N050.04.25.156 E019.47.02.626 Color_251ACI
N050.04.25.156 E019.47.02.626 N050.04.25.977 E019.47.02.067 Color_251ACI
N050.04.25.977 E019.47.02.067 N050.04.26.148 E019.47.02.123 Color_251ACI
N050.04.26.148 E019.47.02.123 N050.04.26.240 E019.47.02.372 Color_251ACI
N050.04.25.930 E019.47.01.268 N050.04.25.851 E019.47.01.461 Color_251ACI
N050.04.25.851 E019.47.01.461 N050.04.25.430 E019.47.01.782 Color_251ACI
N050.04.25.430 E019.47.01.782 N050.04.24.807 E019.47.02.172 Color_251ACI
N050.04.24.807 E019.47.02.172 N050.04.24.673 E019.47.02.091 Color_251ACI
N050.04.24.673 E019.47.02.091 N050.04.24.603 E019.47.02.000 Color_251ACI
N050.04.24.603 E019.47.02.000 N050.04.24.618 E019.47.01.817 Color_251ACI
N050.04.24.618 E019.47.01.817 N050.04.24.681 E019.47.01.566 Color_251ACI
N050.04.24.681 E019.47.01.566 N050.04.24.739 E019.47.01.457 Color_251ACI
N050.04.24.739 E019.47.01.457 N050.04.25.549 E019.47.00.939 Color_251ACI
N050.04.25.549 E019.47.00.939 N050.04.25.650 E019.47.00.905 Color_251ACI
N050.04.25.650 E019.47.00.905 N050.04.25.865 E019.47.01.036 Color_251ACI
N050.04.25.865 E019.47.01.036 N050.04.25.930 E019.47.01.268 Color_251ACI
N050.04.25.620 E019.47.00.164 N050.04.25.520 E019.47.00.440 Color_251ACI
N050.04.25.520 E019.47.00.440 N050.04.25.435 E019.47.00.533 Color_251ACI
N050.04.25.435 E019.47.00.533 N050.04.24.641 E019.47.01.108 Color_251ACI
N050.04.24.641 E019.47.01.108 N050.04.24.550 E019.47.01.101 Color_251ACI
N050.04.24.550 E019.47.01.101 N050.04.24.362 E019.47.00.987 Color_251ACI
N050.04.24.362 E019.47.00.987 N050.04.24.303 E019.47.00.854 Color_251ACI
N050.04.24.303 E019.47.00.854 N050.04.24.281 E019.47.00.696 Color_251ACI
N050.04.24.281 E019.47.00.696 N050.04.24.333 E019.47.00.487 Color_251ACI
N050.04.24.333 E019.47.00.487 N050.04.24.733 E019.47.00.249 Color_251ACI
N050.04.24.733 E019.47.00.249 N050.04.25.245 E019.46.59.935 Color_251ACI
N050.04.25.245 E019.46.59.935 N050.04.25.421 E019.46.59.850 Color_251ACI
N050.04.25.421 E019.46.59.850 N050.04.25.538 E019.46.59.873 Color_251ACI
N050.04.25.538 E019.46.59.873 N050.04.25.620 E019.47.00.164 Color_251ACI
N050.04.25.321 E019.46.59.018 N050.04.25.241 E019.46.59.210 Color_251ACI
N050.04.25.241 E019.46.59.210 N050.04.24.298 E019.46.59.888 Color_251ACI
N050.04.24.298 E019.46.59.888 N050.04.24.160 E019.46.59.948 Color_251ACI
N050.04.24.160 E019.46.59.948 N050.04.24.052 E019.46.59.882 Color_251ACI
N050.04.24.052 E019.46.59.882 N050.04.23.993 E019.46.59.750 Color_251ACI
N050.04.23.993 E019.46.59.750 N050.04.23.971 E019.46.59.592 Color_251ACI
N050.04.23.971 E019.46.59.592 N050.04.24.040 E019.46.59.441 Color_251ACI
N050.04.24.040 E019.46.59.441 N050.04.24.071 E019.46.59.316 Color_251ACI
N050.04.24.071 E019.46.59.316 N050.04.24.129 E019.46.59.207 Color_251ACI
N050.04.24.129 E019.46.59.207 N050.04.24.353 E019.46.59.054 Color_251ACI
N050.04.24.353 E019.46.59.054 N050.04.24.939 E019.46.58.689 Color_251ACI
N050.04.24.939 E019.46.58.689 N050.04.25.041 E019.46.58.655 Color_251ACI
N050.04.25.041 E019.46.58.655 N050.04.25.228 E019.46.58.769 Color_251ACI
N050.04.25.228 E019.46.58.769 N050.04.25.321 E019.46.59.018 Color_251ACI
N050.04.24.984 E019.46.57.897 N050.04.24.910 E019.46.58.190 Color_251ACI
N050.04.24.910 E019.46.58.190 N050.04.24.815 E019.46.58.324 Color_251ACI
N050.04.24.815 E019.46.58.324 N050.04.24.031 E019.46.58.858 Color_251ACI
N050.04.24.031 E019.46.58.858 N050.04.23.914 E019.46.58.835 Color_251ACI
N050.04.23.914 E019.46.58.835 N050.04.23.753 E019.46.58.737 Color_251ACI
N050.04.23.753 E019.46.58.737 N050.04.23.683 E019.46.58.646 Color_251ACI
N050.04.23.683 E019.46.58.646 N050.04.23.677 E019.46.58.546 Color_251ACI
N050.04.23.677 E019.46.58.546 N050.04.23.688 E019.46.58.504 Color_251ACI
N050.04.23.688 E019.46.58.504 N050.04.23.751 E019.46.58.253 Color_251ACI
N050.04.23.751 E019.46.58.253 N050.04.24.758 E019.46.57.567 Color_251ACI
N050.04.24.758 E019.46.57.567 N050.04.24.918 E019.46.57.665 Color_251ACI
N050.04.24.918 E019.46.57.665 N050.04.24.984 E019.46.57.897 Color_251ACI
N050.04.24.674 E019.46.56.793 N050.04.24.611 E019.46.57.044 Color_251ACI
N050.04.24.611 E019.46.57.044 N050.04.24.072 E019.46.57.342 Color_251ACI
N050.04.24.072 E019.46.57.342 N050.04.23.577 E019.46.57.714 Color_251ACI
N050.04.23.577 E019.46.57.714 N050.04.23.443 E019.46.57.632 Color_251ACI
N050.04.23.443 E019.46.57.632 N050.04.23.383 E019.46.57.500 Color_251ACI
N050.04.23.383 E019.46.57.500 N050.04.23.361 E019.46.57.342 Color_251ACI
N050.04.23.361 E019.46.57.342 N050.04.23.424 E019.46.57.091 Color_251ACI
N050.04.23.424 E019.46.57.091 N050.04.23.520 E019.46.56.957 Color_251ACI
N050.04.23.520 E019.46.56.957 N050.04.23.994 E019.46.56.668 Color_251ACI
N050.04.23.994 E019.46.56.668 N050.04.24.303 E019.46.56.423 Color_251ACI
N050.04.24.303 E019.46.56.423 N050.04.24.421 E019.46.56.446 Color_251ACI
N050.04.24.421 E019.46.56.446 N050.04.24.619 E019.46.56.519 Color_251ACI
N050.04.24.619 E019.46.56.519 N050.04.24.674 E019.46.56.793 Color_251ACI
N050.04.24.374 E019.46.55.647 N050.04.24.263 E019.46.55.965 Color_251ACI
N050.04.24.263 E019.46.55.965 N050.04.24.205 E019.46.56.074 Color_251ACI
N050.04.24.205 E019.46.56.074 N050.04.23.422 E019.46.56.608 Color_251ACI
N050.04.23.422 E019.46.56.608 N050.04.23.331 E019.46.56.601 Color_251ACI
N050.04.23.331 E019.46.56.601 N050.04.23.143 E019.46.56.486 Color_251ACI
N050.04.23.143 E019.46.56.486 N050.04.23.073 E019.46.56.396 Color_251ACI
N050.04.23.073 E019.46.56.396 N050.04.23.051 E019.46.56.238 Color_251ACI
N050.04.23.051 E019.46.56.238 N050.04.23.104 E019.46.56.029 Color_251ACI
N050.04.23.104 E019.46.56.029 N050.04.24.148 E019.46.55.317 Color_251ACI
N050.04.24.148 E019.46.55.317 N050.04.24.309 E019.46.55.415 Color_251ACI
N050.04.24.309 E019.46.55.415 N050.04.24.374 E019.46.55.647 Color_251ACI
N050.04.24.107 E019.46.54.618 N050.04.24.012 E019.46.54.752 Color_251ACI
N050.04.24.009 E019.46.54.269 N050.04.24.107 E019.46.54.618 Color_251ACI
N050.04.24.012 E019.46.54.752 N050.04.22.967 E019.46.55.464 Color_251ACI
N050.04.22.967 E019.46.55.464 N050.04.22.833 E019.46.55.382 Color_251ACI
N050.04.22.833 E019.46.55.382 N050.04.22.774 E019.46.55.250 Color_251ACI
N050.04.22.774 E019.46.55.250 N050.04.22.752 E019.46.55.092 Color_251ACI
N050.04.22.752 E019.46.55.092 N050.04.22.815 E019.46.54.841 Color_251ACI
N050.04.22.815 E019.46.54.841 N050.04.22.900 E019.46.54.748 Color_251ACI
N050.04.22.900 E019.46.54.748 N050.04.23.683 E019.46.54.215 Color_251ACI
N050.04.23.683 E019.46.54.215 N050.04.23.774 E019.46.54.222 Color_251ACI
N050.04.23.774 E019.46.54.222 N050.04.23.875 E019.46.54.187 Color_251ACI
N050.04.23.875 E019.46.54.187 N050.04.24.009 E019.46.54.269 Color_251ACI
N050.04.23.764 E019.46.53.397 N050.04.23.438 E019.46.52.235 Color_251ACI
N050.04.22.572 E019.46.54.452 N050.04.22.674 E019.46.54.418 Color_251ACI
N050.04.22.674 E019.46.54.418 N050.04.23.372 E019.46.53.977 Color_251ACI
N050.04.23.372 E019.46.53.977 N050.04.23.595 E019.46.53.824 Color_251ACI
N050.04.23.595 E019.46.53.824 N050.04.23.654 E019.46.53.715 Color_251ACI
N050.04.23.654 E019.46.53.715 N050.04.23.764 E019.46.53.397 Color_251ACI
N050.04.28.307 E019.46.50.820 N050.04.24.721 E019.46.24.600 Color_251ACI
N050.04.24.721 E019.46.24.600 N050.04.23.845 E019.46.50.123 Color_251ACI
N050.04.23.845 E019.46.50.123 N050.04.24.058 E019.46.51.120 Color_251ACI
N050.04.24.058 E019.46.51.120 N050.04.24.600 E019.46.51.547 Color_251ACI
N050.04.24.600 E019.46.51.547 N050.04.27.472 E019.46.51.805 Color_251ACI
N050.04.27.472 E019.46.51.805 N050.04.28.191 E019.46.51.280 Color_251ACI
N050.04.28.191 E019.46.51.280 N050.04.28.307 E019.46.50.820 Color_251ACI
N050.04.23.438 E019.46.52.235 N050.04.23.181 E019.46.52.030 Color_251ACI
N050.04.23.181 E019.46.52.030 N050.04.23.127 E019.46.51.997 Color_251ACI
N050.04.23.127 E019.46.51.997 N050.04.21.973 E019.46.52.161 Color_251ACI
N050.04.21.973 E019.46.52.161 N050.04.21.916 E019.46.52.511 Color_251ACI
N050.04.21.916 E019.46.52.511 N050.04.22.400 E019.46.54.155 Color_251ACI
N050.04.22.400 E019.46.54.155 N050.04.22.449 E019.46.54.329 Color_251ACI
N050.04.22.449 E019.46.54.329 N050.04.22.572 E019.46.54.452 Color_251ACI
N050.04.24.145 E019.46.27.139 N050.04.23.652 E019.46.42.396 Color_251ACI
N050.04.23.652 E019.46.42.396 N050.04.23.348 E019.46.51.362 Color_251ACI
N050.04.29.678 E019.46.51.512 N050.04.30.499 E019.46.52.061 Color_251ACI
N050.04.29.401 E019.46.51.632 N050.04.29.678 E019.46.51.512 Color_251ACI
N050.04.24.334 E019.46.21.956 N050.04.24.296 E019.46.23.955 Color_251ACI
N050.04.48.270 E019.48.12.446 N050.04.48.321 E019.48.12.862 Color_251ACI
N050.04.32.848 E019.46.05.039 N050.04.50.170 E019.48.11.774 Color_251ACI
N050.04.50.170 E019.48.11.774 N050.04.48.270 E019.48.12.446 Color_251ACI
N050.04.30.932 E019.46.05.653 N050.04.32.848 E019.46.05.039 Color_251ACI
N050.04.29.303 E019.46.05.864 N050.04.30.888 E019.46.05.337 Color_251ACI
N050.04.30.888 E019.46.05.337 N050.04.30.932 E019.46.05.653 Color_251ACI
N050.04.49.863 E019.47.43.700 N050.04.50.002 E019.47.43.640 Color_251ACI
N050.04.50.002 E019.47.43.640 N050.04.50.066 E019.47.43.631 Color_251ACI
N050.04.50.066 E019.47.43.631 N050.04.50.114 E019.47.43.563 Color_251ACI
N050.04.50.114 E019.47.43.563 N050.04.50.151 E019.47.43.538 Color_251ACI
N050.04.50.151 E019.47.43.538 N050.04.50.193 E019.47.43.371 Color_251ACI
N050.04.50.193 E019.47.43.371 N050.04.50.187 E019.47.43.271 Color_251ACI
N050.04.50.187 E019.47.43.271 N050.04.50.326 E019.47.43.211 Color_251ACI
N050.04.50.326 E019.47.43.211 N050.04.50.385 E019.47.43.344 Color_251ACI
N050.04.50.385 E019.47.43.344 N050.04.50.402 E019.47.43.402 Color_251ACI
N050.04.50.402 E019.47.43.402 N050.04.50.482 E019.47.43.451 Color_251ACI
N050.04.50.482 E019.47.43.451 N050.04.50.563 E019.47.43.500 Color_251ACI
N050.04.50.563 E019.47.43.500 N050.04.50.637 E019.47.43.449 Color_251ACI
N050.04.50.637 E019.47.43.449 N050.04.50.638 E019.47.43.691 Color_251ACI
N050.04.50.638 E019.47.43.691 N050.04.50.030 E019.47.43.898 Color_251ACI
N050.04.50.030 E019.47.43.898 N050.04.46.519 E019.47.45.080 Color_251ACI
N050.04.46.491 E019.47.44.822 N050.04.47.430 E019.47.44.528 Color_251ACI
N050.04.32.024 E019.48.17.568 N050.04.30.910 E019.48.17.081 Color_251ACI
N050.04.32.789 E019.48.17.600 N050.04.32.698 E019.48.17.593 Color_251ACI
N050.04.32.698 E019.48.17.593 N050.04.32.596 E019.48.17.628 Color_251ACI
N050.04.32.596 E019.48.17.628 N050.04.32.506 E019.48.17.620 Color_251ACI
N050.04.32.506 E019.48.17.620 N050.04.32.404 E019.48.17.655 Color_251ACI
N050.04.32.404 E019.48.17.655 N050.04.32.313 E019.48.17.648 Color_251ACI
N050.04.32.313 E019.48.17.648 N050.04.32.196 E019.48.17.624 Color_251ACI
N050.04.32.196 E019.48.17.624 N050.04.32.115 E019.48.17.575 Color_251ACI
N050.04.32.115 E019.48.17.575 N050.04.32.024 E019.48.17.568 Color_251ACI
N050.04.30.811 E019.48.17.599 N050.04.30.514 E019.48.19.151 Color_251ACI
N050.04.30.514 E019.48.19.151 N050.04.30.086 E019.48.21.347 Color_251ACI
N050.04.30.086 E019.48.21.347 N050.04.28.939 E019.48.20.744 Color_251ACI
N050.04.28.939 E019.48.20.744 N050.04.24.031 E019.48.18.378 Color_251ACI
N050.04.24.031 E019.48.18.378 N050.04.23.898 E019.48.17.430 Color_251ACI
N050.04.30.325 E019.47.59.963 N050.04.30.403 E019.48.00.637 Color_251ACI
N050.04.30.403 E019.48.00.637 N050.04.30.669 E019.48.02.533 Color_251ACI
N050.04.30.669 E019.48.02.533 N050.04.30.884 E019.48.04.013 Color_251ACI
N050.04.30.884 E019.48.04.013 N050.04.30.902 E019.48.04.312 Color_251ACI
N050.04.30.902 E019.48.04.312 N050.04.30.924 E019.48.04.470 Color_251ACI
N050.04.30.924 E019.48.04.470 N050.04.30.935 E019.48.04.670 Color_251ACI
N050.04.30.935 E019.48.04.670 N050.04.30.904 E019.48.04.795 Color_251ACI
N050.04.30.904 E019.48.04.795 N050.04.30.831 E019.48.05.088 Color_251ACI
N050.04.30.831 E019.48.05.088 N050.04.30.799 E019.48.05.213 Color_251ACI
N050.04.30.799 E019.48.05.213 N050.04.30.666 E019.48.05.373 Color_251ACI
N050.04.30.666 E019.48.05.373 N050.04.30.618 E019.48.05.440 Color_251ACI
N050.04.30.618 E019.48.05.440 N050.04.30.533 E019.48.05.533 Color_251ACI
N050.04.30.533 E019.48.05.533 N050.04.30.256 E019.48.05.653 Color_251ACI
N050.04.30.256 E019.48.05.653 N050.04.29.252 E019.48.05.956 Color_251ACI
N050.04.29.252 E019.48.05.956 N050.04.29.114 E019.48.06.016 Color_251ACI
N050.04.29.114 E019.48.06.016 N050.04.29.039 E019.48.06.067 Color_251ACI
N050.04.29.039 E019.48.06.067 N050.04.29.002 E019.48.06.092 Color_251ACI
N050.04.29.002 E019.48.06.092 N050.04.28.917 E019.48.06.185 Color_251ACI
N050.04.28.917 E019.48.06.185 N050.04.28.859 E019.48.06.294 Color_251ACI
N050.04.28.859 E019.48.06.294 N050.04.28.575 E019.48.07.421 Color_251ACI
N050.04.28.575 E019.48.07.421 N050.04.28.486 E019.48.07.656 Color_251ACI
N050.04.28.486 E019.48.07.656 N050.04.28.423 E019.48.07.906 Color_251ACI
N050.04.28.423 E019.48.07.906 N050.04.28.343 E019.48.08.099 Color_251ACI
N050.04.28.343 E019.48.08.099 N050.04.28.243 E019.48.08.375 Color_251ACI
N050.04.28.243 E019.48.08.375 N050.04.28.315 E019.48.08.949 Color_251ACI
N050.04.28.315 E019.48.08.949 N050.04.28.068 E019.48.09.810 Color_251ACI
N050.04.28.068 E019.48.09.810 N050.04.28.234 E019.48.10.874 Color_251ACI
N050.04.28.234 E019.48.10.874 N050.04.28.334 E019.48.11.706 Color_251ACI
N050.04.28.334 E019.48.11.706 N050.04.28.753 E019.48.12.009 Color_251ACI
N050.04.28.753 E019.48.12.009 N050.04.28.776 E019.48.12.408 Color_251ACI
N050.04.28.776 E019.48.12.408 N050.04.28.820 E019.48.12.724 Color_251ACI
N050.04.28.820 E019.48.12.724 N050.04.28.869 E019.48.12.899 Color_251ACI
N050.04.28.869 E019.48.12.899 N050.04.28.945 E019.48.13.089 Color_251ACI
N050.04.28.945 E019.48.13.089 N050.04.29.031 E019.48.13.238 Color_251ACI
N050.04.29.031 E019.48.13.238 N050.04.29.155 E019.48.13.362 Color_251ACI
N050.04.29.155 E019.48.13.362 N050.04.29.980 E019.48.13.769 Color_251ACI
N050.04.29.980 E019.48.13.769 N050.04.30.007 E019.48.13.785 Color_251ACI
N050.04.48.270 E019.48.12.446 N050.04.40.079 E019.48.15.158 Color_251ACI
N050.04.39.652 E019.48.12.056 N050.04.38.499 E019.48.03.598 Color_251ACI
N050.04.38.499 E019.48.03.598 N050.04.38.228 E019.48.02.710 Color_251ACI
N050.04.38.228 E019.48.02.710 N050.04.37.744 E019.48.02.175 Color_251ACI
N050.04.37.744 E019.48.02.175 N050.04.33.700 E019.47.59.324 Color_251ACI
N050.04.33.700 E019.47.59.324 N050.04.33.201 E019.47.58.971 Color_251ACI
N050.04.33.201 E019.47.58.971 N050.04.32.356 E019.47.58.890 Color_251ACI
N050.04.32.356 E019.47.58.890 N050.04.30.264 E019.47.59.589 Color_251ACI
N050.04.36.165 E019.47.47.292 N050.04.36.051 E019.47.45.778 Color_251ACI
N050.04.36.051 E019.47.45.778 N050.04.34.155 E019.47.31.907 Color_251ACI
N050.04.34.155 E019.47.31.907 N050.04.33.865 E019.47.31.585 Color_251ACI
N050.04.48.321 E019.48.12.862 N050.04.47.648 E019.48.13.078 Color_251ACI
N050.04.47.648 E019.48.13.078 N050.04.46.976 E019.48.13.294 Color_251ACI
N050.04.46.976 E019.48.13.294 N050.04.40.129 E019.48.15.573 Color_251ACI
N050.04.36.165 E019.47.47.292 N050.04.36.046 E019.47.48.135 Color_251ACI
N050.04.36.046 E019.47.48.135 N050.04.35.625 E019.47.49.564 Color_251ACI
N050.04.35.625 E019.47.49.564 N050.04.33.465 E019.47.54.845 Color_251ACI
N050.04.33.465 E019.47.54.845 N050.04.32.620 E019.47.56.979 Color_251ACI
N050.04.32.620 E019.47.56.979 N050.04.31.833 E019.47.57.896 Color_251ACI
N050.04.31.833 E019.47.57.896 N050.04.29.639 E019.47.58.630 Color_251ACI
N050.04.29.639 E019.47.58.630 N050.04.29.589 E019.47.58.214 Color_251ACI
N050.04.31.448 E019.46.09.628 N050.04.32.706 E019.46.18.776 Color_251ACI
N050.04.31.425 E019.46.09.229 N050.04.31.447 E019.46.09.387 Color_251ACI
N050.04.31.447 E019.46.09.387 N050.04.31.448 E019.46.09.628 Color_251ACI
N050.04.33.310 E019.46.23.142 N050.04.36.922 E019.46.49.378 Color_251ACI
N050.04.39.078 E019.47.05.287 N050.04.41.793 E019.47.25.004 Color_251ACI
N050.04.42.563 E019.47.30.675 N050.04.47.755 E019.48.08.712 Color_251ACI
N050.04.47.755 E019.48.08.712 N050.04.47.767 E019.48.08.912 Color_251ACI
N050.04.40.129 E019.48.15.573 N050.04.39.872 E019.48.15.610 Color_251ACI
N050.04.39.872 E019.48.15.610 N050.04.39.839 E019.48.15.252 Color_251ACI
N050.04.39.839 E019.48.15.252 N050.04.32.789 E019.48.17.600 Color_251ACI
N050.04.40.079 E019.48.15.158 N050.04.39.839 E019.48.15.252 Color_251ACI
N050.04.39.555 E019.48.13.056 N050.04.39.652 E019.48.12.056 Color_251ACI
N050.04.39.514 E019.48.13.224 N050.04.39.555 E019.48.13.056 Color_251ACI
N050.04.33.019 E019.47.44.555 N050.04.32.502 E019.47.44.770 Color_251ACI
N050.04.32.502 E019.47.44.770 N050.04.32.618 E019.47.45.660 Color_251ACI
N050.04.32.618 E019.47.45.660 N050.04.33.163 E019.47.45.462 Color_251ACI
N050.04.36.889 E019.47.44.410 N050.04.37.797 E019.47.44.241 Color_251ACI
N050.04.37.797 E019.47.44.241 N050.04.39.190 E019.47.43.983 Color_251ACI
N050.04.39.190 E019.47.43.983 N050.04.39.831 E019.47.43.892 Color_251ACI
N050.04.39.831 E019.47.43.892 N050.04.40.013 E019.47.43.907 Color_251ACI
N050.04.40.013 E019.47.43.907 N050.04.40.104 E019.47.43.914 Color_251ACI
N050.04.40.104 E019.47.43.914 N050.04.40.201 E019.47.44.021 Color_251ACI
N050.04.40.201 E019.47.44.021 N050.04.40.287 E019.47.44.170 Color_251ACI
N050.04.40.287 E019.47.44.170 N050.04.40.352 E019.47.44.403 Color_251ACI
N050.04.40.352 E019.47.44.403 N050.04.40.380 E019.47.44.661 Color_251ACI
N050.04.40.380 E019.47.44.661 N050.04.40.376 E019.47.44.802 Color_251ACI
N050.04.40.376 E019.47.44.802 N050.04.40.361 E019.47.44.986 Color_251ACI
N050.04.40.361 E019.47.44.986 N050.04.40.335 E019.47.45.211 Color_251ACI
N050.04.40.335 E019.47.45.211 N050.04.40.229 E019.47.45.387 Color_251ACI
N050.04.40.229 E019.47.45.387 N050.04.40.181 E019.47.45.454 Color_251ACI
N050.04.40.181 E019.47.45.454 N050.04.40.214 E019.47.45.570 Color_251ACI
N050.04.40.214 E019.47.45.570 N050.04.40.288 E019.47.45.520 Color_251ACI
N050.04.40.288 E019.47.45.520 N050.04.40.379 E019.47.45.527 Color_251ACI
N050.04.40.379 E019.47.45.527 N050.04.40.460 E019.47.45.576 Color_251ACI
N050.04.40.460 E019.47.45.576 N050.04.40.503 E019.47.45.650 Color_251ACI
N050.04.40.503 E019.47.45.650 N050.04.40.535 E019.47.45.767 Color_251ACI
N050.04.40.535 E019.47.45.767 N050.04.40.552 E019.47.45.825 Color_251ACI
N050.04.40.552 E019.47.45.825 N050.04.40.557 E019.47.45.925 Color_251ACI
N050.04.40.557 E019.47.45.925 N050.04.40.659 E019.47.45.890 Color_251ACI
N050.04.40.659 E019.47.45.890 N050.04.40.690 E019.47.45.765 Color_251ACI
N050.04.40.690 E019.47.45.765 N050.04.40.728 E019.47.45.739 Color_251ACI
N050.04.40.728 E019.47.45.739 N050.04.41.214 E019.47.45.650 Color_251ACI
N050.04.41.214 E019.47.45.650 N050.04.41.202 E019.47.45.451 Color_251ACI
N050.04.41.031 E019.47.45.394 N050.04.40.899 E019.47.44.688 Color_251ACI
N050.04.40.899 E019.47.44.688 N050.04.40.723 E019.47.44.773 Color_251ACI
N050.04.40.723 E019.47.44.773 N050.04.40.669 E019.47.44.740 Color_251ACI
N050.04.40.669 E019.47.44.740 N050.04.40.616 E019.47.44.708 Color_251ACI
N050.04.40.616 E019.47.44.708 N050.04.40.573 E019.47.44.633 Color_251ACI
N050.04.40.573 E019.47.44.633 N050.04.40.464 E019.47.44.326 Color_251ACI
N050.04.40.464 E019.47.44.326 N050.04.40.399 E019.47.44.094 Color_251ACI
N050.04.40.399 E019.47.44.094 N050.04.40.296 E019.47.43.887 Color_251ACI
N050.04.40.296 E019.47.43.887 N050.04.40.237 E019.47.43.754 Color_251ACI
N050.04.40.237 E019.47.43.754 N050.04.40.103 E019.47.43.673 Color_251ACI
N050.04.40.103 E019.47.43.673 N050.04.40.049 E019.47.43.640 Color_251ACI
N050.04.40.049 E019.47.43.640 N050.04.39.928 E019.47.42.892 Color_251ACI
N050.04.39.928 E019.47.42.892 N050.04.39.827 E019.47.42.926 Color_251ACI
N050.04.39.827 E019.47.42.926 N050.04.39.926 E019.47.43.516 Color_251ACI
N050.04.39.926 E019.47.43.516 N050.04.39.862 E019.47.43.526 Color_251ACI
N050.04.39.862 E019.47.43.526 N050.04.39.857 E019.47.43.667 Color_251ACI
N050.04.39.857 E019.47.43.667 N050.04.38.153 E019.47.43.929 Color_251ACI
N050.04.38.153 E019.47.43.929 N050.04.37.336 E019.47.44.105 Color_251ACI
N050.04.37.336 E019.47.44.105 N050.04.37.005 E019.47.44.192 Color_251ACI
N050.04.37.005 E019.47.44.192 N050.04.36.877 E019.47.44.210 Color_251ACI
N050.04.41.202 E019.47.45.451 N050.04.41.191 E019.47.45.492 Color_251ACI
N050.04.41.191 E019.47.45.492 N050.04.41.165 E019.47.45.476 Color_251ACI
N050.04.41.165 E019.47.45.476 N050.04.41.165 E019.47.45.476 Color_251ACI
N050.04.41.165 E019.47.45.476 N050.04.41.031 E019.47.45.394 Color_251ACI
N050.04.41.031 E019.47.45.394 N050.04.41.031 E019.47.45.394 Color_251ACI
N050.04.41.031 E019.47.45.394 N050.04.41.031 E019.47.45.394 Color_251ACI
N050.04.33.865 E019.47.31.585 N050.04.33.758 E019.47.31.520 Color_251ACI
N050.04.33.758 E019.47.31.520 N050.04.33.195 E019.47.31.177 Color_251ACI
N050.04.33.195 E019.47.31.177 N050.04.32.404 E019.47.31.127 Color_251ACI
N050.04.32.404 E019.47.31.127 N050.04.31.968 E019.47.31.632 Color_251ACI
N050.04.31.968 E019.47.31.632 N050.04.31.784 E019.47.32.243 Color_251ACI
N050.04.31.784 E019.47.32.243 N050.04.31.779 E019.47.32.384 Color_251ACI
N050.04.27.713 E019.47.33.806 N050.04.27.686 E019.47.33.790 Color_251ACI
N050.04.27.686 E019.47.33.790 N050.04.27.648 E019.47.33.815 Color_251ACI
N050.04.27.648 E019.47.33.815 N050.04.27.622 E019.47.33.799 Color_251ACI
N050.04.27.622 E019.47.33.799 N050.04.27.611 E019.47.33.841 Color_251ACI
N050.04.27.611 E019.47.33.841 N050.04.27.584 E019.47.33.824 Color_251ACI
N050.04.27.584 E019.47.33.824 N050.04.27.558 E019.47.33.808 Color_251ACI
N050.04.27.558 E019.47.33.808 N050.04.27.558 E019.47.33.808 Color_251ACI
N050.04.27.558 E019.47.33.808 N050.04.27.520 E019.47.33.834 Color_251ACI
N050.04.26.260 E019.47.34.173 N050.04.26.436 E019.47.34.088 Color_251ACI
N050.04.26.556 E019.47.35.702 N050.04.26.732 E019.47.35.617 Color_251ACI
N050.04.26.545 E019.47.35.503 N050.04.26.694 E019.47.35.401 Color_251ACI
N050.04.26.341 E019.47.35.330 N050.04.26.341 E019.47.35.330 Color_251ACI
N050.04.26.341 E019.47.35.330 N050.04.26.357 E019.47.35.388 Color_251ACI
N050.04.26.357 E019.47.35.388 N050.04.26.384 E019.47.35.404 Color_251ACI
N050.04.26.384 E019.47.35.404 N050.04.26.411 E019.47.35.421 Color_251ACI
N050.04.26.411 E019.47.35.421 N050.04.26.400 E019.47.35.463 Color_251ACI
N050.04.26.400 E019.47.35.463 N050.04.26.481 E019.47.35.512 Color_251ACI
N050.04.26.481 E019.47.35.512 N050.04.26.491 E019.47.35.470 Color_251ACI
N050.04.26.491 E019.47.35.470 N050.04.26.545 E019.47.35.503 Color_251ACI
N050.04.26.187 E019.47.34.466 N050.04.26.341 E019.47.35.330 Color_251ACI
N050.04.26.260 E019.47.34.173 N050.04.26.250 E019.47.34.215 Color_251ACI
N050.04.26.250 E019.47.34.215 N050.04.26.223 E019.47.34.199 Color_251ACI
N050.04.26.223 E019.47.34.199 N050.04.26.212 E019.47.34.240 Color_251ACI
N050.04.26.212 E019.47.34.240 N050.04.26.212 E019.47.34.240 Color_251ACI
N050.04.26.212 E019.47.34.240 N050.04.26.171 E019.47.34.407 Color_251ACI
N050.04.26.171 E019.47.34.407 N050.04.26.171 E019.47.34.407 Color_251ACI
N050.04.26.171 E019.47.34.407 N050.04.26.160 E019.47.34.449 Color_251ACI
N050.04.26.160 E019.47.34.449 N050.04.26.187 E019.47.34.466 Color_251ACI
N050.04.26.467 E019.47.35.937 N050.04.26.544 E019.47.36.369 Color_251ACI
N050.04.26.467 E019.47.35.937 N050.04.26.467 E019.47.35.937 Color_251ACI
N050.04.26.467 E019.47.35.937 N050.04.26.477 E019.47.35.895 Color_251ACI
N050.04.26.477 E019.47.35.895 N050.04.26.461 E019.47.35.837 Color_251ACI
N050.04.26.461 E019.47.35.837 N050.04.26.471 E019.47.35.795 Color_251ACI
N050.04.26.471 E019.47.35.795 N050.04.26.498 E019.47.35.811 Color_251ACI
N050.04.26.498 E019.47.35.811 N050.04.26.519 E019.47.35.728 Color_251ACI
N050.04.26.519 E019.47.35.728 N050.04.26.519 E019.47.35.728 Color_251ACI
N050.04.26.519 E019.47.35.728 N050.04.26.530 E019.47.35.686 Color_251ACI
N050.04.26.530 E019.47.35.686 N050.04.26.556 E019.47.35.702 Color_251ACI
N050.04.26.544 E019.47.36.369 N050.04.26.544 E019.47.36.369 Color_251ACI
N050.04.26.544 E019.47.36.369 N050.04.26.544 E019.47.36.369 Color_251ACI
N050.04.26.544 E019.47.36.369 N050.04.26.570 E019.47.36.385 Color_251ACI
N050.04.26.570 E019.47.36.385 N050.04.26.587 E019.47.36.443 Color_251ACI
N050.04.26.587 E019.47.36.443 N050.04.26.587 E019.47.36.443 Color_251ACI
N050.04.26.587 E019.47.36.443 N050.04.26.613 E019.47.36.460 Color_251ACI
N050.04.26.613 E019.47.36.460 N050.04.26.694 E019.47.36.509 Color_251ACI
N050.04.26.694 E019.47.36.509 N050.04.26.897 E019.47.36.440 Color_251ACI
N050.04.26.897 E019.47.36.440 N050.04.26.968 E019.47.36.772 Color_251ACI
N050.04.26.968 E019.47.36.772 N050.04.26.162 E019.47.37.148 Color_251ACI
N050.04.26.162 E019.47.37.148 N050.04.26.152 E019.47.37.190 Color_251ACI
N050.04.26.152 E019.47.37.190 N050.04.26.125 E019.47.37.173 Color_251ACI
N050.04.26.125 E019.47.37.173 N050.04.26.125 E019.47.37.173 Color_251ACI
N050.04.26.125 E019.47.37.173 N050.04.26.115 E019.47.37.215 Color_251ACI
N050.04.26.115 E019.47.37.215 N050.04.26.094 E019.47.37.299 Color_251ACI
N050.04.26.094 E019.47.37.299 N050.04.26.067 E019.47.37.282 Color_251ACI
N050.04.26.067 E019.47.37.282 N050.04.26.046 E019.47.37.366 Color_251ACI
N050.04.26.046 E019.47.37.366 N050.04.26.073 E019.47.37.382 Color_251ACI
N050.04.26.073 E019.47.37.382 N050.04.26.062 E019.47.37.424 Color_251ACI
N050.04.26.062 E019.47.37.424 N050.04.26.062 E019.47.37.424 Color_251ACI
N050.04.26.062 E019.47.37.424 N050.04.26.052 E019.47.37.466 Color_251ACI
N050.04.26.052 E019.47.37.466 N050.04.26.068 E019.47.37.524 Color_251ACI
N050.04.26.068 E019.47.37.524 N050.04.26.068 E019.47.37.524 Color_251ACI
N050.04.25.999 E019.47.34.351 N050.04.26.027 E019.47.34.609 Color_251ACI
N050.04.26.027 E019.47.34.609 N050.04.26.012 E019.47.34.792 Color_251ACI
N050.04.26.012 E019.47.34.792 N050.04.26.357 E019.47.36.496 Color_251ACI
N050.04.26.108 E019.47.36.874 N050.04.26.246 E019.47.36.814 Color_251ACI
N050.04.26.357 E019.47.36.496 N050.04.26.373 E019.47.36.554 Color_251ACI
N050.04.26.373 E019.47.36.554 N050.04.26.373 E019.47.36.554 Color_251ACI
N050.04.26.373 E019.47.36.554 N050.04.26.363 E019.47.36.596 Color_251ACI
N050.04.26.363 E019.47.36.596 N050.04.26.331 E019.47.36.721 Color_251ACI
N050.04.26.331 E019.47.36.721 N050.04.26.331 E019.47.36.721 Color_251ACI
N050.04.26.331 E019.47.36.721 N050.04.26.310 E019.47.36.805 Color_251ACI
N050.04.26.310 E019.47.36.805 N050.04.26.284 E019.47.36.788 Color_251ACI
N050.04.26.284 E019.47.36.788 N050.04.26.257 E019.47.36.772 Color_251ACI
N050.04.26.257 E019.47.36.772 N050.04.26.246 E019.47.36.814 Color_251ACI
N050.04.25.795 E019.47.34.179 N050.04.25.795 E019.47.34.179 Color_251ACI
N050.04.25.795 E019.47.34.179 N050.04.25.833 E019.47.34.153 Color_251ACI
N050.04.25.833 E019.47.34.153 N050.04.25.940 E019.47.34.219 Color_251ACI
N050.04.25.940 E019.47.34.219 N050.04.25.929 E019.47.34.260 Color_251ACI
N050.04.25.929 E019.47.34.260 N050.04.25.956 E019.47.34.277 Color_251ACI
N050.04.25.956 E019.47.34.277 N050.04.25.956 E019.47.34.277 Color_251ACI
N050.04.25.956 E019.47.34.277 N050.04.25.983 E019.47.34.293 Color_251ACI
N050.04.25.983 E019.47.34.293 N050.04.25.999 E019.47.34.351 Color_251ACI
N050.04.25.999 E019.47.34.351 N050.04.25.999 E019.47.34.351 Color_251ACI
N050.04.26.887 E019.47.26.753 N050.04.26.881 E019.47.26.653 Color_251ACI
N050.04.26.881 E019.47.26.653 N050.04.26.876 E019.47.26.553 Color_251ACI
N050.04.26.876 E019.47.26.553 N050.04.26.897 E019.47.26.469 Color_251ACI
N050.04.26.897 E019.47.26.469 N050.04.26.939 E019.47.26.302 Color_251ACI
N050.04.26.939 E019.47.26.302 N050.04.26.986 E019.47.26.235 Color_251ACI
N050.04.26.986 E019.47.26.235 N050.04.27.034 E019.47.26.168 Color_251ACI
N050.04.27.034 E019.47.26.168 N050.04.27.071 E019.47.26.143 Color_251ACI
N050.04.27.071 E019.47.26.143 N050.04.27.237 E019.47.26.099 Color_251ACI
N050.04.27.237 E019.47.26.099 N050.04.27.218 E019.47.26.666 Color_251ACI
N050.04.27.912 E019.47.26.366 N050.04.27.873 E019.47.26.150 Color_251ACI
N050.04.27.873 E019.47.26.150 N050.04.27.984 E019.47.25.832 Color_251ACI
N050.04.27.984 E019.47.25.832 N050.04.28.405 E019.47.25.511 Color_251ACI
N050.04.28.405 E019.47.25.511 N050.04.28.603 E019.47.25.583 Color_251ACI
N050.04.28.603 E019.47.25.583 N050.04.28.662 E019.47.25.716 Color_251ACI
N050.04.28.662 E019.47.25.716 N050.04.28.738 E019.47.25.906 Color_251ACI
N050.04.28.738 E019.47.25.906 N050.04.28.803 E019.47.26.139 Color_251ACI
N050.04.28.803 E019.47.26.139 N050.04.28.782 E019.47.26.222 Color_251ACI
N050.04.28.782 E019.47.26.222 N050.04.28.606 E019.47.26.308 Color_251ACI
N050.04.28.606 E019.47.26.308 N050.04.28.699 E019.47.26.557 Color_251ACI
N050.04.28.699 E019.47.26.557 N050.04.28.411 E019.47.26.718 Color_251ACI
N050.04.25.877 E019.47.27.822 N050.04.25.838 E019.47.27.606 Color_251ACI
N050.04.25.838 E019.47.27.606 N050.04.25.422 E019.47.27.786 Color_251ACI
N050.04.25.422 E019.47.27.786 N050.04.25.313 E019.47.27.238 Color_251ACI
N050.04.25.313 E019.47.27.238 N050.04.25.434 E019.47.26.878 Color_251ACI
N050.04.25.767 E019.47.28.382 N050.04.25.341 E019.47.28.603 Color_251ACI
N050.04.25.434 E019.47.26.878 N050.04.26.229 E019.47.26.544 Color_251ACI
N050.04.24.281 E019.47.27.283 N050.04.24.761 E019.47.27.094 Color_251ACI
N050.04.25.715 E019.47.26.375 N050.04.24.487 E019.47.26.831 Color_251ACI
N050.04.24.487 E019.47.26.831 N050.04.24.338 E019.47.26.933 Color_251ACI
N050.04.25.804 E019.47.26.141 N050.04.25.794 E019.47.26.183 Color_251ACI
N050.04.25.794 E019.47.26.183 N050.04.25.810 E019.47.26.241 Color_251ACI
N050.04.25.810 E019.47.26.241 N050.04.25.800 E019.47.26.282 Color_251ACI
N050.04.25.800 E019.47.26.282 N050.04.25.763 E019.47.26.308 Color_251ACI
N050.04.25.763 E019.47.26.308 N050.04.25.752 E019.47.26.350 Color_251ACI
N050.04.25.752 E019.47.26.350 N050.04.25.715 E019.47.26.375 Color_251ACI
N050.04.25.715 E019.47.26.375 N050.04.25.715 E019.47.26.375 Color_251ACI
N050.04.25.701 E019.47.25.692 N050.04.25.804 E019.47.26.141 Color_251ACI
N050.04.28.578 E019.46.52.816 N050.04.28.791 E019.46.52.705 Color_251ACI
N050.04.28.791 E019.46.52.705 N050.04.33.425 E019.47.26.693 Color_251ACI
N050.04.33.425 E019.47.26.693 N050.04.33.425 E019.47.26.693 Color_251ACI
N050.04.33.425 E019.47.26.693 N050.04.32.951 E019.47.25.007 Color_251ACI
N050.04.29.169 E019.47.22.220 N050.04.29.659 E019.47.23.963 Color_251ACI
N050.04.26.482 E019.47.10.274 N050.04.26.493 E019.47.10.474 Color_251ACI
N050.04.26.493 E019.47.10.474 N050.04.26.598 E019.47.12.272 Color_251ACI
N050.04.26.598 E019.47.12.272 N050.04.26.508 E019.47.12.506 Color_251ACI
N050.04.26.508 E019.47.12.506 N050.04.27.336 E019.47.15.611 Color_251ACI
N050.04.27.336 E019.47.15.611 N050.04.29.104 E019.47.21.987 Color_251ACI
N050.04.28.463 E019.47.22.078 N050.04.28.629 E019.47.22.035 Color_251ACI
N050.04.28.629 E019.47.22.035 N050.04.28.725 E019.47.22.142 Color_251ACI
N050.04.28.725 E019.47.22.142 N050.04.28.806 E019.47.22.191 Color_251ACI
N050.04.28.806 E019.47.22.191 N050.04.28.870 E019.47.22.182 Color_251ACI
N050.04.28.870 E019.47.22.182 N050.04.29.046 E019.47.22.096 Color_251ACI
N050.04.29.046 E019.47.22.096 N050.04.29.104 E019.47.21.987 Color_251ACI
N050.04.29.293 E019.47.24.559 N050.04.29.229 E019.47.24.568 Color_251ACI
N050.04.29.229 E019.47.24.568 N050.04.29.202 E019.47.24.552 Color_251ACI
N050.04.29.202 E019.47.24.552 N050.04.29.169 E019.47.24.435 Color_251ACI
N050.04.29.169 E019.47.24.435 N050.04.29.098 E019.47.24.103 Color_251ACI
N050.04.29.098 E019.47.24.103 N050.04.28.792 E019.47.22.616 Color_251ACI
N050.04.28.792 E019.47.22.616 N050.04.28.796 E019.47.22.474 Color_251ACI
N050.04.28.796 E019.47.22.474 N050.04.28.855 E019.47.22.365 Color_251ACI
N050.04.28.855 E019.47.22.365 N050.04.29.078 E019.47.22.213 Color_251ACI
N050.04.29.078 E019.47.22.213 N050.04.29.169 E019.47.22.220 Color_251ACI
N050.04.29.659 E019.47.23.963 N050.04.29.538 E019.47.24.323 Color_251ACI
N050.04.29.538 E019.47.24.323 N050.04.29.293 E019.47.24.559 Color_251ACI
N050.04.30.369 E019.47.20.398 N050.04.29.548 E019.47.20.958 Color_251ACI
N050.04.29.548 E019.47.20.958 N050.04.29.216 E019.47.20.803 Color_251ACI
N050.04.29.216 E019.47.20.803 N050.04.29.053 E019.47.20.222 Color_251ACI
N050.04.29.053 E019.47.20.222 N050.04.29.270 E019.47.19.728 Color_251ACI
N050.04.29.270 E019.47.19.728 N050.04.30.453 E019.47.18.956 Color_251ACI
N050.04.30.453 E019.47.18.956 N050.04.30.806 E019.47.19.027 Color_251ACI
N050.04.30.920 E019.47.19.434 N050.04.30.936 E019.47.19.492 Color_251ACI
N050.04.30.936 E019.47.19.492 N050.04.30.719 E019.47.19.986 Color_251ACI
N050.04.30.719 E019.47.19.986 N050.04.30.384 E019.47.20.215 Color_251ACI
N050.04.30.384 E019.47.20.215 N050.04.30.369 E019.47.20.398 Color_251ACI
N050.04.30.052 E019.47.14.522 N050.04.30.144 E019.47.14.770 Color_251ACI
N050.04.30.144 E019.47.14.770 N050.04.30.240 E019.47.14.877 Color_251ACI
N050.04.30.240 E019.47.14.877 N050.04.30.837 E019.47.14.471 Color_251ACI
N050.04.30.837 E019.47.14.471 N050.04.30.919 E019.47.14.761 Color_251ACI
N050.04.30.919 E019.47.14.761 N050.04.30.306 E019.47.15.110 Color_251ACI
N050.04.30.306 E019.47.15.110 N050.04.30.274 E019.47.15.235 Color_251ACI
N050.04.29.870 E019.47.15.615 N050.04.29.726 E019.47.15.816 Color_251ACI
N050.04.29.726 E019.47.15.816 N050.04.29.252 E019.47.16.105 Color_251ACI
N050.04.29.252 E019.47.16.105 N050.04.29.274 E019.47.16.263 Color_251ACI
N050.04.29.274 E019.47.16.263 N050.04.29.307 E019.47.16.379 Color_251ACI
N050.04.29.307 E019.47.16.379 N050.04.29.808 E019.47.16.107 Color_251ACI
N050.04.29.808 E019.47.16.107 N050.04.29.973 E019.47.16.063 Color_251ACI
N050.04.29.543 E019.47.14.453 N050.04.29.294 E019.47.14.830 Color_251ACI
N050.04.29.294 E019.47.14.830 N050.04.28.111 E019.47.15.602 Color_251ACI
N050.04.28.111 E019.47.15.602 N050.04.27.747 E019.47.15.573 Color_251ACI
N050.04.27.747 E019.47.15.573 N050.04.27.578 E019.47.14.892 Color_251ACI
N050.04.27.578 E019.47.14.892 N050.04.27.785 E019.47.14.440 Color_251ACI
N050.04.27.785 E019.47.14.440 N050.04.28.978 E019.47.13.626 Color_251ACI
N050.04.28.978 E019.47.13.626 N050.04.29.331 E019.47.13.697 Color_251ACI
N050.04.29.331 E019.47.13.697 N050.04.29.237 E019.47.14.073 Color_251ACI
N050.04.29.237 E019.47.14.073 N050.04.28.406 E019.47.14.674 Color_251ACI
N050.04.28.406 E019.47.14.674 N050.04.28.487 E019.47.14.965 Color_251ACI
N050.04.28.487 E019.47.14.965 N050.04.29.335 E019.47.14.422 Color_251ACI
N050.04.29.335 E019.47.14.422 N050.04.29.543 E019.47.14.453 Color_251ACI
N050.04.24.428 E019.47.15.620 N050.04.24.065 E019.47.15.833 Color_251ACI
N050.04.23.946 E019.47.15.568 N050.04.24.522 E019.47.15.244 Color_251ACI
N050.04.23.735 E019.47.12.838 N050.04.23.634 E019.47.12.873 Color_251ACI
N050.04.24.450 E019.47.14.671 N050.04.24.370 E019.47.14.622 Color_251ACI
N050.04.24.370 E019.47.14.622 N050.04.24.368 E019.47.14.380 Color_251ACI
N050.04.22.814 E019.47.16.755 N050.04.22.803 E019.47.16.797 Color_251ACI
N050.04.22.803 E019.47.16.797 N050.04.22.803 E019.47.16.797 Color_251ACI
N050.04.22.803 E019.47.16.797 N050.04.22.830 E019.47.16.814 Color_251ACI
N050.04.22.830 E019.47.16.814 N050.04.22.910 E019.47.16.863 Color_251ACI
N050.04.30.274 E019.47.15.235 N050.04.31.488 E019.47.19.636 Color_251ACI
N050.04.31.488 E019.47.19.636 N050.04.32.951 E019.47.25.007 Color_251ACI
N050.04.29.834 E019.47.13.666 N050.04.29.932 E019.47.14.015 Color_251ACI
N050.04.29.632 E019.47.12.869 N050.04.29.730 E019.47.13.218 Color_251ACI
N050.04.29.932 E019.47.14.015 N050.04.30.012 E019.47.14.064 Color_251ACI
N050.04.30.012 E019.47.14.064 N050.04.30.635 E019.47.13.673 Color_251ACI
N050.04.30.635 E019.47.13.673 N050.04.30.690 E019.47.13.948 Color_251ACI
N050.04.30.690 E019.47.13.948 N050.04.30.104 E019.47.14.313 Color_251ACI
N050.04.30.104 E019.47.14.313 N050.04.30.052 E019.47.14.522 Color_251ACI
N050.04.29.730 E019.47.13.218 N050.04.29.810 E019.47.13.267 Color_251ACI
N050.04.29.810 E019.47.13.267 N050.04.30.397 E019.47.12.902 Color_251ACI
N050.04.30.397 E019.47.12.902 N050.04.30.478 E019.47.13.192 Color_251ACI
N050.04.30.478 E019.47.13.192 N050.04.29.865 E019.47.13.541 Color_251ACI
N050.04.29.865 E019.47.13.541 N050.04.29.834 E019.47.13.666 Color_251ACI
N050.04.29.426 E019.47.12.213 N050.04.29.491 E019.47.12.446 Color_251ACI
N050.04.29.126 E019.47.11.067 N050.04.29.191 E019.47.11.300 Color_251ACI
N050.04.28.484 E019.47.08.701 N050.04.28.996 E019.47.10.603 Color_251ACI
N050.04.29.491 E019.47.12.446 N050.04.29.571 E019.47.12.495 Color_251ACI
N050.04.29.571 E019.47.12.495 N050.04.30.195 E019.47.12.104 Color_251ACI
N050.04.30.195 E019.47.12.104 N050.04.30.250 E019.47.12.379 Color_251ACI
N050.04.30.250 E019.47.12.379 N050.04.29.663 E019.47.12.744 Color_251ACI
N050.04.29.663 E019.47.12.744 N050.04.29.632 E019.47.12.869 Color_251ACI
N050.04.29.191 E019.47.11.300 N050.04.29.433 E019.47.11.447 Color_251ACI
N050.04.29.433 E019.47.11.447 N050.04.29.917 E019.47.11.116 Color_251ACI
N050.04.29.917 E019.47.11.116 N050.04.30.026 E019.47.11.423 Color_251ACI
N050.04.30.026 E019.47.11.423 N050.04.29.531 E019.47.11.796 Color_251ACI
N050.04.29.531 E019.47.11.796 N050.04.29.426 E019.47.12.213 Color_251ACI
N050.04.28.996 E019.47.10.603 N050.04.29.076 E019.47.10.652 Color_251ACI
N050.04.29.076 E019.47.10.652 N050.04.29.662 E019.47.10.286 Color_251ACI
N050.04.29.662 E019.47.10.286 N050.04.29.744 E019.47.10.577 Color_251ACI
N050.04.29.744 E019.47.10.577 N050.04.29.131 E019.47.10.926 Color_251ACI
N050.04.29.131 E019.47.10.926 N050.04.29.126 E019.47.11.067 Color_251ACI
N050.04.29.064 E019.47.12.667 N050.04.28.957 E019.47.12.602 Color_251ACI
N050.04.28.957 E019.47.12.602 N050.04.28.398 E019.47.12.983 Color_251ACI
N050.04.28.398 E019.47.12.983 N050.04.28.306 E019.47.12.735 Color_251ACI
N050.04.28.306 E019.47.12.735 N050.04.28.892 E019.47.12.370 Color_251ACI
N050.04.28.892 E019.47.12.370 N050.04.28.934 E019.47.12.202 Color_251ACI
N050.04.28.194 E019.47.09.487 N050.04.28.118 E019.47.09.297 Color_251ACI
N050.04.28.170 E019.47.10.196 N050.04.27.686 E019.47.10.526 Color_251ACI
N050.04.27.686 E019.47.10.526 N050.04.27.761 E019.47.10.717 Color_251ACI
N050.04.27.761 E019.47.10.717 N050.04.27.399 E019.47.10.929 Color_251ACI
N050.04.27.399 E019.47.10.929 N050.04.27.241 E019.47.10.448 Color_251ACI
N050.04.27.241 E019.47.10.448 N050.04.28.089 E019.47.09.905 Color_251ACI
N050.04.28.089 E019.47.09.905 N050.04.28.194 E019.47.09.487 Color_251ACI
N050.04.27.801 E019.47.08.959 N050.04.27.935 E019.47.09.041 Color_251ACI
N050.04.27.935 E019.47.09.041 N050.04.27.989 E019.47.09.073 Color_251ACI
N050.04.27.989 E019.47.09.073 N050.04.28.015 E019.47.09.090 Color_251ACI
N050.04.28.015 E019.47.09.090 N050.04.28.058 E019.47.09.164 Color_251ACI
N050.04.28.058 E019.47.09.164 N050.04.28.075 E019.47.09.222 Color_251ACI
N050.04.28.075 E019.47.09.222 N050.04.28.118 E019.47.09.297 Color_251ACI
N050.04.27.379 E019.47.09.039 N050.04.27.801 E019.47.08.959 Color_251ACI
N050.04.27.558 E019.47.08.570 N050.04.27.596 E019.47.08.545 Color_251ACI
N050.04.27.596 E019.47.08.545 N050.04.27.644 E019.47.08.478 Color_251ACI
N050.04.27.644 E019.47.08.478 N050.04.27.702 E019.47.08.369 Color_251ACI
N050.04.27.702 E019.47.08.369 N050.04.27.744 E019.47.08.202 Color_251ACI
N050.04.27.744 E019.47.08.202 N050.04.27.738 E019.47.08.102 Color_251ACI
N050.04.27.738 E019.47.08.102 N050.04.27.743 E019.47.07.960 Color_251ACI
N050.04.27.743 E019.47.07.960 N050.04.27.726 E019.47.07.902 Color_251ACI
N050.04.22.850 E019.47.07.626 N050.04.22.887 E019.47.07.601 Color_251ACI
N050.04.22.887 E019.47.07.601 N050.04.22.914 E019.47.07.617 Color_251ACI
N050.04.22.914 E019.47.07.617 N050.04.22.903 E019.47.07.659 Color_251ACI
N050.04.22.903 E019.47.07.659 N050.04.22.920 E019.47.07.717 Color_251ACI
N050.04.21.027 E019.47.07.623 N050.04.21.043 E019.47.07.681 Color_251ACI
N050.04.21.043 E019.47.07.681 N050.04.21.059 E019.47.07.739 Color_251ACI
N050.04.21.059 E019.47.07.739 N050.04.21.086 E019.47.07.755 Color_251ACI
N050.04.21.086 E019.47.07.755 N050.04.21.129 E019.47.07.830 Color_251ACI
N050.04.21.129 E019.47.07.830 N050.04.21.156 E019.47.07.846 Color_251ACI
N050.04.21.156 E019.47.07.846 N050.04.21.210 E019.47.07.879 Color_251ACI
N050.04.21.210 E019.47.07.879 N050.04.21.236 E019.47.07.895 Color_251ACI
N050.04.21.236 E019.47.07.895 N050.04.21.301 E019.47.07.886 Color_251ACI
N050.04.37.670 E019.46.54.892 N050.04.37.748 E019.46.55.565 Color_251ACI
N050.04.37.748 E019.46.55.565 N050.04.38.956 E019.47.04.297 Color_251ACI
N050.04.31.663 E019.47.06.257 N050.04.33.739 E019.47.05.499 Color_251ACI
N050.04.33.739 E019.47.05.499 N050.04.33.820 E019.47.05.548 Color_251ACI
N050.04.33.820 E019.47.05.548 N050.04.33.900 E019.47.05.597 Color_251ACI
N050.04.33.900 E019.47.05.597 N050.04.34.025 E019.47.05.962 Color_251ACI
N050.04.34.025 E019.47.05.962 N050.04.34.275 E019.47.05.826 Color_251ACI
N050.04.34.275 E019.47.05.826 N050.04.34.167 E019.47.05.519 Color_251ACI
N050.04.34.167 E019.47.05.519 N050.04.34.593 E019.47.05.298 Color_251ACI
N050.04.34.593 E019.47.05.298 N050.04.34.382 E019.47.04.784 Color_251ACI
N050.04.34.382 E019.47.04.784 N050.04.34.068 E019.47.04.929 Color_251ACI
N050.04.34.068 E019.47.04.929 N050.04.33.634 E019.47.03.701 Color_251ACI
N050.04.33.634 E019.47.03.701 N050.04.33.491 E019.47.03.903 Color_251ACI
N050.04.33.491 E019.47.03.903 N050.04.33.789 E019.47.04.807 Color_251ACI
N050.04.33.789 E019.47.04.807 N050.04.33.795 E019.47.04.907 Color_251ACI
N050.04.33.795 E019.47.04.907 N050.04.33.780 E019.47.05.091 Color_251ACI
N050.04.33.780 E019.47.05.091 N050.04.33.748 E019.47.05.216 Color_251ACI
N050.04.33.748 E019.47.05.216 N050.04.33.674 E019.47.05.267 Color_251ACI
N050.04.33.674 E019.47.05.267 N050.04.31.635 E019.47.05.999 Color_251ACI
N050.04.28.578 E019.46.52.816 N050.04.28.079 E019.46.52.464 Color_251ACI
N050.04.28.079 E019.46.52.464 N050.04.25.197 E019.46.52.248 Color_251ACI
N050.04.25.197 E019.46.52.248 N050.04.24.618 E019.46.52.954 Color_251ACI
N050.04.24.618 E019.46.52.954 N050.04.24.403 E019.46.53.931 Color_251ACI
N050.04.24.403 E019.46.53.931 N050.04.28.359 E019.47.08.336 Color_251ACI
N050.04.23.775 E019.47.00.002 N050.04.25.239 E019.47.05.374 Color_251ACI
N050.04.25.239 E019.47.05.374 N050.04.25.353 E019.47.05.781 Color_251ACI
N050.04.35.226 E019.46.52.438 N050.04.30.499 E019.46.52.061 Color_251ACI
N050.04.35.226 E019.46.52.438 N050.04.35.733 E019.46.52.266 Color_251ACI
N050.04.35.733 E019.46.52.266 N050.04.36.213 E019.46.52.077 Color_251ACI
N050.04.36.213 E019.46.52.077 N050.04.36.844 E019.46.50.920 Color_251ACI
N050.04.36.844 E019.46.50.920 N050.04.36.922 E019.46.49.378 Color_251ACI
N050.04.25.576 E019.47.06.495 N050.04.26.185 E019.47.08.745 Color_251ACI
N050.04.31.425 E019.46.09.229 N050.04.30.739 E019.46.07.654 Color_251ACI
N050.04.30.739 E019.46.07.654 N050.04.29.471 E019.46.07.411 Color_251ACI
N050.04.29.471 E019.46.07.411 N050.04.24.731 E019.46.09.049 Color_251ACI
N050.04.24.731 E019.46.09.049 N050.04.24.083 E019.46.09.906 Color_251ACI
N050.04.24.083 E019.46.09.906 N050.04.23.914 E019.46.11.441 Color_251ACI
N050.04.23.914 E019.46.11.441 N050.04.24.824 E019.46.18.160 Color_251ACI
N050.04.24.824 E019.46.18.160 N050.04.25.091 E019.46.18.082 Color_251ACI
N050.04.22.434 E019.46.08.227 N050.04.28.860 E019.46.06.027 Color_251ACI
N050.04.28.860 E019.46.06.027 N050.04.29.303 E019.46.05.864 Color_251ACI
N050.04.19.622 E019.48.08.609 N050.04.20.348 E019.48.08.426 Color_251ACI
N050.04.19.933 E019.48.13.278 N050.04.19.921 E019.48.13.079 Color_251ACI
N050.04.19.921 E019.48.13.079 N050.04.19.657 E019.48.10.316 Color_251ACI
N050.04.19.657 E019.48.10.316 N050.04.19.688 E019.48.09.083 Color_251ACI
N050.04.19.688 E019.48.09.083 N050.04.19.676 E019.48.08.884 Color_251ACI
N050.04.19.676 E019.48.08.884 N050.04.19.772 E019.48.08.749 Color_251ACI
N050.04.19.772 E019.48.08.749 N050.04.20.370 E019.48.08.584 Color_251ACI
N050.04.20.370 E019.48.08.584 N050.04.20.326 E019.48.08.268 Color_251ACI
N050.04.21.610 E019.48.00.815 N050.04.22.982 E019.48.00.399 Color_251ACI
N050.04.20.001 E019.47.59.834 N050.04.20.866 E019.47.59.591 Color_251ACI
N050.04.20.866 E019.47.59.591 N050.04.21.531 E019.47.58.792 Color_251ACI
N050.04.21.531 E019.47.58.792 N050.04.21.164 E019.47.58.038 Color_251ACI
N050.04.21.164 E019.47.58.038 N050.04.21.381 E019.47.57.786 Color_251ACI
N050.04.36.963 E019.47.54.329 N050.04.36.723 E019.47.54.424 Color_251ACI
N050.04.36.723 E019.47.54.424 N050.04.36.492 E019.47.54.235 Color_251ACI
N050.04.36.492 E019.47.54.235 N050.04.36.578 E019.47.54.142 Color_251ACI
N050.04.36.578 E019.47.54.142 N050.04.36.550 E019.47.53.884 Color_251ACI
N050.04.36.550 E019.47.53.884 N050.04.36.405 E019.47.53.844 Color_251ACI
N050.04.36.405 E019.47.53.844 N050.04.36.240 E019.47.52.780 Color_251ACI
N050.04.36.240 E019.47.52.780 N050.04.36.362 E019.47.52.662 Color_251ACI
N050.04.36.362 E019.47.52.662 N050.04.36.323 E019.47.52.446 Color_251ACI
N050.04.36.323 E019.47.52.446 N050.04.36.216 E019.47.52.381 Color_251ACI
N050.04.36.216 E019.47.52.381 N050.04.36.439 E019.47.51.987 Color_251ACI
N050.04.36.439 E019.47.51.987 N050.04.36.383 E019.47.51.471 Color_251ACI
N050.04.36.383 E019.47.51.471 N050.04.36.302 E019.47.51.422 Color_251ACI
N050.04.36.302 E019.47.51.422 N050.04.36.117 E019.47.51.790 Color_251ACI
N050.04.36.117 E019.47.51.790 N050.04.35.520 E019.47.53.305 Color_251ACI
N050.04.35.520 E019.47.53.305 N050.04.35.743 E019.47.55.127 Color_251ACI
N050.04.35.743 E019.47.55.127 N050.04.35.898 E019.47.56.233 Color_251ACI
N050.04.35.898 E019.47.56.233 N050.04.36.043 E019.47.57.380 Color_251ACI
N050.04.36.043 E019.47.57.380 N050.04.36.264 E019.47.58.960 Color_251ACI
N050.04.36.264 E019.47.58.960 N050.04.36.531 E019.47.58.882 Color_251ACI
N050.04.36.531 E019.47.58.882 N050.04.36.755 E019.47.58.730 Color_251ACI
N050.04.36.755 E019.47.58.730 N050.04.37.094 E019.47.58.118 Color_251ACI
N050.04.37.094 E019.47.58.118 N050.04.37.101 E019.47.57.351 Color_251ACI
N050.04.37.101 E019.47.57.351 N050.04.36.886 E019.47.57.220 Color_251ACI
N050.04.36.886 E019.47.57.220 N050.04.36.982 E019.47.57.086 Color_251ACI
N050.04.36.982 E019.47.57.086 N050.04.36.944 E019.47.56.870 Color_251ACI
N050.04.36.944 E019.47.56.870 N050.04.36.799 E019.47.56.830 Color_251ACI
N050.04.36.799 E019.47.56.830 N050.04.36.671 E019.47.55.740 Color_251ACI
N050.04.36.671 E019.47.55.740 N050.04.36.793 E019.47.55.622 Color_251ACI
N050.04.36.793 E019.47.55.622 N050.04.36.765 E019.47.55.364 Color_251ACI
N050.04.36.765 E019.47.55.364 N050.04.36.647 E019.47.55.341 Color_251ACI
N050.04.36.647 E019.47.55.341 N050.04.36.833 E019.47.54.972 Color_251ACI
N050.04.36.833 E019.47.54.972 N050.04.37.036 E019.47.54.903 Color_251ACI
N050.04.39.174 E019.48.13.836 N050.04.39.222 E019.48.13.768 Color_251ACI
N050.04.39.222 E019.48.13.768 N050.04.39.297 E019.48.13.717 Color_251ACI
N050.04.39.297 E019.48.13.717 N050.04.39.345 E019.48.13.650 Color_251ACI
N050.04.39.345 E019.48.13.650 N050.04.39.392 E019.48.13.583 Color_251ACI
N050.04.39.392 E019.48.13.583 N050.04.39.440 E019.48.13.516 Color_251ACI
N050.04.39.440 E019.48.13.516 N050.04.39.461 E019.48.13.432 Color_251ACI
N050.04.39.461 E019.48.13.432 N050.04.39.514 E019.48.13.224 Color_251ACI
N050.04.38.721 E019.48.14.041 N050.04.39.174 E019.48.13.836 Color_251ACI
N050.04.33.310 E019.46.23.142 N050.04.33.028 E019.46.22.295 Color_251ACI
N050.04.33.028 E019.46.22.295 N050.04.32.398 E019.46.21.478 Color_251ACI
N050.04.32.398 E019.46.21.478 N050.04.31.879 E019.46.21.209 Color_251ACI
N050.04.31.879 E019.46.21.209 N050.04.29.151 E019.46.20.991 Color_251ACI
N050.04.29.151 E019.46.20.991 N050.04.26.424 E019.46.20.774 Color_251ACI
N050.04.26.424 E019.46.20.774 N050.04.25.668 E019.46.21.324 Color_251ACI
N050.04.25.668 E019.46.21.324 N050.04.25.567 E019.46.21.600 Color_251ACI
N050.04.25.567 E019.46.21.600 N050.04.29.678 E019.46.51.512 Color_251ACI
N050.04.30.613 E019.47.07.976 N050.04.32.951 E019.47.25.007 Color_251ACI
N050.04.28.578 E019.46.52.816 N050.04.30.590 E019.47.07.577 Color_251ACI
N050.04.31.830 E019.47.07.562 N050.04.34.317 E019.47.25.599 Color_251ACI
N050.04.31.663 E019.47.06.257 N050.04.31.807 E019.47.07.163 Color_251ACI
N050.04.18.954 E019.48.00.929 N050.04.18.954 E019.48.00.929 Color_251ACI
N050.04.14.981 E019.48.15.269 N050.04.14.944 E019.48.15.294 Color_251ACI
N050.04.14.944 E019.48.15.294 N050.04.14.902 E019.48.15.461 Color_251ACI
N050.04.14.902 E019.48.15.461 N050.04.14.918 E019.48.15.520 Color_251ACI
N050.04.19.976 E019.48.18.892 N050.04.19.992 E019.48.18.950 Color_251ACI
N050.04.19.992 E019.48.18.950 N050.04.20.019 E019.48.18.966 Color_251ACI
N050.04.20.019 E019.48.18.966 N050.04.20.056 E019.48.18.941 Color_251ACI
N050.04.20.056 E019.48.18.941 N050.04.20.083 E019.48.18.957 Color_251ACI
N050.04.20.083 E019.48.18.957 N050.04.20.115 E019.48.18.832 Color_251ACI
N050.04.38.917 E019.47.05.189 N050.04.38.955 E019.47.05.163 Color_251ACI
N050.04.38.955 E019.47.05.163 N050.04.39.008 E019.47.05.196 Color_251ACI
N050.04.39.008 E019.47.05.196 N050.04.39.019 E019.47.05.154 Color_251ACI
N050.04.39.019 E019.47.05.154 N050.04.39.046 E019.47.05.170 Color_251ACI
N050.04.39.046 E019.47.05.170 N050.04.39.062 E019.47.05.229 Color_251ACI
N050.04.39.062 E019.47.05.229 N050.04.39.062 E019.47.05.229 Color_251ACI
N050.04.39.062 E019.47.05.229 N050.04.39.078 E019.47.05.287 Color_251ACI
N050.04.27.203 E019.47.09.124 N050.04.27.379 E019.47.09.039 Color_251ACI
N050.04.27.142 E019.47.08.750 N050.04.27.558 E019.47.08.570 Color_251ACI
N050.04.27.142 E019.47.08.750 N050.04.26.586 E019.47.08.748 Color_251ACI
N050.04.38.702 E019.47.04.816 N050.04.38.739 E019.47.04.791 Color_251ACI
N050.04.38.739 E019.47.04.791 N050.04.38.814 E019.47.04.740 Color_251ACI
N050.04.38.814 E019.47.04.740 N050.04.38.851 E019.47.04.715 Color_251ACI
N050.04.38.851 E019.47.04.715 N050.04.38.872 E019.47.04.631 Color_251ACI
N050.04.38.872 E019.47.04.631 N050.04.38.935 E019.47.04.380 Color_251ACI
N050.04.38.935 E019.47.04.380 N050.04.38.956 E019.47.04.297 Color_251ACI
N050.04.30.613 E019.47.07.976 N050.04.28.484 E019.47.08.701 Color_251ACI
N050.04.38.917 E019.47.05.189 N050.04.31.830 E019.47.07.562 Color_251ACI
N050.04.31.807 E019.47.07.163 N050.04.38.702 E019.47.04.816 Color_251ACI
N050.04.28.359 E019.47.08.336 N050.04.30.590 E019.47.07.577 Color_251ACI
N050.04.26.389 E019.47.10.025 N050.04.26.373 E019.47.09.967 Color_251ACI
N050.04.26.373 E019.47.09.967 N050.04.26.330 E019.47.09.892 Color_251ACI
N050.04.26.330 E019.47.09.892 N050.04.26.223 E019.47.09.827 Color_251ACI
N050.04.26.223 E019.47.09.827 N050.04.26.159 E019.47.09.836 Color_251ACI
N050.04.26.159 E019.47.09.836 N050.04.26.132 E019.47.09.820 Color_251ACI
N050.04.26.132 E019.47.09.820 N050.04.26.068 E019.47.09.829 Color_251ACI
N050.04.26.068 E019.47.09.829 N050.04.26.030 E019.47.09.854 Color_251ACI
N050.04.26.482 E019.47.10.274 N050.04.26.400 E019.47.09.983 Color_251ACI
N050.04.26.640 E019.47.09.889 N050.04.26.674 E019.47.10.247 Color_251ACI
N050.04.26.840 E019.47.09.337 N050.04.26.793 E019.47.09.404 Color_251ACI
N050.04.26.793 E019.47.09.404 N050.04.26.755 E019.47.09.429 Color_251ACI
N050.04.26.755 E019.47.09.429 N050.04.26.708 E019.47.09.497 Color_251ACI
N050.04.26.708 E019.47.09.497 N050.04.26.687 E019.47.09.580 Color_251ACI
N050.04.26.687 E019.47.09.580 N050.04.26.676 E019.47.09.622 Color_251ACI
N050.04.26.676 E019.47.09.622 N050.04.26.655 E019.47.09.705 Color_251ACI
N050.04.26.655 E019.47.09.705 N050.04.26.634 E019.47.09.789 Color_251ACI
N050.04.26.634 E019.47.09.789 N050.04.26.640 E019.47.09.889 Color_251ACI
N050.04.27.203 E019.47.09.124 N050.04.26.840 E019.47.09.337 Color_251ACI
N050.04.36.963 E019.47.54.329 N050.04.36.748 E019.47.52.849 Color_251ACI
N050.04.36.748 E019.47.52.849 N050.04.36.575 E019.47.51.444 Color_251ACI
N050.04.36.575 E019.47.51.444 N050.04.36.449 E019.47.50.837 Color_251ACI
N050.04.36.449 E019.47.50.837 N050.04.36.433 E019.47.50.779 Color_251ACI
N050.04.36.433 E019.47.50.779 N050.04.36.390 E019.47.50.704 Color_251ACI
N050.04.36.390 E019.47.50.704 N050.04.36.353 E019.47.50.730 Color_251ACI
N050.04.36.353 E019.47.50.730 N050.04.36.342 E019.47.50.772 Color_251ACI
N050.04.33.187 E019.47.59.396 N050.04.33.107 E019.47.59.347 Color_251ACI
N050.04.33.107 E019.47.59.347 N050.04.32.914 E019.47.59.374 Color_251ACI
N050.04.32.914 E019.47.59.374 N050.04.32.369 E019.47.59.331 Color_251ACI
N050.04.29.249 E019.47.33.105 N050.04.29.362 E019.47.33.271 Color_251ACI
N050.04.36.239 E019.46.04.216 N050.04.49.836 E019.47.43.683 Color_251ACI
N050.04.49.836 E019.47.43.683 N050.04.47.440 E019.47.44.486 Color_251ACI
N050.04.47.440 E019.47.44.486 N050.04.33.842 E019.46.05.019 Color_251ACI
N050.04.33.842 E019.46.05.019 N050.04.36.239 E019.46.04.216 Color_251ACI
N050.04.40.038 E019.47.42.332 N050.04.40.443 E019.47.42.194 Color_251ACI
N050.04.40.443 E019.47.42.194 N050.04.40.564 E019.47.42.943 Color_251ACI
N050.04.40.564 E019.47.42.943 N050.04.40.132 E019.47.43.064 Color_251ACI
N050.04.40.132 E019.47.43.064 N050.04.40.038 E019.47.42.332 Color_251ACI
N050.04.19.159 E019.48.00.236 N050.04.19.202 E019.48.00.310 Color_251ACI
N050.04.19.202 E019.48.00.310 N050.04.19.362 E019.48.00.167 Color_251ACI
N050.04.19.362 E019.48.00.167 N050.04.19.313 E019.47.59.992 Color_251ACI
N050.04.19.313 E019.47.59.992 N050.04.20.001 E019.47.59.834 Color_251ACI
N050.04.20.001 E019.47.59.834 N050.04.20.046 E019.48.00.150 Color_251ACI
N050.04.20.046 E019.48.00.150 N050.04.21.711 E019.47.59.672 Color_251ACI
N050.04.21.711 E019.47.59.672 N050.04.21.877 E019.47.59.629 Color_251ACI
N050.04.25.180 E019.47.29.613 N050.04.25.338 E019.47.30.336 Color_251ACI
N050.04.25.569 E019.47.29.417 N050.04.25.701 E019.47.30.123 Color_251ACI
N050.04.18.342 E019.48.00.412 N050.04.18.374 E019.48.00.528 Color_251ACI
N050.04.18.374 E019.48.00.528 N050.04.19.074 E019.48.00.328 Color_251ACI
N050.04.31.448 E019.46.09.628 N050.04.30.607 E019.46.08.056 Color_251ACI
N050.04.30.607 E019.46.08.056 N050.04.29.504 E019.46.07.769 Color_251ACI
N050.04.29.504 E019.46.07.769 N050.04.24.840 E019.46.09.356 Color_251ACI
N050.04.24.840 E019.46.09.356 N050.04.24.287 E019.46.10.079 Color_251ACI
N050.04.24.287 E019.46.10.079 N050.04.24.155 E019.46.11.347 Color_251ACI
N050.04.24.155 E019.46.11.347 N050.04.25.091 E019.46.18.082 Color_251ACI
N050.04.25.091 E019.46.18.082 N050.04.29.326 E019.46.18.449 Color_251ACI
N050.04.29.326 E019.46.18.449 N050.04.29.289 E019.46.19.582 Color_251ACI
N050.04.29.289 E019.46.19.582 N050.04.29.747 E019.46.20.343 Color_251ACI
N050.04.29.747 E019.46.20.343 N050.04.31.747 E019.46.20.503 Color_251ACI
N050.04.31.747 E019.46.20.503 N050.04.32.476 E019.46.19.936 Color_251ACI
N050.04.32.476 E019.46.19.936 N050.04.32.706 E019.46.18.776 Color_251ACI
N050.04.40.639 E019.48.11.694 N050.04.39.016 E019.47.59.819 Color_251ACI
N050.04.39.016 E019.47.59.819 N050.04.37.985 E019.47.52.352 Color_251ACI
N050.04.37.985 E019.47.52.352 N050.04.36.889 E019.47.44.410 Color_251ACI
N050.04.47.755 E019.48.08.712 N050.04.47.315 E019.48.10.467 Color_251ACI
N050.04.47.315 E019.48.10.467 N050.04.46.443 E019.48.11.476 Color_251ACI
N050.04.46.443 E019.48.11.476 N050.04.41.928 E019.48.12.962 Color_251ACI
N050.04.41.928 E019.48.12.962 N050.04.41.206 E019.48.12.762 Color_251ACI
N050.04.41.206 E019.48.12.762 N050.04.41.072 E019.48.12.680 Color_251ACI
N050.04.41.072 E019.48.12.680 N050.04.40.639 E019.48.11.694 Color_251ACI
N050.04.40.389 E019.48.11.831 N050.04.37.741 E019.47.52.588 Color_251ACI
N050.04.37.741 E019.47.52.588 N050.04.36.755 E019.47.45.436 Color_251ACI
N050.04.36.755 E019.47.45.436 N050.04.34.920 E019.47.31.939 Color_251ACI
N050.04.31.261 E019.46.52.718 N050.04.33.251 E019.46.52.919 Color_251ACI
N050.04.33.251 E019.46.52.919 N050.04.35.197 E019.46.53.047 Color_251ACI
N050.04.35.197 E019.46.53.047 N050.04.36.005 E019.46.53.154 Color_251ACI
N050.04.36.005 E019.46.53.154 N050.04.36.438 E019.46.53.274 Color_251ACI
N050.04.36.438 E019.46.53.274 N050.04.36.872 E019.46.53.393 Color_251ACI
N050.04.36.872 E019.46.53.393 N050.04.37.152 E019.46.53.757 Color_251ACI
N050.04.37.152 E019.46.53.757 N050.04.37.351 E019.46.54.071 Color_251ACI
N050.04.37.351 E019.46.54.071 N050.04.37.670 E019.46.54.892 Color_251ACI
N050.04.30.456 E019.46.53.094 N050.04.29.984 E019.46.53.866 Color_251ACI
N050.04.29.760 E019.46.54.018 N050.04.34.077 E019.47.25.694 Color_251ACI
N050.04.29.760 E019.46.54.018 N050.04.29.984 E019.46.53.866 Color_251ACI
N050.04.31.261 E019.46.52.718 N050.04.30.456 E019.46.53.094 Color_251ACI
N050.04.25.567 E019.46.21.600 N050.04.25.327 E019.46.21.694 Color_251ACI
N050.04.25.327 E019.46.21.694 N050.04.29.401 E019.46.51.632 Color_251ACI
N050.04.36.877 E019.47.44.210 N050.04.35.082 E019.47.31.171 Color_251ACI
N050.04.19.683 E019.48.09.225 N050.04.19.810 E019.48.10.073 Color_251ACI
N050.04.19.810 E019.48.10.073 N050.04.19.816 E019.48.10.173 Color_251ACI
N050.04.19.816 E019.48.10.173 N050.04.19.833 E019.48.10.231 Color_251ACI
N050.04.19.833 E019.48.10.231 N050.04.19.956 E019.48.10.355 Color_251ACI
N050.04.19.956 E019.48.10.355 N050.04.19.925 E019.48.10.480 Color_251ACI
N050.04.19.925 E019.48.10.480 N050.04.19.894 E019.48.10.847 Color_251ACI
N050.04.19.894 E019.48.10.847 N050.04.19.900 E019.48.10.947 Color_251ACI
N050.04.19.900 E019.48.10.947 N050.04.19.928 E019.48.11.204 Color_251ACI
N050.04.19.928 E019.48.11.204 N050.04.19.956 E019.48.11.462 Color_251ACI
N050.04.19.956 E019.48.11.462 N050.04.20.111 E019.48.11.461 Color_251ACI
N050.04.30.264 E019.47.59.589 N050.04.30.325 E019.47.59.963 Color_251ACI
N050.04.32.369 E019.47.59.331 N050.04.30.325 E019.47.59.963 Color_251ACI
N050.04.31.779 E019.47.32.384 N050.04.31.819 E019.47.32.842 Color_251ACI
N050.04.31.819 E019.47.32.842 N050.04.32.199 E019.47.32.929 Color_251ACI
N050.04.32.199 E019.47.32.929 N050.04.32.746 E019.47.32.348 Color_251ACI
N050.04.32.746 E019.47.32.348 N050.04.32.885 E019.47.32.288 Color_251ACI
N050.04.32.885 E019.47.32.288 N050.04.32.873 E019.47.32.088 Color_251ACI
N050.04.32.873 E019.47.32.088 N050.04.33.103 E019.47.32.036 Color_251ACI
N050.04.33.103 E019.47.32.036 N050.04.33.125 E019.47.32.194 Color_251ACI
N050.04.33.125 E019.47.32.194 N050.04.33.227 E019.47.32.159 Color_251ACI
N050.04.33.227 E019.47.32.159 N050.04.33.960 E019.47.32.317 Color_251ACI
N050.04.29.984 E019.46.53.866 N050.04.31.635 E019.47.05.999 Color_251ACI
N050.04.47.767 E019.48.08.912 N050.04.47.525 E019.48.10.739 Color_251ACI
N050.04.47.525 E019.48.10.739 N050.04.46.531 E019.48.11.867 Color_251ACI
N050.04.46.531 E019.48.11.867 N050.04.41.962 E019.48.13.320 Color_251ACI
N050.04.41.962 E019.48.13.320 N050.04.40.940 E019.48.13.082 Color_251ACI
N050.04.40.940 E019.48.13.082 N050.04.40.389 E019.48.11.831 Color_251ACI
N050.04.37.015 E019.47.52.771 N050.04.36.656 E019.47.50.385 Color_251ACI
N050.04.36.656 E019.47.50.385 N050.04.36.195 E019.47.50.249 Color_251ACI
N050.04.36.195 E019.47.50.249 N050.04.33.358 E019.47.57.237 Color_251ACI
N050.04.33.358 E019.47.57.237 N050.04.33.544 E019.47.57.976 Color_251ACI
N050.04.33.544 E019.47.57.976 N050.04.35.807 E019.47.59.549 Color_251ACI
N050.04.35.807 E019.47.59.549 N050.04.36.743 E019.47.59.638 Color_251ACI
N050.04.36.743 E019.47.59.638 N050.04.37.476 E019.47.58.688 Color_251ACI
N050.04.37.476 E019.47.58.688 N050.04.37.624 E019.47.57.237 Color_251ACI
N050.04.37.624 E019.47.57.237 N050.04.37.015 E019.47.52.771 Color_251ACI
N050.04.34.393 E019.47.28.006 N050.04.34.077 E019.47.25.694 Color_251ACI
N050.04.34.920 E019.47.31.939 N050.04.35.082 E019.47.31.171 Color_251ACI
N050.04.35.082 E019.47.31.171 N050.04.35.394 E019.47.30.543 Color_251ACI
N050.04.35.394 E019.47.30.543 N050.04.36.012 E019.47.30.052 Color_251ACI
N050.04.36.012 E019.47.30.052 N050.04.40.575 E019.47.28.499 Color_251ACI
N050.04.40.575 E019.47.28.499 N050.04.41.366 E019.47.28.548 Color_251ACI
N050.04.41.366 E019.47.28.548 N050.04.42.194 E019.47.29.438 Color_251ACI
N050.04.42.194 E019.47.29.438 N050.04.42.563 E019.47.30.675 Color_251ACI
N050.04.34.772 E019.47.28.959 N050.04.34.317 E019.47.25.599 Color_251ACI
N050.04.28.307 E019.46.50.820 N050.04.28.536 E019.46.50.768 Color_251ACI
N050.04.28.536 E019.46.50.768 N050.04.24.880 E019.46.24.215 Color_251ACI
N050.04.24.880 E019.46.24.215 N050.04.24.779 E019.46.23.383 Color_251ACI
N050.04.24.779 E019.46.23.383 N050.04.24.721 E019.46.24.600 Color_251ACI
N050.04.22.735 E019.46.08.506 N050.04.24.403 E019.46.20.697 Color_251ACI
N050.04.24.403 E019.46.20.697 N050.04.24.334 E019.46.21.956 Color_251ACI
N050.04.22.735 E019.46.08.506 N050.04.30.932 E019.46.05.653 Color_251ACI
N050.04.33.251 E019.47.46.094 N050.04.35.738 E019.47.45.298 Color_251ACI
N050.04.22.434 E019.46.08.227 N050.04.24.334 E019.46.21.956 Color_251ACI
N050.04.18.414 E019.48.00.986 N050.04.18.581 E019.48.02.291 Color_251ACI
N050.04.18.581 E019.48.02.291 N050.04.18.986 E019.48.02.153 Color_251ACI
N050.04.32.706 E019.46.18.776 N050.04.31.448 E019.46.09.628 Color_251ACI
N050.04.31.448 E019.46.09.628 N050.04.31.447 E019.46.09.387 Color_251ACI
N050.04.31.447 E019.46.09.387 N050.04.31.425 E019.46.09.229 Color_251ACI
N050.04.31.425 E019.46.09.229 N050.04.30.932 E019.46.05.653 Color_251ACI
N050.04.30.932 E019.46.05.653 N050.04.32.848 E019.46.05.039 Color_251ACI
N050.04.32.848 E019.46.05.039 N050.04.50.170 E019.48.11.774 Color_251ACI
N050.04.50.170 E019.48.11.774 N050.04.48.270 E019.48.12.446 Color_251ACI
N050.04.48.270 E019.48.12.446 N050.04.47.767 E019.48.08.912 Color_251ACI
N050.04.47.767 E019.48.08.912 N050.04.47.755 E019.48.08.712 Color_251ACI
N050.04.47.755 E019.48.08.712 N050.04.42.563 E019.47.30.675 Color_251ACI
N050.04.42.563 E019.47.30.675 N050.04.41.793 E019.47.25.004 Color_251ACI
N050.04.41.793 E019.47.25.004 N050.04.39.078 E019.47.05.287 Color_251ACI
N050.04.39.078 E019.47.05.287 N050.04.38.956 E019.47.04.297 Color_251ACI
N050.04.38.956 E019.47.04.297 N050.04.37.748 E019.46.55.565 Color_251ACI
N050.04.37.748 E019.46.55.565 N050.04.37.670 E019.46.54.892 Color_251ACI
N050.04.37.670 E019.46.54.892 N050.04.36.922 E019.46.49.378 Color_251ACI
N050.04.36.922 E019.46.49.378 N050.04.33.310 E019.46.23.142 Color_251ACI
N050.04.33.310 E019.46.23.142 N050.04.32.706 E019.46.18.776 Color_251ACI
N050.04.47.440 E019.47.44.486 N050.04.49.836 E019.47.43.683 Color_251ACI
N050.04.49.836 E019.47.43.683 N050.04.36.239 E019.46.04.216 Color_251ACI
N050.04.36.239 E019.46.04.216 N050.04.33.842 E019.46.05.019 Color_251ACI
N050.04.33.842 E019.46.05.019 N050.04.47.440 E019.47.44.486 Color_251ACI
N050.04.23.877 E019.47.26.555 N050.04.23.920 E019.47.26.629 Color_251ACI
N050.04.23.920 E019.47.26.629 N050.04.23.963 E019.47.26.704 Color_251ACI
N050.04.23.963 E019.47.26.704 N050.04.24.006 E019.47.26.778 Color_251ACI
N050.04.24.006 E019.47.26.778 N050.04.24.194 E019.47.26.893 Color_251ACI
N050.04.24.194 E019.47.26.893 N050.04.24.274 E019.47.26.942 Color_251ACI
N050.04.24.274 E019.47.26.942 N050.04.24.338 E019.47.26.933 Color_251ACI
N050.04.25.209 E019.47.27.897 N050.04.25.099 E019.47.27.348 Color_251ACI
N050.04.25.099 E019.47.27.348 N050.04.24.959 E019.47.27.167 Color_251ACI
N050.04.24.959 E019.47.27.167 N050.04.24.852 E019.47.27.101 Color_251ACI
N050.04.24.852 E019.47.27.101 N050.04.24.761 E019.47.27.094 Color_251ACI
N050.04.26.404 E019.47.27.325 N050.04.26.489 E019.47.27.232 Color_251ACI
N050.04.26.489 E019.47.27.232 N050.04.26.547 E019.47.27.123 Color_251ACI
N050.04.26.547 E019.47.27.123 N050.04.26.589 E019.47.26.956 Color_251ACI
N050.04.26.589 E019.47.26.956 N050.04.26.567 E019.47.26.798 Color_251ACI
N050.04.26.567 E019.47.26.798 N050.04.26.507 E019.47.26.666 Color_251ACI
N050.04.26.507 E019.47.26.666 N050.04.26.437 E019.47.26.575 Color_251ACI
N050.04.26.437 E019.47.26.575 N050.04.26.330 E019.47.26.509 Color_251ACI
N050.04.26.330 E019.47.26.509 N050.04.26.229 E019.47.26.544 Color_251ACI
N050.04.29.031 E019.47.24.495 N050.04.29.047 E019.47.24.553 Color_251ACI
N050.04.29.047 E019.47.24.553 N050.04.29.036 E019.47.24.595 Color_251ACI
N050.04.29.036 E019.47.24.595 N050.04.29.026 E019.47.24.637 Color_251ACI
N050.04.29.026 E019.47.24.637 N050.04.29.005 E019.47.24.721 Color_251ACI
N050.04.29.005 E019.47.24.721 N050.04.28.995 E019.47.24.762 Color_251ACI
N050.04.28.995 E019.47.24.762 N050.04.28.995 E019.47.24.762 Color_251ACI
N050.04.26.279 E019.47.25.852 N050.04.26.408 E019.47.26.075 Color_251ACI
N050.04.26.408 E019.47.26.075 N050.04.27.710 E019.47.25.569 Color_251ACI
N050.04.27.710 E019.47.25.569 N050.04.28.052 E019.47.25.440 Color_251ACI
N050.04.28.052 E019.47.25.440 N050.04.28.984 E019.47.24.804 Color_251ACI
N050.04.26.103 E019.47.25.937 N050.04.26.104 E019.47.26.179 Color_251ACI
N050.04.25.954 E019.47.26.039 N050.04.25.970 E019.47.26.097 Color_251ACI
N050.04.25.970 E019.47.26.097 N050.04.25.970 E019.47.26.097 Color_251ACI
N050.04.25.970 E019.47.26.097 N050.04.25.997 E019.47.26.114 Color_251ACI
N050.04.25.997 E019.47.26.114 N050.04.26.104 E019.47.26.179 Color_251ACI
N050.04.26.820 E019.47.29.361 N050.04.26.732 E019.47.28.970 Color_251ACI
;buildings_lines N000.00.00.000 E000.00.00.000 N000.00.00.000 E000.00.00.000
N050.04.28.049 E019.47.33.819 N050.04.28.465 E019.47.33.639 Color_18ACI
N050.04.28.465 E019.47.33.639 N050.04.28.624 E019.47.34.362 Color_18ACI
N050.04.28.624 E019.47.34.362 N050.04.28.208 E019.47.34.542 Color_18ACI
N050.04.28.208 E019.47.34.542 N050.04.28.049 E019.47.33.819 Color_18ACI
N050.04.27.357 E019.47.26.606 N050.04.27.401 E019.47.26.922 Color_18ACI
N050.04.27.401 E019.47.26.922 N050.04.27.289 E019.47.26.998 Color_18ACI
N050.04.27.289 E019.47.26.998 N050.04.27.218 E019.47.26.666 Color_18ACI
N050.04.27.218 E019.47.26.666 N050.04.27.357 E019.47.26.606 Color_18ACI
N050.04.27.912 E019.47.26.366 N050.04.27.384 E019.47.26.622 Color_18ACI
N050.04.27.384 E019.47.26.622 N050.04.27.439 E019.47.26.896 Color_18ACI
N050.04.27.439 E019.47.26.896 N050.04.27.550 E019.47.26.820 Color_18ACI
N050.04.27.550 E019.47.26.820 N050.04.27.545 E019.47.26.720 Color_18ACI
N050.04.27.545 E019.47.26.720 N050.04.27.961 E019.47.26.540 Color_18ACI
N050.04.27.961 E019.47.26.540 N050.04.27.912 E019.47.26.366 Color_18ACI
N050.04.25.877 E019.47.27.822 N050.04.25.970 E019.47.28.313 Color_18ACI
N050.04.25.970 E019.47.28.313 N050.04.25.767 E019.47.28.382 Color_18ACI
N050.04.25.767 E019.47.28.382 N050.04.25.663 E019.47.27.933 Color_18ACI
N050.04.25.663 E019.47.27.933 N050.04.25.877 E019.47.27.822 Color_18ACI
N050.04.23.431 E019.47.26.235 N050.04.23.239 E019.47.26.262 Color_18ACI
N050.04.23.239 E019.47.26.262 N050.04.23.283 E019.47.26.578 Color_18ACI
N050.04.23.283 E019.47.26.578 N050.04.23.449 E019.47.26.535 Color_18ACI
N050.04.23.449 E019.47.26.535 N050.04.23.431 E019.47.26.235 Color_18ACI
N050.04.26.827 E019.47.25.271 N050.04.26.898 E019.47.25.603 Color_18ACI
N050.04.26.898 E019.47.25.603 N050.04.27.047 E019.47.25.501 Color_18ACI
N050.04.27.047 E019.47.25.501 N050.04.26.992 E019.47.25.227 Color_18ACI
N050.04.26.992 E019.47.25.227 N050.04.26.827 E019.47.25.271 Color_18ACI
N050.04.24.029 E019.47.14.992 N050.04.23.896 E019.47.15.152 Color_18ACI
N050.04.23.896 E019.47.15.152 N050.04.24.084 E019.47.15.266 Color_18ACI
N050.04.24.084 E019.47.15.266 N050.04.24.029 E019.47.14.992 Color_18ACI
N050.04.24.064 E019.47.14.484 N050.04.24.092 E019.47.14.741 Color_18ACI
N050.04.24.092 E019.47.14.741 N050.04.24.156 E019.47.14.732 Color_18ACI
N050.04.24.156 E019.47.14.732 N050.04.24.139 E019.47.14.433 Color_18ACI
N050.04.24.139 E019.47.14.433 N050.04.24.064 E019.47.14.484 Color_18ACI
N050.04.59.946 E019.47.20.901 N050.05.00.193 E019.47.22.255 Color_18ACI
N050.05.00.193 E019.47.22.255 N050.05.00.534 E019.47.22.126 Color_18ACI
N050.05.00.534 E019.47.22.126 N050.05.00.281 E019.47.20.672 Color_18ACI
N050.05.00.281 E019.47.20.672 N050.04.59.940 E019.47.20.801 Color_18ACI
N050.04.59.940 E019.47.20.801 N050.04.59.946 E019.47.20.901 Color_18ACI
N050.05.01.611 E019.47.28.178 N050.05.01.412 E019.47.26.756 Color_18ACI
N050.05.01.412 E019.47.26.756 N050.05.01.060 E019.47.26.926 Color_18ACI
N050.05.01.060 E019.47.26.926 N050.05.01.270 E019.47.28.307 Color_18ACI
N050.05.01.270 E019.47.28.307 N050.05.01.611 E019.47.28.178 Color_18ACI
N050.04.22.807 E019.47.08.659 N050.04.23.047 E019.47.08.565 Color_18ACI
N050.04.23.047 E019.47.08.565 N050.04.22.998 E019.47.08.391 Color_18ACI
N050.04.22.998 E019.47.08.391 N050.04.23.494 E019.47.08.260 Color_18ACI
N050.04.23.494 E019.47.08.260 N050.04.23.516 E019.47.08.418 Color_18ACI
N050.04.23.516 E019.47.08.418 N050.04.23.719 E019.47.08.349 Color_18ACI
N050.04.23.719 E019.47.08.349 N050.04.24.134 E019.47.11.251 Color_18ACI
N050.04.24.134 E019.47.11.251 N050.04.23.221 E019.47.11.562 Color_18ACI
N050.04.23.221 E019.47.11.562 N050.04.22.807 E019.47.08.659 Color_18ACI
N050.04.23.161 E019.47.06.756 N050.04.23.288 E019.47.06.497 Color_18ACI
N050.04.23.288 E019.47.06.497 N050.04.23.427 E019.47.06.437 Color_18ACI
N050.04.23.427 E019.47.06.437 N050.04.23.471 E019.47.06.753 Color_18ACI
N050.04.23.471 E019.47.06.753 N050.04.23.167 E019.47.06.856 Color_18ACI
N050.04.23.167 E019.47.06.856 N050.04.23.161 E019.47.06.756 Color_18ACI
N050.04.09.542 E019.48.08.245 N050.04.09.429 E019.48.08.079 Color_18ACI
N050.04.09.429 E019.48.08.079 N050.04.09.333 E019.48.07.972 Color_18ACI
N050.04.09.333 E019.48.07.972 N050.04.09.279 E019.48.07.939 Color_18ACI
N050.04.09.279 E019.48.07.939 N050.04.09.199 E019.48.07.890 Color_18ACI
N050.04.09.199 E019.48.07.890 N050.04.09.134 E019.48.07.900 Color_18ACI
N050.04.09.134 E019.48.07.900 N050.04.09.087 E019.48.07.967 Color_18ACI
N050.04.09.087 E019.48.07.967 N050.04.09.012 E019.48.08.018 Color_18ACI
N050.04.09.012 E019.48.08.018 N050.04.08.981 E019.48.08.143 Color_18ACI
N050.04.08.981 E019.48.08.143 N050.04.08.949 E019.48.08.268 Color_18ACI
N050.04.08.949 E019.48.08.268 N050.04.08.965 E019.48.08.326 Color_18ACI
N050.04.08.965 E019.48.08.326 N050.04.09.014 E019.48.08.501 Color_18ACI
N050.04.09.014 E019.48.08.501 N050.04.09.117 E019.48.08.708 Color_18ACI
N050.04.09.117 E019.48.08.708 N050.04.09.176 E019.48.08.840 Color_18ACI
N050.04.09.176 E019.48.08.840 N050.04.09.246 E019.48.08.931 Color_18ACI
N050.04.09.246 E019.48.08.931 N050.04.09.327 E019.48.08.980 Color_18ACI
N050.04.09.327 E019.48.08.980 N050.04.09.364 E019.48.08.955 Color_18ACI
N050.04.09.364 E019.48.08.955 N050.04.09.418 E019.48.08.987 Color_18ACI
N050.04.09.418 E019.48.08.987 N050.04.09.465 E019.48.08.920 Color_18ACI
N050.04.09.465 E019.48.08.920 N050.04.09.519 E019.48.08.953 Color_18ACI
N050.04.09.519 E019.48.08.953 N050.04.09.652 E019.48.08.793 Color_18ACI
N050.04.09.652 E019.48.08.793 N050.04.09.609 E019.48.08.719 Color_18ACI
N050.04.09.609 E019.48.08.719 N050.04.09.630 E019.48.08.635 Color_18ACI
N050.04.09.630 E019.48.08.635 N050.04.09.651 E019.48.08.551 Color_18ACI
N050.04.09.651 E019.48.08.551 N050.04.09.655 E019.48.08.410 Color_18ACI
N050.04.09.655 E019.48.08.410 N050.04.09.612 E019.48.08.335 Color_18ACI
N050.04.09.612 E019.48.08.335 N050.04.09.542 E019.48.08.245 Color_18ACI
N050.04.13.112 E019.48.18.897 N050.04.13.541 E019.48.20.267 Color_18ACI
N050.04.13.541 E019.48.20.267 N050.04.13.391 E019.48.20.368 Color_18ACI
N050.04.13.391 E019.48.20.368 N050.04.13.000 E019.48.18.974 Color_18ACI
N050.04.13.000 E019.48.18.974 N050.04.13.112 E019.48.18.897 Color_18ACI
N050.04.13.330 E019.48.04.244 N050.04.13.363 E019.48.04.601 Color_18ACI
N050.04.13.363 E019.48.04.601 N050.04.13.492 E019.48.04.583 Color_18ACI
N050.04.13.492 E019.48.04.583 N050.04.13.458 E019.48.04.226 Color_18ACI
N050.04.13.458 E019.48.04.226 N050.04.13.330 E019.48.04.244 Color_18ACI
N050.04.13.145 E019.48.02.638 N050.04.13.169 E019.48.03.038 Color_18ACI
N050.04.13.169 E019.48.03.038 N050.04.13.425 E019.48.03.002 Color_18ACI
N050.04.13.425 E019.48.03.002 N050.04.13.375 E019.48.02.586 Color_18ACI
N050.04.13.375 E019.48.02.586 N050.04.13.145 E019.48.02.638 Color_18ACI
N050.04.23.249 E019.48.22.477 N050.04.23.769 E019.48.22.745 Color_18ACI
N050.04.23.769 E019.48.22.745 N050.04.25.044 E019.48.23.330 Color_18ACI
N050.04.25.044 E019.48.23.330 N050.04.25.012 E019.48.23.455 Color_18ACI
N050.04.25.012 E019.48.23.455 N050.04.23.217 E019.48.22.602 Color_18ACI
N050.04.23.217 E019.48.22.602 N050.04.23.249 E019.48.22.477 Color_18ACI
N050.04.17.096 E019.48.01.434 N050.04.17.916 E019.48.07.522 Color_18ACI
N050.04.17.916 E019.48.07.522 N050.04.16.139 E019.48.08.076 Color_18ACI
N050.04.16.139 E019.48.08.076 N050.04.15.308 E019.48.02.030 Color_18ACI
N050.04.15.308 E019.48.02.030 N050.04.17.096 E019.48.01.434 Color_18ACI
N050.04.30.510 E019.48.21.750 N050.04.30.260 E019.48.22.994 Color_18ACI
N050.04.30.260 E019.48.22.994 N050.04.30.072 E019.48.22.880 Color_18ACI
N050.04.30.072 E019.48.22.880 N050.04.30.339 E019.48.21.694 Color_18ACI
N050.04.30.339 E019.48.21.694 N050.04.30.510 E019.48.21.750 Color_18ACI
N050.04.22.152 E019.48.31.152 N050.04.22.303 E019.48.31.292 Color_18ACI
N050.04.22.303 E019.48.31.292 N050.04.22.387 E019.48.30.958 Color_18ACI
N050.04.22.387 E019.48.30.958 N050.04.22.226 E019.48.30.860 Color_18ACI
N050.04.22.226 E019.48.30.860 N050.04.22.152 E019.48.31.152 Color_18ACI
N050.04.22.503 E019.48.34.063 N050.04.23.072 E019.48.34.506 Color_18ACI
N050.04.23.072 E019.48.34.506 N050.04.23.267 E019.48.33.854 Color_18ACI
N050.04.23.267 E019.48.33.854 N050.04.22.698 E019.48.33.411 Color_18ACI
N050.04.22.698 E019.48.33.411 N050.04.22.503 E019.48.34.063 Color_18ACI
N050.04.24.082 E019.48.32.329 N050.04.24.293 E019.48.32.843 Color_18ACI
N050.04.24.293 E019.48.32.843 N050.04.24.075 E019.48.33.095 Color_18ACI
N050.04.24.075 E019.48.33.095 N050.04.23.875 E019.48.32.539 Color_18ACI
N050.04.23.875 E019.48.32.539 N050.04.24.082 E019.48.32.329 Color_18ACI
N050.04.24.214 E019.48.31.927 N050.04.24.398 E019.48.32.425 Color_18ACI
N050.04.24.398 E019.48.32.425 N050.04.24.191 E019.48.32.636 Color_18ACI
N050.04.24.191 E019.48.32.636 N050.04.24.017 E019.48.32.096 Color_18ACI
N050.04.24.017 E019.48.32.096 N050.04.24.214 E019.48.31.927 Color_18ACI
N050.04.24.335 E019.48.31.568 N050.04.24.546 E019.48.32.082 Color_18ACI
N050.04.24.546 E019.48.32.082 N050.04.24.349 E019.48.32.251 Color_18ACI
N050.04.24.349 E019.48.32.251 N050.04.24.138 E019.48.31.737 Color_18ACI
N050.04.24.138 E019.48.31.737 N050.04.24.335 E019.48.31.568 Color_18ACI
N050.04.24.615 E019.48.30.823 N050.04.24.799 E019.48.31.321 Color_18ACI
N050.04.24.799 E019.48.31.321 N050.04.24.592 E019.48.31.531 Color_18ACI
N050.04.24.592 E019.48.31.531 N050.04.24.408 E019.48.31.034 Color_18ACI
N050.04.24.408 E019.48.31.034 N050.04.24.615 E019.48.30.823 Color_18ACI
N050.04.24.467 E019.48.31.166 N050.04.24.678 E019.48.31.680 Color_18ACI
N050.04.24.678 E019.48.31.680 N050.04.24.471 E019.48.31.891 Color_18ACI
N050.04.24.471 E019.48.31.891 N050.04.24.286 E019.48.31.393 Color_18ACI
N050.04.24.286 E019.48.31.393 N050.04.24.467 E019.48.31.166 Color_18ACI
N050.04.23.281 E019.47.20.556 N050.04.23.530 E019.47.22.394 Color_18ACI
N050.04.23.530 E019.47.22.394 N050.04.23.936 E019.47.22.256 Color_18ACI
N050.04.23.936 E019.47.22.256 N050.04.23.676 E019.47.20.460 Color_18ACI
N050.04.23.676 E019.47.20.460 N050.04.23.281 E019.47.20.556 Color_18ACI
N050.04.22.526 E019.47.00.300 N050.04.22.695 E019.47.00.981 Color_18ACI
N050.04.22.695 E019.47.00.981 N050.04.23.169 E019.47.00.692 Color_18ACI
N050.04.23.169 E019.47.00.692 N050.04.22.973 E019.46.59.995 Color_18ACI
N050.04.22.973 E019.46.59.995 N050.04.22.526 E019.47.00.300 Color_18ACI
N050.04.20.568 E019.46.54.676 N050.04.20.093 E019.46.54.723 Color_18ACI
N050.04.20.093 E019.46.54.723 N050.04.20.096 E019.46.54.340 Color_18ACI
N050.04.20.096 E019.46.54.340 N050.04.20.572 E019.46.54.293 Color_18ACI
N050.04.20.572 E019.46.54.293 N050.04.20.568 E019.46.54.676 Color_18ACI
N050.04.21.972 E019.48.03.926 N050.04.21.662 E019.48.01.714 Color_18ACI
N050.04.21.662 E019.48.01.714 N050.04.20.408 E019.48.02.153 Color_18ACI
N050.04.20.408 E019.48.02.153 N050.04.20.564 E019.48.03.501 Color_18ACI
N050.04.20.564 E019.48.03.501 N050.04.20.942 E019.48.04.213 Color_18ACI
N050.04.20.942 E019.48.04.213 N050.04.21.972 E019.48.03.926 Color_18ACI
N050.04.24.860 E019.48.22.833 N050.04.23.836 E019.48.22.353 Color_18ACI
N050.04.23.836 E019.48.22.353 N050.04.23.769 E019.48.22.745 Color_18ACI
N050.04.23.769 E019.48.22.745 N050.04.24.792 E019.48.23.225 Color_18ACI
N050.04.24.792 E019.48.23.225 N050.04.24.860 E019.48.22.833 Color_18ACI
N050.04.21.234 E019.48.20.285 N050.04.21.468 E019.48.20.090 Color_18ACI
N050.04.21.468 E019.48.20.090 N050.04.21.517 E019.48.20.265 Color_18ACI
N050.04.21.517 E019.48.20.265 N050.04.21.677 E019.48.20.121 Color_18ACI
N050.04.21.677 E019.48.20.121 N050.04.21.731 E019.48.20.396 Color_18ACI
N050.04.21.731 E019.48.20.396 N050.04.21.834 E019.48.20.603 Color_18ACI
N050.04.21.834 E019.48.20.603 N050.04.21.936 E019.48.20.810 Color_18ACI
N050.04.21.936 E019.48.20.810 N050.04.22.076 E019.48.20.991 Color_18ACI
N050.04.22.076 E019.48.20.991 N050.04.22.189 E019.48.21.156 Color_18ACI
N050.04.22.189 E019.48.21.156 N050.04.22.297 E019.48.21.222 Color_18ACI
N050.04.22.297 E019.48.21.222 N050.04.22.367 E019.48.21.313 Color_18ACI
N050.04.22.367 E019.48.21.313 N050.04.22.420 E019.48.21.345 Color_18ACI
N050.04.22.420 E019.48.21.345 N050.04.22.517 E019.48.21.452 Color_18ACI
N050.04.22.517 E019.48.21.452 N050.04.22.571 E019.48.21.485 Color_18ACI
N050.04.22.571 E019.48.21.485 N050.04.22.661 E019.48.21.492 Color_18ACI
N050.04.22.661 E019.48.21.492 N050.04.22.615 E019.48.21.801 Color_18ACI
N050.04.22.615 E019.48.21.801 N050.04.22.813 E019.48.21.874 Color_18ACI
N050.04.22.813 E019.48.21.874 N050.04.22.870 E019.48.21.523 Color_18ACI
N050.04.22.870 E019.48.21.523 N050.04.23.481 E019.48.18.476 Color_18ACI
N050.04.23.481 E019.48.18.476 N050.04.24.290 E019.48.18.825 Color_18ACI
N050.04.24.290 E019.48.18.825 N050.04.23.638 E019.48.22.281 Color_18ACI
N050.04.23.638 E019.48.22.281 N050.04.23.836 E019.48.22.353 Color_18ACI
N050.04.23.836 E019.48.22.353 N050.04.23.769 E019.48.22.745 Color_18ACI
N050.04.23.769 E019.48.22.745 N050.04.23.303 E019.48.22.509 Color_18ACI
N050.04.23.303 E019.48.22.509 N050.04.22.531 E019.48.22.135 Color_18ACI
N050.04.22.531 E019.48.22.135 N050.04.22.440 E019.48.22.128 Color_18ACI
N050.04.22.440 E019.48.22.128 N050.04.22.306 E019.48.22.046 Color_18ACI
N050.04.22.306 E019.48.22.046 N050.04.22.182 E019.48.21.923 Color_18ACI
N050.04.22.182 E019.48.21.923 N050.04.22.086 E019.48.21.816 Color_18ACI
N050.04.22.086 E019.48.21.816 N050.04.21.978 E019.48.21.750 Color_18ACI
N050.04.21.978 E019.48.21.750 N050.04.21.865 E019.48.21.585 Color_18ACI
N050.04.21.865 E019.48.21.585 N050.04.21.742 E019.48.21.462 Color_18ACI
N050.04.21.742 E019.48.21.462 N050.04.21.656 E019.48.21.313 Color_18ACI
N050.04.21.656 E019.48.21.313 N050.04.21.526 E019.48.21.089 Color_18ACI
N050.04.21.526 E019.48.21.089 N050.04.21.450 E019.48.20.899 Color_18ACI
N050.04.21.450 E019.48.20.899 N050.04.21.348 E019.48.20.692 Color_18ACI
N050.04.21.348 E019.48.20.692 N050.04.21.283 E019.48.20.459 Color_18ACI
N050.04.21.283 E019.48.20.459 N050.04.21.234 E019.48.20.285 Color_18ACI
N050.04.10.871 E019.48.12.185 N050.04.12.264 E019.48.16.117 Color_18ACI
N050.04.12.264 E019.48.16.117 N050.04.12.040 E019.48.16.270 Color_18ACI
N050.04.12.040 E019.48.16.270 N050.04.10.637 E019.48.12.380 Color_18ACI
N050.04.10.637 E019.48.12.380 N050.04.10.871 E019.48.12.185 Color_18ACI
N050.04.12.457 E019.48.12.766 N050.04.11.968 E019.48.13.480 Color_18ACI
N050.04.11.968 E019.48.13.480 N050.04.12.141 E019.48.13.778 Color_18ACI
N050.04.12.141 E019.48.13.778 N050.04.12.645 E019.48.13.122 Color_18ACI
N050.04.12.645 E019.48.13.122 N050.04.12.457 E019.48.12.766 Color_18ACI
N050.04.11.681 E019.48.11.668 N050.04.12.236 E019.48.12.536 Color_18ACI
N050.04.12.236 E019.48.12.536 N050.04.11.960 E019.48.12.897 Color_18ACI
N050.04.11.960 E019.48.12.897 N050.04.11.421 E019.48.12.087 Color_18ACI
N050.04.11.421 E019.48.12.087 N050.04.11.681 E019.48.11.668 Color_18ACI
N050.04.10.224 E019.48.05.530 N050.04.09.829 E019.48.05.626 Color_18ACI
N050.04.09.829 E019.48.05.626 N050.04.09.885 E019.48.06.142 Color_18ACI
N050.04.09.885 E019.48.06.142 N050.04.10.280 E019.48.06.045 Color_18ACI
N050.04.10.280 E019.48.06.045 N050.04.10.224 E019.48.05.530 Color_18ACI
N050.04.10.096 E019.48.03.332 N050.04.10.208 E019.48.04.364 Color_18ACI
N050.04.10.208 E019.48.04.364 N050.04.09.941 E019.48.04.442 Color_18ACI
N050.04.09.941 E019.48.04.442 N050.04.09.840 E019.48.03.368 Color_18ACI
N050.04.09.840 E019.48.03.368 N050.04.10.096 E019.48.03.332 Color_18ACI
N050.04.09.701 E019.48.04.536 N050.04.09.354 E019.48.04.565 Color_18ACI
N050.04.09.354 E019.48.04.565 N050.04.09.350 E019.48.04.948 Color_18ACI
N050.04.09.350 E019.48.04.948 N050.04.09.735 E019.48.04.894 Color_18ACI
N050.04.09.735 E019.48.04.894 N050.04.09.701 E019.48.04.536 Color_18ACI
N050.04.09.082 E019.48.04.785 N050.04.08.650 E019.48.04.907 Color_18ACI
N050.04.08.650 E019.48.04.907 N050.04.08.700 E019.48.05.323 Color_18ACI
N050.04.08.700 E019.48.05.323 N050.04.09.122 E019.48.05.243 Color_18ACI
N050.04.09.122 E019.48.05.243 N050.04.09.082 E019.48.04.785 Color_18ACI
N050.04.08.815 E019.48.03.755 N050.04.08.936 E019.48.04.503 Color_18ACI
N050.04.08.936 E019.48.04.503 N050.04.08.622 E019.48.04.649 Color_18ACI
N050.04.08.622 E019.48.04.649 N050.04.08.463 E019.48.03.926 Color_18ACI
N050.04.08.463 E019.48.03.926 N050.04.08.815 E019.48.03.755 Color_18ACI
N050.04.12.452 E019.48.16.231 N050.04.12.979 E019.48.17.949 Color_18ACI
N050.04.12.979 E019.48.17.949 N050.04.12.680 E019.48.18.153 Color_18ACI
N050.04.12.680 E019.48.18.153 N050.04.12.180 E019.48.16.451 Color_18ACI
N050.04.12.180 E019.48.16.451 N050.04.12.452 E019.48.16.231 Color_18ACI
N050.04.09.344 E019.48.09.280 N050.04.09.711 E019.48.10.033 Color_18ACI
N050.04.09.711 E019.48.10.033 N050.04.09.855 E019.48.09.832 Color_18ACI
N050.04.09.855 E019.48.09.832 N050.04.09.525 E019.48.09.053 Color_18ACI
N050.04.09.525 E019.48.09.053 N050.04.09.344 E019.48.09.280 Color_18ACI
N050.04.14.842 E019.48.20.626 N050.04.15.314 E019.48.20.962 Color_18ACI
N050.04.15.314 E019.48.20.962 N050.04.15.408 E019.48.20.586 Color_18ACI
N050.04.15.408 E019.48.20.586 N050.04.15.746 E019.48.20.841 Color_18ACI
N050.04.15.746 E019.48.20.841 N050.04.15.572 E019.48.21.409 Color_18ACI
N050.04.15.572 E019.48.21.409 N050.04.15.261 E019.48.21.171 Color_18ACI
N050.04.15.261 E019.48.21.171 N050.04.15.209 E019.48.21.380 Color_18ACI
N050.04.15.209 E019.48.21.380 N050.04.14.737 E019.48.21.044 Color_18ACI
N050.04.14.737 E019.48.21.044 N050.04.14.842 E019.48.20.626 Color_18ACI
N050.04.16.478 E019.48.19.649 N050.04.17.222 E019.48.20.873 Color_18ACI
N050.04.17.222 E019.48.20.873 N050.04.16.972 E019.48.21.251 Color_18ACI
N050.04.16.972 E019.48.21.251 N050.04.16.239 E019.48.19.985 Color_18ACI
N050.04.16.239 E019.48.19.985 N050.04.16.478 E019.48.19.649 Color_18ACI
N050.04.15.477 E019.48.18.220 N050.04.13.889 E019.48.20.479 Color_18ACI
N050.04.13.889 E019.48.20.479 N050.04.14.051 E019.48.20.819 Color_18ACI
N050.04.14.051 E019.48.20.819 N050.04.15.676 E019.48.18.534 Color_18ACI
N050.04.15.676 E019.48.18.534 N050.04.15.477 E019.48.18.220 Color_18ACI
N050.04.13.518 E019.48.14.570 N050.04.14.262 E019.48.15.794 Color_18ACI
N050.04.14.262 E019.48.15.794 N050.04.13.928 E019.48.16.264 Color_18ACI
N050.04.13.928 E019.48.16.264 N050.04.13.173 E019.48.15.082 Color_18ACI
N050.04.13.173 E019.48.15.082 N050.04.13.518 E019.48.14.570 Color_18ACI
N050.04.10.748 E019.48.04.307 N050.04.10.833 E019.48.05.322 Color_18ACI
N050.04.10.833 E019.48.05.322 N050.04.11.164 E019.48.05.235 Color_18ACI
N050.04.11.164 E019.48.05.235 N050.04.11.079 E019.48.04.220 Color_18ACI
N050.04.11.079 E019.48.04.220 N050.04.10.748 E019.48.04.307 Color_18ACI
N050.04.11.315 E019.48.04.509 N050.04.11.919 E019.48.04.443 Color_18ACI
N050.04.11.919 E019.48.04.443 N050.04.11.911 E019.48.03.861 Color_18ACI
N050.04.11.911 E019.48.03.861 N050.04.11.307 E019.48.03.926 Color_18ACI
N050.04.11.307 E019.48.03.926 N050.04.11.315 E019.48.04.509 Color_18ACI
N050.04.11.179 E019.48.02.836 N050.04.11.269 E019.48.03.710 Color_18ACI
N050.04.11.269 E019.48.03.710 N050.04.11.498 E019.48.03.657 Color_18ACI
N050.04.11.498 E019.48.03.657 N050.04.11.487 E019.48.03.457 Color_18ACI
N050.04.11.487 E019.48.03.457 N050.04.11.396 E019.48.03.450 Color_18ACI
N050.04.11.396 E019.48.03.450 N050.04.11.318 E019.48.02.776 Color_18ACI
N050.04.11.318 E019.48.02.776 N050.04.11.179 E019.48.02.836 Color_18ACI
N050.04.12.805 E019.48.04.117 N050.04.12.802 E019.48.03.392 Color_18ACI
N050.04.12.802 E019.48.03.392 N050.04.12.994 E019.48.03.365 Color_18ACI
N050.04.12.994 E019.48.03.365 N050.04.12.989 E019.48.03.506 Color_18ACI
N050.04.12.989 E019.48.03.506 N050.04.13.144 E019.48.03.505 Color_18ACI
N050.04.13.144 E019.48.03.505 N050.04.13.152 E019.48.04.088 Color_18ACI
N050.04.13.152 E019.48.04.088 N050.04.12.805 E019.48.04.117 Color_18ACI
N050.04.13.541 E019.48.03.650 N050.04.14.053 E019.48.03.577 Color_18ACI
N050.04.14.053 E019.48.03.577 N050.04.14.083 E019.48.04.077 Color_18ACI
N050.04.14.083 E019.48.04.077 N050.04.13.725 E019.48.04.147 Color_18ACI
N050.04.13.725 E019.48.04.147 N050.04.13.726 E019.48.04.389 Color_18ACI
N050.04.13.726 E019.48.04.389 N050.04.13.587 E019.48.04.449 Color_18ACI
N050.04.13.587 E019.48.04.449 N050.04.13.541 E019.48.03.650 Color_18ACI
N050.04.14.337 E019.48.13.527 N050.04.14.733 E019.48.13.673 Color_18ACI
N050.04.14.733 E019.48.13.673 N050.04.14.676 E019.48.14.023 Color_18ACI
N050.04.14.676 E019.48.14.023 N050.04.14.306 E019.48.13.894 Color_18ACI
N050.04.14.306 E019.48.13.894 N050.04.14.337 E019.48.13.527 Color_18ACI
N050.04.14.158 E019.48.12.022 N050.04.14.619 E019.48.12.158 Color_18ACI
N050.04.14.619 E019.48.12.158 N050.04.14.505 E019.48.12.859 Color_18ACI
N050.04.14.505 E019.48.12.859 N050.04.14.055 E019.48.12.681 Color_18ACI
N050.04.14.055 E019.48.12.681 N050.04.14.158 E019.48.12.022 Color_18ACI
N050.04.22.256 E019.47.58.367 N050.04.22.211 E019.47.58.051 Color_18ACI
N050.04.22.211 E019.47.58.051 N050.04.22.019 E019.47.58.078 Color_18ACI
N050.04.22.019 E019.47.58.078 N050.04.22.090 E019.47.58.410 Color_18ACI
N050.04.22.090 E019.47.58.410 N050.04.22.256 E019.47.58.367 Color_18ACI
N050.04.22.744 E019.47.58.761 N050.04.22.573 E019.47.57.597 Color_18ACI
N050.04.22.573 E019.47.57.597 N050.04.22.178 E019.47.57.693 Color_18ACI
N050.04.22.178 E019.47.57.693 N050.04.22.256 E019.47.58.367 Color_18ACI
N050.04.22.256 E019.47.58.367 N050.04.22.458 E019.47.58.298 Color_18ACI
N050.04.22.458 E019.47.58.298 N050.04.22.541 E019.47.58.830 Color_18ACI
N050.04.22.541 E019.47.58.830 N050.04.22.744 E019.47.58.761 Color_18ACI
N050.04.28.540 E019.47.33.588 N050.04.28.956 E019.47.33.409 Color_18ACI
N050.04.28.956 E019.47.33.409 N050.04.29.077 E019.47.34.157 Color_18ACI
N050.04.29.077 E019.47.34.157 N050.04.28.661 E019.47.34.337 Color_18ACI
N050.04.28.661 E019.47.34.337 N050.04.28.540 E019.47.33.588 Color_18ACI
N050.04.26.398 E019.47.33.872 N050.04.26.858 E019.47.36.223 Color_18ACI
N050.04.26.858 E019.47.36.223 N050.04.27.349 E019.47.35.993 Color_18ACI
N050.04.27.349 E019.47.35.993 N050.04.27.284 E019.47.35.760 Color_18ACI
N050.04.27.284 E019.47.35.760 N050.04.28.089 E019.47.35.384 Color_18ACI
N050.04.28.089 E019.47.35.384 N050.04.27.892 E019.47.34.446 Color_18ACI
N050.04.27.892 E019.47.34.446 N050.04.27.753 E019.47.34.505 Color_18ACI
N050.04.27.753 E019.47.34.505 N050.04.27.627 E019.47.33.899 Color_18ACI
N050.04.27.627 E019.47.33.899 N050.04.27.553 E019.47.33.950 Color_18ACI
N050.04.27.553 E019.47.33.950 N050.04.27.400 E019.47.33.327 Color_18ACI
N050.04.27.400 E019.47.33.327 N050.04.26.926 E019.47.33.616 Color_18ACI
N050.04.26.926 E019.47.33.616 N050.04.26.855 E019.47.33.283 Color_18ACI
N050.04.26.855 E019.47.33.283 N050.04.26.652 E019.47.33.352 Color_18ACI
N050.04.26.652 E019.47.33.352 N050.04.26.713 E019.47.33.726 Color_18ACI
N050.04.26.713 E019.47.33.726 N050.04.26.398 E019.47.33.872 Color_18ACI
N050.04.24.054 E019.47.23.388 N050.04.24.313 E019.47.24.942 Color_18ACI
N050.04.24.313 E019.47.24.942 N050.04.24.174 E019.47.25.002 Color_18ACI
N050.04.24.174 E019.47.25.002 N050.04.23.915 E019.47.23.448 Color_18ACI
N050.04.23.915 E019.47.23.448 N050.04.24.054 E019.47.23.388 Color_18ACI
N050.04.24.722 E019.47.27.744 N050.04.24.753 E019.47.27.619 Color_18ACI
N050.04.24.753 E019.47.27.619 N050.04.24.807 E019.47.27.652 Color_18ACI
N050.04.24.807 E019.47.27.652 N050.04.24.970 E019.47.27.125 Color_18ACI
N050.04.24.970 E019.47.27.125 N050.04.25.104 E019.47.27.207 Color_18ACI
N050.04.25.104 E019.47.27.207 N050.04.24.957 E019.47.27.792 Color_18ACI
N050.04.24.957 E019.47.27.792 N050.04.24.984 E019.47.27.808 Color_18ACI
N050.04.24.984 E019.47.27.808 N050.04.24.963 E019.47.27.891 Color_18ACI
N050.04.24.963 E019.47.27.891 N050.04.24.722 E019.47.27.744 Color_18ACI
N050.04.26.235 E019.47.25.536 N050.04.26.048 E019.47.25.663 Color_18ACI
N050.04.26.048 E019.47.25.663 N050.04.26.103 E019.47.25.937 Color_18ACI
N050.04.26.103 E019.47.25.937 N050.04.26.279 E019.47.25.852 Color_18ACI
N050.04.26.279 E019.47.25.852 N050.04.26.235 E019.47.25.536 Color_18ACI
N050.04.27.605 E019.47.24.879 N050.04.27.013 E019.47.25.144 Color_18ACI
N050.04.27.013 E019.47.25.144 N050.04.27.057 E019.47.25.460 Color_18ACI
N050.04.27.057 E019.47.25.460 N050.04.27.676 E019.47.25.211 Color_18ACI
N050.04.27.676 E019.47.25.211 N050.04.27.605 E019.47.24.879 Color_18ACI
N050.04.25.356 E019.47.30.635 N050.04.25.975 E019.47.33.710 Color_18ACI
N050.04.25.975 E019.47.33.710 N050.04.27.532 E019.47.32.925 Color_18ACI
N050.04.27.532 E019.47.32.925 N050.04.26.940 E019.47.29.867 Color_18ACI
N050.04.26.940 E019.47.29.867 N050.04.25.356 E019.47.30.635 Color_18ACI
N050.04.25.735 E019.47.54.853 N050.04.25.974 E019.47.56.732 Color_18ACI
N050.04.25.974 E019.47.56.732 N050.04.26.278 E019.47.56.629 Color_18ACI
N050.04.26.278 E019.47.56.629 N050.04.26.012 E019.47.54.733 Color_18ACI
N050.04.26.012 E019.47.54.733 N050.04.25.735 E019.47.54.853 Color_18ACI
N050.04.24.792 E019.48.23.225 N050.04.24.860 E019.48.22.833 Color_18ACI
N050.04.24.860 E019.48.22.833 N050.04.25.085 E019.48.22.922 Color_18ACI
N050.04.25.085 E019.48.22.922 N050.04.25.121 E019.48.22.655 Color_18ACI
N050.04.25.121 E019.48.22.655 N050.04.25.215 E019.48.22.279 Color_18ACI
N050.04.25.215 E019.48.22.279 N050.04.25.283 E019.48.21.886 Color_18ACI
N050.04.25.283 E019.48.21.886 N050.04.25.726 E019.48.19.507 Color_18ACI
N050.04.25.726 E019.48.19.507 N050.04.26.551 E019.48.19.914 Color_18ACI
N050.04.26.551 E019.48.19.914 N050.04.25.883 E019.48.23.312 Color_18ACI
N050.04.25.883 E019.48.23.312 N050.04.26.681 E019.48.23.702 Color_18ACI
N050.04.26.681 E019.48.23.702 N050.04.27.346 E019.48.24.011 Color_18ACI
N050.04.27.346 E019.48.24.011 N050.04.28.014 E019.48.20.613 Color_18ACI
N050.04.28.014 E019.48.20.613 N050.04.28.839 E019.48.21.020 Color_18ACI
N050.04.28.839 E019.48.21.020 N050.04.28.171 E019.48.24.418 Color_18ACI
N050.04.28.171 E019.48.24.418 N050.04.28.262 E019.48.24.425 Color_18ACI
N050.04.28.262 E019.48.24.425 N050.04.28.194 E019.48.24.817 Color_18ACI
N050.04.28.194 E019.48.24.817 N050.04.24.792 E019.48.23.225 Color_18ACI
N050.04.24.386 E019.47.14.680 N050.04.24.082 E019.47.14.783 Color_18ACI
N050.04.24.082 E019.47.14.783 N050.04.24.115 E019.47.15.141 Color_18ACI
N050.04.24.115 E019.47.15.141 N050.04.24.420 E019.47.15.037 Color_18ACI
N050.04.24.420 E019.47.15.037 N050.04.24.386 E019.47.14.680 Color_18ACI
N050.04.16.343 E019.48.13.787 N050.04.16.001 E019.48.13.916 Color_18ACI
N050.04.16.001 E019.48.13.916 N050.04.16.046 E019.48.14.232 Color_18ACI
N050.04.16.046 E019.48.14.232 N050.04.16.377 E019.48.14.145 Color_18ACI
N050.04.16.377 E019.48.14.145 N050.04.16.343 E019.48.13.787 Color_18ACI
N050.04.55.144 E019.48.54.495 N050.04.55.072 E019.48.53.921 Color_18ACI
N050.04.55.072 E019.48.53.921 N050.04.54.805 E019.48.53.999 Color_18ACI
N050.04.54.805 E019.48.53.999 N050.04.54.888 E019.48.54.531 Color_18ACI
N050.04.54.888 E019.48.54.531 N050.04.55.144 E019.48.54.495 Color_18ACI
N050.04.30.652 E019.47.55.828 N050.04.30.967 E019.47.55.682 Color_18ACI
N050.04.30.967 E019.47.55.682 N050.04.30.944 E019.47.55.283 Color_18ACI
N050.04.30.944 E019.47.55.283 N050.04.30.575 E019.47.55.395 Color_18ACI
N050.04.30.575 E019.47.55.395 N050.04.30.652 E019.47.55.828 Color_18ACI
N050.04.39.304 E019.48.30.676 N050.04.39.137 E019.48.29.370 Color_18ACI
N050.04.39.137 E019.48.29.370 N050.04.38.310 E019.48.29.588 Color_18ACI
N050.04.38.310 E019.48.29.588 N050.04.38.366 E019.48.30.104 Color_18ACI
N050.04.38.366 E019.48.30.104 N050.04.38.862 E019.48.29.973 Color_18ACI
N050.04.38.862 E019.48.29.973 N050.04.38.973 E019.48.30.763 Color_18ACI
N050.04.38.973 E019.48.30.763 N050.04.39.304 E019.48.30.676 Color_18ACI
N050.04.40.039 E019.48.29.101 N050.04.40.173 E019.48.30.291 Color_18ACI
N050.04.40.173 E019.48.30.291 N050.04.40.643 E019.48.30.144 Color_18ACI
N050.04.40.643 E019.48.30.144 N050.04.40.509 E019.48.28.954 Color_18ACI
N050.04.40.509 E019.48.28.954 N050.04.40.039 E019.48.29.101 Color_18ACI
N050.04.26.404 E019.47.27.325 N050.04.26.820 E019.47.29.361 Color_18ACI
N050.04.26.820 E019.47.29.361 N050.04.26.356 E019.47.29.608 Color_18ACI
N050.04.26.356 E019.47.29.608 N050.04.26.285 E019.47.29.275 Color_18ACI
N050.04.26.285 E019.47.29.275 N050.04.26.461 E019.47.29.190 Color_18ACI
N050.04.26.461 E019.47.29.190 N050.04.26.089 E019.47.27.470 Color_18ACI
N050.04.26.089 E019.47.27.470 N050.04.26.404 E019.47.27.325 Color_18ACI
N050.04.21.785 E019.47.58.272 N050.04.21.513 E019.47.58.492 Color_18ACI
N050.04.21.513 E019.47.58.492 N050.04.21.323 E019.47.57.895 Color_18ACI
N050.04.21.323 E019.47.57.895 N050.04.21.622 E019.47.57.691 Color_18ACI
N050.04.21.622 E019.47.57.691 N050.04.21.785 E019.47.58.272 Color_18ACI
N050.04.21.309 E019.47.59.427 N050.04.20.914 E019.47.59.524 Color_18ACI
N050.04.20.914 E019.47.59.524 N050.04.20.932 E019.47.59.823 Color_18ACI
N050.04.20.932 E019.47.59.823 N050.04.21.364 E019.47.59.702 Color_18ACI
N050.04.21.364 E019.47.59.702 N050.04.21.309 E019.47.59.427 Color_18ACI
N050.04.21.887 E019.47.59.587 N050.04.21.777 E019.47.58.797 Color_18ACI
N050.04.21.777 E019.47.58.797 N050.04.21.601 E019.47.58.883 Color_18ACI
N050.04.21.601 E019.47.58.883 N050.04.21.695 E019.47.59.614 Color_18ACI
N050.04.21.695 E019.47.59.614 N050.04.21.887 E019.47.59.587 Color_18ACI
N050.04.22.330 E019.47.56.100 N050.04.21.749 E019.47.56.324 Color_18ACI
N050.04.21.749 E019.47.56.324 N050.04.21.671 E019.47.55.650 Color_18ACI
N050.04.21.671 E019.47.55.650 N050.04.22.268 E019.47.55.485 Color_18ACI
N050.04.22.268 E019.47.55.485 N050.04.22.330 E019.47.56.100 Color_18ACI
N050.04.29.793 E019.48.08.357 N050.04.30.164 E019.48.08.727 Color_18ACI
N050.04.30.164 E019.48.08.727 N050.04.30.227 E019.48.08.477 Color_18ACI
N050.04.30.227 E019.48.08.477 N050.04.29.883 E019.48.08.122 Color_18ACI
N050.04.29.883 E019.48.08.122 N050.04.29.793 E019.48.08.357 Color_18ACI
N050.04.29.489 E019.48.10.676 N050.04.29.226 E019.48.11.479 Color_18ACI
N050.04.29.226 E019.48.11.479 N050.04.28.968 E019.48.11.273 Color_18ACI
N050.04.28.968 E019.48.11.273 N050.04.29.205 E019.48.10.454 Color_18ACI
N050.04.29.205 E019.48.10.454 N050.04.29.489 E019.48.10.676 Color_18ACI
N050.04.18.859 E019.48.01.305 N050.04.19.646 E019.48.07.035 Color_18ACI
N050.04.19.646 E019.48.07.035 N050.04.20.099 E019.48.06.830 Color_18ACI
N050.04.20.099 E019.48.06.830 N050.04.20.127 E019.48.07.087 Color_18ACI
N050.04.20.127 E019.48.07.087 N050.04.20.597 E019.48.06.940 Color_18ACI
N050.04.20.597 E019.48.06.940 N050.04.20.542 E019.48.06.666 Color_18ACI
N050.04.20.542 E019.48.06.666 N050.04.21.012 E019.48.06.519 Color_18ACI
N050.04.21.012 E019.48.06.519 N050.04.21.145 E019.48.07.467 Color_18ACI
N050.04.21.145 E019.48.07.467 N050.04.21.348 E019.48.07.398 Color_18ACI
N050.04.21.348 E019.48.07.398 N050.04.20.831 E019.48.03.423 Color_18ACI
N050.04.20.831 E019.48.03.423 N050.04.20.564 E019.48.03.501 Color_18ACI
N050.04.20.564 E019.48.03.501 N050.04.20.408 E019.48.02.153 Color_18ACI
N050.04.20.408 E019.48.02.153 N050.04.21.662 E019.48.01.714 Color_18ACI
N050.04.21.662 E019.48.01.714 N050.04.21.512 E019.48.00.466 Color_18ACI
N050.04.21.512 E019.48.00.466 N050.04.20.231 E019.48.00.889 Color_18ACI
N050.04.20.231 E019.48.00.889 N050.04.20.215 E019.48.00.831 Color_18ACI
N050.04.20.215 E019.48.00.831 N050.04.19.302 E019.48.01.142 Color_18ACI
N050.04.19.302 E019.48.01.142 N050.04.19.258 E019.48.00.826 Color_18ACI
N050.04.19.258 E019.48.00.826 N050.04.18.954 E019.48.00.929 Color_18ACI
N050.04.18.954 E019.48.00.929 N050.04.18.998 E019.48.01.245 Color_18ACI
N050.04.18.998 E019.48.01.245 N050.04.18.859 E019.48.01.305 Color_18ACI
N050.04.20.998 E019.48.09.160 N050.04.19.920 E019.48.09.514 Color_18ACI
N050.04.19.920 E019.48.09.514 N050.04.19.976 E019.48.10.029 Color_18ACI
N050.04.19.976 E019.48.10.029 N050.04.20.408 E019.48.09.908 Color_18ACI
N050.04.20.408 E019.48.09.908 N050.04.20.491 E019.48.10.440 Color_18ACI
N050.04.20.491 E019.48.10.440 N050.04.20.603 E019.48.10.364 Color_18ACI
N050.04.20.603 E019.48.10.364 N050.04.20.537 E019.48.09.890 Color_18ACI
N050.04.20.537 E019.48.09.890 N050.04.20.766 E019.48.09.837 Color_18ACI
N050.04.20.766 E019.48.09.837 N050.04.20.799 E019.48.09.953 Color_18ACI
N050.04.20.799 E019.48.09.953 N050.04.21.093 E019.48.09.891 Color_18ACI
N050.04.21.093 E019.48.09.891 N050.04.20.998 E019.48.09.160 Color_18ACI
N050.04.22.698 E019.48.10.147 N050.04.21.725 E019.48.10.325 Color_18ACI
N050.04.21.725 E019.48.10.325 N050.04.21.659 E019.48.09.851 Color_18ACI
N050.04.21.659 E019.48.09.851 N050.04.22.017 E019.48.09.781 Color_18ACI
N050.04.22.017 E019.48.09.781 N050.04.21.950 E019.48.09.307 Color_18ACI
N050.04.21.950 E019.48.09.307 N050.04.22.612 E019.48.09.132 Color_18ACI
N050.04.22.612 E019.48.09.132 N050.04.22.698 E019.48.10.147 Color_18ACI
N050.04.21.680 E019.48.10.876 N050.04.22.737 E019.48.10.605 Color_18ACI
N050.04.22.737 E019.48.10.605 N050.04.22.781 E019.48.10.921 Color_18ACI
N050.04.22.781 E019.48.10.921 N050.04.21.724 E019.48.11.192 Color_18ACI
N050.04.21.724 E019.48.11.192 N050.04.21.680 E019.48.10.876 Color_18ACI
N050.04.21.125 E019.48.11.115 N050.04.20.111 E019.48.11.461 Color_18ACI
N050.04.20.111 E019.48.11.461 N050.04.20.051 E019.48.11.086 Color_18ACI
N050.04.20.051 E019.48.11.086 N050.04.21.054 E019.48.10.783 Color_18ACI
N050.04.21.054 E019.48.10.783 N050.04.21.125 E019.48.11.115 Color_18ACI
N050.04.21.618 E019.48.12.476 N050.04.20.300 E019.48.12.924 Color_18ACI
N050.04.20.300 E019.48.12.924 N050.04.20.234 E019.48.12.450 Color_18ACI
N050.04.20.234 E019.48.12.450 N050.04.21.274 E019.48.12.122 Color_18ACI
N050.04.21.274 E019.48.12.122 N050.04.21.236 E019.48.11.905 Color_18ACI
N050.04.21.236 E019.48.11.905 N050.04.21.503 E019.48.11.827 Color_18ACI
N050.04.21.503 E019.48.11.827 N050.04.21.618 E019.48.12.476 Color_18ACI
N050.04.22.960 E019.48.14.642 N050.04.21.273 E019.48.15.203 Color_18ACI
N050.04.21.273 E019.48.15.203 N050.04.21.152 E019.48.14.455 Color_18ACI
N050.04.21.152 E019.48.14.455 N050.04.21.408 E019.48.14.419 Color_18ACI
N050.04.21.408 E019.48.14.419 N050.04.21.187 E019.48.12.839 Color_18ACI
N050.04.21.187 E019.48.12.839 N050.04.22.404 E019.48.12.425 Color_18ACI
N050.04.22.404 E019.48.12.425 N050.04.22.625 E019.48.14.005 Color_18ACI
N050.04.22.625 E019.48.14.005 N050.04.22.865 E019.48.13.910 Color_18ACI
N050.04.22.865 E019.48.13.910 N050.04.22.960 E019.48.14.642 Color_18ACI
N050.04.21.601 E019.48.16.607 N050.04.20.837 E019.48.16.816 Color_18ACI
N050.04.20.837 E019.48.16.816 N050.04.20.831 E019.48.16.716 Color_18ACI
N050.04.20.831 E019.48.16.716 N050.04.20.500 E019.48.16.803 Color_18ACI
N050.04.20.500 E019.48.16.803 N050.04.20.667 E019.48.18.109 Color_18ACI
N050.04.20.667 E019.48.18.109 N050.04.20.971 E019.48.18.006 Color_18ACI
N050.04.20.971 E019.48.18.006 N050.04.20.977 E019.48.18.105 Color_18ACI
N050.04.20.977 E019.48.18.105 N050.04.21.788 E019.48.17.829 Color_18ACI
N050.04.21.788 E019.48.17.829 N050.04.21.601 E019.48.16.607 Color_18ACI
N050.04.20.884 E019.46.53.664 N050.04.20.061 E019.46.53.741 Color_18ACI
N050.04.20.061 E019.46.53.741 N050.04.20.037 E019.46.53.100 Color_18ACI
N050.04.20.037 E019.46.53.100 N050.04.20.833 E019.46.53.007 Color_18ACI
N050.04.20.833 E019.46.53.007 N050.04.20.884 E019.46.53.664 Color_18ACI
N050.04.23.044 E019.47.04.759 N050.04.23.111 E019.47.05.233 Color_18ACI
N050.04.23.111 E019.47.05.233 N050.04.22.908 E019.47.05.302 Color_18ACI
N050.04.22.908 E019.47.05.302 N050.04.22.841 E019.47.04.828 Color_18ACI
N050.04.22.841 E019.47.04.828 N050.04.23.044 E019.47.04.759 Color_18ACI
N050.04.23.172 E019.47.05.848 N050.04.23.300 E019.47.06.696 Color_18ACI
N050.04.23.300 E019.47.06.696 N050.04.22.995 E019.47.06.800 Color_18ACI
N050.04.22.995 E019.47.06.800 N050.04.22.868 E019.47.05.952 Color_18ACI
N050.04.22.868 E019.47.05.952 N050.04.23.172 E019.47.05.848 Color_18ACI
N050.04.25.209 E019.47.27.897 N050.04.25.515 E019.47.29.384 Color_18ACI
N050.04.25.515 E019.47.29.384 N050.04.25.153 E019.47.29.597 Color_18ACI
N050.04.25.153 E019.47.29.597 N050.04.24.820 E019.47.28.093 Color_18ACI
N050.04.24.820 E019.47.28.093 N050.04.25.209 E019.47.27.897 Color_18ACI
N050.04.24.168 E019.47.12.717 N050.04.24.368 E019.47.14.380 Color_18ACI
N050.04.24.368 E019.47.14.380 N050.04.23.936 E019.47.14.502 Color_18ACI
N050.04.23.936 E019.47.14.502 N050.04.23.735 E019.47.12.838 Color_18ACI
N050.04.23.735 E019.47.12.838 N050.04.24.168 E019.47.12.717 Color_18ACI
N050.04.24.356 E019.47.56.035 N050.04.22.947 E019.47.56.476 Color_18ACI
N050.04.22.947 E019.47.56.476 N050.04.22.991 E019.47.56.792 Color_18ACI
N050.04.22.991 E019.47.56.792 N050.04.22.826 E019.47.56.836 Color_18ACI
N050.04.22.826 E019.47.56.836 N050.04.22.960 E019.47.58.025 Color_18ACI
N050.04.22.960 E019.47.58.025 N050.04.24.727 E019.47.57.513 Color_18ACI
N050.04.24.727 E019.47.57.513 N050.04.24.576 E019.47.56.266 Color_18ACI
N050.04.24.576 E019.47.56.266 N050.04.24.384 E019.47.56.293 Color_18ACI
N050.04.24.384 E019.47.56.293 N050.04.24.356 E019.47.56.035 Color_18ACI
N050.04.27.927 E019.47.25.075 N050.04.29.031 E019.47.24.495 Color_18ACI
N050.04.29.031 E019.47.24.495 N050.04.28.612 E019.47.24.192 Color_18ACI
N050.04.28.612 E019.47.24.192 N050.04.28.020 E019.47.24.457 Color_18ACI
N050.04.28.020 E019.47.24.457 N050.04.27.626 E019.47.22.579 Color_18ACI
N050.04.27.626 E019.47.22.579 N050.04.28.229 E019.47.22.272 Color_18ACI
N050.04.28.229 E019.47.22.272 N050.04.28.612 E019.47.24.192 Color_18ACI
N050.04.28.612 E019.47.24.192 N050.04.29.031 E019.47.24.495 Color_18ACI
N050.04.29.031 E019.47.24.495 N050.04.28.592 E019.47.22.302 Color_18ACI
N050.04.28.592 E019.47.22.302 N050.04.28.481 E019.47.22.378 Color_18ACI
N050.04.28.481 E019.47.22.378 N050.04.28.365 E019.47.21.729 Color_18ACI
N050.04.28.365 E019.47.21.729 N050.04.27.218 E019.47.22.234 Color_18ACI
N050.04.27.218 E019.47.22.234 N050.04.27.646 E019.47.24.470 Color_18ACI
N050.04.27.646 E019.47.24.470 N050.04.27.758 E019.47.24.394 Color_18ACI
N050.04.27.758 E019.47.24.394 N050.04.27.927 E019.47.25.075 Color_18ACI
N050.04.58.676 E019.47.30.144 N050.05.01.119 E019.47.29.274 Color_18ACI
N050.05.01.119 E019.47.29.274 N050.05.01.181 E019.47.29.890 Color_18ACI
N050.05.01.181 E019.47.29.890 N050.04.58.791 E019.47.30.793 Color_18ACI
N050.04.58.791 E019.47.30.793 N050.04.58.676 E019.47.30.144 Color_18ACI
N050.04.23.426 E019.48.32.603 N050.04.23.811 E019.48.33.656 Color_18ACI
N050.04.23.811 E019.48.33.656 N050.04.24.205 E019.48.33.319 Color_18ACI
N050.04.24.205 E019.48.33.319 N050.04.23.793 E019.48.32.249 Color_18ACI
N050.04.23.793 E019.48.32.249 N050.04.23.426 E019.48.32.603 Color_18ACI
;twy_lines N000.00.00.000 E000.00.00.000 N000.00.00.000 E000.00.00.000
N050.04.40.329 E019.48.12.372 N050.04.40.431 E019.48.12.335 Color_44ACI
N050.04.35.279 E019.47.59.805 N050.04.36.357 E019.48.00.558 Color_44ACI
N050.04.33.273 E019.47.58.437 N050.04.35.279 E019.47.59.805 Color_44ACI
N050.04.38.800 E019.48.14.956 N050.04.37.888 E019.48.15.267 Color_44ACI
N050.04.37.888 E019.48.15.267 N050.04.36.570 E019.48.15.715 Color_44ACI
N050.04.36.570 E019.48.15.715 N050.04.35.289 E019.48.16.138 Color_44ACI
N050.04.35.289 E019.48.16.138 N050.04.34.744 E019.48.16.336 Color_44ACI
N050.04.42.072 E019.48.13.868 N050.04.39.243 E019.48.14.793 Color_44ACI
N050.04.39.243 E019.48.14.793 N050.04.38.902 E019.48.14.922 Color_44ACI
N050.04.31.980 E019.47.58.419 N050.04.32.247 E019.47.58.341 Color_44ACI
N050.04.32.247 E019.47.58.341 N050.04.32.433 E019.47.58.214 Color_44ACI
N050.04.32.433 E019.47.58.214 N050.04.32.587 E019.47.57.971 Color_44ACI
N050.04.32.587 E019.47.57.971 N050.04.32.751 E019.47.57.685 Color_44ACI
N050.04.32.751 E019.47.57.685 N050.04.32.920 E019.47.57.259 Color_44ACI
N050.04.32.920 E019.47.57.259 N050.04.33.079 E019.47.56.874 Color_44ACI
N050.04.33.079 E019.47.56.874 N050.04.33.702 E019.47.55.375 Color_44ACI
N050.04.33.702 E019.47.55.375 N050.04.34.289 E019.47.53.903 Color_44ACI
N050.04.31.355 E019.47.58.568 N050.04.31.852 E019.47.58.437 Color_44ACI
N050.04.29.428 E019.47.59.224 N050.04.27.934 E019.47.59.758 Color_44ACI
N050.04.27.934 E019.47.59.758 N050.04.26.413 E019.48.00.275 Color_44ACI
N050.04.26.413 E019.48.00.275 N050.04.26.163 E019.48.00.412 Color_44ACI
N050.04.26.163 E019.48.00.412 N050.04.25.918 E019.48.00.648 Color_44ACI
N050.04.25.918 E019.48.00.648 N050.04.25.716 E019.48.00.958 Color_44ACI
N050.04.25.716 E019.48.00.958 N050.04.25.531 E019.48.01.327 Color_44ACI
N050.04.25.531 E019.48.01.327 N050.04.25.457 E019.48.01.619 Color_44ACI
N050.04.25.457 E019.48.01.619 N050.04.25.400 E019.48.01.970 Color_44ACI
N050.04.25.400 E019.48.01.970 N050.04.25.397 E019.48.02.353 Color_44ACI
N050.04.25.397 E019.48.02.353 N050.04.25.404 E019.48.02.694 Color_44ACI
N050.04.25.404 E019.48.02.694 N050.04.25.614 E019.48.04.075 Color_44ACI
N050.04.25.614 E019.48.04.075 N050.04.25.797 E019.48.05.438 Color_44ACI
N050.04.25.797 E019.48.05.438 N050.04.26.096 E019.48.07.692 Color_44ACI
N050.04.26.096 E019.48.07.692 N050.04.26.423 E019.48.09.962 Color_44ACI
N050.04.26.423 E019.48.09.962 N050.04.26.533 E019.48.10.752 Color_44ACI
N050.04.26.533 E019.48.10.752 N050.04.26.617 E019.48.11.526 Color_44ACI
N050.04.26.617 E019.48.11.526 N050.04.26.678 E019.48.11.900 Color_44ACI
N050.04.26.678 E019.48.11.900 N050.04.26.815 E019.48.12.706 Color_44ACI
N050.04.26.815 E019.48.12.706 N050.04.26.926 E019.48.13.496 Color_44ACI
N050.04.26.926 E019.48.13.496 N050.04.26.954 E019.48.13.754 Color_44ACI
N050.04.26.862 E019.48.19.044 N050.04.27.378 E019.48.16.373 Color_44ACI
N050.04.27.378 E019.48.16.373 N050.04.27.431 E019.48.16.164 Color_44ACI
N050.04.27.692 E019.48.14.878 N050.04.28.849 E019.48.15.439 Color_44ACI
N050.04.28.849 E019.48.15.439 N050.04.29.540 E019.48.15.764 Color_44ACI
N050.04.29.540 E019.48.15.764 N050.04.30.124 E019.48.16.024 Color_44ACI
N050.04.30.124 E019.48.16.024 N050.04.32.000 E019.48.16.927 Color_44ACI
N050.04.29.051 E019.48.15.129 N050.04.29.131 E019.48.15.178 Color_44ACI
N050.04.29.131 E019.48.15.178 N050.04.29.255 E019.48.15.301 Color_44ACI
N050.04.29.255 E019.48.15.301 N050.04.29.325 E019.48.15.392 Color_44ACI
N050.04.29.325 E019.48.15.392 N050.04.29.395 E019.48.15.483 Color_44ACI
N050.04.29.395 E019.48.15.483 N050.04.29.438 E019.48.15.557 Color_44ACI
N050.04.29.438 E019.48.15.557 N050.04.29.481 E019.48.15.632 Color_44ACI
N050.04.29.481 E019.48.15.632 N050.04.29.514 E019.48.15.748 Color_44ACI
N050.04.40.124 E019.48.12.702 N050.04.40.093 E019.48.12.517 Color_44ACI
N050.04.40.071 E019.48.12.359 N050.04.39.893 E019.48.11.095 Color_44ACI
N050.04.39.893 E019.48.11.095 N050.04.39.716 E019.48.09.831 Color_44ACI
N050.04.39.716 E019.48.09.831 N050.04.39.600 E019.48.08.941 Color_44ACI
N050.04.39.600 E019.48.08.941 N050.04.39.499 E019.48.08.109 Color_44ACI
N050.04.39.499 E019.48.08.109 N050.04.39.023 E019.48.04.592 Color_44ACI
N050.04.39.023 E019.48.04.592 N050.04.38.701 E019.48.02.180 Color_44ACI
N050.04.38.701 E019.48.02.180 N050.04.38.402 E019.47.59.926 Color_44ACI
N050.04.38.402 E019.47.59.926 N050.04.38.075 E019.47.57.656 Color_44ACI
N050.04.38.075 E019.47.57.656 N050.04.38.047 E019.47.57.398 Color_44ACI
N050.04.38.047 E019.47.57.398 N050.04.38.019 E019.47.57.141 Color_44ACI
N050.04.37.997 E019.47.56.983 N050.04.37.798 E019.47.55.561 Color_44ACI
N050.04.37.798 E019.47.55.561 N050.04.37.598 E019.47.54.139 Color_44ACI
N050.04.37.598 E019.47.54.139 N050.04.36.940 E019.47.49.499 Color_44ACI
N050.04.36.940 E019.47.49.499 N050.04.36.574 E019.47.46.771 Color_44ACI
N050.04.36.574 E019.47.46.771 N050.04.36.502 E019.47.46.197 Color_44ACI
N050.04.36.502 E019.47.46.197 N050.04.36.429 E019.47.45.623 Color_44ACI
N050.04.36.407 E019.47.45.465 N050.04.36.053 E019.47.42.937 Color_44ACI
N050.04.36.053 E019.47.42.937 N050.04.35.699 E019.47.40.409 Color_44ACI
N050.04.35.699 E019.47.40.409 N050.04.35.344 E019.47.37.881 Color_44ACI
N050.04.35.344 E019.47.37.881 N050.04.35.023 E019.47.35.470 Color_44ACI
N050.04.35.023 E019.47.35.470 N050.04.34.685 E019.47.33.000 Color_44ACI
N050.04.34.652 E019.47.32.884 N050.04.34.258 E019.47.29.898 Color_44ACI
N050.04.34.258 E019.47.29.898 N050.04.33.837 E019.47.26.896 Color_44ACI
N050.04.35.866 E019.47.29.771 N050.04.36.208 E019.47.29.642 Color_44ACI
N050.04.36.208 E019.47.29.642 N050.04.36.549 E019.47.29.513 Color_44ACI
N050.04.34.153 E019.47.29.208 N050.04.34.256 E019.47.29.415 Color_44ACI
N050.04.34.256 E019.47.29.415 N050.04.34.331 E019.47.29.606 Color_44ACI
N050.04.34.331 E019.47.29.606 N050.04.34.471 E019.47.29.787 Color_44ACI
N050.04.34.471 E019.47.29.787 N050.04.34.622 E019.47.29.927 Color_44ACI
N050.04.34.622 E019.47.29.927 N050.04.34.900 E019.47.30.049 Color_44ACI
N050.04.34.900 E019.47.30.049 N050.04.35.167 E019.47.29.971 Color_44ACI
N050.04.35.167 E019.47.29.971 N050.04.35.434 E019.47.29.893 Color_44ACI
N050.04.35.434 E019.47.29.893 N050.04.35.610 E019.47.29.807 Color_44ACI
N050.04.35.610 E019.47.29.807 N050.04.35.802 E019.47.29.780 Color_44ACI
N050.04.32.025 E019.47.13.557 N050.04.30.578 E019.47.02.946 Color_44ACI
N050.04.30.578 E019.47.02.946 N050.04.29.486 E019.46.54.863 Color_44ACI
N050.04.29.464 E019.46.54.705 N050.04.29.381 E019.46.54.173 Color_44ACI
N050.04.29.381 E019.46.54.173 N050.04.29.315 E019.46.53.699 Color_44ACI
N050.04.35.860 E019.47.29.913 N050.04.35.881 E019.47.30.065 Color_44ACI
N050.04.35.830 E019.47.29.694 N050.04.35.852 E019.47.29.853 Color_44ACI
N050.04.35.801 E019.47.29.486 N050.04.35.819 E019.47.29.614 Color_44ACI
N050.04.31.978 E019.47.58.802 N050.04.31.999 E019.47.58.960 Color_44ACI
N050.04.31.950 E019.47.58.587 N050.04.31.970 E019.47.58.741 Color_44ACI
N050.04.31.920 E019.47.58.359 N050.04.31.937 E019.47.58.492 Color_44ACI
N050.04.31.889 E019.47.58.130 N050.04.31.907 E019.47.58.264 Color_44ACI
N050.04.31.855 E019.47.57.870 N050.04.31.873 E019.47.58.009 Color_44ACI
N050.04.38.759 E019.48.14.053 N050.04.38.772 E019.48.14.149 Color_44ACI
N050.04.38.944 E019.48.15.414 N050.04.38.962 E019.48.15.544 Color_44ACI
N050.04.38.911 E019.48.15.168 N050.04.38.931 E019.48.15.320 Color_44ACI
N050.04.38.883 E019.48.14.967 N050.04.38.901 E019.48.15.096 Color_44ACI
N050.04.38.853 E019.48.14.747 N050.04.38.867 E019.48.14.845 Color_44ACI
N050.04.38.823 E019.48.14.526 N050.04.38.837 E019.48.14.626 Color_44ACI
N050.04.38.789 E019.48.14.271 N050.04.38.806 E019.48.14.401 Color_44ACI
N050.04.39.624 E019.48.12.624 N050.04.39.697 E019.48.12.598 Color_44ACI
N050.04.40.480 E019.48.12.314 N050.04.40.559 E019.48.12.285 Color_44ACI
N050.04.40.187 E019.48.12.420 N050.04.40.289 E019.48.12.383 Color_44ACI
N050.04.40.049 E019.48.12.470 N050.04.40.125 E019.48.12.443 Color_44ACI
N050.04.39.905 E019.48.12.523 N050.04.39.991 E019.48.12.491 Color_44ACI
N050.04.39.766 E019.48.12.573 N050.04.39.838 E019.48.12.547 Color_44ACI
N050.04.38.223 E019.47.56.990 N050.04.38.308 E019.47.56.961 Color_44ACI
N050.04.38.090 E019.47.57.035 N050.04.38.172 E019.47.57.007 Color_44ACI
N050.04.37.936 E019.47.57.087 N050.04.38.041 E019.47.57.052 Color_44ACI
N050.04.37.796 E019.47.57.135 N050.04.37.893 E019.47.57.102 Color_44ACI
N050.04.37.644 E019.47.57.186 N050.04.37.745 E019.47.57.152 Color_44ACI
N050.04.36.653 E019.47.45.471 N050.04.36.744 E019.47.45.478 Color_44ACI
N050.04.36.515 E019.47.45.531 N050.04.36.579 E019.47.45.521 Color_44ACI
N050.04.36.376 E019.47.45.590 N050.04.36.450 E019.47.45.540 Color_44ACI
N050.04.36.221 E019.47.45.592 N050.04.36.312 E019.47.45.600 Color_44ACI
N050.04.36.082 E019.47.45.652 N050.04.36.157 E019.47.45.601 Color_44ACI
N050.04.34.924 E019.47.32.854 N050.04.35.003 E019.47.32.825 Color_44ACI
N050.04.34.793 E019.47.32.900 N050.04.34.867 E019.47.32.874 Color_44ACI
N050.04.34.629 E019.47.32.959 N050.04.34.731 E019.47.32.922 Color_44ACI
N050.04.34.483 E019.47.33.011 N050.04.34.580 E019.47.32.976 Color_44ACI
N050.04.34.333 E019.47.33.065 N050.04.34.431 E019.47.33.029 Color_44ACI
N050.04.33.837 E019.47.26.896 N050.04.32.950 E019.47.20.335 Color_44ACI
N050.04.32.950 E019.47.20.335 N050.04.32.047 E019.47.13.715 Color_44ACI
N050.04.32.271 E019.47.13.557 N050.04.32.371 E019.47.13.523 Color_44ACI
N050.04.32.145 E019.47.13.599 N050.04.32.231 E019.47.13.570 Color_44ACI
N050.04.32.004 E019.47.13.647 N050.04.32.083 E019.47.13.620 Color_44ACI
N050.04.31.838 E019.47.13.702 N050.04.31.940 E019.47.13.668 Color_44ACI
N050.04.31.699 E019.47.13.749 N050.04.31.778 E019.47.13.723 Color_44ACI
N050.04.28.716 E019.46.49.191 N050.04.26.972 E019.46.36.809 Color_44ACI
N050.04.29.315 E019.46.53.699 N050.04.28.721 E019.46.49.291 Color_44ACI
N050.04.28.935 E019.46.49.180 N050.04.29.036 E019.46.49.145 Color_44ACI
N050.04.28.808 E019.46.49.223 N050.04.28.897 E019.46.49.193 Color_44ACI
N050.04.28.669 E019.46.49.271 N050.04.28.748 E019.46.49.244 Color_44ACI
N050.04.28.505 E019.46.49.328 N050.04.28.607 E019.46.49.293 Color_44ACI
N050.04.28.365 E019.46.49.376 N050.04.28.443 E019.46.49.349 Color_44ACI
N050.04.29.707 E019.46.54.690 N050.04.29.785 E019.46.54.664 Color_44ACI
N050.04.29.582 E019.46.54.732 N050.04.29.645 E019.46.54.711 Color_44ACI
N050.04.29.442 E019.46.54.780 N050.04.29.521 E019.46.54.753 Color_44ACI
N050.04.29.278 E019.46.54.835 N050.04.29.379 E019.46.54.801 Color_44ACI
N050.04.29.137 E019.46.54.883 N050.04.29.217 E019.46.54.856 Color_44ACI
N050.04.30.853 E019.46.52.373 N050.04.31.789 E019.46.52.462 Color_44ACI
N050.04.29.126 E019.46.52.235 N050.04.30.736 E019.46.52.349 Color_44ACI
N050.04.30.786 E019.46.52.765 N050.04.30.781 E019.46.52.907 Color_44ACI
N050.04.30.794 E019.46.52.523 N050.04.30.788 E019.46.52.684 Color_44ACI
N050.04.30.801 E019.46.52.302 N050.04.30.797 E019.46.52.435 Color_44ACI
N050.04.30.808 E019.46.52.085 N050.04.30.804 E019.46.52.199 Color_44ACI
N050.04.34.744 E019.48.16.336 N050.04.32.727 E019.48.16.985 Color_44ACI
N050.04.47.323 E019.48.12.157 N050.04.45.573 E019.48.12.728 Color_44ACI
N050.04.48.042 E019.48.11.632 N050.04.47.957 E019.48.11.725 Color_44ACI
N050.04.47.957 E019.48.11.725 N050.04.47.872 E019.48.11.818 Color_44ACI
N050.04.47.872 E019.48.11.818 N050.04.47.787 E019.48.11.910 Color_44ACI
N050.04.47.787 E019.48.11.910 N050.04.47.712 E019.48.11.961 Color_44ACI
N050.04.47.712 E019.48.11.961 N050.04.47.600 E019.48.12.037 Color_44ACI
N050.04.47.600 E019.48.12.037 N050.04.47.526 E019.48.12.088 Color_44ACI
N050.04.47.526 E019.48.12.088 N050.04.47.424 E019.48.12.123 Color_44ACI
N050.04.47.424 E019.48.12.123 N050.04.47.323 E019.48.12.157 Color_44ACI
N050.04.48.758 E019.48.09.275 N050.04.48.765 E019.48.09.617 Color_44ACI
N050.04.48.765 E019.48.09.617 N050.04.48.707 E019.48.09.967 Color_44ACI
N050.04.48.707 E019.48.09.967 N050.04.48.634 E019.48.10.259 Color_44ACI
N050.04.48.634 E019.48.10.259 N050.04.48.561 E019.48.10.552 Color_44ACI
N050.04.48.561 E019.48.10.552 N050.04.48.450 E019.48.10.870 Color_44ACI
N050.04.48.450 E019.48.10.870 N050.04.48.350 E019.48.11.146 Color_44ACI
N050.04.48.350 E019.48.11.146 N050.04.48.196 E019.48.11.389 Color_44ACI
N050.04.48.196 E019.48.11.389 N050.04.48.042 E019.48.11.632 Color_44ACI
N050.04.41.625 E019.47.27.887 N050.04.41.854 E019.47.27.835 Color_44ACI
N050.04.41.854 E019.47.27.835 N050.04.42.079 E019.47.27.924 Color_44ACI
N050.04.42.079 E019.47.27.924 N050.04.42.315 E019.47.27.971 Color_44ACI
N050.04.42.315 E019.47.27.971 N050.04.42.529 E019.47.28.102 Color_44ACI
N050.04.42.529 E019.47.28.102 N050.04.42.733 E019.47.28.274 Color_44ACI
N050.04.42.733 E019.47.28.274 N050.04.42.927 E019.47.28.489 Color_44ACI
N050.04.42.927 E019.47.28.489 N050.04.43.072 E019.47.28.770 Color_44ACI
N050.04.43.072 E019.47.28.770 N050.04.43.218 E019.47.29.051 Color_44ACI
N050.04.42.817 E019.47.25.724 N050.04.42.760 E019.47.26.075 Color_44ACI
N050.04.42.760 E019.47.26.075 N050.04.42.666 E019.47.26.451 Color_44ACI
N050.04.42.666 E019.47.26.451 N050.04.42.555 E019.47.26.769 Color_44ACI
N050.04.42.555 E019.47.26.769 N050.04.42.417 E019.47.27.070 Color_44ACI
N050.04.42.417 E019.47.27.070 N050.04.42.226 E019.47.27.339 Color_44ACI
N050.04.42.226 E019.47.27.339 N050.04.42.046 E019.47.27.566 Color_44ACI
N050.04.42.046 E019.47.27.566 N050.04.41.849 E019.47.27.735 Color_44ACI
N050.04.41.849 E019.47.27.735 N050.04.41.625 E019.47.27.887 Color_44ACI
N050.04.40.141 E019.47.28.380 N050.04.41.625 E019.47.27.887 Color_44ACI
N050.04.23.413 E019.46.10.606 N050.04.23.406 E019.46.10.264 Color_44ACI
N050.04.23.406 E019.46.10.264 N050.04.23.453 E019.46.09.955 Color_44ACI
N050.04.23.453 E019.46.09.955 N050.04.23.537 E019.46.09.621 Color_44ACI
N050.04.23.537 E019.46.09.621 N050.04.23.637 E019.46.09.345 Color_44ACI
N050.04.23.637 E019.46.09.345 N050.04.23.801 E019.46.09.060 Color_44ACI
N050.04.23.801 E019.46.09.060 N050.04.23.945 E019.46.08.859 Color_44ACI
N050.04.23.945 E019.46.08.859 N050.04.24.142 E019.46.08.690 Color_44ACI
N050.04.24.142 E019.46.08.690 N050.04.24.355 E019.46.08.579 Color_44ACI
N050.04.24.355 E019.46.08.579 N050.04.24.899 E019.46.08.381 Color_44ACI
N050.04.24.899 E019.46.08.381 N050.04.25.977 E019.46.08.027 Color_44ACI
N050.04.23.819 E019.46.13.791 N050.04.23.642 E019.46.12.527 Color_44ACI
N050.04.23.642 E019.46.12.527 N050.04.23.491 E019.46.11.279 Color_44ACI
N050.04.23.491 E019.46.11.279 N050.04.23.431 E019.46.10.905 Color_44ACI
N050.04.23.431 E019.46.10.905 N050.04.23.413 E019.46.10.606 Color_44ACI
N050.04.30.044 E019.46.06.605 N050.04.28.929 E019.46.06.984 Color_44ACI
N050.04.30.044 E019.46.06.605 N050.04.30.338 E019.46.06.543 Color_44ACI
N050.04.30.338 E019.46.06.543 N050.04.30.610 E019.46.06.565 Color_44ACI
N050.04.30.610 E019.46.06.565 N050.04.30.728 E019.46.06.588 Color_44ACI
N050.04.30.728 E019.46.06.588 N050.04.30.873 E019.46.06.628 Color_44ACI
N050.04.30.873 E019.46.06.628 N050.04.30.990 E019.46.06.652 Color_44ACI
N050.04.30.990 E019.46.06.652 N050.04.31.124 E019.46.06.734 Color_44ACI
N050.04.37.308 E019.46.52.889 N050.04.37.506 E019.46.52.961 Color_44ACI
N050.04.37.506 E019.46.52.961 N050.04.37.693 E019.46.53.076 Color_44ACI
N050.04.37.693 E019.46.53.076 N050.04.37.871 E019.46.53.232 Color_44ACI
N050.04.37.871 E019.46.53.232 N050.04.38.037 E019.46.53.430 Color_44ACI
N050.04.38.037 E019.46.53.430 N050.04.38.177 E019.46.53.611 Color_44ACI
N050.04.38.177 E019.46.53.611 N050.04.38.307 E019.46.53.835 Color_44ACI
N050.04.38.307 E019.46.53.835 N050.04.38.436 E019.46.54.058 Color_44ACI
N050.04.38.436 E019.46.54.058 N050.04.38.528 E019.46.54.307 Color_44ACI
N050.04.36.554 E019.46.52.814 N050.04.37.308 E019.46.52.889 Color_44ACI
N050.04.37.985 E019.46.50.315 N050.04.37.960 E019.46.50.782 Color_44ACI
N050.04.37.960 E019.46.50.782 N050.04.37.855 E019.46.51.200 Color_44ACI
N050.04.37.855 E019.46.51.200 N050.04.37.724 E019.46.51.601 Color_44ACI
N050.04.37.724 E019.46.51.601 N050.04.37.565 E019.46.51.986 Color_44ACI
N050.04.37.565 E019.46.51.986 N050.04.37.337 E019.46.52.280 Color_44ACI
N050.04.37.337 E019.46.52.280 N050.04.37.092 E019.46.52.516 Color_44ACI
N050.04.37.092 E019.46.52.516 N050.04.36.831 E019.46.52.694 Color_44ACI
N050.04.36.831 E019.46.52.694 N050.04.36.554 E019.46.52.814 Color_44ACI
N050.04.30.123 E019.46.52.306 N050.04.29.934 E019.46.52.342 Color_44ACI
N050.04.29.934 E019.46.52.342 N050.04.29.784 E019.46.52.444 Color_44ACI
N050.04.29.784 E019.46.52.444 N050.04.29.652 E019.46.52.604 Color_44ACI
N050.04.29.652 E019.46.52.604 N050.04.29.529 E019.46.52.722 Color_44ACI
N050.04.29.529 E019.46.52.722 N050.04.29.439 E019.46.52.956 Color_44ACI
N050.04.29.439 E019.46.52.956 N050.04.29.387 E019.46.53.165 Color_44ACI
N050.04.29.387 E019.46.53.165 N050.04.29.324 E019.46.53.415 Color_44ACI
N050.04.29.324 E019.46.53.415 N050.04.29.315 E019.46.53.699 Color_44ACI
N050.04.37.390 E019.48.00.755 N050.04.37.599 E019.48.00.785 Color_44ACI
N050.04.37.599 E019.48.00.785 N050.04.37.797 E019.48.00.858 Color_44ACI
N050.04.37.797 E019.48.00.858 N050.04.37.984 E019.48.00.972 Color_44ACI
N050.04.37.984 E019.48.00.972 N050.04.38.135 E019.48.01.112 Color_44ACI
N050.04.38.135 E019.48.01.112 N050.04.38.328 E019.48.01.327 Color_44ACI
N050.04.38.328 E019.48.01.327 N050.04.38.457 E019.48.01.550 Color_44ACI
N050.04.38.457 E019.48.01.550 N050.04.38.576 E019.48.01.815 Color_44ACI
N050.04.38.576 E019.48.01.815 N050.04.38.694 E019.48.02.139 Color_44ACI
N050.04.36.791 E019.48.00.678 N050.04.37.390 E019.48.00.755 Color_44ACI
N050.04.36.791 E019.48.00.678 N050.04.37.047 E019.48.00.642 Color_44ACI
N050.04.37.047 E019.48.00.642 N050.04.37.325 E019.48.00.522 Color_44ACI
N050.04.37.325 E019.48.00.522 N050.04.37.569 E019.48.00.286 Color_44ACI
N050.04.37.569 E019.48.00.286 N050.04.37.787 E019.48.00.034 Color_44ACI
N050.04.37.787 E019.48.00.034 N050.04.37.962 E019.47.59.707 Color_44ACI
N050.04.37.962 E019.47.59.707 N050.04.38.094 E019.47.59.305 Color_44ACI
N050.04.38.094 E019.47.59.305 N050.04.38.161 E019.47.58.913 Color_44ACI
N050.04.38.161 E019.47.58.913 N050.04.38.191 E019.47.58.452 Color_44ACI
N050.04.36.331 E019.48.00.542 N050.04.36.411 E019.48.00.591 Color_44ACI
N050.04.36.411 E019.48.00.591 N050.04.36.465 E019.48.00.624 Color_44ACI
N050.04.36.465 E019.48.00.624 N050.04.36.545 E019.48.00.673 Color_44ACI
N050.04.36.545 E019.48.00.673 N050.04.36.727 E019.48.00.687 Color_44ACI
N050.04.36.727 E019.48.00.687 N050.04.36.791 E019.48.00.678 Color_44ACI
N050.04.32.321 E019.47.58.290 N050.04.32.423 E019.47.58.256 Color_44ACI
N050.04.32.423 E019.47.58.256 N050.04.32.551 E019.47.58.238 Color_44ACI
N050.04.32.551 E019.47.58.238 N050.04.32.679 E019.47.58.219 Color_44ACI
N050.04.32.679 E019.47.58.219 N050.04.32.797 E019.47.58.243 Color_44ACI
N050.04.32.797 E019.47.58.243 N050.04.32.914 E019.47.58.267 Color_44ACI
N050.04.32.914 E019.47.58.267 N050.04.33.059 E019.47.58.307 Color_44ACI
N050.04.33.059 E019.47.58.307 N050.04.33.166 E019.47.58.372 Color_44ACI
N050.04.33.166 E019.47.58.372 N050.04.33.273 E019.47.58.437 Color_44ACI
N050.04.35.094 E019.48.14.575 N050.04.35.015 E019.48.14.767 Color_44ACI
N050.04.35.015 E019.48.14.767 N050.04.34.979 E019.48.15.034 Color_44ACI
N050.04.34.979 E019.48.15.034 N050.04.34.964 E019.48.15.218 Color_44ACI
N050.04.34.964 E019.48.15.218 N050.04.34.965 E019.48.15.459 Color_44ACI
N050.04.34.965 E019.48.15.459 N050.04.35.014 E019.48.15.634 Color_44ACI
N050.04.35.014 E019.48.15.634 N050.04.35.089 E019.48.15.824 Color_44ACI
N050.04.35.089 E019.48.15.824 N050.04.35.192 E019.48.16.031 Color_44ACI
N050.04.35.192 E019.48.16.031 N050.04.35.289 E019.48.16.138 Color_44ACI
N050.04.35.094 E019.48.14.575 N050.04.35.180 E019.48.14.724 Color_44ACI
N050.04.35.180 E019.48.14.724 N050.04.35.293 E019.48.14.889 Color_44ACI
N050.04.35.293 E019.48.14.889 N050.04.35.369 E019.48.15.080 Color_44ACI
N050.04.35.369 E019.48.15.080 N050.04.35.408 E019.48.15.296 Color_44ACI
N050.04.35.408 E019.48.15.296 N050.04.35.419 E019.48.15.495 Color_44ACI
N050.04.35.419 E019.48.15.495 N050.04.35.420 E019.48.15.737 Color_44ACI
N050.04.35.420 E019.48.15.737 N050.04.35.368 E019.48.15.946 Color_44ACI
N050.04.35.368 E019.48.15.946 N050.04.35.289 E019.48.16.138 Color_44ACI
N050.04.36.375 E019.48.14.152 N050.04.36.270 E019.48.14.569 Color_44ACI
N050.04.36.270 E019.48.14.569 N050.04.36.271 E019.48.14.811 Color_44ACI
N050.04.36.271 E019.48.14.811 N050.04.36.283 E019.48.15.011 Color_44ACI
N050.04.36.283 E019.48.15.011 N050.04.36.321 E019.48.15.227 Color_44ACI
N050.04.36.321 E019.48.15.227 N050.04.36.397 E019.48.15.417 Color_44ACI
N050.04.36.397 E019.48.15.417 N050.04.36.483 E019.48.15.566 Color_44ACI
N050.04.36.483 E019.48.15.566 N050.04.36.570 E019.48.15.715 Color_44ACI
N050.04.36.375 E019.48.14.152 N050.04.36.498 E019.48.14.275 Color_44ACI
N050.04.36.498 E019.48.14.275 N050.04.36.601 E019.48.14.482 Color_44ACI
N050.04.36.601 E019.48.14.482 N050.04.36.650 E019.48.14.656 Color_44ACI
N050.04.36.650 E019.48.14.656 N050.04.36.715 E019.48.14.889 Color_44ACI
N050.04.36.715 E019.48.14.889 N050.04.36.727 E019.48.15.089 Color_44ACI
N050.04.36.727 E019.48.15.089 N050.04.36.701 E019.48.15.314 Color_44ACI
N050.04.36.701 E019.48.15.314 N050.04.36.649 E019.48.15.523 Color_44ACI
N050.04.36.649 E019.48.15.523 N050.04.36.596 E019.48.15.732 Color_44ACI
N050.04.37.656 E019.48.13.728 N050.04.37.779 E019.48.13.852 Color_44ACI
N050.04.37.779 E019.48.13.852 N050.04.37.855 E019.48.14.043 Color_44ACI
N050.04.37.855 E019.48.14.043 N050.04.37.931 E019.48.14.233 Color_44ACI
N050.04.37.931 E019.48.14.233 N050.04.38.007 E019.48.14.424 Color_44ACI
N050.04.38.007 E019.48.14.424 N050.04.38.018 E019.48.14.624 Color_44ACI
N050.04.38.018 E019.48.14.624 N050.04.37.993 E019.48.14.849 Color_44ACI
N050.04.37.993 E019.48.14.849 N050.04.37.977 E019.48.15.032 Color_44ACI
N050.04.37.977 E019.48.15.032 N050.04.37.925 E019.48.15.241 Color_44ACI
N050.04.37.656 E019.48.13.728 N050.04.37.603 E019.48.13.937 Color_44ACI
N050.04.37.603 E019.48.13.937 N050.04.37.578 E019.48.14.162 Color_44ACI
N050.04.37.578 E019.48.14.162 N050.04.37.563 E019.48.14.346 Color_44ACI
N050.04.37.563 E019.48.14.346 N050.04.37.601 E019.48.14.562 Color_44ACI
N050.04.37.601 E019.48.14.562 N050.04.37.639 E019.48.14.778 Color_44ACI
N050.04.37.639 E019.48.14.778 N050.04.37.688 E019.48.14.952 Color_44ACI
N050.04.37.688 E019.48.14.952 N050.04.37.764 E019.48.15.143 Color_44ACI
N050.04.37.764 E019.48.15.143 N050.04.37.888 E019.48.15.267 Color_44ACI
N050.04.34.695 E019.48.11.731 N050.04.35.094 E019.48.14.575 Color_44ACI
N050.04.35.976 E019.48.11.308 N050.04.36.375 E019.48.14.152 Color_44ACI
N050.04.37.257 E019.48.10.884 N050.04.37.656 E019.48.13.728 Color_44ACI
N050.04.30.124 E019.48.16.024 N050.04.29.992 E019.48.16.184 Color_44ACI
N050.04.29.992 E019.48.16.184 N050.04.29.896 E019.48.16.318 Color_44ACI
N050.04.29.896 E019.48.16.318 N050.04.29.817 E019.48.16.511 Color_44ACI
N050.04.29.817 E019.48.16.511 N050.04.29.775 E019.48.16.678 Color_44ACI
N050.04.29.775 E019.48.16.678 N050.04.29.722 E019.48.16.887 Color_44ACI
N050.04.29.722 E019.48.16.887 N050.04.29.734 E019.48.17.086 Color_44ACI
N050.04.29.734 E019.48.17.086 N050.04.29.762 E019.48.17.344 Color_44ACI
N050.04.29.762 E019.48.17.344 N050.04.29.811 E019.48.17.519 Color_44ACI
N050.04.30.124 E019.48.16.024 N050.04.30.163 E019.48.16.240 Color_44ACI
N050.04.30.163 E019.48.16.240 N050.04.30.201 E019.48.16.456 Color_44ACI
N050.04.30.201 E019.48.16.456 N050.04.30.213 E019.48.16.656 Color_44ACI
N050.04.30.213 E019.48.16.656 N050.04.30.161 E019.48.16.865 Color_44ACI
N050.04.30.161 E019.48.16.865 N050.04.30.108 E019.48.17.074 Color_44ACI
N050.04.30.108 E019.48.17.074 N050.04.30.029 E019.48.17.266 Color_44ACI
N050.04.30.029 E019.48.17.266 N050.04.29.933 E019.48.17.401 Color_44ACI
N050.04.29.933 E019.48.17.401 N050.04.29.811 E019.48.17.519 Color_44ACI
N050.04.28.849 E019.48.15.439 N050.04.28.727 E019.48.15.557 Color_44ACI
N050.04.28.727 E019.48.15.557 N050.04.28.631 E019.48.15.692 Color_44ACI
N050.04.28.631 E019.48.15.692 N050.04.28.552 E019.48.15.884 Color_44ACI
N050.04.28.552 E019.48.15.884 N050.04.28.500 E019.48.16.093 Color_44ACI
N050.04.28.500 E019.48.16.093 N050.04.28.447 E019.48.16.302 Color_44ACI
N050.04.28.447 E019.48.16.302 N050.04.28.448 E019.48.16.544 Color_44ACI
N050.04.28.448 E019.48.16.544 N050.04.28.487 E019.48.16.760 Color_44ACI
N050.04.28.487 E019.48.16.760 N050.04.28.536 E019.48.16.934 Color_44ACI
N050.04.28.823 E019.48.15.423 N050.04.28.898 E019.48.15.614 Color_44ACI
N050.04.28.898 E019.48.15.614 N050.04.28.910 E019.48.15.813 Color_44ACI
N050.04.28.910 E019.48.15.813 N050.04.28.911 E019.48.16.055 Color_44ACI
N050.04.28.911 E019.48.16.055 N050.04.28.859 E019.48.16.264 Color_44ACI
N050.04.28.859 E019.48.16.264 N050.04.28.806 E019.48.16.473 Color_44ACI
N050.04.28.806 E019.48.16.473 N050.04.28.764 E019.48.16.640 Color_44ACI
N050.04.28.764 E019.48.16.640 N050.04.28.631 E019.48.16.800 Color_44ACI
N050.04.28.631 E019.48.16.800 N050.04.28.536 E019.48.16.934 Color_44ACI
N050.04.27.692 E019.48.14.878 N050.04.27.570 E019.48.14.996 Color_44ACI
N050.04.27.570 E019.48.14.996 N050.04.27.474 E019.48.15.131 Color_44ACI
N050.04.27.474 E019.48.15.131 N050.04.27.395 E019.48.15.323 Color_44ACI
N050.04.27.395 E019.48.15.323 N050.04.27.342 E019.48.15.532 Color_44ACI
N050.04.27.342 E019.48.15.532 N050.04.27.290 E019.48.15.741 Color_44ACI
N050.04.27.290 E019.48.15.741 N050.04.27.291 E019.48.15.982 Color_44ACI
N050.04.27.291 E019.48.15.982 N050.04.27.313 E019.48.16.140 Color_44ACI
N050.04.27.313 E019.48.16.140 N050.04.27.378 E019.48.16.373 Color_44ACI
N050.04.27.692 E019.48.14.878 N050.04.27.714 E019.48.15.036 Color_44ACI
N050.04.27.714 E019.48.15.036 N050.04.27.726 E019.48.15.236 Color_44ACI
N050.04.27.726 E019.48.15.236 N050.04.27.707 E019.48.15.427 Color_44ACI
N050.04.27.707 E019.48.15.427 N050.04.27.696 E019.48.15.555 Color_44ACI
N050.04.27.696 E019.48.15.555 N050.04.27.653 E019.48.15.770 Color_44ACI
N050.04.27.653 E019.48.15.770 N050.04.27.585 E019.48.15.921 Color_44ACI
N050.04.27.585 E019.48.15.921 N050.04.27.526 E019.48.16.030 Color_44ACI
N050.04.27.526 E019.48.16.030 N050.04.27.431 E019.48.16.164 Color_44ACI
N050.04.28.056 E019.48.19.338 N050.04.28.536 E019.48.16.934 Color_44ACI
N050.04.29.320 E019.48.19.965 N050.04.29.811 E019.48.17.519 Color_44ACI
N050.04.29.051 E019.48.15.129 N050.04.25.972 E019.48.16.189 Color_44ACI
N050.04.25.972 E019.48.16.189 N050.04.24.461 E019.48.16.665 Color_44ACI
N050.04.32.727 E019.48.16.985 N050.04.32.561 E019.48.17.028 Color_44ACI
N050.04.32.561 E019.48.17.028 N050.04.32.369 E019.48.17.056 Color_44ACI
N050.04.32.369 E019.48.17.056 N050.04.32.278 E019.48.17.048 Color_44ACI
N050.04.32.278 E019.48.17.048 N050.04.32.000 E019.48.16.927 Color_44ACI
N050.04.26.954 E019.48.13.754 N050.04.27.030 E019.48.13.945 Color_44ACI
N050.04.27.030 E019.48.13.945 N050.04.27.079 E019.48.14.119 Color_44ACI
N050.04.27.079 E019.48.14.119 N050.04.27.155 E019.48.14.310 Color_44ACI
N050.04.27.155 E019.48.14.310 N050.04.27.251 E019.48.14.417 Color_44ACI
N050.04.27.251 E019.48.14.417 N050.04.27.338 E019.48.14.566 Color_44ACI
N050.04.27.338 E019.48.14.566 N050.04.27.461 E019.48.14.689 Color_44ACI
N050.04.27.461 E019.48.14.689 N050.04.27.558 E019.48.14.796 Color_44ACI
N050.04.27.558 E019.48.14.796 N050.04.27.692 E019.48.14.878 Color_44ACI
N050.04.27.257 E019.48.14.517 N050.04.27.139 E019.48.14.493 Color_44ACI
N050.04.27.139 E019.48.14.493 N050.04.27.001 E019.48.14.553 Color_44ACI
N050.04.27.001 E019.48.14.553 N050.04.26.878 E019.48.14.671 Color_44ACI
N050.04.26.878 E019.48.14.671 N050.04.26.756 E019.48.14.789 Color_44ACI
N050.04.26.756 E019.48.14.789 N050.04.26.660 E019.48.14.924 Color_44ACI
N050.04.26.660 E019.48.14.924 N050.04.26.581 E019.48.15.116 Color_44ACI
N050.04.26.581 E019.48.15.116 N050.04.26.512 E019.48.15.267 Color_44ACI
N050.04.26.512 E019.48.15.267 N050.04.26.460 E019.48.15.476 Color_44ACI
N050.04.27.268 E019.48.14.475 N050.04.27.215 E019.48.14.684 Color_44ACI
N050.04.27.215 E019.48.14.684 N050.04.27.163 E019.48.14.893 Color_44ACI
N050.04.27.163 E019.48.14.893 N050.04.27.094 E019.48.15.043 Color_44ACI
N050.04.27.094 E019.48.15.043 N050.04.26.988 E019.48.15.220 Color_44ACI
N050.04.26.988 E019.48.15.220 N050.04.26.866 E019.48.15.338 Color_44ACI
N050.04.26.866 E019.48.15.338 N050.04.26.754 E019.48.15.414 Color_44ACI
N050.04.26.754 E019.48.15.414 N050.04.26.615 E019.48.15.474 Color_44ACI
N050.04.26.615 E019.48.15.474 N050.04.26.460 E019.48.15.476 Color_44ACI
N050.04.24.898 E019.48.17.510 N050.04.26.460 E019.48.15.476 Color_44ACI
N050.04.40.124 E019.48.12.702 N050.04.40.149 E019.48.13.033 Color_44ACI
N050.04.40.149 E019.48.13.033 N050.04.40.118 E019.48.13.400 Color_44ACI
N050.04.40.118 E019.48.13.400 N050.04.40.072 E019.48.13.708 Color_44ACI
N050.04.40.072 E019.48.13.708 N050.04.39.961 E019.48.14.026 Color_44ACI
N050.04.39.961 E019.48.14.026 N050.04.39.834 E019.48.14.286 Color_44ACI
N050.04.39.834 E019.48.14.286 N050.04.39.653 E019.48.14.513 Color_44ACI
N050.04.39.653 E019.48.14.513 N050.04.39.456 E019.48.14.682 Color_44ACI
N050.04.39.456 E019.48.14.682 N050.04.39.243 E019.48.14.793 Color_44ACI
N050.04.40.124 E019.48.12.702 N050.04.40.240 E019.48.13.040 Color_44ACI
N050.04.40.240 E019.48.13.040 N050.04.40.358 E019.48.13.305 Color_44ACI
N050.04.40.358 E019.48.13.305 N050.04.40.541 E019.48.13.561 Color_44ACI
N050.04.40.541 E019.48.13.561 N050.04.40.708 E019.48.13.759 Color_44ACI
N050.04.40.708 E019.48.13.759 N050.04.40.912 E019.48.13.932 Color_44ACI
N050.04.40.912 E019.48.13.932 N050.04.41.137 E019.48.14.021 Color_44ACI
N050.04.41.137 E019.48.14.021 N050.04.41.457 E019.48.14.069 Color_44ACI
N050.04.43.011 E019.48.13.574 N050.04.42.477 E019.48.13.730 Color_44ACI
N050.04.42.477 E019.48.13.730 N050.04.42.069 E019.48.13.869 Color_44ACI
N050.04.45.573 E019.48.12.728 N050.04.43.545 E019.48.13.418 Color_44ACI
N050.04.36.538 E019.47.54.792 N050.04.36.186 E019.47.54.963 Color_44ACI
N050.04.36.186 E019.47.54.963 N050.04.36.044 E019.47.55.157 Color_44ACI
N050.04.36.044 E019.47.55.157 N050.04.35.967 E019.47.55.458 Color_44ACI
N050.04.35.967 E019.47.55.458 N050.04.36.059 E019.47.56.174 Color_44ACI
N050.04.36.538 E019.47.54.792 N050.04.37.636 E019.47.54.382 Color_44ACI
N050.04.43.489 E019.48.13.627 N050.04.43.541 E019.48.14.011 Color_44ACI
N050.04.43.386 E019.48.12.867 N050.04.43.430 E019.48.13.191 Color_44ACI
N050.04.25.977 E019.46.08.027 N050.04.27.306 E019.46.07.536 Color_44ACI
N050.04.27.306 E019.46.07.536 N050.04.27.915 E019.46.07.329 Color_44ACI
N050.04.27.915 E019.46.07.329 N050.04.28.459 E019.46.07.131 Color_44ACI
N050.04.28.942 E019.46.07.183 N050.04.28.995 E019.46.07.567 Color_44ACI
N050.04.28.829 E019.46.06.394 N050.04.28.885 E019.46.06.771 Color_44ACI
N050.04.28.424 E019.46.06.532 N050.04.28.593 E019.46.07.717 Color_44ACI
N050.04.35.190 E019.46.52.705 N050.04.35.880 E019.46.52.789 Color_44ACI
N050.04.35.880 E019.46.52.789 N050.04.36.554 E019.46.52.814 Color_44ACI
N050.04.35.142 E019.46.52.865 N050.04.35.140 E019.46.53.043 Color_44ACI
N050.04.35.146 E019.46.52.432 N050.04.35.140 E019.46.52.629 Color_44ACI
N050.04.35.018 E019.46.52.831 N050.04.35.013 E019.46.53.035 Color_44ACI
N050.04.35.028 E019.46.52.422 N050.04.35.025 E019.46.52.611 Color_44ACI
N050.04.31.789 E019.46.52.462 N050.04.33.554 E019.46.52.574 Color_44ACI
N050.04.33.554 E019.46.52.574 N050.04.34.698 E019.46.52.694 Color_44ACI
N050.04.34.753 E019.46.52.400 N050.04.34.733 E019.46.53.016 Color_44ACI
N050.04.40.120 E019.47.28.463 N050.04.40.132 E019.47.28.663 Color_44ACI
N050.04.40.070 E019.47.28.047 N050.04.40.082 E019.47.28.247 Color_44ACI
N050.04.36.549 E019.47.29.513 N050.04.37.489 E019.47.29.219 Color_44ACI
N050.04.37.489 E019.47.29.219 N050.04.38.705 E019.47.28.805 Color_44ACI
N050.04.38.705 E019.47.28.805 N050.04.39.682 E019.47.28.485 Color_44ACI
N050.04.39.803 E019.47.28.125 N050.04.39.892 E019.47.28.757 Color_44ACI
N050.04.28.801 E019.46.07.244 N050.04.28.854 E019.46.07.624 Color_44ACI
N050.04.28.701 E019.46.06.429 N050.04.28.758 E019.46.06.823 Color_44ACI
N050.04.28.564 E019.46.06.477 N050.04.28.728 E019.46.07.667 Color_44ACI
N050.04.34.899 E019.46.52.412 N050.04.34.887 E019.46.53.026 Color_44ACI
N050.04.29.428 E019.47.59.224 N050.04.30.138 E019.47.58.982 Color_44ACI
N050.04.30.138 E019.47.58.982 N050.04.31.355 E019.47.58.568 Color_44ACI
N050.04.39.982 E019.47.28.523 N050.04.40.031 E019.47.28.697 Color_44ACI
N050.04.39.931 E019.47.28.107 N050.04.39.970 E019.47.28.323 Color_44ACI
N050.04.39.691 E019.47.28.202 N050.04.39.764 E019.47.28.776 Color_44ACI
N050.04.43.376 E019.48.13.672 N050.04.43.427 E019.48.14.049 Color_44ACI
N050.04.43.272 E019.48.12.903 N050.04.43.315 E019.48.13.227 Color_44ACI
N050.04.42.990 E019.48.12.993 N050.04.43.145 E019.48.14.143 Color_44ACI
N050.04.43.138 E019.48.12.946 N050.04.43.294 E019.48.14.093 Color_44ACI
N050.04.34.289 E019.47.53.903 N050.04.35.430 E019.47.51.082 Color_44ACI
N050.04.35.430 E019.47.51.082 N050.04.36.122 E019.47.49.433 Color_44ACI
N050.04.36.122 E019.47.49.433 N050.04.36.274 E019.47.48.948 Color_44ACI
N050.04.36.274 E019.47.48.948 N050.04.36.481 E019.47.48.496 Color_44ACI
N050.04.36.481 E019.47.48.496 N050.04.36.533 E019.47.48.287 Color_44ACI
N050.04.36.533 E019.47.48.287 N050.04.36.596 E019.47.48.037 Color_44ACI
N050.04.36.596 E019.47.48.037 N050.04.36.632 E019.47.47.770 Color_44ACI
N050.04.36.632 E019.47.47.770 N050.04.36.642 E019.47.47.486 Color_44ACI
N050.04.36.642 E019.47.47.486 N050.04.36.608 E019.47.47.129 Color_44ACI
N050.04.26.972 E019.46.36.809 N050.04.25.387 E019.46.25.150 Color_44ACI
N050.04.25.387 E019.46.25.150 N050.04.23.819 E019.46.13.791 Color_44ACI
N050.04.33.646 E019.48.01.506 N050.04.33.573 E019.48.01.799 Color_44ACI
N050.04.33.573 E019.48.01.799 N050.04.33.483 E019.48.02.033 Color_44ACI
N050.04.33.483 E019.48.02.033 N050.04.33.340 E019.48.02.235 Color_44ACI
N050.04.33.340 E019.48.02.235 N050.04.33.094 E019.48.02.229 Color_44ACI
N050.04.33.094 E019.48.02.229 N050.04.32.874 E019.48.01.999 Color_44ACI
N050.04.32.874 E019.48.01.999 N050.04.32.867 E019.48.01.657 Color_44ACI
N050.04.32.867 E019.48.01.657 N050.04.33.051 E019.48.01.047 Color_44ACI
N050.04.33.051 E019.48.01.047 N050.04.33.679 E019.47.58.726 Color_44ACI
N050.04.25.194 E019.48.01.314 N050.04.25.360 E019.48.01.271 Color_44ACI
N050.04.25.360 E019.48.01.271 N050.04.25.482 E019.48.01.152 Color_44ACI
N050.04.25.482 E019.48.01.152 N050.04.25.567 E019.48.01.060 Color_44ACI
N050.04.25.567 E019.48.01.060 N050.04.25.769 E019.48.00.877 Color_44ACI
N050.04.26.814 E019.48.09.141 N050.04.27.913 E019.48.08.704 Color_44ACI
N050.04.27.313 E019.48.12.817 N050.04.28.418 E019.48.12.479 Color_44ACI
N050.04.27.313 E019.48.12.817 N050.04.27.239 E019.48.12.868 Color_44ACI
N050.04.27.239 E019.48.12.868 N050.04.27.164 E019.48.12.919 Color_44ACI
N050.04.27.164 E019.48.12.919 N050.04.27.079 E019.48.13.011 Color_44ACI
N050.04.27.079 E019.48.13.011 N050.04.27.010 E019.48.13.162 Color_44ACI
N050.04.27.010 E019.48.13.162 N050.04.26.937 E019.48.13.454 Color_44ACI
N050.04.26.937 E019.48.13.454 N050.04.26.932 E019.48.13.596 Color_44ACI
N050.04.26.932 E019.48.13.596 N050.04.26.954 E019.48.13.754 Color_44ACI
N050.04.26.722 E019.48.12.216 N050.04.26.771 E019.48.12.390 Color_44ACI
N050.04.26.771 E019.48.12.390 N050.04.26.804 E019.48.12.506 Color_44ACI
N050.04.26.804 E019.48.12.506 N050.04.26.874 E019.48.12.597 Color_44ACI
N050.04.26.874 E019.48.12.597 N050.04.26.933 E019.48.12.730 Color_44ACI
N050.04.26.933 E019.48.12.730 N050.04.27.121 E019.48.12.844 Color_44ACI
N050.04.27.121 E019.48.12.844 N050.04.27.222 E019.48.12.810 Color_44ACI
N050.04.27.222 E019.48.12.810 N050.04.27.313 E019.48.12.817 Color_44ACI
N050.04.26.814 E019.48.09.141 N050.04.26.723 E019.48.09.134 Color_44ACI
N050.04.26.723 E019.48.09.134 N050.04.26.632 E019.48.09.127 Color_44ACI
N050.04.26.632 E019.48.09.127 N050.04.26.541 E019.48.09.120 Color_44ACI
N050.04.26.541 E019.48.09.120 N050.04.26.461 E019.48.09.070 Color_44ACI
N050.04.26.461 E019.48.09.070 N050.04.26.391 E019.48.08.980 Color_44ACI
N050.04.26.391 E019.48.08.980 N050.04.26.321 E019.48.08.889 Color_44ACI
N050.04.26.321 E019.48.08.889 N050.04.26.272 E019.48.08.715 Color_44ACI
N050.04.26.272 E019.48.08.715 N050.04.26.240 E019.48.08.598 Color_44ACI
N050.04.26.800 E019.48.09.140 N050.04.26.713 E019.48.09.176 Color_44ACI
N050.04.26.713 E019.48.09.176 N050.04.26.614 E019.48.09.227 Color_44ACI
N050.04.26.614 E019.48.09.227 N050.04.26.530 E019.48.09.324 Color_44ACI
N050.04.26.530 E019.48.09.324 N050.04.26.437 E019.48.09.537 Color_44ACI
N050.04.26.437 E019.48.09.537 N050.04.26.411 E019.48.09.699 Color_44ACI
N050.04.26.411 E019.48.09.699 N050.04.26.423 E019.48.09.962 Color_44ACI
N050.04.25.744 E019.48.13.402 N050.04.25.857 E019.48.13.567 Color_44ACI
N050.04.25.857 E019.48.13.567 N050.04.25.991 E019.48.13.649 Color_44ACI
N050.04.25.991 E019.48.13.649 N050.04.26.152 E019.48.13.747 Color_44ACI
N050.04.26.152 E019.48.13.747 N050.04.26.334 E019.48.13.761 Color_44ACI
N050.04.26.334 E019.48.13.761 N050.04.26.489 E019.48.13.760 Color_44ACI
N050.04.26.489 E019.48.13.760 N050.04.26.638 E019.48.13.658 Color_44ACI
N050.04.26.638 E019.48.13.658 N050.04.26.761 E019.48.13.540 Color_44ACI
N050.04.26.761 E019.48.13.540 N050.04.26.894 E019.48.13.380 Color_44ACI
N050.04.26.799 E019.48.12.648 N050.04.26.638 E019.48.12.550 Color_44ACI
N050.04.26.638 E019.48.12.550 N050.04.26.456 E019.48.12.536 Color_44ACI
N050.04.26.456 E019.48.12.536 N050.04.26.328 E019.48.12.554 Color_44ACI
N050.04.26.328 E019.48.12.554 N050.04.26.152 E019.48.12.639 Color_44ACI
N050.04.26.152 E019.48.12.639 N050.04.26.019 E019.48.12.799 Color_44ACI
N050.04.26.019 E019.48.12.799 N050.04.25.886 E019.48.12.959 Color_44ACI
N050.04.25.886 E019.48.12.959 N050.04.25.807 E019.48.13.151 Color_44ACI
N050.04.25.807 E019.48.13.151 N050.04.25.717 E019.48.13.385 Color_44ACI
N050.04.26.528 E019.48.10.652 N050.04.26.395 E019.48.10.812 Color_44ACI
N050.04.26.395 E019.48.10.812 N050.04.26.245 E019.48.10.914 Color_44ACI
N050.04.26.245 E019.48.10.914 N050.04.26.069 E019.48.10.999 Color_44ACI
N050.04.26.069 E019.48.10.999 N050.04.25.914 E019.48.11.001 Color_44ACI
N050.04.25.914 E019.48.11.001 N050.04.25.759 E019.48.11.003 Color_44ACI
N050.04.25.759 E019.48.11.003 N050.04.25.625 E019.48.10.921 Color_44ACI
N050.04.25.625 E019.48.10.921 N050.04.25.465 E019.48.10.823 Color_44ACI
N050.04.25.465 E019.48.10.823 N050.04.25.351 E019.48.10.658 Color_44ACI
N050.04.25.351 E019.48.10.658 N050.04.25.414 E019.48.10.407 Color_44ACI
N050.04.25.414 E019.48.10.407 N050.04.25.531 E019.48.10.189 Color_44ACI
N050.04.25.531 E019.48.10.189 N050.04.25.653 E019.48.10.071 Color_44ACI
N050.04.25.653 E019.48.10.071 N050.04.25.786 E019.48.09.911 Color_44ACI
N050.04.25.786 E019.48.09.911 N050.04.25.925 E019.48.09.851 Color_44ACI
N050.04.25.925 E019.48.09.851 N050.04.26.090 E019.48.09.808 Color_44ACI
N050.04.26.090 E019.48.09.808 N050.04.26.272 E019.48.09.822 Color_44ACI
N050.04.26.272 E019.48.09.822 N050.04.26.417 E019.48.09.862 Color_44ACI
N050.04.25.744 E019.48.13.402 N050.04.24.079 E019.48.13.879 Color_44ACI
N050.04.25.362 E019.48.10.616 N050.04.23.713 E019.48.11.152 Color_44ACI
N050.04.22.859 E019.48.04.948 N050.04.24.498 E019.48.04.454 Color_44ACI
N050.04.23.215 E019.48.07.718 N050.04.24.891 E019.48.07.198 Color_44ACI
N050.04.24.116 E019.48.01.668 N050.04.22.467 E019.48.02.204 Color_44ACI
N050.04.24.116 E019.48.01.668 N050.04.24.216 E019.48.01.392 Color_44ACI
N050.04.24.216 E019.48.01.392 N050.04.24.370 E019.48.01.149 Color_44ACI
N050.04.24.370 E019.48.01.149 N050.04.24.567 E019.48.00.980 Color_44ACI
N050.04.24.567 E019.48.00.980 N050.04.24.780 E019.48.00.869 Color_44ACI
N050.04.24.780 E019.48.00.869 N050.04.24.999 E019.48.00.858 Color_44ACI
N050.04.24.999 E019.48.00.858 N050.04.25.198 E019.48.00.931 Color_44ACI
N050.04.25.198 E019.48.00.931 N050.04.25.402 E019.48.01.103 Color_44ACI
N050.04.25.402 E019.48.01.103 N050.04.25.531 E019.48.01.327 Color_44ACI
N050.04.26.030 E019.48.07.218 N050.04.25.897 E019.48.07.378 Color_44ACI
N050.04.25.897 E019.48.07.378 N050.04.25.775 E019.48.07.496 Color_44ACI
N050.04.25.775 E019.48.07.496 N050.04.25.609 E019.48.07.540 Color_44ACI
N050.04.25.609 E019.48.07.540 N050.04.25.444 E019.48.07.583 Color_44ACI
N050.04.25.444 E019.48.07.583 N050.04.25.299 E019.48.07.543 Color_44ACI
N050.04.25.299 E019.48.07.543 N050.04.25.128 E019.48.07.487 Color_44ACI
N050.04.25.128 E019.48.07.487 N050.04.25.004 E019.48.07.363 Color_44ACI
N050.04.25.004 E019.48.07.363 N050.04.24.891 E019.48.07.198 Color_44ACI
N050.04.25.946 E019.48.06.444 N050.04.25.775 E019.48.06.388 Color_44ACI
N050.04.25.775 E019.48.06.388 N050.04.25.630 E019.48.06.348 Color_44ACI
N050.04.25.630 E019.48.06.348 N050.04.25.465 E019.48.06.392 Color_44ACI
N050.04.25.465 E019.48.06.392 N050.04.25.289 E019.48.06.477 Color_44ACI
N050.04.25.289 E019.48.06.477 N050.04.25.166 E019.48.06.595 Color_44ACI
N050.04.25.166 E019.48.06.595 N050.04.25.023 E019.48.06.797 Color_44ACI
N050.04.25.023 E019.48.06.797 N050.04.24.944 E019.48.06.989 Color_44ACI
N050.04.24.944 E019.48.06.989 N050.04.24.891 E019.48.07.198 Color_44ACI
N050.04.25.647 E019.48.04.432 N050.04.25.541 E019.48.04.608 Color_44ACI
N050.04.25.541 E019.48.04.608 N050.04.25.392 E019.48.04.710 Color_44ACI
N050.04.25.392 E019.48.04.710 N050.04.25.216 E019.48.04.796 Color_44ACI
N050.04.25.216 E019.48.04.796 N050.04.25.061 E019.48.04.797 Color_44ACI
N050.04.25.061 E019.48.04.797 N050.04.24.917 E019.48.04.757 Color_44ACI
N050.04.24.917 E019.48.04.757 N050.04.24.772 E019.48.04.717 Color_44ACI
N050.04.24.772 E019.48.04.717 N050.04.24.622 E019.48.04.578 Color_44ACI
N050.04.24.622 E019.48.04.578 N050.04.24.498 E019.48.04.454 Color_44ACI
N050.04.24.498 E019.48.04.454 N050.04.24.561 E019.48.04.203 Color_44ACI
N050.04.24.561 E019.48.04.203 N050.04.24.667 E019.48.04.027 Color_44ACI
N050.04.24.667 E019.48.04.027 N050.04.24.800 E019.48.03.868 Color_44ACI
N050.04.24.800 E019.48.03.868 N050.04.24.923 E019.48.03.749 Color_44ACI
N050.04.24.923 E019.48.03.749 N050.04.25.072 E019.48.03.648 Color_44ACI
N050.04.25.072 E019.48.03.648 N050.04.25.237 E019.48.03.604 Color_44ACI
N050.04.25.237 E019.48.03.604 N050.04.25.392 E019.48.03.602 Color_44ACI
N050.04.25.392 E019.48.03.602 N050.04.25.553 E019.48.03.700 Color_44ACI
N050.04.25.194 E019.48.01.314 N050.04.24.116 E019.48.01.668 Color_44ACI
N050.04.26.959 E019.48.06.966 N050.04.28.240 E019.48.06.542 Color_44ACI
N050.04.26.709 E019.48.05.128 N050.04.27.963 E019.48.04.688 Color_44ACI
N050.04.26.460 E019.48.03.290 N050.04.27.741 E019.48.02.867 Color_44ACI
N050.04.26.046 E019.48.07.276 N050.04.26.170 E019.48.07.400 Color_44ACI
N050.04.26.170 E019.48.07.400 N050.04.26.287 E019.48.07.423 Color_44ACI
N050.04.26.287 E019.48.07.423 N050.04.26.405 E019.48.07.447 Color_44ACI
N050.04.26.405 E019.48.07.447 N050.04.26.533 E019.48.07.429 Color_44ACI
N050.04.26.533 E019.48.07.429 N050.04.26.672 E019.48.07.369 Color_44ACI
N050.04.26.672 E019.48.07.369 N050.04.26.757 E019.48.07.276 Color_44ACI
N050.04.26.757 E019.48.07.276 N050.04.26.879 E019.48.07.158 Color_44ACI
N050.04.26.879 E019.48.07.158 N050.04.26.959 E019.48.06.966 Color_44ACI
N050.04.25.797 E019.48.05.438 N050.04.25.904 E019.48.05.504 Color_44ACI
N050.04.25.904 E019.48.05.504 N050.04.26.038 E019.48.05.585 Color_44ACI
N050.04.26.038 E019.48.05.585 N050.04.26.156 E019.48.05.609 Color_44ACI
N050.04.26.156 E019.48.05.609 N050.04.26.284 E019.48.05.591 Color_44ACI
N050.04.26.284 E019.48.05.591 N050.04.26.423 E019.48.05.531 Color_44ACI
N050.04.26.423 E019.48.05.531 N050.04.26.518 E019.48.05.397 Color_44ACI
N050.04.26.518 E019.48.05.397 N050.04.26.603 E019.48.05.304 Color_44ACI
N050.04.26.603 E019.48.05.304 N050.04.26.709 E019.48.05.128 Color_44ACI
N050.04.26.046 E019.48.07.276 N050.04.26.115 E019.48.07.125 Color_44ACI
N050.04.26.115 E019.48.07.125 N050.04.26.237 E019.48.07.007 Color_44ACI
N050.04.26.237 E019.48.07.007 N050.04.26.322 E019.48.06.915 Color_44ACI
N050.04.26.322 E019.48.06.915 N050.04.26.461 E019.48.06.855 Color_44ACI
N050.04.26.461 E019.48.06.855 N050.04.26.589 E019.48.06.837 Color_44ACI
N050.04.26.589 E019.48.06.837 N050.04.26.707 E019.48.06.860 Color_44ACI
N050.04.26.707 E019.48.06.860 N050.04.26.825 E019.48.06.884 Color_44ACI
N050.04.26.825 E019.48.06.884 N050.04.26.959 E019.48.06.966 Color_44ACI
N050.04.25.797 E019.48.05.438 N050.04.25.865 E019.48.05.288 Color_44ACI
N050.04.25.865 E019.48.05.288 N050.04.25.988 E019.48.05.170 Color_44ACI
N050.04.25.988 E019.48.05.170 N050.04.26.083 E019.48.05.035 Color_44ACI
N050.04.26.083 E019.48.05.035 N050.04.26.222 E019.48.04.975 Color_44ACI
N050.04.26.222 E019.48.04.975 N050.04.26.340 E019.48.04.999 Color_44ACI
N050.04.26.340 E019.48.04.999 N050.04.26.468 E019.48.04.981 Color_44ACI
N050.04.26.468 E019.48.04.981 N050.04.26.575 E019.48.05.046 Color_44ACI
N050.04.26.575 E019.48.05.046 N050.04.26.709 E019.48.05.128 Color_44ACI
N050.04.26.461 E019.48.03.289 N050.04.26.354 E019.48.03.466 Color_44ACI
N050.04.26.354 E019.48.03.466 N050.04.26.269 E019.48.03.559 Color_44ACI
N050.04.26.269 E019.48.03.559 N050.04.26.146 E019.48.03.677 Color_44ACI
N050.04.26.146 E019.48.03.677 N050.04.26.034 E019.48.03.753 Color_44ACI
N050.04.26.034 E019.48.03.753 N050.04.25.879 E019.48.03.755 Color_44ACI
N050.04.25.879 E019.48.03.755 N050.04.25.762 E019.48.03.731 Color_44ACI
N050.04.25.762 E019.48.03.731 N050.04.25.644 E019.48.03.708 Color_44ACI
N050.04.25.644 E019.48.03.708 N050.04.25.520 E019.48.03.584 Color_44ACI
N050.04.26.461 E019.48.03.289 N050.04.26.326 E019.48.03.208 Color_44ACI
N050.04.26.326 E019.48.03.208 N050.04.26.208 E019.48.03.185 Color_44ACI
N050.04.26.208 E019.48.03.185 N050.04.26.090 E019.48.03.161 Color_44ACI
N050.04.26.090 E019.48.03.161 N050.04.25.935 E019.48.03.163 Color_44ACI
N050.04.25.935 E019.48.03.163 N050.04.25.823 E019.48.03.239 Color_44ACI
N050.04.25.823 E019.48.03.239 N050.04.25.712 E019.48.03.315 Color_44ACI
N050.04.25.712 E019.48.03.315 N050.04.25.616 E019.48.03.450 Color_44ACI
N050.04.25.616 E019.48.03.450 N050.04.25.537 E019.48.03.642 Color_44ACI
N050.04.28.990 E019.48.01.461 N050.04.29.455 E019.48.04.779 Color_44ACI
N050.04.29.017 E019.48.01.477 N050.04.28.829 E019.48.01.363 Color_44ACI
N050.04.28.829 E019.48.01.363 N050.04.28.689 E019.48.01.181 Color_44ACI
N050.04.28.689 E019.48.01.181 N050.04.28.560 E019.48.00.958 Color_44ACI
N050.04.28.560 E019.48.00.958 N050.04.28.468 E019.48.00.709 Color_44ACI
N050.04.28.468 E019.48.00.709 N050.04.28.403 E019.48.00.477 Color_44ACI
N050.04.28.403 E019.48.00.477 N050.04.28.358 E019.48.00.161 Color_44ACI
N050.04.28.358 E019.48.00.161 N050.04.28.395 E019.47.59.894 Color_44ACI
N050.04.28.395 E019.47.59.894 N050.04.28.404 E019.47.59.611 Color_44ACI
N050.04.28.990 E019.48.01.461 N050.04.29.107 E019.48.01.243 Color_44ACI
N050.04.29.107 E019.48.01.243 N050.04.29.197 E019.48.01.009 Color_44ACI
N050.04.29.197 E019.48.01.009 N050.04.29.233 E019.48.00.742 Color_44ACI
N050.04.29.233 E019.48.00.742 N050.04.29.269 E019.48.00.475 Color_44ACI
N050.04.29.269 E019.48.00.475 N050.04.29.251 E019.48.00.175 Color_44ACI
N050.04.29.251 E019.48.00.175 N050.04.29.223 E019.47.59.917 Color_44ACI
N050.04.29.223 E019.47.59.917 N050.04.29.142 E019.47.59.627 Color_44ACI
N050.04.29.142 E019.47.59.627 N050.04.29.012 E019.47.59.404 Color_44ACI
N050.04.35.205 E019.47.29.960 N050.04.35.055 E019.47.30.047 Color_44ACI
N050.04.35.055 E019.47.30.047 N050.04.34.923 E019.47.30.126 Color_44ACI
N050.04.34.923 E019.47.30.126 N050.04.34.784 E019.47.30.267 Color_44ACI
N050.04.34.784 E019.47.30.267 N050.04.34.678 E019.47.30.443 Color_44ACI
N050.04.34.678 E019.47.30.443 N050.04.34.577 E019.47.30.719 Color_44ACI
N050.04.34.577 E019.47.30.719 N050.04.34.477 E019.47.30.995 Color_44ACI
N050.04.34.477 E019.47.30.995 N050.04.34.468 E019.47.31.278 Color_44ACI
N050.04.34.468 E019.47.31.278 N050.04.34.485 E019.47.31.578 Color_44ACI
;twy_edge_lights N000.00.00.000 E000.00.00.000 N000.00.00.000 E000.00.00.000
N050.04.24.995 E019.46.17.805 N050.04.24.941 E019.46.17.769 Color_186ACI
N050.04.24.941 E019.46.17.769 N050.04.24.876 E019.46.17.789 Color_186ACI
N050.04.24.876 E019.46.17.789 N050.04.24.836 E019.46.17.853 Color_186ACI
N050.04.24.836 E019.46.17.853 N050.04.24.825 E019.46.17.958 Color_186ACI
N050.04.24.825 E019.46.17.958 N050.04.24.852 E019.46.18.045 Color_186ACI
N050.04.24.852 E019.46.18.045 N050.04.24.910 E019.46.18.093 Color_186ACI
N050.04.24.910 E019.46.18.093 N050.04.24.971 E019.46.18.081 Color_186ACI
N050.04.24.971 E019.46.18.081 N050.04.25.020 E019.46.18.012 Color_186ACI
N050.04.25.020 E019.46.18.012 N050.04.25.034 E019.46.17.932 Color_186ACI
N050.04.25.034 E019.46.17.932 N050.04.25.020 E019.46.17.850 Color_186ACI
N050.04.25.020 E019.46.17.850 N050.04.24.995 E019.46.17.805 Color_186ACI
N050.04.24.678 E019.46.15.521 N050.04.24.624 E019.46.15.485 Color_186ACI
N050.04.24.624 E019.46.15.485 N050.04.24.559 E019.46.15.505 Color_186ACI
N050.04.24.559 E019.46.15.505 N050.04.24.519 E019.46.15.569 Color_186ACI
N050.04.24.519 E019.46.15.569 N050.04.24.507 E019.46.15.674 Color_186ACI
N050.04.24.507 E019.46.15.674 N050.04.24.535 E019.46.15.761 Color_186ACI
N050.04.24.535 E019.46.15.761 N050.04.24.593 E019.46.15.809 Color_186ACI
N050.04.24.593 E019.46.15.809 N050.04.24.654 E019.46.15.797 Color_186ACI
N050.04.24.654 E019.46.15.797 N050.04.24.703 E019.46.15.728 Color_186ACI
N050.04.24.703 E019.46.15.728 N050.04.24.716 E019.46.15.648 Color_186ACI
N050.04.24.716 E019.46.15.648 N050.04.24.703 E019.46.15.566 Color_186ACI
N050.04.24.703 E019.46.15.566 N050.04.24.678 E019.46.15.521 Color_186ACI
N050.04.24.392 E019.46.13.362 N050.04.24.337 E019.46.13.326 Color_186ACI
N050.04.24.337 E019.46.13.326 N050.04.24.273 E019.46.13.346 Color_186ACI
N050.04.24.273 E019.46.13.346 N050.04.24.232 E019.46.13.410 Color_186ACI
N050.04.24.232 E019.46.13.410 N050.04.24.221 E019.46.13.515 Color_186ACI
N050.04.24.221 E019.46.13.515 N050.04.24.249 E019.46.13.602 Color_186ACI
N050.04.24.249 E019.46.13.602 N050.04.24.307 E019.46.13.650 Color_186ACI
N050.04.24.307 E019.46.13.650 N050.04.24.367 E019.46.13.639 Color_186ACI
N050.04.24.367 E019.46.13.639 N050.04.24.416 E019.46.13.569 Color_186ACI
N050.04.24.416 E019.46.13.569 N050.04.24.430 E019.46.13.489 Color_186ACI
N050.04.24.430 E019.46.13.489 N050.04.24.416 E019.46.13.407 Color_186ACI
N050.04.24.416 E019.46.13.407 N050.04.24.392 E019.46.13.362 Color_186ACI
N050.04.24.087 E019.46.11.292 N050.04.24.032 E019.46.11.255 Color_186ACI
N050.04.24.032 E019.46.11.255 N050.04.23.968 E019.46.11.275 Color_186ACI
N050.04.23.968 E019.46.11.275 N050.04.23.927 E019.46.11.339 Color_186ACI
N050.04.23.927 E019.46.11.339 N050.04.23.916 E019.46.11.444 Color_186ACI
N050.04.23.916 E019.46.11.444 N050.04.23.944 E019.46.11.531 Color_186ACI
N050.04.23.944 E019.46.11.531 N050.04.24.002 E019.46.11.580 Color_186ACI
N050.04.24.002 E019.46.11.580 N050.04.24.062 E019.46.11.568 Color_186ACI
N050.04.24.062 E019.46.11.568 N050.04.24.111 E019.46.11.498 Color_186ACI
N050.04.24.111 E019.46.11.498 N050.04.24.125 E019.46.11.418 Color_186ACI
N050.04.24.125 E019.46.11.418 N050.04.24.111 E019.46.11.337 Color_186ACI
N050.04.24.111 E019.46.11.337 N050.04.24.087 E019.46.11.292 Color_186ACI
N050.04.24.164 E019.46.10.464 N050.04.24.110 E019.46.10.428 Color_186ACI
N050.04.24.110 E019.46.10.428 N050.04.24.045 E019.46.10.448 Color_186ACI
N050.04.24.045 E019.46.10.448 N050.04.24.004 E019.46.10.512 Color_186ACI
N050.04.24.004 E019.46.10.512 N050.04.23.993 E019.46.10.617 Color_186ACI
N050.04.23.993 E019.46.10.617 N050.04.24.021 E019.46.10.704 Color_186ACI
N050.04.24.021 E019.46.10.704 N050.04.24.079 E019.46.10.752 Color_186ACI
N050.04.24.079 E019.46.10.752 N050.04.24.139 E019.46.10.740 Color_186ACI
N050.04.24.139 E019.46.10.740 N050.04.24.188 E019.46.10.671 Color_186ACI
N050.04.24.188 E019.46.10.671 N050.04.24.202 E019.46.10.591 Color_186ACI
N050.04.24.202 E019.46.10.591 N050.04.24.188 E019.46.10.509 Color_186ACI
N050.04.24.188 E019.46.10.509 N050.04.24.164 E019.46.10.464 Color_186ACI
N050.04.24.265 E019.46.09.866 N050.04.24.211 E019.46.09.830 Color_186ACI
N050.04.24.211 E019.46.09.830 N050.04.24.146 E019.46.09.850 Color_186ACI
N050.04.24.146 E019.46.09.850 N050.04.24.106 E019.46.09.914 Color_186ACI
N050.04.24.106 E019.46.09.914 N050.04.24.094 E019.46.10.019 Color_186ACI
N050.04.24.094 E019.46.10.019 N050.04.24.122 E019.46.10.106 Color_186ACI
N050.04.24.122 E019.46.10.106 N050.04.24.180 E019.46.10.154 Color_186ACI
N050.04.24.180 E019.46.10.154 N050.04.24.241 E019.46.10.142 Color_186ACI
N050.04.24.241 E019.46.10.142 N050.04.24.290 E019.46.10.073 Color_186ACI
N050.04.24.290 E019.46.10.073 N050.04.24.303 E019.46.09.993 Color_186ACI
N050.04.24.303 E019.46.09.993 N050.04.24.290 E019.46.09.911 Color_186ACI
N050.04.24.290 E019.46.09.911 N050.04.24.265 E019.46.09.866 Color_186ACI
N050.04.24.580 E019.46.09.430 N050.04.24.526 E019.46.09.393 Color_186ACI
N050.04.24.526 E019.46.09.393 N050.04.24.461 E019.46.09.413 Color_186ACI
N050.04.24.461 E019.46.09.413 N050.04.24.421 E019.46.09.477 Color_186ACI
N050.04.24.421 E019.46.09.477 N050.04.24.409 E019.46.09.582 Color_186ACI
N050.04.24.409 E019.46.09.582 N050.04.24.437 E019.46.09.669 Color_186ACI
N050.04.24.437 E019.46.09.669 N050.04.24.495 E019.46.09.718 Color_186ACI
N050.04.24.495 E019.46.09.718 N050.04.24.556 E019.46.09.706 Color_186ACI
N050.04.24.556 E019.46.09.706 N050.04.24.605 E019.46.09.636 Color_186ACI
N050.04.24.605 E019.46.09.636 N050.04.24.618 E019.46.09.556 Color_186ACI
N050.04.24.618 E019.46.09.556 N050.04.24.604 E019.46.09.475 Color_186ACI
N050.04.24.604 E019.46.09.475 N050.04.24.580 E019.46.09.430 Color_186ACI
N050.04.24.849 E019.46.09.089 N050.04.24.795 E019.46.09.053 Color_186ACI
N050.04.24.795 E019.46.09.053 N050.04.24.730 E019.46.09.073 Color_186ACI
N050.04.24.730 E019.46.09.073 N050.04.24.690 E019.46.09.137 Color_186ACI
N050.04.24.690 E019.46.09.137 N050.04.24.679 E019.46.09.242 Color_186ACI
N050.04.24.679 E019.46.09.242 N050.04.24.706 E019.46.09.329 Color_186ACI
N050.04.24.706 E019.46.09.329 N050.04.24.764 E019.46.09.377 Color_186ACI
N050.04.24.764 E019.46.09.377 N050.04.24.825 E019.46.09.366 Color_186ACI
N050.04.24.825 E019.46.09.366 N050.04.24.874 E019.46.09.296 Color_186ACI
N050.04.24.874 E019.46.09.296 N050.04.24.888 E019.46.09.216 Color_186ACI
N050.04.24.888 E019.46.09.216 N050.04.24.874 E019.46.09.134 Color_186ACI
N050.04.24.874 E019.46.09.134 N050.04.24.849 E019.46.09.089 Color_186ACI
N050.04.26.439 E019.46.08.505 N050.04.26.385 E019.46.08.469 Color_186ACI
N050.04.26.385 E019.46.08.469 N050.04.26.320 E019.46.08.489 Color_186ACI
N050.04.26.320 E019.46.08.489 N050.04.26.280 E019.46.08.553 Color_186ACI
N050.04.26.280 E019.46.08.553 N050.04.26.268 E019.46.08.658 Color_186ACI
N050.04.26.268 E019.46.08.658 N050.04.26.296 E019.46.08.745 Color_186ACI
N050.04.26.296 E019.46.08.745 N050.04.26.354 E019.46.08.793 Color_186ACI
N050.04.26.354 E019.46.08.793 N050.04.26.415 E019.46.08.781 Color_186ACI
N050.04.26.415 E019.46.08.781 N050.04.26.464 E019.46.08.712 Color_186ACI
N050.04.26.464 E019.46.08.712 N050.04.26.477 E019.46.08.632 Color_186ACI
N050.04.26.477 E019.46.08.632 N050.04.26.463 E019.46.08.550 Color_186ACI
N050.04.26.463 E019.46.08.550 N050.04.26.439 E019.46.08.505 Color_186ACI
N050.04.28.017 E019.46.07.983 N050.04.27.963 E019.46.07.947 Color_186ACI
N050.04.27.963 E019.46.07.947 N050.04.27.898 E019.46.07.967 Color_186ACI
N050.04.27.898 E019.46.07.967 N050.04.27.858 E019.46.08.031 Color_186ACI
N050.04.27.858 E019.46.08.031 N050.04.27.846 E019.46.08.136 Color_186ACI
N050.04.27.846 E019.46.08.136 N050.04.27.874 E019.46.08.223 Color_186ACI
N050.04.27.874 E019.46.08.223 N050.04.27.932 E019.46.08.271 Color_186ACI
N050.04.27.932 E019.46.08.271 N050.04.27.993 E019.46.08.260 Color_186ACI
N050.04.27.993 E019.46.08.260 N050.04.28.042 E019.46.08.190 Color_186ACI
N050.04.28.042 E019.46.08.190 N050.04.28.055 E019.46.08.110 Color_186ACI
N050.04.28.055 E019.46.08.110 N050.04.28.041 E019.46.08.028 Color_186ACI
N050.04.28.041 E019.46.08.028 N050.04.28.017 E019.46.07.983 Color_186ACI
N050.04.30.112 E019.46.07.569 N050.04.30.058 E019.46.07.532 Color_186ACI
N050.04.30.058 E019.46.07.532 N050.04.29.993 E019.46.07.552 Color_186ACI
N050.04.29.993 E019.46.07.552 N050.04.29.953 E019.46.07.616 Color_186ACI
N050.04.29.953 E019.46.07.616 N050.04.29.941 E019.46.07.721 Color_186ACI
N050.04.29.941 E019.46.07.721 N050.04.29.969 E019.46.07.808 Color_186ACI
N050.04.29.969 E019.46.07.808 N050.04.30.027 E019.46.07.857 Color_186ACI
N050.04.30.027 E019.46.07.857 N050.04.30.088 E019.46.07.845 Color_186ACI
N050.04.30.088 E019.46.07.845 N050.04.30.137 E019.46.07.775 Color_186ACI
N050.04.30.137 E019.46.07.775 N050.04.30.150 E019.46.07.695 Color_186ACI
N050.04.30.150 E019.46.07.695 N050.04.30.136 E019.46.07.614 Color_186ACI
N050.04.30.136 E019.46.07.614 N050.04.30.112 E019.46.07.569 Color_186ACI
N050.04.30.724 E019.46.07.730 N050.04.30.670 E019.46.07.694 Color_186ACI
N050.04.30.670 E019.46.07.694 N050.04.30.605 E019.46.07.714 Color_186ACI
N050.04.30.605 E019.46.07.714 N050.04.30.564 E019.46.07.778 Color_186ACI
N050.04.30.564 E019.46.07.778 N050.04.30.553 E019.46.07.883 Color_186ACI
N050.04.30.553 E019.46.07.883 N050.04.30.581 E019.46.07.970 Color_186ACI
N050.04.30.581 E019.46.07.970 N050.04.30.639 E019.46.08.018 Color_186ACI
N050.04.30.639 E019.46.08.018 N050.04.30.699 E019.46.08.007 Color_186ACI
N050.04.30.699 E019.46.08.007 N050.04.30.748 E019.46.07.937 Color_186ACI
N050.04.30.748 E019.46.07.937 N050.04.30.762 E019.46.07.857 Color_186ACI
N050.04.30.762 E019.46.07.857 N050.04.30.748 E019.46.07.775 Color_186ACI
N050.04.30.748 E019.46.07.775 N050.04.30.724 E019.46.07.730 Color_186ACI
N050.04.31.027 E019.46.08.404 N050.04.30.973 E019.46.08.368 Color_186ACI
N050.04.30.973 E019.46.08.368 N050.04.30.908 E019.46.08.388 Color_186ACI
N050.04.30.908 E019.46.08.388 N050.04.30.867 E019.46.08.452 Color_186ACI
N050.04.30.867 E019.46.08.452 N050.04.30.856 E019.46.08.557 Color_186ACI
N050.04.30.856 E019.46.08.557 N050.04.30.884 E019.46.08.644 Color_186ACI
N050.04.30.884 E019.46.08.644 N050.04.30.942 E019.46.08.692 Color_186ACI
N050.04.30.942 E019.46.08.692 N050.04.31.002 E019.46.08.680 Color_186ACI
N050.04.31.002 E019.46.08.680 N050.04.31.051 E019.46.08.611 Color_186ACI
N050.04.31.051 E019.46.08.611 N050.04.31.065 E019.46.08.531 Color_186ACI
N050.04.31.065 E019.46.08.531 N050.04.31.051 E019.46.08.449 Color_186ACI
N050.04.31.051 E019.46.08.449 N050.04.31.027 E019.46.08.404 Color_186ACI
N050.04.29.553 E019.46.07.469 N050.04.29.499 E019.46.07.432 Color_186ACI
N050.04.29.499 E019.46.07.432 N050.04.29.434 E019.46.07.452 Color_186ACI
N050.04.29.434 E019.46.07.452 N050.04.29.393 E019.46.07.516 Color_186ACI
N050.04.29.393 E019.46.07.516 N050.04.29.382 E019.46.07.621 Color_186ACI
N050.04.29.382 E019.46.07.621 N050.04.29.410 E019.46.07.708 Color_186ACI
N050.04.29.410 E019.46.07.708 N050.04.29.468 E019.46.07.757 Color_186ACI
N050.04.29.468 E019.46.07.757 N050.04.29.528 E019.46.07.745 Color_186ACI
N050.04.29.528 E019.46.07.745 N050.04.29.577 E019.46.07.676 Color_186ACI
N050.04.29.577 E019.46.07.676 N050.04.29.591 E019.46.07.595 Color_186ACI
N050.04.29.591 E019.46.07.595 N050.04.29.577 E019.46.07.514 Color_186ACI
N050.04.29.577 E019.46.07.514 N050.04.29.553 E019.46.07.469 Color_186ACI
N050.04.30.518 E019.46.05.483 N050.04.30.464 E019.46.05.447 Color_186ACI
N050.04.30.464 E019.46.05.447 N050.04.30.399 E019.46.05.467 Color_186ACI
N050.04.30.399 E019.46.05.467 N050.04.30.359 E019.46.05.530 Color_186ACI
N050.04.30.359 E019.46.05.530 N050.04.30.347 E019.46.05.635 Color_186ACI
N050.04.30.347 E019.46.05.635 N050.04.30.375 E019.46.05.723 Color_186ACI
N050.04.30.375 E019.46.05.723 N050.04.30.433 E019.46.05.771 Color_186ACI
N050.04.30.433 E019.46.05.771 N050.04.30.494 E019.46.05.759 Color_186ACI
N050.04.30.494 E019.46.05.759 N050.04.30.543 E019.46.05.690 Color_186ACI
N050.04.30.543 E019.46.05.690 N050.04.30.556 E019.46.05.610 Color_186ACI
N050.04.30.556 E019.46.05.610 N050.04.30.543 E019.46.05.528 Color_186ACI
N050.04.30.543 E019.46.05.528 N050.04.30.518 E019.46.05.483 Color_186ACI
N050.04.29.311 E019.46.05.930 N050.04.29.257 E019.46.05.893 Color_186ACI
N050.04.29.257 E019.46.05.893 N050.04.29.193 E019.46.05.914 Color_186ACI
N050.04.29.193 E019.46.05.914 N050.04.29.152 E019.46.05.977 Color_186ACI
N050.04.29.152 E019.46.05.977 N050.04.29.141 E019.46.06.082 Color_186ACI
N050.04.29.141 E019.46.06.082 N050.04.29.168 E019.46.06.169 Color_186ACI
N050.04.29.168 E019.46.06.169 N050.04.29.226 E019.46.06.218 Color_186ACI
N050.04.29.226 E019.46.06.218 N050.04.29.287 E019.46.06.206 Color_186ACI
N050.04.29.287 E019.46.06.206 N050.04.29.336 E019.46.06.137 Color_186ACI
N050.04.29.336 E019.46.06.137 N050.04.29.350 E019.46.06.056 Color_186ACI
N050.04.29.350 E019.46.06.056 N050.04.29.336 E019.46.05.975 Color_186ACI
N050.04.29.336 E019.46.05.975 N050.04.29.311 E019.46.05.930 Color_186ACI
N050.04.27.806 E019.46.06.445 N050.04.27.752 E019.46.06.409 Color_186ACI
N050.04.27.752 E019.46.06.409 N050.04.27.687 E019.46.06.429 Color_186ACI
N050.04.27.687 E019.46.06.429 N050.04.27.647 E019.46.06.493 Color_186ACI
N050.04.27.647 E019.46.06.493 N050.04.27.635 E019.46.06.598 Color_186ACI
N050.04.27.635 E019.46.06.598 N050.04.27.663 E019.46.06.685 Color_186ACI
N050.04.27.663 E019.46.06.685 N050.04.27.721 E019.46.06.733 Color_186ACI
N050.04.27.721 E019.46.06.733 N050.04.27.782 E019.46.06.721 Color_186ACI
N050.04.27.782 E019.46.06.721 N050.04.27.831 E019.46.06.652 Color_186ACI
N050.04.27.831 E019.46.06.652 N050.04.27.845 E019.46.06.572 Color_186ACI
N050.04.27.845 E019.46.06.572 N050.04.27.831 E019.46.06.490 Color_186ACI
N050.04.27.831 E019.46.06.490 N050.04.27.806 E019.46.06.445 Color_186ACI
N050.04.26.243 E019.46.07.009 N050.04.26.188 E019.46.06.973 Color_186ACI
N050.04.26.188 E019.46.06.973 N050.04.26.124 E019.46.06.993 Color_186ACI
N050.04.26.124 E019.46.06.993 N050.04.26.083 E019.46.07.057 Color_186ACI
N050.04.26.083 E019.46.07.057 N050.04.26.072 E019.46.07.161 Color_186ACI
N050.04.26.072 E019.46.07.161 N050.04.26.100 E019.46.07.249 Color_186ACI
N050.04.26.100 E019.46.07.249 N050.04.26.158 E019.46.07.297 Color_186ACI
N050.04.26.158 E019.46.07.297 N050.04.26.218 E019.46.07.285 Color_186ACI
N050.04.26.218 E019.46.07.285 N050.04.26.267 E019.46.07.216 Color_186ACI
N050.04.26.267 E019.46.07.216 N050.04.26.281 E019.46.07.136 Color_186ACI
N050.04.26.281 E019.46.07.136 N050.04.26.267 E019.46.07.054 Color_186ACI
N050.04.26.267 E019.46.07.054 N050.04.26.243 E019.46.07.009 Color_186ACI
N050.04.24.661 E019.46.07.530 N050.04.24.607 E019.46.07.494 Color_186ACI
N050.04.24.607 E019.46.07.494 N050.04.24.542 E019.46.07.514 Color_186ACI
N050.04.24.542 E019.46.07.514 N050.04.24.502 E019.46.07.578 Color_186ACI
N050.04.24.502 E019.46.07.578 N050.04.24.490 E019.46.07.683 Color_186ACI
N050.04.24.490 E019.46.07.683 N050.04.24.518 E019.46.07.770 Color_186ACI
N050.04.24.518 E019.46.07.770 N050.04.24.576 E019.46.07.818 Color_186ACI
N050.04.24.576 E019.46.07.818 N050.04.24.636 E019.46.07.806 Color_186ACI
N050.04.24.636 E019.46.07.806 N050.04.24.686 E019.46.07.737 Color_186ACI
N050.04.24.686 E019.46.07.737 N050.04.24.699 E019.46.07.657 Color_186ACI
N050.04.24.699 E019.46.07.657 N050.04.24.685 E019.46.07.575 Color_186ACI
N050.04.24.685 E019.46.07.575 N050.04.24.661 E019.46.07.530 Color_186ACI
N050.04.23.710 E019.46.07.879 N050.04.23.656 E019.46.07.843 Color_186ACI
N050.04.23.656 E019.46.07.843 N050.04.23.591 E019.46.07.863 Color_186ACI
N050.04.23.591 E019.46.07.863 N050.04.23.551 E019.46.07.927 Color_186ACI
N050.04.23.551 E019.46.07.927 N050.04.23.539 E019.46.08.032 Color_186ACI
N050.04.23.539 E019.46.08.032 N050.04.23.567 E019.46.08.119 Color_186ACI
N050.04.23.567 E019.46.08.119 N050.04.23.625 E019.46.08.167 Color_186ACI
N050.04.23.625 E019.46.08.167 N050.04.23.686 E019.46.08.155 Color_186ACI
N050.04.23.686 E019.46.08.155 N050.04.23.735 E019.46.08.086 Color_186ACI
N050.04.23.735 E019.46.08.086 N050.04.23.748 E019.46.08.006 Color_186ACI
N050.04.23.748 E019.46.08.006 N050.04.23.735 E019.46.07.924 Color_186ACI
N050.04.23.735 E019.46.07.924 N050.04.23.710 E019.46.07.879 Color_186ACI
N050.04.22.662 E019.46.08.279 N050.04.22.608 E019.46.08.242 Color_186ACI
N050.04.22.608 E019.46.08.242 N050.04.22.543 E019.46.08.263 Color_186ACI
N050.04.22.543 E019.46.08.263 N050.04.22.503 E019.46.08.326 Color_186ACI
N050.04.22.503 E019.46.08.326 N050.04.22.491 E019.46.08.431 Color_186ACI
N050.04.22.491 E019.46.08.431 N050.04.22.519 E019.46.08.518 Color_186ACI
N050.04.22.519 E019.46.08.518 N050.04.22.577 E019.46.08.567 Color_186ACI
N050.04.22.577 E019.46.08.567 N050.04.22.638 E019.46.08.555 Color_186ACI
N050.04.22.638 E019.46.08.555 N050.04.22.687 E019.46.08.486 Color_186ACI
N050.04.22.687 E019.46.08.486 N050.04.22.700 E019.46.08.405 Color_186ACI
N050.04.22.700 E019.46.08.405 N050.04.22.686 E019.46.08.324 Color_186ACI
N050.04.22.686 E019.46.08.324 N050.04.22.662 E019.46.08.279 Color_186ACI
N050.04.22.902 E019.46.10.006 N050.04.22.848 E019.46.09.970 Color_186ACI
N050.04.22.848 E019.46.09.970 N050.04.22.783 E019.46.09.990 Color_186ACI
N050.04.22.783 E019.46.09.990 N050.04.22.742 E019.46.10.054 Color_186ACI
N050.04.22.742 E019.46.10.054 N050.04.22.731 E019.46.10.159 Color_186ACI
N050.04.22.731 E019.46.10.159 N050.04.22.759 E019.46.10.246 Color_186ACI
N050.04.22.759 E019.46.10.246 N050.04.22.817 E019.46.10.294 Color_186ACI
N050.04.22.817 E019.46.10.294 N050.04.22.877 E019.46.10.283 Color_186ACI
N050.04.22.877 E019.46.10.283 N050.04.22.926 E019.46.10.213 Color_186ACI
N050.04.22.926 E019.46.10.213 N050.04.22.940 E019.46.10.133 Color_186ACI
N050.04.22.940 E019.46.10.133 N050.04.22.926 E019.46.10.051 Color_186ACI
N050.04.22.926 E019.46.10.051 N050.04.22.902 E019.46.10.006 Color_186ACI
N050.04.23.102 E019.46.11.605 N050.04.23.048 E019.46.11.569 Color_186ACI
N050.04.23.048 E019.46.11.569 N050.04.22.983 E019.46.11.589 Color_186ACI
N050.04.22.983 E019.46.11.589 N050.04.22.943 E019.46.11.653 Color_186ACI
N050.04.22.943 E019.46.11.653 N050.04.22.931 E019.46.11.758 Color_186ACI
N050.04.22.931 E019.46.11.758 N050.04.22.959 E019.46.11.845 Color_186ACI
N050.04.22.959 E019.46.11.845 N050.04.23.017 E019.46.11.893 Color_186ACI
N050.04.23.017 E019.46.11.893 N050.04.23.078 E019.46.11.881 Color_186ACI
N050.04.23.078 E019.46.11.881 N050.04.23.127 E019.46.11.812 Color_186ACI
N050.04.23.127 E019.46.11.812 N050.04.23.140 E019.46.11.732 Color_186ACI
N050.04.23.140 E019.46.11.732 N050.04.23.126 E019.46.11.650 Color_186ACI
N050.04.23.126 E019.46.11.650 N050.04.23.102 E019.46.11.605 Color_186ACI
N050.04.23.388 E019.46.13.674 N050.04.23.334 E019.46.13.638 Color_186ACI
N050.04.23.334 E019.46.13.638 N050.04.23.269 E019.46.13.658 Color_186ACI
N050.04.23.269 E019.46.13.658 N050.04.23.229 E019.46.13.722 Color_186ACI
N050.04.23.229 E019.46.13.722 N050.04.23.217 E019.46.13.827 Color_186ACI
N050.04.23.217 E019.46.13.827 N050.04.23.245 E019.46.13.914 Color_186ACI
N050.04.23.245 E019.46.13.914 N050.04.23.303 E019.46.13.962 Color_186ACI
N050.04.23.303 E019.46.13.962 N050.04.23.364 E019.46.13.950 Color_186ACI
N050.04.23.364 E019.46.13.950 N050.04.23.413 E019.46.13.881 Color_186ACI
N050.04.23.413 E019.46.13.881 N050.04.23.426 E019.46.13.801 Color_186ACI
N050.04.23.426 E019.46.13.801 N050.04.23.413 E019.46.13.719 Color_186ACI
N050.04.23.413 E019.46.13.719 N050.04.23.388 E019.46.13.674 Color_186ACI
N050.04.23.696 E019.46.15.881 N050.04.23.642 E019.46.15.845 Color_186ACI
N050.04.23.642 E019.46.15.845 N050.04.23.577 E019.46.15.865 Color_186ACI
N050.04.23.577 E019.46.15.865 N050.04.23.537 E019.46.15.929 Color_186ACI
N050.04.23.537 E019.46.15.929 N050.04.23.525 E019.46.16.034 Color_186ACI
N050.04.23.525 E019.46.16.034 N050.04.23.553 E019.46.16.121 Color_186ACI
N050.04.23.553 E019.46.16.121 N050.04.23.611 E019.46.16.169 Color_186ACI
N050.04.23.611 E019.46.16.169 N050.04.23.672 E019.46.16.158 Color_186ACI
N050.04.23.672 E019.46.16.158 N050.04.23.721 E019.46.16.088 Color_186ACI
N050.04.23.721 E019.46.16.088 N050.04.23.734 E019.46.16.008 Color_186ACI
N050.04.23.734 E019.46.16.008 N050.04.23.720 E019.46.15.926 Color_186ACI
N050.04.23.720 E019.46.15.926 N050.04.23.696 E019.46.15.881 Color_186ACI
N050.04.24.018 E019.46.18.180 N050.04.23.963 E019.46.18.144 Color_186ACI
N050.04.23.963 E019.46.18.144 N050.04.23.899 E019.46.18.164 Color_186ACI
N050.04.23.899 E019.46.18.164 N050.04.23.858 E019.46.18.228 Color_186ACI
N050.04.23.858 E019.46.18.228 N050.04.23.847 E019.46.18.333 Color_186ACI
N050.04.23.847 E019.46.18.333 N050.04.23.875 E019.46.18.420 Color_186ACI
N050.04.23.875 E019.46.18.420 N050.04.23.933 E019.46.18.469 Color_186ACI
N050.04.23.933 E019.46.18.469 N050.04.23.993 E019.46.18.457 Color_186ACI
N050.04.23.993 E019.46.18.457 N050.04.24.042 E019.46.18.387 Color_186ACI
N050.04.24.042 E019.46.18.387 N050.04.24.056 E019.46.18.307 Color_186ACI
N050.04.24.056 E019.46.18.307 N050.04.24.042 E019.46.18.226 Color_186ACI
N050.04.24.042 E019.46.18.226 N050.04.24.018 E019.46.18.180 Color_186ACI
N050.04.24.289 E019.46.20.166 N050.04.24.235 E019.46.20.129 Color_186ACI
N050.04.24.235 E019.46.20.129 N050.04.24.170 E019.46.20.150 Color_186ACI
N050.04.24.170 E019.46.20.150 N050.04.24.129 E019.46.20.213 Color_186ACI
N050.04.24.129 E019.46.20.213 N050.04.24.118 E019.46.20.318 Color_186ACI
N050.04.24.118 E019.46.20.318 N050.04.24.146 E019.46.20.406 Color_186ACI
N050.04.24.146 E019.46.20.406 N050.04.24.204 E019.46.20.454 Color_186ACI
N050.04.24.204 E019.46.20.454 N050.04.24.264 E019.46.20.442 Color_186ACI
N050.04.24.264 E019.46.20.442 N050.04.24.313 E019.46.20.373 Color_186ACI
N050.04.24.313 E019.46.20.373 N050.04.24.327 E019.46.20.292 Color_186ACI
N050.04.24.327 E019.46.20.292 N050.04.24.313 E019.46.20.211 Color_186ACI
N050.04.24.313 E019.46.20.211 N050.04.24.289 E019.46.20.166 Color_186ACI
N050.04.24.730 E019.46.23.384 N050.04.24.676 E019.46.23.348 Color_186ACI
N050.04.24.676 E019.46.23.348 N050.04.24.611 E019.46.23.368 Color_186ACI
N050.04.24.611 E019.46.23.368 N050.04.24.570 E019.46.23.432 Color_186ACI
N050.04.24.570 E019.46.23.432 N050.04.24.559 E019.46.23.537 Color_186ACI
N050.04.24.559 E019.46.23.537 N050.04.24.587 E019.46.23.624 Color_186ACI
N050.04.24.587 E019.46.23.624 N050.04.24.645 E019.46.23.672 Color_186ACI
N050.04.24.645 E019.46.23.672 N050.04.24.705 E019.46.23.660 Color_186ACI
N050.04.24.705 E019.46.23.660 N050.04.24.754 E019.46.23.591 Color_186ACI
N050.04.24.754 E019.46.23.591 N050.04.24.768 E019.46.23.511 Color_186ACI
N050.04.24.768 E019.46.23.511 N050.04.24.754 E019.46.23.429 Color_186ACI
N050.04.24.754 E019.46.23.429 N050.04.24.730 E019.46.23.384 Color_186ACI
N050.04.25.089 E019.46.25.957 N050.04.25.035 E019.46.25.921 Color_186ACI
N050.04.25.035 E019.46.25.921 N050.04.24.970 E019.46.25.941 Color_186ACI
N050.04.24.970 E019.46.25.941 N050.04.24.930 E019.46.26.005 Color_186ACI
N050.04.24.930 E019.46.26.005 N050.04.24.918 E019.46.26.110 Color_186ACI
N050.04.24.918 E019.46.26.110 N050.04.24.946 E019.46.26.197 Color_186ACI
N050.04.24.946 E019.46.26.197 N050.04.25.004 E019.46.26.245 Color_186ACI
N050.04.25.004 E019.46.26.245 N050.04.25.065 E019.46.26.233 Color_186ACI
N050.04.25.065 E019.46.26.233 N050.04.25.114 E019.46.26.164 Color_186ACI
N050.04.25.114 E019.46.26.164 N050.04.25.128 E019.46.26.084 Color_186ACI
N050.04.25.128 E019.46.26.084 N050.04.25.114 E019.46.26.002 Color_186ACI
N050.04.25.114 E019.46.26.002 N050.04.25.089 E019.46.25.957 Color_186ACI
N050.04.25.451 E019.46.28.544 N050.04.25.397 E019.46.28.508 Color_186ACI
N050.04.25.397 E019.46.28.508 N050.04.25.332 E019.46.28.528 Color_186ACI
N050.04.25.332 E019.46.28.528 N050.04.25.291 E019.46.28.592 Color_186ACI
N050.04.25.291 E019.46.28.592 N050.04.25.280 E019.46.28.697 Color_186ACI
N050.04.25.280 E019.46.28.697 N050.04.25.308 E019.46.28.784 Color_186ACI
N050.04.25.308 E019.46.28.784 N050.04.25.366 E019.46.28.832 Color_186ACI
N050.04.25.366 E019.46.28.832 N050.04.25.426 E019.46.28.821 Color_186ACI
N050.04.25.426 E019.46.28.821 N050.04.25.475 E019.46.28.751 Color_186ACI
N050.04.25.475 E019.46.28.751 N050.04.25.489 E019.46.28.671 Color_186ACI
N050.04.25.489 E019.46.28.671 N050.04.25.475 E019.46.28.589 Color_186ACI
N050.04.25.475 E019.46.28.589 N050.04.25.451 E019.46.28.544 Color_186ACI
N050.04.25.855 E019.46.31.544 N050.04.25.801 E019.46.31.508 Color_186ACI
N050.04.25.801 E019.46.31.508 N050.04.25.736 E019.46.31.528 Color_186ACI
N050.04.25.736 E019.46.31.528 N050.04.25.696 E019.46.31.592 Color_186ACI
N050.04.25.696 E019.46.31.592 N050.04.25.684 E019.46.31.697 Color_186ACI
N050.04.25.684 E019.46.31.697 N050.04.25.712 E019.46.31.784 Color_186ACI
N050.04.25.712 E019.46.31.784 N050.04.25.770 E019.46.31.832 Color_186ACI
N050.04.25.770 E019.46.31.832 N050.04.25.831 E019.46.31.820 Color_186ACI
N050.04.25.831 E019.46.31.820 N050.04.25.880 E019.46.31.751 Color_186ACI
N050.04.25.880 E019.46.31.751 N050.04.25.894 E019.46.31.671 Color_186ACI
N050.04.25.894 E019.46.31.671 N050.04.25.880 E019.46.31.589 Color_186ACI
N050.04.25.880 E019.46.31.589 N050.04.25.855 E019.46.31.544 Color_186ACI
N050.04.26.255 E019.46.34.505 N050.04.26.201 E019.46.34.469 Color_186ACI
N050.04.26.201 E019.46.34.469 N050.04.26.136 E019.46.34.489 Color_186ACI
N050.04.26.136 E019.46.34.489 N050.04.26.096 E019.46.34.553 Color_186ACI
N050.04.26.096 E019.46.34.553 N050.04.26.084 E019.46.34.658 Color_186ACI
N050.04.26.084 E019.46.34.658 N050.04.26.112 E019.46.34.745 Color_186ACI
N050.04.26.112 E019.46.34.745 N050.04.26.170 E019.46.34.793 Color_186ACI
N050.04.26.170 E019.46.34.793 N050.04.26.231 E019.46.34.781 Color_186ACI
N050.04.26.231 E019.46.34.781 N050.04.26.280 E019.46.34.712 Color_186ACI
N050.04.26.280 E019.46.34.712 N050.04.26.293 E019.46.34.632 Color_186ACI
N050.04.26.293 E019.46.34.632 N050.04.26.280 E019.46.34.550 Color_186ACI
N050.04.26.280 E019.46.34.550 N050.04.26.255 E019.46.34.505 Color_186ACI
N050.04.26.681 E019.46.37.506 N050.04.26.627 E019.46.37.470 Color_186ACI
N050.04.26.627 E019.46.37.470 N050.04.26.562 E019.46.37.490 Color_186ACI
N050.04.26.562 E019.46.37.490 N050.04.26.522 E019.46.37.554 Color_186ACI
N050.04.26.522 E019.46.37.554 N050.04.26.511 E019.46.37.659 Color_186ACI
N050.04.26.511 E019.46.37.659 N050.04.26.538 E019.46.37.746 Color_186ACI
N050.04.26.538 E019.46.37.746 N050.04.26.596 E019.46.37.794 Color_186ACI
N050.04.26.596 E019.46.37.794 N050.04.26.657 E019.46.37.783 Color_186ACI
N050.04.26.657 E019.46.37.783 N050.04.26.706 E019.46.37.713 Color_186ACI
N050.04.26.706 E019.46.37.713 N050.04.26.720 E019.46.37.633 Color_186ACI
N050.04.26.720 E019.46.37.633 N050.04.26.706 E019.46.37.551 Color_186ACI
N050.04.26.706 E019.46.37.551 N050.04.26.681 E019.46.37.506 Color_186ACI
N050.04.27.075 E019.46.40.476 N050.04.27.021 E019.46.40.439 Color_186ACI
N050.04.27.021 E019.46.40.439 N050.04.26.956 E019.46.40.460 Color_186ACI
N050.04.26.956 E019.46.40.460 N050.04.26.916 E019.46.40.523 Color_186ACI
N050.04.26.916 E019.46.40.523 N050.04.26.904 E019.46.40.628 Color_186ACI
N050.04.26.904 E019.46.40.628 N050.04.26.932 E019.46.40.716 Color_186ACI
N050.04.26.932 E019.46.40.716 N050.04.26.990 E019.46.40.764 Color_186ACI
N050.04.26.990 E019.46.40.764 N050.04.27.051 E019.46.40.752 Color_186ACI
N050.04.27.051 E019.46.40.752 N050.04.27.100 E019.46.40.683 Color_186ACI
N050.04.27.100 E019.46.40.683 N050.04.27.114 E019.46.40.603 Color_186ACI
N050.04.27.114 E019.46.40.603 N050.04.27.100 E019.46.40.521 Color_186ACI
N050.04.27.100 E019.46.40.521 N050.04.27.075 E019.46.40.476 Color_186ACI
N050.04.27.489 E019.46.43.474 N050.04.27.435 E019.46.43.437 Color_186ACI
N050.04.27.435 E019.46.43.437 N050.04.27.370 E019.46.43.457 Color_186ACI
N050.04.27.370 E019.46.43.457 N050.04.27.330 E019.46.43.521 Color_186ACI
N050.04.27.330 E019.46.43.521 N050.04.27.318 E019.46.43.626 Color_186ACI
N050.04.27.318 E019.46.43.626 N050.04.27.346 E019.46.43.713 Color_186ACI
N050.04.27.346 E019.46.43.713 N050.04.27.404 E019.46.43.762 Color_186ACI
N050.04.27.404 E019.46.43.762 N050.04.27.465 E019.46.43.750 Color_186ACI
N050.04.27.465 E019.46.43.750 N050.04.27.514 E019.46.43.680 Color_186ACI
N050.04.27.514 E019.46.43.680 N050.04.27.528 E019.46.43.600 Color_186ACI
N050.04.27.528 E019.46.43.600 N050.04.27.514 E019.46.43.519 Color_186ACI
N050.04.27.514 E019.46.43.519 N050.04.27.489 E019.46.43.474 Color_186ACI
N050.04.27.894 E019.46.46.455 N050.04.27.840 E019.46.46.419 Color_186ACI
N050.04.27.840 E019.46.46.419 N050.04.27.775 E019.46.46.439 Color_186ACI
N050.04.27.775 E019.46.46.439 N050.04.27.735 E019.46.46.503 Color_186ACI
N050.04.27.735 E019.46.46.503 N050.04.27.723 E019.46.46.608 Color_186ACI
N050.04.27.723 E019.46.46.608 N050.04.27.751 E019.46.46.695 Color_186ACI
N050.04.27.751 E019.46.46.695 N050.04.27.809 E019.46.46.743 Color_186ACI
N050.04.27.809 E019.46.46.743 N050.04.27.870 E019.46.46.731 Color_186ACI
N050.04.27.870 E019.46.46.731 N050.04.27.919 E019.46.46.662 Color_186ACI
N050.04.27.919 E019.46.46.662 N050.04.27.932 E019.46.46.582 Color_186ACI
N050.04.27.932 E019.46.46.582 N050.04.27.918 E019.46.46.500 Color_186ACI
N050.04.27.918 E019.46.46.500 N050.04.27.894 E019.46.46.455 Color_186ACI
N050.04.28.273 E019.46.49.203 N050.04.28.219 E019.46.49.167 Color_186ACI
N050.04.28.219 E019.46.49.167 N050.04.28.154 E019.46.49.187 Color_186ACI
N050.04.28.154 E019.46.49.187 N050.04.28.114 E019.46.49.251 Color_186ACI
N050.04.28.114 E019.46.49.251 N050.04.28.102 E019.46.49.356 Color_186ACI
N050.04.28.102 E019.46.49.356 N050.04.28.130 E019.46.49.443 Color_186ACI
N050.04.28.130 E019.46.49.443 N050.04.28.188 E019.46.49.491 Color_186ACI
N050.04.28.188 E019.46.49.491 N050.04.28.249 E019.46.49.480 Color_186ACI
N050.04.28.249 E019.46.49.480 N050.04.28.298 E019.46.49.410 Color_186ACI
N050.04.28.298 E019.46.49.410 N050.04.28.311 E019.46.49.330 Color_186ACI
N050.04.28.311 E019.46.49.330 N050.04.28.297 E019.46.49.249 Color_186ACI
N050.04.28.297 E019.46.49.249 N050.04.28.273 E019.46.49.203 Color_186ACI
N050.04.29.067 E019.46.55.096 N050.04.29.013 E019.46.55.060 Color_186ACI
N050.04.29.013 E019.46.55.060 N050.04.28.948 E019.46.55.080 Color_186ACI
N050.04.28.948 E019.46.55.080 N050.04.28.908 E019.46.55.144 Color_186ACI
N050.04.28.908 E019.46.55.144 N050.04.28.896 E019.46.55.249 Color_186ACI
N050.04.28.896 E019.46.55.249 N050.04.28.924 E019.46.55.336 Color_186ACI
N050.04.28.924 E019.46.55.336 N050.04.28.982 E019.46.55.384 Color_186ACI
N050.04.28.982 E019.46.55.384 N050.04.29.043 E019.46.55.372 Color_186ACI
N050.04.29.043 E019.46.55.372 N050.04.29.092 E019.46.55.303 Color_186ACI
N050.04.29.092 E019.46.55.303 N050.04.29.105 E019.46.55.223 Color_186ACI
N050.04.29.105 E019.46.55.223 N050.04.29.091 E019.46.55.141 Color_186ACI
N050.04.29.091 E019.46.55.141 N050.04.29.067 E019.46.55.096 Color_186ACI
N050.04.29.357 E019.46.57.201 N050.04.29.303 E019.46.57.165 Color_186ACI
N050.04.29.303 E019.46.57.165 N050.04.29.239 E019.46.57.185 Color_186ACI
N050.04.29.239 E019.46.57.185 N050.04.29.198 E019.46.57.249 Color_186ACI
N050.04.29.198 E019.46.57.249 N050.04.29.187 E019.46.57.354 Color_186ACI
N050.04.29.187 E019.46.57.354 N050.04.29.214 E019.46.57.441 Color_186ACI
N050.04.29.214 E019.46.57.441 N050.04.29.272 E019.46.57.489 Color_186ACI
N050.04.29.272 E019.46.57.489 N050.04.29.333 E019.46.57.478 Color_186ACI
N050.04.29.333 E019.46.57.478 N050.04.29.382 E019.46.57.408 Color_186ACI
N050.04.29.382 E019.46.57.408 N050.04.29.396 E019.46.57.328 Color_186ACI
N050.04.29.396 E019.46.57.328 N050.04.29.382 E019.46.57.246 Color_186ACI
N050.04.29.382 E019.46.57.246 N050.04.29.357 E019.46.57.201 Color_186ACI
N050.04.29.662 E019.46.59.265 N050.04.29.608 E019.46.59.229 Color_186ACI
N050.04.29.608 E019.46.59.229 N050.04.29.543 E019.46.59.249 Color_186ACI
N050.04.29.543 E019.46.59.249 N050.04.29.503 E019.46.59.313 Color_186ACI
N050.04.29.503 E019.46.59.313 N050.04.29.491 E019.46.59.418 Color_186ACI
N050.04.29.491 E019.46.59.418 N050.04.29.519 E019.46.59.505 Color_186ACI
N050.04.29.519 E019.46.59.505 N050.04.29.577 E019.46.59.553 Color_186ACI
N050.04.29.577 E019.46.59.553 N050.04.29.638 E019.46.59.541 Color_186ACI
N050.04.29.638 E019.46.59.541 N050.04.29.687 E019.46.59.472 Color_186ACI
N050.04.29.687 E019.46.59.472 N050.04.29.700 E019.46.59.392 Color_186ACI
N050.04.29.700 E019.46.59.392 N050.04.29.687 E019.46.59.310 Color_186ACI
N050.04.29.687 E019.46.59.310 N050.04.29.662 E019.46.59.265 Color_186ACI
N050.04.30.049 E019.47.02.215 N050.04.29.995 E019.47.02.178 Color_186ACI
N050.04.29.995 E019.47.02.178 N050.04.29.930 E019.47.02.199 Color_186ACI
N050.04.29.930 E019.47.02.199 N050.04.29.890 E019.47.02.262 Color_186ACI
N050.04.29.890 E019.47.02.262 N050.04.29.878 E019.47.02.367 Color_186ACI
N050.04.29.878 E019.47.02.367 N050.04.29.906 E019.47.02.454 Color_186ACI
N050.04.29.906 E019.47.02.454 N050.04.29.964 E019.47.02.503 Color_186ACI
N050.04.29.964 E019.47.02.503 N050.04.30.025 E019.47.02.491 Color_186ACI
N050.04.30.025 E019.47.02.491 N050.04.30.074 E019.47.02.422 Color_186ACI
N050.04.30.074 E019.47.02.422 N050.04.30.087 E019.47.02.341 Color_186ACI
N050.04.30.087 E019.47.02.341 N050.04.30.073 E019.47.02.260 Color_186ACI
N050.04.30.073 E019.47.02.260 N050.04.30.049 E019.47.02.215 Color_186ACI
N050.04.30.448 E019.47.05.205 N050.04.30.394 E019.47.05.169 Color_186ACI
N050.04.30.394 E019.47.05.169 N050.04.30.329 E019.47.05.189 Color_186ACI
N050.04.30.329 E019.47.05.189 N050.04.30.288 E019.47.05.253 Color_186ACI
N050.04.30.288 E019.47.05.253 N050.04.30.277 E019.47.05.358 Color_186ACI
N050.04.30.277 E019.47.05.358 N050.04.30.305 E019.47.05.445 Color_186ACI
N050.04.30.305 E019.47.05.445 N050.04.30.363 E019.47.05.493 Color_186ACI
N050.04.30.363 E019.47.05.493 N050.04.30.423 E019.47.05.482 Color_186ACI
N050.04.30.423 E019.47.05.482 N050.04.30.472 E019.47.05.412 Color_186ACI
N050.04.30.472 E019.47.05.412 N050.04.30.486 E019.47.05.332 Color_186ACI
N050.04.30.486 E019.47.05.332 N050.04.30.472 E019.47.05.250 Color_186ACI
N050.04.30.472 E019.47.05.250 N050.04.30.448 E019.47.05.205 Color_186ACI
N050.04.30.857 E019.47.08.189 N050.04.30.803 E019.47.08.153 Color_186ACI
N050.04.30.803 E019.47.08.153 N050.04.30.739 E019.47.08.173 Color_186ACI
N050.04.30.739 E019.47.08.173 N050.04.30.698 E019.47.08.237 Color_186ACI
N050.04.30.698 E019.47.08.237 N050.04.30.687 E019.47.08.342 Color_186ACI
N050.04.30.687 E019.47.08.342 N050.04.30.714 E019.47.08.429 Color_186ACI
N050.04.30.714 E019.47.08.429 N050.04.30.772 E019.47.08.477 Color_186ACI
N050.04.30.772 E019.47.08.477 N050.04.30.833 E019.47.08.465 Color_186ACI
N050.04.30.833 E019.47.08.465 N050.04.30.882 E019.47.08.396 Color_186ACI
N050.04.30.882 E019.47.08.396 N050.04.30.896 E019.47.08.316 Color_186ACI
N050.04.30.896 E019.47.08.316 N050.04.30.882 E019.47.08.234 Color_186ACI
N050.04.30.882 E019.47.08.234 N050.04.30.857 E019.47.08.189 Color_186ACI
N050.04.31.289 E019.47.11.211 N050.04.31.234 E019.47.11.174 Color_186ACI
N050.04.31.234 E019.47.11.174 N050.04.31.170 E019.47.11.195 Color_186ACI
N050.04.31.170 E019.47.11.195 N050.04.31.129 E019.47.11.258 Color_186ACI
N050.04.31.129 E019.47.11.258 N050.04.31.118 E019.47.11.363 Color_186ACI
N050.04.31.118 E019.47.11.363 N050.04.31.146 E019.47.11.450 Color_186ACI
N050.04.31.146 E019.47.11.450 N050.04.31.204 E019.47.11.499 Color_186ACI
N050.04.31.204 E019.47.11.499 N050.04.31.264 E019.47.11.487 Color_186ACI
N050.04.31.264 E019.47.11.487 N050.04.31.313 E019.47.11.418 Color_186ACI
N050.04.31.313 E019.47.11.418 N050.04.31.327 E019.47.11.337 Color_186ACI
N050.04.31.327 E019.47.11.337 N050.04.31.313 E019.47.11.256 Color_186ACI
N050.04.31.313 E019.47.11.256 N050.04.31.289 E019.47.11.211 Color_186ACI
N050.04.31.692 E019.47.14.178 N050.04.31.638 E019.47.14.142 Color_186ACI
N050.04.31.638 E019.47.14.142 N050.04.31.573 E019.47.14.162 Color_186ACI
N050.04.31.573 E019.47.14.162 N050.04.31.532 E019.47.14.226 Color_186ACI
N050.04.31.532 E019.47.14.226 N050.04.31.521 E019.47.14.331 Color_186ACI
N050.04.31.521 E019.47.14.331 N050.04.31.549 E019.47.14.418 Color_186ACI
N050.04.31.549 E019.47.14.418 N050.04.31.607 E019.47.14.466 Color_186ACI
N050.04.31.607 E019.47.14.466 N050.04.31.667 E019.47.14.454 Color_186ACI
N050.04.31.667 E019.47.14.454 N050.04.31.716 E019.47.14.385 Color_186ACI
N050.04.31.716 E019.47.14.385 N050.04.31.730 E019.47.14.305 Color_186ACI
N050.04.31.730 E019.47.14.305 N050.04.31.716 E019.47.14.223 Color_186ACI
N050.04.31.716 E019.47.14.223 N050.04.31.692 E019.47.14.178 Color_186ACI
N050.04.32.060 E019.47.16.881 N050.04.32.006 E019.47.16.845 Color_186ACI
N050.04.32.006 E019.47.16.845 N050.04.31.941 E019.47.16.865 Color_186ACI
N050.04.31.941 E019.47.16.865 N050.04.31.901 E019.47.16.929 Color_186ACI
N050.04.31.901 E019.47.16.929 N050.04.31.889 E019.47.17.034 Color_186ACI
N050.04.31.889 E019.47.17.034 N050.04.31.917 E019.47.17.121 Color_186ACI
N050.04.31.917 E019.47.17.121 N050.04.31.975 E019.47.17.169 Color_186ACI
N050.04.31.975 E019.47.17.169 N050.04.32.036 E019.47.17.158 Color_186ACI
N050.04.32.036 E019.47.17.158 N050.04.32.085 E019.47.17.088 Color_186ACI
N050.04.32.085 E019.47.17.088 N050.04.32.098 E019.47.17.008 Color_186ACI
N050.04.32.098 E019.47.17.008 N050.04.32.084 E019.47.16.926 Color_186ACI
N050.04.32.084 E019.47.16.926 N050.04.32.060 E019.47.16.881 Color_186ACI
N050.04.32.476 E019.47.19.856 N050.04.32.422 E019.47.19.820 Color_186ACI
N050.04.32.422 E019.47.19.820 N050.04.32.357 E019.47.19.840 Color_186ACI
N050.04.32.357 E019.47.19.840 N050.04.32.317 E019.47.19.904 Color_186ACI
N050.04.32.317 E019.47.19.904 N050.04.32.305 E019.47.20.009 Color_186ACI
N050.04.32.305 E019.47.20.009 N050.04.32.333 E019.47.20.096 Color_186ACI
N050.04.32.333 E019.47.20.096 N050.04.32.391 E019.47.20.144 Color_186ACI
N050.04.32.391 E019.47.20.144 N050.04.32.452 E019.47.20.132 Color_186ACI
N050.04.32.452 E019.47.20.132 N050.04.32.501 E019.47.20.063 Color_186ACI
N050.04.32.501 E019.47.20.063 N050.04.32.514 E019.47.19.983 Color_186ACI
N050.04.32.514 E019.47.19.983 N050.04.32.500 E019.47.19.901 Color_186ACI
N050.04.32.500 E019.47.19.901 N050.04.32.476 E019.47.19.856 Color_186ACI
N050.04.32.893 E019.47.22.860 N050.04.32.839 E019.47.22.823 Color_186ACI
N050.04.32.839 E019.47.22.823 N050.04.32.774 E019.47.22.844 Color_186ACI
N050.04.32.774 E019.47.22.844 N050.04.32.734 E019.47.22.907 Color_186ACI
N050.04.32.734 E019.47.22.907 N050.04.32.722 E019.47.23.012 Color_186ACI
N050.04.32.722 E019.47.23.012 N050.04.32.750 E019.47.23.099 Color_186ACI
N050.04.32.750 E019.47.23.099 N050.04.32.808 E019.47.23.148 Color_186ACI
N050.04.32.808 E019.47.23.148 N050.04.32.868 E019.47.23.136 Color_186ACI
N050.04.32.868 E019.47.23.136 N050.04.32.918 E019.47.23.067 Color_186ACI
N050.04.32.918 E019.47.23.067 N050.04.32.931 E019.47.22.986 Color_186ACI
N050.04.32.931 E019.47.22.986 N050.04.32.917 E019.47.22.905 Color_186ACI
N050.04.32.917 E019.47.22.905 N050.04.32.893 E019.47.22.860 Color_186ACI
N050.04.33.314 E019.47.25.706 N050.04.33.260 E019.47.25.670 Color_186ACI
N050.04.33.260 E019.47.25.670 N050.04.33.196 E019.47.25.690 Color_186ACI
N050.04.33.196 E019.47.25.690 N050.04.33.155 E019.47.25.754 Color_186ACI
N050.04.33.155 E019.47.25.754 N050.04.33.144 E019.47.25.859 Color_186ACI
N050.04.33.144 E019.47.25.859 N050.04.33.171 E019.47.25.946 Color_186ACI
N050.04.33.171 E019.47.25.946 N050.04.33.229 E019.47.25.994 Color_186ACI
N050.04.33.229 E019.47.25.994 N050.04.33.290 E019.47.25.983 Color_186ACI
N050.04.33.290 E019.47.25.983 N050.04.33.339 E019.47.25.913 Color_186ACI
N050.04.33.339 E019.47.25.913 N050.04.33.353 E019.47.25.833 Color_186ACI
N050.04.33.353 E019.47.25.833 N050.04.33.339 E019.47.25.751 Color_186ACI
N050.04.33.339 E019.47.25.751 N050.04.33.314 E019.47.25.706 Color_186ACI
N050.04.25.564 E019.46.21.956 N050.04.25.510 E019.46.21.919 Color_186ACI
N050.04.25.510 E019.46.21.919 N050.04.25.445 E019.46.21.939 Color_186ACI
N050.04.25.445 E019.46.21.939 N050.04.25.405 E019.46.22.003 Color_186ACI
N050.04.25.405 E019.46.22.003 N050.04.25.393 E019.46.22.108 Color_186ACI
N050.04.25.393 E019.46.22.108 N050.04.25.421 E019.46.22.195 Color_186ACI
N050.04.25.421 E019.46.22.195 N050.04.25.479 E019.46.22.244 Color_186ACI
N050.04.25.479 E019.46.22.244 N050.04.25.539 E019.46.22.232 Color_186ACI
N050.04.25.539 E019.46.22.232 N050.04.25.589 E019.46.22.162 Color_186ACI
N050.04.25.589 E019.46.22.162 N050.04.25.602 E019.46.22.082 Color_186ACI
N050.04.25.602 E019.46.22.082 N050.04.25.588 E019.46.22.001 Color_186ACI
N050.04.25.588 E019.46.22.001 N050.04.25.564 E019.46.21.956 Color_186ACI
N050.04.25.731 E019.46.23.088 N050.04.25.677 E019.46.23.052 Color_186ACI
N050.04.25.677 E019.46.23.052 N050.04.25.613 E019.46.23.072 Color_186ACI
N050.04.25.613 E019.46.23.072 N050.04.25.572 E019.46.23.136 Color_186ACI
N050.04.25.572 E019.46.23.136 N050.04.25.561 E019.46.23.241 Color_186ACI
N050.04.25.561 E019.46.23.241 N050.04.25.588 E019.46.23.328 Color_186ACI
N050.04.25.588 E019.46.23.328 N050.04.25.646 E019.46.23.376 Color_186ACI
N050.04.25.646 E019.46.23.376 N050.04.25.707 E019.46.23.364 Color_186ACI
N050.04.25.707 E019.46.23.364 N050.04.25.756 E019.46.23.295 Color_186ACI
N050.04.25.756 E019.46.23.295 N050.04.25.770 E019.46.23.215 Color_186ACI
N050.04.25.770 E019.46.23.215 N050.04.25.756 E019.46.23.133 Color_186ACI
N050.04.25.756 E019.46.23.133 N050.04.25.731 E019.46.23.088 Color_186ACI
N050.04.26.071 E019.46.25.627 N050.04.26.017 E019.46.25.591 Color_186ACI
N050.04.26.017 E019.46.25.591 N050.04.25.952 E019.46.25.611 Color_186ACI
N050.04.25.952 E019.46.25.611 N050.04.25.912 E019.46.25.675 Color_186ACI
N050.04.25.912 E019.46.25.675 N050.04.25.900 E019.46.25.780 Color_186ACI
N050.04.25.900 E019.46.25.780 N050.04.25.928 E019.46.25.867 Color_186ACI
N050.04.25.928 E019.46.25.867 N050.04.25.986 E019.46.25.915 Color_186ACI
N050.04.25.986 E019.46.25.915 N050.04.26.047 E019.46.25.904 Color_186ACI
N050.04.26.047 E019.46.25.904 N050.04.26.096 E019.46.25.834 Color_186ACI
N050.04.26.096 E019.46.25.834 N050.04.26.110 E019.46.25.754 Color_186ACI
N050.04.26.110 E019.46.25.754 N050.04.26.096 E019.46.25.673 Color_186ACI
N050.04.26.096 E019.46.25.673 N050.04.26.071 E019.46.25.627 Color_186ACI
N050.04.26.422 E019.46.28.229 N050.04.26.368 E019.46.28.193 Color_186ACI
N050.04.26.368 E019.46.28.193 N050.04.26.303 E019.46.28.213 Color_186ACI
N050.04.26.303 E019.46.28.213 N050.04.26.263 E019.46.28.277 Color_186ACI
N050.04.26.263 E019.46.28.277 N050.04.26.251 E019.46.28.382 Color_186ACI
N050.04.26.251 E019.46.28.382 N050.04.26.279 E019.46.28.469 Color_186ACI
N050.04.26.279 E019.46.28.469 N050.04.26.337 E019.46.28.517 Color_186ACI
N050.04.26.337 E019.46.28.517 N050.04.26.398 E019.46.28.506 Color_186ACI
N050.04.26.398 E019.46.28.506 N050.04.26.447 E019.46.28.436 Color_186ACI
N050.04.26.447 E019.46.28.436 N050.04.26.460 E019.46.28.356 Color_186ACI
N050.04.26.460 E019.46.28.356 N050.04.26.446 E019.46.28.274 Color_186ACI
N050.04.26.446 E019.46.28.274 N050.04.26.422 E019.46.28.229 Color_186ACI
N050.04.26.832 E019.46.31.209 N050.04.26.778 E019.46.31.173 Color_186ACI
N050.04.26.778 E019.46.31.173 N050.04.26.713 E019.46.31.193 Color_186ACI
N050.04.26.713 E019.46.31.193 N050.04.26.673 E019.46.31.257 Color_186ACI
N050.04.26.673 E019.46.31.257 N050.04.26.661 E019.46.31.362 Color_186ACI
N050.04.26.661 E019.46.31.362 N050.04.26.689 E019.46.31.449 Color_186ACI
N050.04.26.689 E019.46.31.449 N050.04.26.747 E019.46.31.497 Color_186ACI
N050.04.26.747 E019.46.31.497 N050.04.26.808 E019.46.31.486 Color_186ACI
N050.04.26.808 E019.46.31.486 N050.04.26.857 E019.46.31.416 Color_186ACI
N050.04.26.857 E019.46.31.416 N050.04.26.870 E019.46.31.336 Color_186ACI
N050.04.26.870 E019.46.31.336 N050.04.26.856 E019.46.31.254 Color_186ACI
N050.04.26.856 E019.46.31.254 N050.04.26.832 E019.46.31.209 Color_186ACI
N050.04.27.232 E019.46.34.192 N050.04.27.178 E019.46.34.156 Color_186ACI
N050.04.27.178 E019.46.34.156 N050.04.27.113 E019.46.34.176 Color_186ACI
N050.04.27.113 E019.46.34.176 N050.04.27.073 E019.46.34.240 Color_186ACI
N050.04.27.073 E019.46.34.240 N050.04.27.061 E019.46.34.345 Color_186ACI
N050.04.27.061 E019.46.34.345 N050.04.27.089 E019.46.34.432 Color_186ACI
N050.04.27.089 E019.46.34.432 N050.04.27.147 E019.46.34.480 Color_186ACI
N050.04.27.147 E019.46.34.480 N050.04.27.208 E019.46.34.469 Color_186ACI
N050.04.27.208 E019.46.34.469 N050.04.27.257 E019.46.34.399 Color_186ACI
N050.04.27.257 E019.46.34.399 N050.04.27.271 E019.46.34.319 Color_186ACI
N050.04.27.271 E019.46.34.319 N050.04.27.257 E019.46.34.237 Color_186ACI
N050.04.27.257 E019.46.34.237 N050.04.27.232 E019.46.34.192 Color_186ACI
N050.04.27.652 E019.46.37.170 N050.04.27.597 E019.46.37.133 Color_186ACI
N050.04.27.597 E019.46.37.133 N050.04.27.533 E019.46.37.154 Color_186ACI
N050.04.27.533 E019.46.37.154 N050.04.27.492 E019.46.37.217 Color_186ACI
N050.04.27.492 E019.46.37.217 N050.04.27.481 E019.46.37.322 Color_186ACI
N050.04.27.481 E019.46.37.322 N050.04.27.509 E019.46.37.409 Color_186ACI
N050.04.27.509 E019.46.37.409 N050.04.27.567 E019.46.37.458 Color_186ACI
N050.04.27.567 E019.46.37.458 N050.04.27.627 E019.46.37.446 Color_186ACI
N050.04.27.627 E019.46.37.446 N050.04.27.676 E019.46.37.377 Color_186ACI
N050.04.27.676 E019.46.37.377 N050.04.27.690 E019.46.37.296 Color_186ACI
N050.04.27.690 E019.46.37.296 N050.04.27.676 E019.46.37.215 Color_186ACI
N050.04.27.676 E019.46.37.215 N050.04.27.652 E019.46.37.170 Color_186ACI
N050.04.28.058 E019.46.40.146 N050.04.28.004 E019.46.40.110 Color_186ACI
N050.04.28.004 E019.46.40.110 N050.04.27.939 E019.46.40.130 Color_186ACI
N050.04.27.939 E019.46.40.130 N050.04.27.898 E019.46.40.194 Color_186ACI
N050.04.27.898 E019.46.40.194 N050.04.27.887 E019.46.40.299 Color_186ACI
N050.04.27.887 E019.46.40.299 N050.04.27.915 E019.46.40.386 Color_186ACI
N050.04.27.915 E019.46.40.386 N050.04.27.973 E019.46.40.434 Color_186ACI
N050.04.27.973 E019.46.40.434 N050.04.28.033 E019.46.40.422 Color_186ACI
N050.04.28.033 E019.46.40.422 N050.04.28.082 E019.46.40.353 Color_186ACI
N050.04.28.082 E019.46.40.353 N050.04.28.096 E019.46.40.273 Color_186ACI
N050.04.28.096 E019.46.40.273 N050.04.28.082 E019.46.40.191 Color_186ACI
N050.04.28.082 E019.46.40.191 N050.04.28.058 E019.46.40.146 Color_186ACI
N050.04.28.478 E019.46.43.133 N050.04.28.424 E019.46.43.097 Color_186ACI
N050.04.28.424 E019.46.43.097 N050.04.28.359 E019.46.43.117 Color_186ACI
N050.04.28.359 E019.46.43.117 N050.04.28.319 E019.46.43.181 Color_186ACI
N050.04.28.319 E019.46.43.181 N050.04.28.307 E019.46.43.286 Color_186ACI
N050.04.28.307 E019.46.43.286 N050.04.28.335 E019.46.43.373 Color_186ACI
N050.04.28.335 E019.46.43.373 N050.04.28.393 E019.46.43.421 Color_186ACI
N050.04.28.393 E019.46.43.421 N050.04.28.454 E019.46.43.410 Color_186ACI
N050.04.28.454 E019.46.43.410 N050.04.28.503 E019.46.43.340 Color_186ACI
N050.04.28.503 E019.46.43.340 N050.04.28.517 E019.46.43.260 Color_186ACI
N050.04.28.517 E019.46.43.260 N050.04.28.503 E019.46.43.178 Color_186ACI
N050.04.28.503 E019.46.43.178 N050.04.28.478 E019.46.43.133 Color_186ACI
N050.04.28.874 E019.46.46.158 N050.04.28.820 E019.46.46.122 Color_186ACI
N050.04.28.820 E019.46.46.122 N050.04.28.755 E019.46.46.142 Color_186ACI
N050.04.28.755 E019.46.46.142 N050.04.28.715 E019.46.46.206 Color_186ACI
N050.04.28.715 E019.46.46.206 N050.04.28.703 E019.46.46.311 Color_186ACI
N050.04.28.703 E019.46.46.311 N050.04.28.731 E019.46.46.398 Color_186ACI
N050.04.28.731 E019.46.46.398 N050.04.28.789 E019.46.46.446 Color_186ACI
N050.04.28.789 E019.46.46.446 N050.04.28.850 E019.46.46.435 Color_186ACI
N050.04.28.850 E019.46.46.435 N050.04.28.899 E019.46.46.365 Color_186ACI
N050.04.28.899 E019.46.46.365 N050.04.28.912 E019.46.46.285 Color_186ACI
N050.04.28.912 E019.46.46.285 N050.04.28.899 E019.46.46.204 Color_186ACI
N050.04.28.899 E019.46.46.204 N050.04.28.874 E019.46.46.158 Color_186ACI
N050.04.29.263 E019.46.48.861 N050.04.29.209 E019.46.48.825 Color_186ACI
N050.04.29.209 E019.46.48.825 N050.04.29.144 E019.46.48.845 Color_186ACI
N050.04.29.144 E019.46.48.845 N050.04.29.104 E019.46.48.909 Color_186ACI
N050.04.29.104 E019.46.48.909 N050.04.29.092 E019.46.49.014 Color_186ACI
N050.04.29.092 E019.46.49.014 N050.04.29.120 E019.46.49.101 Color_186ACI
N050.04.29.120 E019.46.49.101 N050.04.29.178 E019.46.49.149 Color_186ACI
N050.04.29.178 E019.46.49.149 N050.04.29.239 E019.46.49.137 Color_186ACI
N050.04.29.239 E019.46.49.137 N050.04.29.288 E019.46.49.068 Color_186ACI
N050.04.29.288 E019.46.49.068 N050.04.29.301 E019.46.48.988 Color_186ACI
N050.04.29.301 E019.46.48.988 N050.04.29.287 E019.46.48.906 Color_186ACI
N050.04.29.287 E019.46.48.906 N050.04.29.263 E019.46.48.861 Color_186ACI
N050.04.29.451 E019.46.50.216 N050.04.29.397 E019.46.50.179 Color_186ACI
N050.04.29.397 E019.46.50.179 N050.04.29.333 E019.46.50.199 Color_186ACI
N050.04.29.333 E019.46.50.199 N050.04.29.292 E019.46.50.263 Color_186ACI
N050.04.29.292 E019.46.50.263 N050.04.29.281 E019.46.50.368 Color_186ACI
N050.04.29.281 E019.46.50.368 N050.04.29.308 E019.46.50.455 Color_186ACI
N050.04.29.308 E019.46.50.455 N050.04.29.366 E019.46.50.504 Color_186ACI
N050.04.29.366 E019.46.50.504 N050.04.29.427 E019.46.50.492 Color_186ACI
N050.04.29.427 E019.46.50.492 N050.04.29.476 E019.46.50.422 Color_186ACI
N050.04.29.476 E019.46.50.422 N050.04.29.490 E019.46.50.342 Color_186ACI
N050.04.29.490 E019.46.50.342 N050.04.29.476 E019.46.50.261 Color_186ACI
N050.04.29.476 E019.46.50.261 N050.04.29.451 E019.46.50.216 Color_186ACI
N050.04.29.849 E019.46.51.250 N050.04.29.795 E019.46.51.214 Color_186ACI
N050.04.29.795 E019.46.51.214 N050.04.29.730 E019.46.51.234 Color_186ACI
N050.04.29.730 E019.46.51.234 N050.04.29.690 E019.46.51.298 Color_186ACI
N050.04.29.690 E019.46.51.298 N050.04.29.678 E019.46.51.403 Color_186ACI
N050.04.29.678 E019.46.51.403 N050.04.29.706 E019.46.51.490 Color_186ACI
N050.04.29.706 E019.46.51.490 N050.04.29.764 E019.46.51.538 Color_186ACI
N050.04.29.764 E019.46.51.538 N050.04.29.825 E019.46.51.527 Color_186ACI
N050.04.29.825 E019.46.51.527 N050.04.29.874 E019.46.51.457 Color_186ACI
N050.04.29.874 E019.46.51.457 N050.04.29.887 E019.46.51.377 Color_186ACI
N050.04.29.887 E019.46.51.377 N050.04.29.874 E019.46.51.295 Color_186ACI
N050.04.29.874 E019.46.51.295 N050.04.29.849 E019.46.51.250 Color_186ACI
N050.04.30.196 E019.46.51.482 N050.04.30.142 E019.46.51.446 Color_186ACI
N050.04.30.142 E019.46.51.446 N050.04.30.078 E019.46.51.466 Color_186ACI
N050.04.30.078 E019.46.51.466 N050.04.30.037 E019.46.51.530 Color_186ACI
N050.04.30.037 E019.46.51.530 N050.04.30.026 E019.46.51.635 Color_186ACI
N050.04.30.026 E019.46.51.635 N050.04.30.053 E019.46.51.722 Color_186ACI
N050.04.30.053 E019.46.51.722 N050.04.30.111 E019.46.51.770 Color_186ACI
N050.04.30.111 E019.46.51.770 N050.04.30.172 E019.46.51.758 Color_186ACI
N050.04.30.172 E019.46.51.758 N050.04.30.221 E019.46.51.689 Color_186ACI
N050.04.30.221 E019.46.51.689 N050.04.30.235 E019.46.51.609 Color_186ACI
N050.04.30.235 E019.46.51.609 N050.04.30.221 E019.46.51.527 Color_186ACI
N050.04.30.221 E019.46.51.527 N050.04.30.196 E019.46.51.482 Color_186ACI
N050.04.30.596 E019.46.51.719 N050.04.30.542 E019.46.51.682 Color_186ACI
N050.04.30.542 E019.46.51.682 N050.04.30.477 E019.46.51.702 Color_186ACI
N050.04.30.477 E019.46.51.702 N050.04.30.437 E019.46.51.766 Color_186ACI
N050.04.30.437 E019.46.51.766 N050.04.30.425 E019.46.51.871 Color_186ACI
N050.04.30.425 E019.46.51.871 N050.04.30.453 E019.46.51.958 Color_186ACI
N050.04.30.453 E019.46.51.958 N050.04.30.511 E019.46.52.007 Color_186ACI
N050.04.30.511 E019.46.52.007 N050.04.30.572 E019.46.51.995 Color_186ACI
N050.04.30.572 E019.46.51.995 N050.04.30.621 E019.46.51.925 Color_186ACI
N050.04.30.621 E019.46.51.925 N050.04.30.635 E019.46.51.845 Color_186ACI
N050.04.30.635 E019.46.51.845 N050.04.30.621 E019.46.51.764 Color_186ACI
N050.04.30.621 E019.46.51.764 N050.04.30.596 E019.46.51.719 Color_186ACI
N050.04.31.369 E019.46.51.778 N050.04.31.315 E019.46.51.742 Color_186ACI
N050.04.31.315 E019.46.51.742 N050.04.31.250 E019.46.51.762 Color_186ACI
N050.04.31.250 E019.46.51.762 N050.04.31.210 E019.46.51.826 Color_186ACI
N050.04.31.210 E019.46.51.826 N050.04.31.198 E019.46.51.931 Color_186ACI
N050.04.31.198 E019.46.51.931 N050.04.31.226 E019.46.52.018 Color_186ACI
N050.04.31.226 E019.46.52.018 N050.04.31.284 E019.46.52.066 Color_186ACI
N050.04.31.284 E019.46.52.066 N050.04.31.345 E019.46.52.055 Color_186ACI
N050.04.31.345 E019.46.52.055 N050.04.31.394 E019.46.51.985 Color_186ACI
N050.04.31.394 E019.46.51.985 N050.04.31.407 E019.46.51.905 Color_186ACI
N050.04.31.407 E019.46.51.905 N050.04.31.394 E019.46.51.823 Color_186ACI
N050.04.31.394 E019.46.51.823 N050.04.31.369 E019.46.51.778 Color_186ACI
N050.04.33.322 E019.46.51.925 N050.04.33.268 E019.46.51.889 Color_186ACI
N050.04.33.268 E019.46.51.889 N050.04.33.203 E019.46.51.909 Color_186ACI
N050.04.33.203 E019.46.51.909 N050.04.33.163 E019.46.51.973 Color_186ACI
N050.04.33.163 E019.46.51.973 N050.04.33.151 E019.46.52.078 Color_186ACI
N050.04.33.151 E019.46.52.078 N050.04.33.179 E019.46.52.165 Color_186ACI
N050.04.33.179 E019.46.52.165 N050.04.33.237 E019.46.52.213 Color_186ACI
N050.04.33.237 E019.46.52.213 N050.04.33.298 E019.46.52.201 Color_186ACI
N050.04.33.298 E019.46.52.201 N050.04.33.347 E019.46.52.132 Color_186ACI
N050.04.33.347 E019.46.52.132 N050.04.33.361 E019.46.52.052 Color_186ACI
N050.04.33.361 E019.46.52.052 N050.04.33.347 E019.46.51.970 Color_186ACI
N050.04.33.347 E019.46.51.970 N050.04.33.322 E019.46.51.925 Color_186ACI
N050.04.35.352 E019.46.52.048 N050.04.35.298 E019.46.52.012 Color_186ACI
N050.04.35.298 E019.46.52.012 N050.04.35.233 E019.46.52.032 Color_186ACI
N050.04.35.233 E019.46.52.032 N050.04.35.193 E019.46.52.096 Color_186ACI
N050.04.35.193 E019.46.52.096 N050.04.35.181 E019.46.52.201 Color_186ACI
N050.04.35.181 E019.46.52.201 N050.04.35.209 E019.46.52.288 Color_186ACI
N050.04.35.209 E019.46.52.288 N050.04.35.267 E019.46.52.336 Color_186ACI
N050.04.35.267 E019.46.52.336 N050.04.35.328 E019.46.52.325 Color_186ACI
N050.04.35.328 E019.46.52.325 N050.04.35.377 E019.46.52.255 Color_186ACI
N050.04.35.377 E019.46.52.255 N050.04.35.390 E019.46.52.175 Color_186ACI
N050.04.35.390 E019.46.52.175 N050.04.35.376 E019.46.52.094 Color_186ACI
N050.04.35.376 E019.46.52.094 N050.04.35.352 E019.46.52.048 Color_186ACI
N050.04.35.741 E019.46.51.907 N050.04.35.687 E019.46.51.871 Color_186ACI
N050.04.35.687 E019.46.51.871 N050.04.35.622 E019.46.51.891 Color_186ACI
N050.04.35.622 E019.46.51.891 N050.04.35.582 E019.46.51.955 Color_186ACI
N050.04.35.582 E019.46.51.955 N050.04.35.571 E019.46.52.060 Color_186ACI
N050.04.35.571 E019.46.52.060 N050.04.35.598 E019.46.52.147 Color_186ACI
N050.04.35.598 E019.46.52.147 N050.04.35.656 E019.46.52.195 Color_186ACI
N050.04.35.656 E019.46.52.195 N050.04.35.717 E019.46.52.184 Color_186ACI
N050.04.35.717 E019.46.52.184 N050.04.35.766 E019.46.52.114 Color_186ACI
N050.04.35.766 E019.46.52.114 N050.04.35.780 E019.46.52.034 Color_186ACI
N050.04.35.780 E019.46.52.034 N050.04.35.766 E019.46.51.953 Color_186ACI
N050.04.35.766 E019.46.51.953 N050.04.35.741 E019.46.51.907 Color_186ACI
N050.04.36.201 E019.46.51.741 N050.04.36.147 E019.46.51.704 Color_186ACI
N050.04.36.147 E019.46.51.704 N050.04.36.082 E019.46.51.724 Color_186ACI
N050.04.36.082 E019.46.51.724 N050.04.36.041 E019.46.51.788 Color_186ACI
N050.04.36.041 E019.46.51.788 N050.04.36.030 E019.46.51.893 Color_186ACI
N050.04.36.030 E019.46.51.893 N050.04.36.058 E019.46.51.980 Color_186ACI
N050.04.36.058 E019.46.51.980 N050.04.36.116 E019.46.52.029 Color_186ACI
N050.04.36.116 E019.46.52.029 N050.04.36.176 E019.46.52.017 Color_186ACI
N050.04.36.176 E019.46.52.017 N050.04.36.225 E019.46.51.947 Color_186ACI
N050.04.36.225 E019.46.51.947 N050.04.36.239 E019.46.51.867 Color_186ACI
N050.04.36.239 E019.46.51.867 N050.04.36.225 E019.46.51.786 Color_186ACI
N050.04.36.225 E019.46.51.786 N050.04.36.201 E019.46.51.741 Color_186ACI
N050.04.36.510 E019.46.51.187 N050.04.36.456 E019.46.51.151 Color_186ACI
N050.04.36.456 E019.46.51.151 N050.04.36.392 E019.46.51.171 Color_186ACI
N050.04.36.392 E019.46.51.171 N050.04.36.351 E019.46.51.235 Color_186ACI
N050.04.36.351 E019.46.51.235 N050.04.36.340 E019.46.51.340 Color_186ACI
N050.04.36.340 E019.46.51.340 N050.04.36.367 E019.46.51.427 Color_186ACI
N050.04.36.367 E019.46.51.427 N050.04.36.425 E019.46.51.475 Color_186ACI
N050.04.36.425 E019.46.51.475 N050.04.36.486 E019.46.51.463 Color_186ACI
N050.04.36.486 E019.46.51.463 N050.04.36.535 E019.46.51.394 Color_186ACI
N050.04.36.535 E019.46.51.394 N050.04.36.549 E019.46.51.314 Color_186ACI
N050.04.36.549 E019.46.51.314 N050.04.36.535 E019.46.51.232 Color_186ACI
N050.04.36.535 E019.46.51.232 N050.04.36.510 E019.46.51.187 Color_186ACI
N050.04.36.765 E019.46.50.665 N050.04.36.711 E019.46.50.628 Color_186ACI
N050.04.36.711 E019.46.50.628 N050.04.36.647 E019.46.50.649 Color_186ACI
N050.04.36.647 E019.46.50.649 N050.04.36.606 E019.46.50.712 Color_186ACI
N050.04.36.606 E019.46.50.712 N050.04.36.595 E019.46.50.817 Color_186ACI
N050.04.36.595 E019.46.50.817 N050.04.36.622 E019.46.50.905 Color_186ACI
N050.04.36.622 E019.46.50.905 N050.04.36.680 E019.46.50.953 Color_186ACI
N050.04.36.680 E019.46.50.953 N050.04.36.741 E019.46.50.941 Color_186ACI
N050.04.36.741 E019.46.50.941 N050.04.36.790 E019.46.50.872 Color_186ACI
N050.04.36.790 E019.46.50.872 N050.04.36.804 E019.46.50.792 Color_186ACI
N050.04.36.804 E019.46.50.792 N050.04.36.790 E019.46.50.710 Color_186ACI
N050.04.36.790 E019.46.50.710 N050.04.36.765 E019.46.50.665 Color_186ACI
N050.04.36.825 E019.46.50.033 N050.04.36.771 E019.46.49.997 Color_186ACI
N050.04.36.771 E019.46.49.997 N050.04.36.706 E019.46.50.017 Color_186ACI
N050.04.36.706 E019.46.50.017 N050.04.36.666 E019.46.50.081 Color_186ACI
N050.04.36.666 E019.46.50.081 N050.04.36.654 E019.46.50.186 Color_186ACI
N050.04.36.654 E019.46.50.186 N050.04.36.682 E019.46.50.273 Color_186ACI
N050.04.36.682 E019.46.50.273 N050.04.36.740 E019.46.50.321 Color_186ACI
N050.04.36.740 E019.46.50.321 N050.04.36.801 E019.46.50.310 Color_186ACI
N050.04.36.801 E019.46.50.310 N050.04.36.850 E019.46.50.240 Color_186ACI
N050.04.36.850 E019.46.50.240 N050.04.36.863 E019.46.50.160 Color_186ACI
N050.04.36.863 E019.46.50.160 N050.04.36.849 E019.46.50.078 Color_186ACI
N050.04.36.849 E019.46.50.078 N050.04.36.825 E019.46.50.033 Color_186ACI
N050.04.37.458 E019.46.54.469 N050.04.37.404 E019.46.54.432 Color_186ACI
N050.04.37.404 E019.46.54.432 N050.04.37.340 E019.46.54.453 Color_186ACI
N050.04.37.340 E019.46.54.453 N050.04.37.299 E019.46.54.516 Color_186ACI
N050.04.37.299 E019.46.54.516 N050.04.37.288 E019.46.54.621 Color_186ACI
N050.04.37.288 E019.46.54.621 N050.04.37.316 E019.46.54.709 Color_186ACI
N050.04.37.316 E019.46.54.709 N050.04.37.373 E019.46.54.757 Color_186ACI
N050.04.37.373 E019.46.54.757 N050.04.37.434 E019.46.54.745 Color_186ACI
N050.04.37.434 E019.46.54.745 N050.04.37.483 E019.46.54.676 Color_186ACI
N050.04.37.483 E019.46.54.676 N050.04.37.497 E019.46.54.595 Color_186ACI
N050.04.37.497 E019.46.54.595 N050.04.37.483 E019.46.54.514 Color_186ACI
N050.04.37.483 E019.46.54.514 N050.04.37.458 E019.46.54.469 Color_186ACI
N050.04.37.315 E019.46.54.090 N050.04.37.260 E019.46.54.054 Color_186ACI
N050.04.37.260 E019.46.54.054 N050.04.37.196 E019.46.54.074 Color_186ACI
N050.04.37.196 E019.46.54.074 N050.04.37.155 E019.46.54.138 Color_186ACI
N050.04.37.155 E019.46.54.138 N050.04.37.144 E019.46.54.243 Color_186ACI
N050.04.37.144 E019.46.54.243 N050.04.37.172 E019.46.54.330 Color_186ACI
N050.04.37.172 E019.46.54.330 N050.04.37.230 E019.46.54.378 Color_186ACI
N050.04.37.230 E019.46.54.378 N050.04.37.290 E019.46.54.367 Color_186ACI
N050.04.37.290 E019.46.54.367 N050.04.37.339 E019.46.54.297 Color_186ACI
N050.04.37.339 E019.46.54.297 N050.04.37.353 E019.46.54.217 Color_186ACI
N050.04.37.353 E019.46.54.217 N050.04.37.339 E019.46.54.135 Color_186ACI
N050.04.37.339 E019.46.54.135 N050.04.37.315 E019.46.54.090 Color_186ACI
N050.04.37.096 E019.46.53.795 N050.04.37.042 E019.46.53.759 Color_186ACI
N050.04.37.042 E019.46.53.759 N050.04.36.977 E019.46.53.779 Color_186ACI
N050.04.36.977 E019.46.53.779 N050.04.36.937 E019.46.53.843 Color_186ACI
N050.04.36.937 E019.46.53.843 N050.04.36.925 E019.46.53.948 Color_186ACI
N050.04.36.925 E019.46.53.948 N050.04.36.953 E019.46.54.035 Color_186ACI
N050.04.36.953 E019.46.54.035 N050.04.37.011 E019.46.54.083 Color_186ACI
N050.04.37.011 E019.46.54.083 N050.04.37.072 E019.46.54.071 Color_186ACI
N050.04.37.072 E019.46.54.071 N050.04.37.121 E019.46.54.002 Color_186ACI
N050.04.37.121 E019.46.54.002 N050.04.37.135 E019.46.53.922 Color_186ACI
N050.04.37.135 E019.46.53.922 N050.04.37.121 E019.46.53.840 Color_186ACI
N050.04.37.121 E019.46.53.840 N050.04.37.096 E019.46.53.795 Color_186ACI
N050.04.36.861 E019.46.53.494 N050.04.36.807 E019.46.53.458 Color_186ACI
N050.04.36.807 E019.46.53.458 N050.04.36.742 E019.46.53.478 Color_186ACI
N050.04.36.742 E019.46.53.478 N050.04.36.702 E019.46.53.542 Color_186ACI
N050.04.36.702 E019.46.53.542 N050.04.36.690 E019.46.53.647 Color_186ACI
N050.04.36.690 E019.46.53.647 N050.04.36.718 E019.46.53.734 Color_186ACI
N050.04.36.718 E019.46.53.734 N050.04.36.776 E019.46.53.782 Color_186ACI
N050.04.36.776 E019.46.53.782 N050.04.36.837 E019.46.53.771 Color_186ACI
N050.04.36.837 E019.46.53.771 N050.04.36.886 E019.46.53.701 Color_186ACI
N050.04.36.886 E019.46.53.701 N050.04.36.899 E019.46.53.621 Color_186ACI
N050.04.36.899 E019.46.53.621 N050.04.36.885 E019.46.53.539 Color_186ACI
N050.04.36.885 E019.46.53.539 N050.04.36.861 E019.46.53.494 Color_186ACI
N050.04.36.502 E019.46.53.336 N050.04.36.448 E019.46.53.300 Color_186ACI
N050.04.36.448 E019.46.53.300 N050.04.36.383 E019.46.53.320 Color_186ACI
N050.04.36.383 E019.46.53.320 N050.04.36.343 E019.46.53.384 Color_186ACI
N050.04.36.343 E019.46.53.384 N050.04.36.331 E019.46.53.489 Color_186ACI
N050.04.36.331 E019.46.53.489 N050.04.36.359 E019.46.53.576 Color_186ACI
N050.04.36.359 E019.46.53.576 N050.04.36.417 E019.46.53.624 Color_186ACI
N050.04.36.417 E019.46.53.624 N050.04.36.478 E019.46.53.613 Color_186ACI
N050.04.36.478 E019.46.53.613 N050.04.36.527 E019.46.53.543 Color_186ACI
N050.04.36.527 E019.46.53.543 N050.04.36.541 E019.46.53.463 Color_186ACI
N050.04.36.541 E019.46.53.463 N050.04.36.527 E019.46.53.381 Color_186ACI
N050.04.36.527 E019.46.53.381 N050.04.36.502 E019.46.53.336 Color_186ACI
N050.04.36.049 E019.46.53.222 N050.04.35.995 E019.46.53.186 Color_186ACI
N050.04.35.995 E019.46.53.186 N050.04.35.930 E019.46.53.206 Color_186ACI
N050.04.35.930 E019.46.53.206 N050.04.35.890 E019.46.53.270 Color_186ACI
N050.04.35.890 E019.46.53.270 N050.04.35.878 E019.46.53.375 Color_186ACI
N050.04.35.878 E019.46.53.375 N050.04.35.906 E019.46.53.462 Color_186ACI
N050.04.35.906 E019.46.53.462 N050.04.35.964 E019.46.53.510 Color_186ACI
N050.04.35.964 E019.46.53.510 N050.04.36.025 E019.46.53.498 Color_186ACI
N050.04.36.025 E019.46.53.498 N050.04.36.074 E019.46.53.429 Color_186ACI
N050.04.36.074 E019.46.53.429 N050.04.36.087 E019.46.53.349 Color_186ACI
N050.04.36.087 E019.46.53.349 N050.04.36.073 E019.46.53.267 Color_186ACI
N050.04.36.073 E019.46.53.267 N050.04.36.049 E019.46.53.222 Color_186ACI
N050.04.35.334 E019.46.53.140 N050.04.35.280 E019.46.53.103 Color_186ACI
N050.04.35.280 E019.46.53.103 N050.04.35.216 E019.46.53.123 Color_186ACI
N050.04.35.216 E019.46.53.123 N050.04.35.175 E019.46.53.187 Color_186ACI
N050.04.35.175 E019.46.53.187 N050.04.35.164 E019.46.53.292 Color_186ACI
N050.04.35.164 E019.46.53.292 N050.04.35.191 E019.46.53.379 Color_186ACI
N050.04.35.191 E019.46.53.379 N050.04.35.249 E019.46.53.428 Color_186ACI
N050.04.35.249 E019.46.53.428 N050.04.35.310 E019.46.53.416 Color_186ACI
N050.04.35.310 E019.46.53.416 N050.04.35.359 E019.46.53.346 Color_186ACI
N050.04.35.359 E019.46.53.346 N050.04.35.373 E019.46.53.266 Color_186ACI
N050.04.35.373 E019.46.53.266 N050.04.35.359 E019.46.53.185 Color_186ACI
N050.04.35.359 E019.46.53.185 N050.04.35.334 E019.46.53.140 Color_186ACI
N050.04.33.316 E019.46.52.967 N050.04.33.262 E019.46.52.931 Color_186ACI
N050.04.33.262 E019.46.52.931 N050.04.33.198 E019.46.52.951 Color_186ACI
N050.04.33.198 E019.46.52.951 N050.04.33.157 E019.46.53.015 Color_186ACI
N050.04.33.157 E019.46.53.015 N050.04.33.146 E019.46.53.120 Color_186ACI
N050.04.33.146 E019.46.53.120 N050.04.33.173 E019.46.53.207 Color_186ACI
N050.04.33.173 E019.46.53.207 N050.04.33.231 E019.46.53.255 Color_186ACI
N050.04.33.231 E019.46.53.255 N050.04.33.292 E019.46.53.244 Color_186ACI
N050.04.33.292 E019.46.53.244 N050.04.33.341 E019.46.53.174 Color_186ACI
N050.04.33.341 E019.46.53.174 N050.04.33.355 E019.46.53.094 Color_186ACI
N050.04.33.355 E019.46.53.094 N050.04.33.341 E019.46.53.012 Color_186ACI
N050.04.33.341 E019.46.53.012 N050.04.33.316 E019.46.52.967 Color_186ACI
N050.04.31.343 E019.46.52.812 N050.04.31.289 E019.46.52.776 Color_186ACI
N050.04.31.289 E019.46.52.776 N050.04.31.224 E019.46.52.796 Color_186ACI
N050.04.31.224 E019.46.52.796 N050.04.31.184 E019.46.52.860 Color_186ACI
N050.04.31.184 E019.46.52.860 N050.04.31.172 E019.46.52.965 Color_186ACI
N050.04.31.172 E019.46.52.965 N050.04.31.200 E019.46.53.052 Color_186ACI
N050.04.31.200 E019.46.53.052 N050.04.31.258 E019.46.53.100 Color_186ACI
N050.04.31.258 E019.46.53.100 N050.04.31.318 E019.46.53.088 Color_186ACI
N050.04.31.318 E019.46.53.088 N050.04.31.368 E019.46.53.019 Color_186ACI
N050.04.31.368 E019.46.53.019 N050.04.31.381 E019.46.52.939 Color_186ACI
N050.04.31.381 E019.46.52.939 N050.04.31.367 E019.46.52.857 Color_186ACI
N050.04.31.367 E019.46.52.857 N050.04.31.343 E019.46.52.812 Color_186ACI
N050.04.30.940 E019.46.52.957 N050.04.30.886 E019.46.52.921 Color_186ACI
N050.04.30.886 E019.46.52.921 N050.04.30.821 E019.46.52.941 Color_186ACI
N050.04.30.821 E019.46.52.941 N050.04.30.781 E019.46.53.005 Color_186ACI
N050.04.30.781 E019.46.53.005 N050.04.30.769 E019.46.53.110 Color_186ACI
N050.04.30.769 E019.46.53.110 N050.04.30.797 E019.46.53.197 Color_186ACI
N050.04.30.797 E019.46.53.197 N050.04.30.855 E019.46.53.245 Color_186ACI
N050.04.30.855 E019.46.53.245 N050.04.30.916 E019.46.53.233 Color_186ACI
N050.04.30.916 E019.46.53.233 N050.04.30.965 E019.46.53.164 Color_186ACI
N050.04.30.965 E019.46.53.164 N050.04.30.978 E019.46.53.084 Color_186ACI
N050.04.30.978 E019.46.53.084 N050.04.30.965 E019.46.53.002 Color_186ACI
N050.04.30.965 E019.46.53.002 N050.04.30.940 E019.46.52.957 Color_186ACI
N050.04.30.571 E019.46.53.112 N050.04.30.517 E019.46.53.076 Color_186ACI
N050.04.30.517 E019.46.53.076 N050.04.30.452 E019.46.53.096 Color_186ACI
N050.04.30.452 E019.46.53.096 N050.04.30.412 E019.46.53.160 Color_186ACI
N050.04.30.412 E019.46.53.160 N050.04.30.400 E019.46.53.265 Color_186ACI
N050.04.30.400 E019.46.53.265 N050.04.30.428 E019.46.53.352 Color_186ACI
N050.04.30.428 E019.46.53.352 N050.04.30.486 E019.46.53.400 Color_186ACI
N050.04.30.486 E019.46.53.400 N050.04.30.547 E019.46.53.389 Color_186ACI
N050.04.30.547 E019.46.53.389 N050.04.30.596 E019.46.53.319 Color_186ACI
N050.04.30.596 E019.46.53.319 N050.04.30.609 E019.46.53.239 Color_186ACI
N050.04.30.609 E019.46.53.239 N050.04.30.596 E019.46.53.157 Color_186ACI
N050.04.30.596 E019.46.53.157 N050.04.30.571 E019.46.53.112 Color_186ACI
N050.04.30.202 E019.46.53.790 N050.04.30.148 E019.46.53.754 Color_186ACI
N050.04.30.148 E019.46.53.754 N050.04.30.083 E019.46.53.774 Color_186ACI
N050.04.30.083 E019.46.53.774 N050.04.30.043 E019.46.53.838 Color_186ACI
N050.04.30.043 E019.46.53.838 N050.04.30.031 E019.46.53.943 Color_186ACI
N050.04.30.031 E019.46.53.943 N050.04.30.059 E019.46.54.030 Color_186ACI
N050.04.30.059 E019.46.54.030 N050.04.30.117 E019.46.54.078 Color_186ACI
N050.04.30.117 E019.46.54.078 N050.04.30.177 E019.46.54.066 Color_186ACI
N050.04.30.177 E019.46.54.066 N050.04.30.226 E019.46.53.997 Color_186ACI
N050.04.30.226 E019.46.53.997 N050.04.30.240 E019.46.53.917 Color_186ACI
N050.04.30.240 E019.46.53.917 N050.04.30.226 E019.46.53.835 Color_186ACI
N050.04.30.226 E019.46.53.835 N050.04.30.202 E019.46.53.790 Color_186ACI
N050.04.30.079 E019.46.54.811 N050.04.30.025 E019.46.54.775 Color_186ACI
N050.04.30.025 E019.46.54.775 N050.04.29.960 E019.46.54.795 Color_186ACI
N050.04.29.960 E019.46.54.795 N050.04.29.920 E019.46.54.859 Color_186ACI
N050.04.29.920 E019.46.54.859 N050.04.29.908 E019.46.54.964 Color_186ACI
N050.04.29.908 E019.46.54.964 N050.04.29.936 E019.46.55.051 Color_186ACI
N050.04.29.936 E019.46.55.051 N050.04.29.994 E019.46.55.099 Color_186ACI
N050.04.29.994 E019.46.55.099 N050.04.30.055 E019.46.55.088 Color_186ACI
N050.04.30.055 E019.46.55.088 N050.04.30.104 E019.46.55.018 Color_186ACI
N050.04.30.104 E019.46.55.018 N050.04.30.117 E019.46.54.938 Color_186ACI
N050.04.30.117 E019.46.54.938 N050.04.30.103 E019.46.54.856 Color_186ACI
N050.04.30.103 E019.46.54.856 N050.04.30.079 E019.46.54.811 Color_186ACI
N050.04.30.361 E019.46.56.875 N050.04.30.307 E019.46.56.839 Color_186ACI
N050.04.30.307 E019.46.56.839 N050.04.30.242 E019.46.56.859 Color_186ACI
N050.04.30.242 E019.46.56.859 N050.04.30.201 E019.46.56.923 Color_186ACI
N050.04.30.201 E019.46.56.923 N050.04.30.190 E019.46.57.028 Color_186ACI
N050.04.30.190 E019.46.57.028 N050.04.30.218 E019.46.57.115 Color_186ACI
N050.04.30.218 E019.46.57.115 N050.04.30.276 E019.46.57.163 Color_186ACI
N050.04.30.276 E019.46.57.163 N050.04.30.336 E019.46.57.152 Color_186ACI
N050.04.30.336 E019.46.57.152 N050.04.30.385 E019.46.57.082 Color_186ACI
N050.04.30.385 E019.46.57.082 N050.04.30.399 E019.46.57.002 Color_186ACI
N050.04.30.399 E019.46.57.002 N050.04.30.385 E019.46.56.920 Color_186ACI
N050.04.30.385 E019.46.56.920 N050.04.30.361 E019.46.56.875 Color_186ACI
N050.04.30.638 E019.46.58.961 N050.04.30.584 E019.46.58.925 Color_186ACI
N050.04.30.584 E019.46.58.925 N050.04.30.520 E019.46.58.945 Color_186ACI
N050.04.30.520 E019.46.58.945 N050.04.30.479 E019.46.59.008 Color_186ACI
N050.04.30.479 E019.46.59.008 N050.04.30.468 E019.46.59.113 Color_186ACI
N050.04.30.468 E019.46.59.113 N050.04.30.495 E019.46.59.201 Color_186ACI
N050.04.30.495 E019.46.59.201 N050.04.30.553 E019.46.59.249 Color_186ACI
N050.04.30.553 E019.46.59.249 N050.04.30.614 E019.46.59.237 Color_186ACI
N050.04.30.614 E019.46.59.237 N050.04.30.663 E019.46.59.168 Color_186ACI
N050.04.30.663 E019.46.59.168 N050.04.30.677 E019.46.59.088 Color_186ACI
N050.04.30.677 E019.46.59.088 N050.04.30.663 E019.46.59.006 Color_186ACI
N050.04.30.663 E019.46.59.006 N050.04.30.638 E019.46.58.961 Color_186ACI
N050.04.31.040 E019.47.01.897 N050.04.30.986 E019.47.01.861 Color_186ACI
N050.04.30.986 E019.47.01.861 N050.04.30.921 E019.47.01.881 Color_186ACI
N050.04.30.921 E019.47.01.881 N050.04.30.880 E019.47.01.945 Color_186ACI
N050.04.30.880 E019.47.01.945 N050.04.30.869 E019.47.02.050 Color_186ACI
N050.04.30.869 E019.47.02.050 N050.04.30.897 E019.47.02.137 Color_186ACI
N050.04.30.897 E019.47.02.137 N050.04.30.955 E019.47.02.185 Color_186ACI
N050.04.30.955 E019.47.02.185 N050.04.31.015 E019.47.02.174 Color_186ACI
N050.04.31.015 E019.47.02.174 N050.04.31.064 E019.47.02.104 Color_186ACI
N050.04.31.064 E019.47.02.104 N050.04.31.078 E019.47.02.024 Color_186ACI
N050.04.31.078 E019.47.02.024 N050.04.31.064 E019.47.01.942 Color_186ACI
N050.04.31.064 E019.47.01.942 N050.04.31.040 E019.47.01.897 Color_186ACI
N050.04.31.445 E019.47.04.894 N050.04.31.391 E019.47.04.858 Color_186ACI
N050.04.31.391 E019.47.04.858 N050.04.31.326 E019.47.04.878 Color_186ACI
N050.04.31.326 E019.47.04.878 N050.04.31.286 E019.47.04.942 Color_186ACI
N050.04.31.286 E019.47.04.942 N050.04.31.274 E019.47.05.047 Color_186ACI
N050.04.31.274 E019.47.05.047 N050.04.31.302 E019.47.05.134 Color_186ACI
N050.04.31.302 E019.47.05.134 N050.04.31.360 E019.47.05.182 Color_186ACI
N050.04.31.360 E019.47.05.182 N050.04.31.421 E019.47.05.170 Color_186ACI
N050.04.31.421 E019.47.05.170 N050.04.31.470 E019.47.05.101 Color_186ACI
N050.04.31.470 E019.47.05.101 N050.04.31.483 E019.47.05.021 Color_186ACI
N050.04.31.483 E019.47.05.021 N050.04.31.469 E019.47.04.939 Color_186ACI
N050.04.31.469 E019.47.04.939 N050.04.31.445 E019.47.04.894 Color_186ACI
N050.04.31.864 E019.47.07.867 N050.04.31.810 E019.47.07.830 Color_186ACI
N050.04.31.810 E019.47.07.830 N050.04.31.745 E019.47.07.851 Color_186ACI
N050.04.31.745 E019.47.07.851 N050.04.31.704 E019.47.07.914 Color_186ACI
N050.04.31.704 E019.47.07.914 N050.04.31.693 E019.47.08.019 Color_186ACI
N050.04.31.693 E019.47.08.019 N050.04.31.721 E019.47.08.106 Color_186ACI
N050.04.31.721 E019.47.08.106 N050.04.31.779 E019.47.08.155 Color_186ACI
N050.04.31.779 E019.47.08.155 N050.04.31.839 E019.47.08.143 Color_186ACI
N050.04.31.839 E019.47.08.143 N050.04.31.888 E019.47.08.074 Color_186ACI
N050.04.31.888 E019.47.08.074 N050.04.31.902 E019.47.07.993 Color_186ACI
N050.04.31.902 E019.47.07.993 N050.04.31.888 E019.47.07.912 Color_186ACI
N050.04.31.888 E019.47.07.912 N050.04.31.864 E019.47.07.867 Color_186ACI
N050.04.32.256 E019.47.10.862 N050.04.32.202 E019.47.10.826 Color_186ACI
N050.04.32.202 E019.47.10.826 N050.04.32.137 E019.47.10.846 Color_186ACI
N050.04.32.137 E019.47.10.846 N050.04.32.097 E019.47.10.910 Color_186ACI
N050.04.32.097 E019.47.10.910 N050.04.32.085 E019.47.11.015 Color_186ACI
N050.04.32.085 E019.47.11.015 N050.04.32.113 E019.47.11.102 Color_186ACI
N050.04.32.113 E019.47.11.102 N050.04.32.171 E019.47.11.150 Color_186ACI
N050.04.32.171 E019.47.11.150 N050.04.32.232 E019.47.11.139 Color_186ACI
N050.04.32.232 E019.47.11.139 N050.04.32.281 E019.47.11.069 Color_186ACI
N050.04.32.281 E019.47.11.069 N050.04.32.294 E019.47.10.989 Color_186ACI
N050.04.32.294 E019.47.10.989 N050.04.32.280 E019.47.10.907 Color_186ACI
N050.04.32.280 E019.47.10.907 N050.04.32.256 E019.47.10.862 Color_186ACI
N050.04.32.669 E019.47.13.842 N050.04.32.615 E019.47.13.806 Color_186ACI
N050.04.32.615 E019.47.13.806 N050.04.32.550 E019.47.13.826 Color_186ACI
N050.04.32.550 E019.47.13.826 N050.04.32.510 E019.47.13.889 Color_186ACI
N050.04.32.510 E019.47.13.889 N050.04.32.498 E019.47.13.994 Color_186ACI
N050.04.32.498 E019.47.13.994 N050.04.32.526 E019.47.14.082 Color_186ACI
N050.04.32.526 E019.47.14.082 N050.04.32.584 E019.47.14.130 Color_186ACI
N050.04.32.584 E019.47.14.130 N050.04.32.645 E019.47.14.118 Color_186ACI
N050.04.32.645 E019.47.14.118 N050.04.32.694 E019.47.14.049 Color_186ACI
N050.04.32.694 E019.47.14.049 N050.04.32.707 E019.47.13.969 Color_186ACI
N050.04.32.707 E019.47.13.969 N050.04.32.694 E019.47.13.887 Color_186ACI
N050.04.32.694 E019.47.13.887 N050.04.32.669 E019.47.13.842 Color_186ACI
N050.04.33.044 E019.47.16.563 N050.04.32.990 E019.47.16.527 Color_186ACI
N050.04.32.990 E019.47.16.527 N050.04.32.925 E019.47.16.547 Color_186ACI
N050.04.32.925 E019.47.16.547 N050.04.32.885 E019.47.16.611 Color_186ACI
N050.04.32.885 E019.47.16.611 N050.04.32.873 E019.47.16.716 Color_186ACI
N050.04.32.873 E019.47.16.716 N050.04.32.901 E019.47.16.803 Color_186ACI
N050.04.32.901 E019.47.16.803 N050.04.32.959 E019.47.16.851 Color_186ACI
N050.04.32.959 E019.47.16.851 N050.04.33.020 E019.47.16.840 Color_186ACI
N050.04.33.020 E019.47.16.840 N050.04.33.069 E019.47.16.770 Color_186ACI
N050.04.33.069 E019.47.16.770 N050.04.33.082 E019.47.16.690 Color_186ACI
N050.04.33.082 E019.47.16.690 N050.04.33.069 E019.47.16.609 Color_186ACI
N050.04.33.069 E019.47.16.609 N050.04.33.044 E019.47.16.563 Color_186ACI
N050.04.33.448 E019.47.19.576 N050.04.33.394 E019.47.19.539 Color_186ACI
N050.04.33.394 E019.47.19.539 N050.04.33.329 E019.47.19.559 Color_186ACI
N050.04.33.329 E019.47.19.559 N050.04.33.289 E019.47.19.623 Color_186ACI
N050.04.33.289 E019.47.19.623 N050.04.33.277 E019.47.19.728 Color_186ACI
N050.04.33.277 E019.47.19.728 N050.04.33.305 E019.47.19.815 Color_186ACI
N050.04.33.305 E019.47.19.815 N050.04.33.363 E019.47.19.864 Color_186ACI
N050.04.33.363 E019.47.19.864 N050.04.33.424 E019.47.19.852 Color_186ACI
N050.04.33.424 E019.47.19.852 N050.04.33.473 E019.47.19.782 Color_186ACI
N050.04.33.473 E019.47.19.782 N050.04.33.486 E019.47.19.702 Color_186ACI
N050.04.33.486 E019.47.19.702 N050.04.33.473 E019.47.19.621 Color_186ACI
N050.04.33.473 E019.47.19.621 N050.04.33.448 E019.47.19.576 Color_186ACI
N050.04.33.866 E019.47.22.543 N050.04.33.812 E019.47.22.507 Color_186ACI
N050.04.33.812 E019.47.22.507 N050.04.33.747 E019.47.22.527 Color_186ACI
N050.04.33.747 E019.47.22.527 N050.04.33.707 E019.47.22.591 Color_186ACI
N050.04.33.707 E019.47.22.591 N050.04.33.695 E019.47.22.696 Color_186ACI
N050.04.33.695 E019.47.22.696 N050.04.33.723 E019.47.22.783 Color_186ACI
N050.04.33.723 E019.47.22.783 N050.04.33.781 E019.47.22.831 Color_186ACI
N050.04.33.781 E019.47.22.831 N050.04.33.842 E019.47.22.820 Color_186ACI
N050.04.33.842 E019.47.22.820 N050.04.33.891 E019.47.22.750 Color_186ACI
N050.04.33.891 E019.47.22.750 N050.04.33.905 E019.47.22.670 Color_186ACI
N050.04.33.905 E019.47.22.670 N050.04.33.891 E019.47.22.588 Color_186ACI
N050.04.33.891 E019.47.22.588 N050.04.33.866 E019.47.22.543 Color_186ACI
N050.04.34.251 E019.47.25.425 N050.04.34.197 E019.47.25.389 Color_186ACI
N050.04.34.197 E019.47.25.389 N050.04.34.132 E019.47.25.409 Color_186ACI
N050.04.34.132 E019.47.25.409 N050.04.34.092 E019.47.25.473 Color_186ACI
N050.04.34.092 E019.47.25.473 N050.04.34.080 E019.47.25.578 Color_186ACI
N050.04.34.080 E019.47.25.578 N050.04.34.108 E019.47.25.665 Color_186ACI
N050.04.34.108 E019.47.25.665 N050.04.34.166 E019.47.25.713 Color_186ACI
N050.04.34.166 E019.47.25.713 N050.04.34.227 E019.47.25.701 Color_186ACI
N050.04.34.227 E019.47.25.701 N050.04.34.276 E019.47.25.632 Color_186ACI
N050.04.34.276 E019.47.25.632 N050.04.34.289 E019.47.25.552 Color_186ACI
N050.04.34.289 E019.47.25.552 N050.04.34.276 E019.47.25.470 Color_186ACI
N050.04.34.276 E019.47.25.470 N050.04.34.251 E019.47.25.425 Color_186ACI
N050.04.30.429 E019.48.19.733 N050.04.30.375 E019.48.19.697 Color_186ACI
N050.04.30.375 E019.48.19.697 N050.04.30.310 E019.48.19.717 Color_186ACI
N050.04.30.310 E019.48.19.717 N050.04.30.269 E019.48.19.781 Color_186ACI
N050.04.30.269 E019.48.19.781 N050.04.30.258 E019.48.19.886 Color_186ACI
N050.04.30.258 E019.48.19.886 N050.04.30.286 E019.48.19.973 Color_186ACI
N050.04.30.286 E019.48.19.973 N050.04.30.344 E019.48.20.021 Color_186ACI
N050.04.30.344 E019.48.20.021 N050.04.30.404 E019.48.20.009 Color_186ACI
N050.04.30.404 E019.48.20.009 N050.04.30.453 E019.48.19.940 Color_186ACI
N050.04.30.453 E019.48.19.940 N050.04.30.467 E019.48.19.860 Color_186ACI
N050.04.30.467 E019.48.19.860 N050.04.30.453 E019.48.19.778 Color_186ACI
N050.04.30.453 E019.48.19.778 N050.04.30.429 E019.48.19.733 Color_186ACI
N050.04.30.736 E019.48.18.295 N050.04.30.682 E019.48.18.258 Color_186ACI
N050.04.30.682 E019.48.18.258 N050.04.30.617 E019.48.18.279 Color_186ACI
N050.04.30.617 E019.48.18.279 N050.04.30.577 E019.48.18.342 Color_186ACI
N050.04.30.577 E019.48.18.342 N050.04.30.565 E019.48.18.447 Color_186ACI
N050.04.30.565 E019.48.18.447 N050.04.30.593 E019.48.18.534 Color_186ACI
N050.04.30.593 E019.48.18.534 N050.04.30.651 E019.48.18.583 Color_186ACI
N050.04.30.651 E019.48.18.583 N050.04.30.711 E019.48.18.571 Color_186ACI
N050.04.30.711 E019.48.18.571 N050.04.30.761 E019.48.18.502 Color_186ACI
N050.04.30.761 E019.48.18.502 N050.04.30.774 E019.48.18.421 Color_186ACI
N050.04.30.774 E019.48.18.421 N050.04.30.760 E019.48.18.340 Color_186ACI
N050.04.30.760 E019.48.18.340 N050.04.30.736 E019.48.18.295 Color_186ACI
N050.04.30.863 E019.48.17.640 N050.04.30.809 E019.48.17.604 Color_186ACI
N050.04.30.809 E019.48.17.604 N050.04.30.744 E019.48.17.624 Color_186ACI
N050.04.30.744 E019.48.17.624 N050.04.30.703 E019.48.17.688 Color_186ACI
N050.04.30.703 E019.48.17.688 N050.04.30.692 E019.48.17.793 Color_186ACI
N050.04.30.692 E019.48.17.793 N050.04.30.720 E019.48.17.880 Color_186ACI
N050.04.30.720 E019.48.17.880 N050.04.30.778 E019.48.17.928 Color_186ACI
N050.04.30.778 E019.48.17.928 N050.04.30.838 E019.48.17.916 Color_186ACI
N050.04.30.838 E019.48.17.916 N050.04.30.887 E019.48.17.847 Color_186ACI
N050.04.30.887 E019.48.17.847 N050.04.30.901 E019.48.17.767 Color_186ACI
N050.04.30.901 E019.48.17.767 N050.04.30.887 E019.48.17.685 Color_186ACI
N050.04.30.887 E019.48.17.685 N050.04.30.863 E019.48.17.640 Color_186ACI
N050.04.30.983 E019.48.16.934 N050.04.30.929 E019.48.16.898 Color_186ACI
N050.04.30.929 E019.48.16.898 N050.04.30.864 E019.48.16.918 Color_186ACI
N050.04.30.864 E019.48.16.918 N050.04.30.824 E019.48.16.982 Color_186ACI
N050.04.30.824 E019.48.16.982 N050.04.30.812 E019.48.17.087 Color_186ACI
N050.04.30.812 E019.48.17.087 N050.04.30.840 E019.48.17.174 Color_186ACI
N050.04.30.840 E019.48.17.174 N050.04.30.898 E019.48.17.222 Color_186ACI
N050.04.30.898 E019.48.17.222 N050.04.30.959 E019.48.17.211 Color_186ACI
N050.04.30.959 E019.48.17.211 N050.04.31.008 E019.48.17.141 Color_186ACI
N050.04.31.008 E019.48.17.141 N050.04.31.021 E019.48.17.061 Color_186ACI
N050.04.31.021 E019.48.17.061 N050.04.31.007 E019.48.16.980 Color_186ACI
N050.04.31.007 E019.48.16.980 N050.04.30.983 E019.48.16.934 Color_186ACI
N050.04.31.488 E019.48.17.160 N050.04.31.433 E019.48.17.124 Color_186ACI
N050.04.31.433 E019.48.17.124 N050.04.31.369 E019.48.17.144 Color_186ACI
N050.04.31.369 E019.48.17.144 N050.04.31.328 E019.48.17.208 Color_186ACI
N050.04.31.328 E019.48.17.208 N050.04.31.317 E019.48.17.313 Color_186ACI
N050.04.31.317 E019.48.17.313 N050.04.31.345 E019.48.17.400 Color_186ACI
N050.04.31.345 E019.48.17.400 N050.04.31.403 E019.48.17.448 Color_186ACI
N050.04.31.403 E019.48.17.448 N050.04.31.463 E019.48.17.437 Color_186ACI
N050.04.31.463 E019.48.17.437 N050.04.31.512 E019.48.17.367 Color_186ACI
N050.04.31.512 E019.48.17.367 N050.04.31.526 E019.48.17.287 Color_186ACI
N050.04.31.526 E019.48.17.287 N050.04.31.512 E019.48.17.205 Color_186ACI
N050.04.31.512 E019.48.17.205 N050.04.31.488 E019.48.17.160 Color_186ACI
N050.04.32.019 E019.48.17.408 N050.04.31.965 E019.48.17.372 Color_186ACI
N050.04.31.965 E019.48.17.372 N050.04.31.900 E019.48.17.392 Color_186ACI
N050.04.31.900 E019.48.17.392 N050.04.31.860 E019.48.17.456 Color_186ACI
N050.04.31.860 E019.48.17.456 N050.04.31.848 E019.48.17.561 Color_186ACI
N050.04.31.848 E019.48.17.561 N050.04.31.876 E019.48.17.648 Color_186ACI
N050.04.31.876 E019.48.17.648 N050.04.31.934 E019.48.17.696 Color_186ACI
N050.04.31.934 E019.48.17.696 N050.04.31.995 E019.48.17.685 Color_186ACI
N050.04.31.995 E019.48.17.685 N050.04.32.044 E019.48.17.615 Color_186ACI
N050.04.32.044 E019.48.17.615 N050.04.32.057 E019.48.17.535 Color_186ACI
N050.04.32.057 E019.48.17.535 N050.04.32.043 E019.48.17.453 Color_186ACI
N050.04.32.043 E019.48.17.453 N050.04.32.019 E019.48.17.408 Color_186ACI
N050.04.32.464 E019.48.17.532 N050.04.32.410 E019.48.17.495 Color_186ACI
N050.04.32.410 E019.48.17.495 N050.04.32.345 E019.48.17.516 Color_186ACI
N050.04.32.345 E019.48.17.516 N050.04.32.305 E019.48.17.579 Color_186ACI
N050.04.32.305 E019.48.17.579 N050.04.32.293 E019.48.17.684 Color_186ACI
N050.04.32.293 E019.48.17.684 N050.04.32.321 E019.48.17.772 Color_186ACI
N050.04.32.321 E019.48.17.772 N050.04.32.379 E019.48.17.820 Color_186ACI
N050.04.32.379 E019.48.17.820 N050.04.32.440 E019.48.17.808 Color_186ACI
N050.04.32.440 E019.48.17.808 N050.04.32.489 E019.48.17.739 Color_186ACI
N050.04.32.489 E019.48.17.739 N050.04.32.503 E019.48.17.658 Color_186ACI
N050.04.32.503 E019.48.17.658 N050.04.32.489 E019.48.17.577 Color_186ACI
N050.04.32.489 E019.48.17.577 N050.04.32.464 E019.48.17.532 Color_186ACI
N050.04.32.869 E019.48.17.457 N050.04.32.815 E019.48.17.420 Color_186ACI
N050.04.32.815 E019.48.17.420 N050.04.32.751 E019.48.17.440 Color_186ACI
N050.04.32.751 E019.48.17.440 N050.04.32.710 E019.48.17.504 Color_186ACI
N050.04.32.710 E019.48.17.504 N050.04.32.699 E019.48.17.609 Color_186ACI
N050.04.32.699 E019.48.17.609 N050.04.32.726 E019.48.17.696 Color_186ACI
N050.04.32.726 E019.48.17.696 N050.04.32.784 E019.48.17.745 Color_186ACI
N050.04.32.784 E019.48.17.745 N050.04.32.845 E019.48.17.733 Color_186ACI
N050.04.32.845 E019.48.17.733 N050.04.32.894 E019.48.17.663 Color_186ACI
N050.04.32.894 E019.48.17.663 N050.04.32.908 E019.48.17.583 Color_186ACI
N050.04.32.908 E019.48.17.583 N050.04.32.894 E019.48.17.502 Color_186ACI
N050.04.32.894 E019.48.17.502 N050.04.32.869 E019.48.17.457 Color_186ACI
N050.04.33.332 E019.48.17.304 N050.04.33.278 E019.48.17.267 Color_186ACI
N050.04.33.278 E019.48.17.267 N050.04.33.213 E019.48.17.288 Color_186ACI
N050.04.33.213 E019.48.17.288 N050.04.33.173 E019.48.17.351 Color_186ACI
N050.04.33.173 E019.48.17.351 N050.04.33.161 E019.48.17.456 Color_186ACI
N050.04.33.161 E019.48.17.456 N050.04.33.189 E019.48.17.544 Color_186ACI
N050.04.33.189 E019.48.17.544 N050.04.33.247 E019.48.17.592 Color_186ACI
N050.04.33.247 E019.48.17.592 N050.04.33.308 E019.48.17.580 Color_186ACI
N050.04.33.308 E019.48.17.580 N050.04.33.357 E019.48.17.511 Color_186ACI
N050.04.33.357 E019.48.17.511 N050.04.33.370 E019.48.17.430 Color_186ACI
N050.04.33.370 E019.48.17.430 N050.04.33.357 E019.48.17.349 Color_186ACI
N050.04.33.357 E019.48.17.349 N050.04.33.332 E019.48.17.304 Color_186ACI
N050.04.35.246 E019.48.16.650 N050.04.35.192 E019.48.16.614 Color_186ACI
N050.04.35.192 E019.48.16.614 N050.04.35.127 E019.48.16.634 Color_186ACI
N050.04.35.127 E019.48.16.634 N050.04.35.087 E019.48.16.698 Color_186ACI
N050.04.35.087 E019.48.16.698 N050.04.35.075 E019.48.16.803 Color_186ACI
N050.04.35.075 E019.48.16.803 N050.04.35.103 E019.48.16.890 Color_186ACI
N050.04.35.103 E019.48.16.890 N050.04.35.161 E019.48.16.938 Color_186ACI
N050.04.35.161 E019.48.16.938 N050.04.35.222 E019.48.16.926 Color_186ACI
N050.04.35.222 E019.48.16.926 N050.04.35.271 E019.48.16.857 Color_186ACI
N050.04.35.271 E019.48.16.857 N050.04.35.284 E019.48.16.777 Color_186ACI
N050.04.35.284 E019.48.16.777 N050.04.35.271 E019.48.16.695 Color_186ACI
N050.04.35.271 E019.48.16.695 N050.04.35.246 E019.48.16.650 Color_186ACI
N050.04.37.154 E019.48.16.041 N050.04.37.100 E019.48.16.005 Color_186ACI
N050.04.37.100 E019.48.16.005 N050.04.37.035 E019.48.16.025 Color_186ACI
N050.04.37.035 E019.48.16.025 N050.04.36.995 E019.48.16.089 Color_186ACI
N050.04.36.995 E019.48.16.089 N050.04.36.983 E019.48.16.193 Color_186ACI
N050.04.36.983 E019.48.16.193 N050.04.37.011 E019.48.16.281 Color_186ACI
N050.04.37.011 E019.48.16.281 N050.04.37.069 E019.48.16.329 Color_186ACI
N050.04.37.069 E019.48.16.329 N050.04.37.130 E019.48.16.317 Color_186ACI
N050.04.37.130 E019.48.16.317 N050.04.37.179 E019.48.16.248 Color_186ACI
N050.04.37.179 E019.48.16.248 N050.04.37.192 E019.48.16.168 Color_186ACI
N050.04.37.192 E019.48.16.168 N050.04.37.178 E019.48.16.086 Color_186ACI
N050.04.37.178 E019.48.16.086 N050.04.37.154 E019.48.16.041 Color_186ACI
N050.04.39.082 E019.48.15.383 N050.04.39.027 E019.48.15.347 Color_186ACI
N050.04.39.027 E019.48.15.347 N050.04.38.963 E019.48.15.367 Color_186ACI
N050.04.38.963 E019.48.15.367 N050.04.38.922 E019.48.15.431 Color_186ACI
N050.04.38.922 E019.48.15.431 N050.04.38.911 E019.48.15.536 Color_186ACI
N050.04.38.911 E019.48.15.536 N050.04.38.939 E019.48.15.623 Color_186ACI
N050.04.38.939 E019.48.15.623 N050.04.38.997 E019.48.15.671 Color_186ACI
N050.04.38.997 E019.48.15.671 N050.04.39.057 E019.48.15.659 Color_186ACI
N050.04.39.057 E019.48.15.659 N050.04.39.106 E019.48.15.590 Color_186ACI
N050.04.39.106 E019.48.15.590 N050.04.39.120 E019.48.15.510 Color_186ACI
N050.04.39.120 E019.48.15.510 N050.04.39.106 E019.48.15.428 Color_186ACI
N050.04.39.106 E019.48.15.428 N050.04.39.082 E019.48.15.383 Color_186ACI
N050.04.47.605 E019.48.09.535 N050.04.47.551 E019.48.09.499 Color_186ACI
N050.04.47.551 E019.48.09.499 N050.04.47.487 E019.48.09.519 Color_186ACI
N050.04.47.487 E019.48.09.519 N050.04.47.446 E019.48.09.583 Color_186ACI
N050.04.47.446 E019.48.09.583 N050.04.47.435 E019.48.09.688 Color_186ACI
N050.04.47.435 E019.48.09.688 N050.04.47.463 E019.48.09.775 Color_186ACI
N050.04.47.463 E019.48.09.775 N050.04.47.521 E019.48.09.823 Color_186ACI
N050.04.47.521 E019.48.09.823 N050.04.47.581 E019.48.09.811 Color_186ACI
N050.04.47.581 E019.48.09.811 N050.04.47.630 E019.48.09.742 Color_186ACI
N050.04.47.630 E019.48.09.742 N050.04.47.644 E019.48.09.662 Color_186ACI
N050.04.47.644 E019.48.09.662 N050.04.47.630 E019.48.09.580 Color_186ACI
N050.04.47.630 E019.48.09.580 N050.04.47.605 E019.48.09.535 Color_186ACI
N050.04.39.554 E019.48.12.847 N050.04.39.500 E019.48.12.811 Color_186ACI
N050.04.39.500 E019.48.12.811 N050.04.39.435 E019.48.12.831 Color_186ACI
N050.04.39.435 E019.48.12.831 N050.04.39.395 E019.48.12.895 Color_186ACI
N050.04.39.395 E019.48.12.895 N050.04.39.383 E019.48.13.000 Color_186ACI
N050.04.39.383 E019.48.13.000 N050.04.39.411 E019.48.13.087 Color_186ACI
N050.04.39.411 E019.48.13.087 N050.04.39.469 E019.48.13.136 Color_186ACI
N050.04.39.469 E019.48.13.136 N050.04.39.530 E019.48.13.124 Color_186ACI
N050.04.39.530 E019.48.13.124 N050.04.39.579 E019.48.13.054 Color_186ACI
N050.04.39.579 E019.48.13.054 N050.04.39.592 E019.48.12.974 Color_186ACI
N050.04.39.592 E019.48.12.974 N050.04.39.578 E019.48.12.893 Color_186ACI
N050.04.39.578 E019.48.12.893 N050.04.39.554 E019.48.12.847 Color_186ACI
N050.04.39.455 E019.48.13.323 N050.04.39.401 E019.48.13.287 Color_186ACI
N050.04.39.401 E019.48.13.287 N050.04.39.336 E019.48.13.307 Color_186ACI
N050.04.39.336 E019.48.13.307 N050.04.39.296 E019.48.13.371 Color_186ACI
N050.04.39.296 E019.48.13.371 N050.04.39.285 E019.48.13.476 Color_186ACI
N050.04.39.285 E019.48.13.476 N050.04.39.312 E019.48.13.563 Color_186ACI
N050.04.39.312 E019.48.13.563 N050.04.39.370 E019.48.13.611 Color_186ACI
N050.04.39.370 E019.48.13.611 N050.04.39.431 E019.48.13.599 Color_186ACI
N050.04.39.431 E019.48.13.599 N050.04.39.480 E019.48.13.530 Color_186ACI
N050.04.39.480 E019.48.13.530 N050.04.39.494 E019.48.13.450 Color_186ACI
N050.04.39.494 E019.48.13.450 N050.04.39.480 E019.48.13.368 Color_186ACI
N050.04.39.480 E019.48.13.368 N050.04.39.455 E019.48.13.323 Color_186ACI
N050.04.39.233 E019.48.13.647 N050.04.39.179 E019.48.13.611 Color_186ACI
N050.04.39.179 E019.48.13.611 N050.04.39.115 E019.48.13.631 Color_186ACI
N050.04.39.115 E019.48.13.631 N050.04.39.074 E019.48.13.695 Color_186ACI
N050.04.39.074 E019.48.13.695 N050.04.39.063 E019.48.13.800 Color_186ACI
N050.04.39.063 E019.48.13.800 N050.04.39.090 E019.48.13.887 Color_186ACI
N050.04.39.090 E019.48.13.887 N050.04.39.148 E019.48.13.935 Color_186ACI
N050.04.39.148 E019.48.13.935 N050.04.39.209 E019.48.13.924 Color_186ACI
N050.04.39.209 E019.48.13.924 N050.04.39.258 E019.48.13.854 Color_186ACI
N050.04.39.258 E019.48.13.854 N050.04.39.272 E019.48.13.774 Color_186ACI
N050.04.39.272 E019.48.13.774 N050.04.39.258 E019.48.13.692 Color_186ACI
N050.04.39.258 E019.48.13.692 N050.04.39.233 E019.48.13.647 Color_186ACI
N050.04.38.862 E019.48.13.813 N050.04.38.808 E019.48.13.777 Color_186ACI
N050.04.38.808 E019.48.13.777 N050.04.38.743 E019.48.13.797 Color_186ACI
N050.04.38.743 E019.48.13.797 N050.04.38.703 E019.48.13.861 Color_186ACI
N050.04.38.703 E019.48.13.861 N050.04.38.691 E019.48.13.966 Color_186ACI
N050.04.38.691 E019.48.13.966 N050.04.38.719 E019.48.14.053 Color_186ACI
N050.04.38.719 E019.48.14.053 N050.04.38.777 E019.48.14.101 Color_186ACI
N050.04.38.777 E019.48.14.101 N050.04.38.837 E019.48.14.090 Color_186ACI
N050.04.38.837 E019.48.14.090 N050.04.38.886 E019.48.14.020 Color_186ACI
N050.04.38.886 E019.48.14.020 N050.04.38.900 E019.48.13.940 Color_186ACI
N050.04.38.900 E019.48.13.940 N050.04.38.886 E019.48.13.858 Color_186ACI
N050.04.38.886 E019.48.13.858 N050.04.38.862 E019.48.13.813 Color_186ACI
N050.04.39.779 E019.48.15.200 N050.04.39.725 E019.48.15.163 Color_186ACI
N050.04.39.725 E019.48.15.163 N050.04.39.660 E019.48.15.184 Color_186ACI
N050.04.39.660 E019.48.15.184 N050.04.39.620 E019.48.15.247 Color_186ACI
N050.04.39.620 E019.48.15.247 N050.04.39.608 E019.48.15.352 Color_186ACI
N050.04.39.608 E019.48.15.352 N050.04.39.636 E019.48.15.439 Color_186ACI
N050.04.39.636 E019.48.15.439 N050.04.39.694 E019.48.15.488 Color_186ACI
N050.04.39.694 E019.48.15.488 N050.04.39.755 E019.48.15.476 Color_186ACI
N050.04.39.755 E019.48.15.476 N050.04.39.804 E019.48.15.407 Color_186ACI
N050.04.39.804 E019.48.15.407 N050.04.39.817 E019.48.15.326 Color_186ACI
N050.04.39.817 E019.48.15.326 N050.04.39.803 E019.48.15.245 Color_186ACI
N050.04.39.803 E019.48.15.245 N050.04.39.779 E019.48.15.200 Color_186ACI
N050.04.40.514 E019.48.15.093 N050.04.40.460 E019.48.15.057 Color_186ACI
N050.04.40.460 E019.48.15.057 N050.04.40.395 E019.48.15.077 Color_186ACI
N050.04.40.395 E019.48.15.077 N050.04.40.355 E019.48.15.141 Color_186ACI
N050.04.40.355 E019.48.15.141 N050.04.40.343 E019.48.15.246 Color_186ACI
N050.04.40.343 E019.48.15.246 N050.04.40.371 E019.48.15.333 Color_186ACI
N050.04.40.371 E019.48.15.333 N050.04.40.429 E019.48.15.381 Color_186ACI
N050.04.40.429 E019.48.15.381 N050.04.40.490 E019.48.15.369 Color_186ACI
N050.04.40.490 E019.48.15.369 N050.04.40.539 E019.48.15.300 Color_186ACI
N050.04.40.539 E019.48.15.300 N050.04.40.553 E019.48.15.220 Color_186ACI
N050.04.40.553 E019.48.15.220 N050.04.40.539 E019.48.15.138 Color_186ACI
N050.04.40.539 E019.48.15.138 N050.04.40.514 E019.48.15.093 Color_186ACI
N050.04.41.325 E019.48.14.838 N050.04.41.271 E019.48.14.801 Color_186ACI
N050.04.41.271 E019.48.14.801 N050.04.41.206 E019.48.14.821 Color_186ACI
N050.04.41.206 E019.48.14.821 N050.04.41.166 E019.48.14.885 Color_186ACI
N050.04.41.166 E019.48.14.885 N050.04.41.154 E019.48.14.990 Color_186ACI
N050.04.41.154 E019.48.14.990 N050.04.41.182 E019.48.15.077 Color_186ACI
N050.04.41.182 E019.48.15.077 N050.04.41.240 E019.48.15.126 Color_186ACI
N050.04.41.240 E019.48.15.126 N050.04.41.301 E019.48.15.114 Color_186ACI
N050.04.41.301 E019.48.15.114 N050.04.41.350 E019.48.15.044 Color_186ACI
N050.04.41.350 E019.48.15.044 N050.04.41.363 E019.48.14.964 Color_186ACI
N050.04.41.363 E019.48.14.964 N050.04.41.350 E019.48.14.883 Color_186ACI
N050.04.41.350 E019.48.14.883 N050.04.41.325 E019.48.14.838 Color_186ACI
N050.04.42.169 E019.48.14.607 N050.04.42.115 E019.48.14.571 Color_186ACI
N050.04.42.115 E019.48.14.571 N050.04.42.051 E019.48.14.591 Color_186ACI
N050.04.42.051 E019.48.14.591 N050.04.42.010 E019.48.14.655 Color_186ACI
N050.04.42.010 E019.48.14.655 N050.04.41.999 E019.48.14.760 Color_186ACI
N050.04.41.999 E019.48.14.760 N050.04.42.026 E019.48.14.847 Color_186ACI
N050.04.42.026 E019.48.14.847 N050.04.42.084 E019.48.14.895 Color_186ACI
N050.04.42.084 E019.48.14.895 N050.04.42.145 E019.48.14.884 Color_186ACI
N050.04.42.145 E019.48.14.884 N050.04.42.194 E019.48.14.814 Color_186ACI
N050.04.42.194 E019.48.14.814 N050.04.42.208 E019.48.14.734 Color_186ACI
N050.04.42.208 E019.48.14.734 N050.04.42.194 E019.48.14.653 Color_186ACI
N050.04.42.194 E019.48.14.653 N050.04.42.169 E019.48.14.607 Color_186ACI
N050.04.43.558 E019.48.14.087 N050.04.43.504 E019.48.14.051 Color_186ACI
N050.04.43.504 E019.48.14.051 N050.04.43.439 E019.48.14.071 Color_186ACI
N050.04.43.439 E019.48.14.071 N050.04.43.399 E019.48.14.135 Color_186ACI
N050.04.43.399 E019.48.14.135 N050.04.43.387 E019.48.14.240 Color_186ACI
N050.04.43.387 E019.48.14.240 N050.04.43.415 E019.48.14.327 Color_186ACI
N050.04.43.415 E019.48.14.327 N050.04.43.473 E019.48.14.375 Color_186ACI
N050.04.43.473 E019.48.14.375 N050.04.43.534 E019.48.14.364 Color_186ACI
N050.04.43.534 E019.48.14.364 N050.04.43.583 E019.48.14.294 Color_186ACI
N050.04.43.583 E019.48.14.294 N050.04.43.596 E019.48.14.214 Color_186ACI
N050.04.43.596 E019.48.14.214 N050.04.43.582 E019.48.14.133 Color_186ACI
N050.04.43.582 E019.48.14.133 N050.04.43.558 E019.48.14.087 Color_186ACI
N050.04.45.183 E019.48.13.545 N050.04.45.129 E019.48.13.509 Color_186ACI
N050.04.45.129 E019.48.13.509 N050.04.45.064 E019.48.13.529 Color_186ACI
N050.04.45.064 E019.48.13.529 N050.04.45.024 E019.48.13.593 Color_186ACI
N050.04.45.024 E019.48.13.593 N050.04.45.012 E019.48.13.698 Color_186ACI
N050.04.45.012 E019.48.13.698 N050.04.45.040 E019.48.13.785 Color_186ACI
N050.04.45.040 E019.48.13.785 N050.04.45.098 E019.48.13.833 Color_186ACI
N050.04.45.098 E019.48.13.833 N050.04.45.159 E019.48.13.822 Color_186ACI
N050.04.45.159 E019.48.13.822 N050.04.45.208 E019.48.13.752 Color_186ACI
N050.04.45.208 E019.48.13.752 N050.04.45.222 E019.48.13.672 Color_186ACI
N050.04.45.222 E019.48.13.672 N050.04.45.208 E019.48.13.590 Color_186ACI
N050.04.45.208 E019.48.13.590 N050.04.45.183 E019.48.13.545 Color_186ACI
N050.04.46.745 E019.48.13.022 N050.04.46.691 E019.48.12.985 Color_186ACI
N050.04.46.691 E019.48.12.985 N050.04.46.626 E019.48.13.006 Color_186ACI
N050.04.46.626 E019.48.13.006 N050.04.46.586 E019.48.13.069 Color_186ACI
N050.04.46.586 E019.48.13.069 N050.04.46.574 E019.48.13.174 Color_186ACI
N050.04.46.574 E019.48.13.174 N050.04.46.602 E019.48.13.261 Color_186ACI
N050.04.46.602 E019.48.13.261 N050.04.46.660 E019.48.13.310 Color_186ACI
N050.04.46.660 E019.48.13.310 N050.04.46.721 E019.48.13.298 Color_186ACI
N050.04.46.721 E019.48.13.298 N050.04.46.770 E019.48.13.229 Color_186ACI
N050.04.46.770 E019.48.13.229 N050.04.46.783 E019.48.13.148 Color_186ACI
N050.04.46.783 E019.48.13.148 N050.04.46.769 E019.48.13.067 Color_186ACI
N050.04.46.769 E019.48.13.067 N050.04.46.745 E019.48.13.022 Color_186ACI
N050.04.47.903 E019.48.12.635 N050.04.47.848 E019.48.12.599 Color_186ACI
N050.04.47.848 E019.48.12.599 N050.04.47.784 E019.48.12.619 Color_186ACI
N050.04.47.784 E019.48.12.619 N050.04.47.743 E019.48.12.683 Color_186ACI
N050.04.47.743 E019.48.12.683 N050.04.47.732 E019.48.12.788 Color_186ACI
N050.04.47.732 E019.48.12.788 N050.04.47.760 E019.48.12.875 Color_186ACI
N050.04.47.760 E019.48.12.875 N050.04.47.818 E019.48.12.923 Color_186ACI
N050.04.47.818 E019.48.12.923 N050.04.47.878 E019.48.12.911 Color_186ACI
N050.04.47.878 E019.48.12.911 N050.04.47.927 E019.48.12.842 Color_186ACI
N050.04.47.927 E019.48.12.842 N050.04.47.941 E019.48.12.762 Color_186ACI
N050.04.47.941 E019.48.12.762 N050.04.47.927 E019.48.12.680 Color_186ACI
N050.04.47.927 E019.48.12.680 N050.04.47.903 E019.48.12.635 Color_186ACI
N050.04.47.667 E019.48.09.057 N050.04.47.613 E019.48.09.020 Color_186ACI
N050.04.47.613 E019.48.09.020 N050.04.47.548 E019.48.09.041 Color_186ACI
N050.04.47.548 E019.48.09.041 N050.04.47.508 E019.48.09.104 Color_186ACI
N050.04.47.508 E019.48.09.104 N050.04.47.496 E019.48.09.209 Color_186ACI
N050.04.47.496 E019.48.09.209 N050.04.47.524 E019.48.09.297 Color_186ACI
N050.04.47.524 E019.48.09.297 N050.04.47.582 E019.48.09.345 Color_186ACI
N050.04.47.582 E019.48.09.345 N050.04.47.643 E019.48.09.333 Color_186ACI
N050.04.47.643 E019.48.09.333 N050.04.47.692 E019.48.09.264 Color_186ACI
N050.04.47.692 E019.48.09.264 N050.04.47.706 E019.48.09.184 Color_186ACI
N050.04.47.706 E019.48.09.184 N050.04.47.692 E019.48.09.102 Color_186ACI
N050.04.47.692 E019.48.09.102 N050.04.47.667 E019.48.09.057 Color_186ACI
N050.04.47.551 E019.48.09.987 N050.04.47.497 E019.48.09.951 Color_186ACI
N050.04.47.497 E019.48.09.951 N050.04.47.432 E019.48.09.971 Color_186ACI
N050.04.47.432 E019.48.09.971 N050.04.47.392 E019.48.10.035 Color_186ACI
N050.04.47.392 E019.48.10.035 N050.04.47.380 E019.48.10.140 Color_186ACI
N050.04.47.380 E019.48.10.140 N050.04.47.408 E019.48.10.227 Color_186ACI
N050.04.47.408 E019.48.10.227 N050.04.47.466 E019.48.10.275 Color_186ACI
N050.04.47.466 E019.48.10.275 N050.04.47.527 E019.48.10.264 Color_186ACI
N050.04.47.527 E019.48.10.264 N050.04.47.576 E019.48.10.194 Color_186ACI
N050.04.47.576 E019.48.10.194 N050.04.47.589 E019.48.10.114 Color_186ACI
N050.04.47.589 E019.48.10.114 N050.04.47.576 E019.48.10.033 Color_186ACI
N050.04.47.576 E019.48.10.033 N050.04.47.551 E019.48.09.987 Color_186ACI
N050.04.47.459 E019.48.10.493 N050.04.47.405 E019.48.10.457 Color_186ACI
N050.04.47.405 E019.48.10.457 N050.04.47.341 E019.48.10.477 Color_186ACI
N050.04.47.341 E019.48.10.477 N050.04.47.300 E019.48.10.541 Color_186ACI
N050.04.47.300 E019.48.10.541 N050.04.47.289 E019.48.10.646 Color_186ACI
N050.04.47.289 E019.48.10.646 N050.04.47.316 E019.48.10.733 Color_186ACI
N050.04.47.316 E019.48.10.733 N050.04.47.374 E019.48.10.781 Color_186ACI
N050.04.47.374 E019.48.10.781 N050.04.47.435 E019.48.10.770 Color_186ACI
N050.04.47.435 E019.48.10.770 N050.04.47.484 E019.48.10.700 Color_186ACI
N050.04.47.484 E019.48.10.700 N050.04.47.498 E019.48.10.620 Color_186ACI
N050.04.47.498 E019.48.10.620 N050.04.47.484 E019.48.10.538 Color_186ACI
N050.04.47.484 E019.48.10.538 N050.04.47.459 E019.48.10.493 Color_186ACI
N050.04.47.228 E019.48.10.734 N050.04.47.174 E019.48.10.698 Color_186ACI
N050.04.47.174 E019.48.10.698 N050.04.47.109 E019.48.10.718 Color_186ACI
N050.04.47.109 E019.48.10.718 N050.04.47.068 E019.48.10.782 Color_186ACI
N050.04.47.068 E019.48.10.782 N050.04.47.057 E019.48.10.887 Color_186ACI
N050.04.47.057 E019.48.10.887 N050.04.47.085 E019.48.10.974 Color_186ACI
N050.04.47.085 E019.48.10.974 N050.04.47.143 E019.48.11.022 Color_186ACI
N050.04.47.143 E019.48.11.022 N050.04.47.203 E019.48.11.011 Color_186ACI
N050.04.47.203 E019.48.11.011 N050.04.47.252 E019.48.10.941 Color_186ACI
N050.04.47.252 E019.48.10.941 N050.04.47.266 E019.48.10.861 Color_186ACI
N050.04.47.266 E019.48.10.861 N050.04.47.252 E019.48.10.780 Color_186ACI
N050.04.47.252 E019.48.10.780 N050.04.47.228 E019.48.10.734 Color_186ACI
N050.04.46.991 E019.48.11.034 N050.04.46.937 E019.48.10.998 Color_186ACI
N050.04.46.937 E019.48.10.998 N050.04.46.872 E019.48.11.018 Color_186ACI
N050.04.46.872 E019.48.11.018 N050.04.46.832 E019.48.11.081 Color_186ACI
N050.04.46.832 E019.48.11.081 N050.04.46.820 E019.48.11.186 Color_186ACI
N050.04.46.820 E019.48.11.186 N050.04.46.848 E019.48.11.274 Color_186ACI
N050.04.46.848 E019.48.11.274 N050.04.46.906 E019.48.11.322 Color_186ACI
N050.04.46.906 E019.48.11.322 N050.04.46.967 E019.48.11.310 Color_186ACI
N050.04.46.967 E019.48.11.310 N050.04.47.016 E019.48.11.241 Color_186ACI
N050.04.47.016 E019.48.11.241 N050.04.47.029 E019.48.11.161 Color_186ACI
N050.04.47.029 E019.48.11.161 N050.04.47.015 E019.48.11.079 Color_186ACI
N050.04.47.015 E019.48.11.079 N050.04.46.991 E019.48.11.034 Color_186ACI
N050.04.46.762 E019.48.11.283 N050.04.46.708 E019.48.11.247 Color_186ACI
N050.04.46.708 E019.48.11.247 N050.04.46.643 E019.48.11.267 Color_186ACI
N050.04.46.643 E019.48.11.267 N050.04.46.603 E019.48.11.331 Color_186ACI
N050.04.46.603 E019.48.11.331 N050.04.46.591 E019.48.11.436 Color_186ACI
N050.04.46.591 E019.48.11.436 N050.04.46.619 E019.48.11.523 Color_186ACI
N050.04.46.619 E019.48.11.523 N050.04.46.677 E019.48.11.571 Color_186ACI
N050.04.46.677 E019.48.11.571 N050.04.46.737 E019.48.11.559 Color_186ACI
N050.04.46.737 E019.48.11.559 N050.04.46.786 E019.48.11.490 Color_186ACI
N050.04.46.786 E019.48.11.490 N050.04.46.800 E019.48.11.410 Color_186ACI
N050.04.46.800 E019.48.11.410 N050.04.46.786 E019.48.11.328 Color_186ACI
N050.04.46.786 E019.48.11.328 N050.04.46.762 E019.48.11.283 Color_186ACI
N050.04.46.538 E019.48.11.525 N050.04.46.484 E019.48.11.489 Color_186ACI
N050.04.46.484 E019.48.11.489 N050.04.46.420 E019.48.11.509 Color_186ACI
N050.04.46.420 E019.48.11.509 N050.04.46.379 E019.48.11.573 Color_186ACI
N050.04.46.379 E019.48.11.573 N050.04.46.368 E019.48.11.678 Color_186ACI
N050.04.46.368 E019.48.11.678 N050.04.46.396 E019.48.11.765 Color_186ACI
N050.04.46.396 E019.48.11.765 N050.04.46.453 E019.48.11.813 Color_186ACI
N050.04.46.453 E019.48.11.813 N050.04.46.514 E019.48.11.801 Color_186ACI
N050.04.46.514 E019.48.11.801 N050.04.46.563 E019.48.11.732 Color_186ACI
N050.04.46.563 E019.48.11.732 N050.04.46.577 E019.48.11.652 Color_186ACI
N050.04.46.577 E019.48.11.652 N050.04.46.563 E019.48.11.570 Color_186ACI
N050.04.46.563 E019.48.11.570 N050.04.46.538 E019.48.11.525 Color_186ACI
N050.04.44.965 E019.48.12.035 N050.04.44.911 E019.48.11.998 Color_186ACI
N050.04.44.911 E019.48.11.998 N050.04.44.846 E019.48.12.019 Color_186ACI
N050.04.44.846 E019.48.12.019 N050.04.44.806 E019.48.12.082 Color_186ACI
N050.04.44.806 E019.48.12.082 N050.04.44.794 E019.48.12.187 Color_186ACI
N050.04.44.794 E019.48.12.187 N050.04.44.822 E019.48.12.275 Color_186ACI
N050.04.44.822 E019.48.12.275 N050.04.44.880 E019.48.12.323 Color_186ACI
N050.04.44.880 E019.48.12.323 N050.04.44.941 E019.48.12.311 Color_186ACI
N050.04.44.941 E019.48.12.311 N050.04.44.990 E019.48.12.242 Color_186ACI
N050.04.44.990 E019.48.12.242 N050.04.45.003 E019.48.12.162 Color_186ACI
N050.04.45.003 E019.48.12.162 N050.04.44.989 E019.48.12.080 Color_186ACI
N050.04.44.989 E019.48.12.080 N050.04.44.965 E019.48.12.035 Color_186ACI
N050.04.43.341 E019.48.12.570 N050.04.43.286 E019.48.12.534 Color_186ACI
N050.04.43.286 E019.48.12.534 N050.04.43.222 E019.48.12.554 Color_186ACI
N050.04.43.222 E019.48.12.554 N050.04.43.181 E019.48.12.618 Color_186ACI
N050.04.43.181 E019.48.12.618 N050.04.43.170 E019.48.12.723 Color_186ACI
N050.04.43.170 E019.48.12.723 N050.04.43.198 E019.48.12.810 Color_186ACI
N050.04.43.198 E019.48.12.810 N050.04.43.256 E019.48.12.858 Color_186ACI
N050.04.43.256 E019.48.12.858 N050.04.43.316 E019.48.12.847 Color_186ACI
N050.04.43.316 E019.48.12.847 N050.04.43.365 E019.48.12.777 Color_186ACI
N050.04.43.365 E019.48.12.777 N050.04.43.379 E019.48.12.697 Color_186ACI
N050.04.43.379 E019.48.12.697 N050.04.43.365 E019.48.12.615 Color_186ACI
N050.04.43.365 E019.48.12.615 N050.04.43.341 E019.48.12.570 Color_186ACI
N050.04.42.007 E019.48.12.998 N050.04.41.953 E019.48.12.962 Color_186ACI
N050.04.41.953 E019.48.12.962 N050.04.41.888 E019.48.12.982 Color_186ACI
N050.04.41.888 E019.48.12.982 N050.04.41.848 E019.48.13.046 Color_186ACI
N050.04.41.848 E019.48.13.046 N050.04.41.836 E019.48.13.151 Color_186ACI
N050.04.41.836 E019.48.13.151 N050.04.41.864 E019.48.13.238 Color_186ACI
N050.04.41.864 E019.48.13.238 N050.04.41.922 E019.48.13.286 Color_186ACI
N050.04.41.922 E019.48.13.286 N050.04.41.983 E019.48.13.274 Color_186ACI
N050.04.41.983 E019.48.13.274 N050.04.42.032 E019.48.13.205 Color_186ACI
N050.04.42.032 E019.48.13.205 N050.04.42.045 E019.48.13.125 Color_186ACI
N050.04.42.045 E019.48.13.125 N050.04.42.031 E019.48.13.043 Color_186ACI
N050.04.42.031 E019.48.13.043 N050.04.42.007 E019.48.12.998 Color_186ACI
N050.04.41.541 E019.48.12.885 N050.04.41.487 E019.48.12.849 Color_186ACI
N050.04.41.487 E019.48.12.849 N050.04.41.422 E019.48.12.869 Color_186ACI
N050.04.41.422 E019.48.12.869 N050.04.41.382 E019.48.12.933 Color_186ACI
N050.04.41.382 E019.48.12.933 N050.04.41.370 E019.48.13.038 Color_186ACI
N050.04.41.370 E019.48.13.038 N050.04.41.398 E019.48.13.125 Color_186ACI
N050.04.41.398 E019.48.13.125 N050.04.41.456 E019.48.13.173 Color_186ACI
N050.04.41.456 E019.48.13.173 N050.04.41.517 E019.48.13.162 Color_186ACI
N050.04.41.517 E019.48.13.162 N050.04.41.566 E019.48.13.092 Color_186ACI
N050.04.41.566 E019.48.13.092 N050.04.41.579 E019.48.13.012 Color_186ACI
N050.04.41.579 E019.48.13.012 N050.04.41.566 E019.48.12.930 Color_186ACI
N050.04.41.566 E019.48.12.930 N050.04.41.541 E019.48.12.885 Color_186ACI
N050.04.41.084 E019.48.12.754 N050.04.41.030 E019.48.12.718 Color_186ACI
N050.04.41.030 E019.48.12.718 N050.04.40.966 E019.48.12.738 Color_186ACI
N050.04.40.966 E019.48.12.738 N050.04.40.925 E019.48.12.802 Color_186ACI
N050.04.40.925 E019.48.12.802 N050.04.40.914 E019.48.12.907 Color_186ACI
N050.04.40.914 E019.48.12.907 N050.04.40.941 E019.48.12.994 Color_186ACI
N050.04.40.941 E019.48.12.994 N050.04.40.999 E019.48.13.043 Color_186ACI
N050.04.40.999 E019.48.13.043 N050.04.41.060 E019.48.13.031 Color_186ACI
N050.04.41.060 E019.48.13.031 N050.04.41.109 E019.48.12.961 Color_186ACI
N050.04.41.109 E019.48.12.961 N050.04.41.123 E019.48.12.881 Color_186ACI
N050.04.41.123 E019.48.12.881 N050.04.41.109 E019.48.12.800 Color_186ACI
N050.04.41.109 E019.48.12.800 N050.04.41.084 E019.48.12.754 Color_186ACI
N050.04.40.821 E019.48.12.167 N050.04.40.767 E019.48.12.130 Color_186ACI
N050.04.40.767 E019.48.12.130 N050.04.40.702 E019.48.12.150 Color_186ACI
N050.04.40.702 E019.48.12.150 N050.04.40.662 E019.48.12.214 Color_186ACI
N050.04.40.662 E019.48.12.214 N050.04.40.650 E019.48.12.319 Color_186ACI
N050.04.40.650 E019.48.12.319 N050.04.40.678 E019.48.12.406 Color_186ACI
N050.04.40.678 E019.48.12.406 N050.04.40.736 E019.48.12.455 Color_186ACI
N050.04.40.736 E019.48.12.455 N050.04.40.797 E019.48.12.443 Color_186ACI
N050.04.40.797 E019.48.12.443 N050.04.40.846 E019.48.12.374 Color_186ACI
N050.04.40.846 E019.48.12.374 N050.04.40.860 E019.48.12.293 Color_186ACI
N050.04.40.860 E019.48.12.293 N050.04.40.846 E019.48.12.212 Color_186ACI
N050.04.40.846 E019.48.12.212 N050.04.40.821 E019.48.12.167 Color_186ACI
N050.04.34.396 E019.47.59.854 N050.04.34.342 E019.47.59.817 Color_186ACI
N050.04.34.342 E019.47.59.817 N050.04.34.278 E019.47.59.838 Color_186ACI
N050.04.34.278 E019.47.59.838 N050.04.34.237 E019.47.59.901 Color_186ACI
N050.04.34.237 E019.47.59.901 N050.04.34.226 E019.48.00.006 Color_186ACI
N050.04.34.226 E019.48.00.006 N050.04.34.253 E019.48.00.093 Color_186ACI
N050.04.34.253 E019.48.00.093 N050.04.34.311 E019.48.00.142 Color_186ACI
N050.04.34.311 E019.48.00.142 N050.04.34.372 E019.48.00.130 Color_186ACI
N050.04.34.372 E019.48.00.130 N050.04.34.421 E019.48.00.061 Color_186ACI
N050.04.34.421 E019.48.00.061 N050.04.34.435 E019.47.59.980 Color_186ACI
N050.04.34.435 E019.47.59.980 N050.04.34.421 E019.47.59.899 Color_186ACI
N050.04.34.421 E019.47.59.899 N050.04.34.396 E019.47.59.854 Color_186ACI
N050.04.35.509 E019.48.00.638 N050.04.35.455 E019.48.00.602 Color_186ACI
N050.04.35.455 E019.48.00.602 N050.04.35.390 E019.48.00.622 Color_186ACI
N050.04.35.390 E019.48.00.622 N050.04.35.349 E019.48.00.686 Color_186ACI
N050.04.35.349 E019.48.00.686 N050.04.35.338 E019.48.00.791 Color_186ACI
N050.04.35.338 E019.48.00.791 N050.04.35.366 E019.48.00.878 Color_186ACI
N050.04.35.366 E019.48.00.878 N050.04.35.424 E019.48.00.926 Color_186ACI
N050.04.35.424 E019.48.00.926 N050.04.35.484 E019.48.00.914 Color_186ACI
N050.04.35.484 E019.48.00.914 N050.04.35.533 E019.48.00.845 Color_186ACI
N050.04.35.533 E019.48.00.845 N050.04.35.547 E019.48.00.765 Color_186ACI
N050.04.35.547 E019.48.00.765 N050.04.35.533 E019.48.00.683 Color_186ACI
N050.04.35.533 E019.48.00.683 N050.04.35.509 E019.48.00.638 Color_186ACI
N050.04.36.733 E019.48.01.516 N050.04.36.679 E019.48.01.480 Color_186ACI
N050.04.36.679 E019.48.01.480 N050.04.36.614 E019.48.01.500 Color_186ACI
N050.04.36.614 E019.48.01.500 N050.04.36.574 E019.48.01.564 Color_186ACI
N050.04.36.574 E019.48.01.564 N050.04.36.562 E019.48.01.669 Color_186ACI
N050.04.36.562 E019.48.01.669 N050.04.36.590 E019.48.01.756 Color_186ACI
N050.04.36.590 E019.48.01.756 N050.04.36.648 E019.48.01.804 Color_186ACI
N050.04.36.648 E019.48.01.804 N050.04.36.709 E019.48.01.793 Color_186ACI
N050.04.36.709 E019.48.01.793 N050.04.36.758 E019.48.01.723 Color_186ACI
N050.04.36.758 E019.48.01.723 N050.04.36.771 E019.48.01.643 Color_186ACI
N050.04.36.771 E019.48.01.643 N050.04.36.757 E019.48.01.562 Color_186ACI
N050.04.36.757 E019.48.01.562 N050.04.36.733 E019.48.01.516 Color_186ACI
N050.04.37.743 E019.48.02.229 N050.04.37.689 E019.48.02.193 Color_186ACI
N050.04.37.689 E019.48.02.193 N050.04.37.624 E019.48.02.213 Color_186ACI
N050.04.37.624 E019.48.02.213 N050.04.37.584 E019.48.02.277 Color_186ACI
N050.04.37.584 E019.48.02.277 N050.04.37.572 E019.48.02.382 Color_186ACI
N050.04.37.572 E019.48.02.382 N050.04.37.600 E019.48.02.469 Color_186ACI
N050.04.37.600 E019.48.02.469 N050.04.37.658 E019.48.02.517 Color_186ACI
N050.04.37.658 E019.48.02.517 N050.04.37.719 E019.48.02.505 Color_186ACI
N050.04.37.719 E019.48.02.505 N050.04.37.768 E019.48.02.436 Color_186ACI
N050.04.37.768 E019.48.02.436 N050.04.37.782 E019.48.02.356 Color_186ACI
N050.04.37.782 E019.48.02.356 N050.04.37.768 E019.48.02.274 Color_186ACI
N050.04.37.768 E019.48.02.274 N050.04.37.743 E019.48.02.229 Color_186ACI
N050.04.38.183 E019.48.02.750 N050.04.38.129 E019.48.02.714 Color_186ACI
N050.04.38.129 E019.48.02.714 N050.04.38.064 E019.48.02.734 Color_186ACI
N050.04.38.064 E019.48.02.734 N050.04.38.023 E019.48.02.798 Color_186ACI
N050.04.38.023 E019.48.02.798 N050.04.38.012 E019.48.02.902 Color_186ACI
N050.04.38.012 E019.48.02.902 N050.04.38.040 E019.48.02.990 Color_186ACI
N050.04.38.040 E019.48.02.990 N050.04.38.098 E019.48.03.038 Color_186ACI
N050.04.38.098 E019.48.03.038 N050.04.38.158 E019.48.03.026 Color_186ACI
N050.04.38.158 E019.48.03.026 N050.04.38.207 E019.48.02.957 Color_186ACI
N050.04.38.207 E019.48.02.957 N050.04.38.221 E019.48.02.877 Color_186ACI
N050.04.38.221 E019.48.02.877 N050.04.38.207 E019.48.02.795 Color_186ACI
N050.04.38.207 E019.48.02.795 N050.04.38.183 E019.48.02.750 Color_186ACI
N050.04.38.427 E019.48.03.485 N050.04.38.372 E019.48.03.449 Color_186ACI
N050.04.38.372 E019.48.03.449 N050.04.38.308 E019.48.03.469 Color_186ACI
N050.04.38.308 E019.48.03.469 N050.04.38.267 E019.48.03.533 Color_186ACI
N050.04.38.267 E019.48.03.533 N050.04.38.256 E019.48.03.638 Color_186ACI
N050.04.38.256 E019.48.03.638 N050.04.38.284 E019.48.03.725 Color_186ACI
N050.04.38.284 E019.48.03.725 N050.04.38.342 E019.48.03.773 Color_186ACI
N050.04.38.342 E019.48.03.773 N050.04.38.402 E019.48.03.762 Color_186ACI
N050.04.38.402 E019.48.03.762 N050.04.38.451 E019.48.03.692 Color_186ACI
N050.04.38.451 E019.48.03.692 N050.04.38.465 E019.48.03.612 Color_186ACI
N050.04.38.465 E019.48.03.612 N050.04.38.451 E019.48.03.530 Color_186ACI
N050.04.38.451 E019.48.03.530 N050.04.38.427 E019.48.03.485 Color_186ACI
N050.04.38.767 E019.48.05.944 N050.04.38.713 E019.48.05.908 Color_186ACI
N050.04.38.713 E019.48.05.908 N050.04.38.648 E019.48.05.928 Color_186ACI
N050.04.38.648 E019.48.05.928 N050.04.38.608 E019.48.05.992 Color_186ACI
N050.04.38.608 E019.48.05.992 N050.04.38.596 E019.48.06.097 Color_186ACI
N050.04.38.596 E019.48.06.097 N050.04.38.624 E019.48.06.184 Color_186ACI
N050.04.38.624 E019.48.06.184 N050.04.38.682 E019.48.06.232 Color_186ACI
N050.04.38.682 E019.48.06.232 N050.04.38.743 E019.48.06.220 Color_186ACI
N050.04.38.743 E019.48.06.220 N050.04.38.792 E019.48.06.151 Color_186ACI
N050.04.38.792 E019.48.06.151 N050.04.38.805 E019.48.06.071 Color_186ACI
N050.04.38.805 E019.48.06.071 N050.04.38.791 E019.48.05.989 Color_186ACI
N050.04.38.791 E019.48.05.989 N050.04.38.767 E019.48.05.944 Color_186ACI
N050.04.39.195 E019.48.08.930 N050.04.39.141 E019.48.08.894 Color_186ACI
N050.04.39.141 E019.48.08.894 N050.04.39.076 E019.48.08.914 Color_186ACI
N050.04.39.076 E019.48.08.914 N050.04.39.036 E019.48.08.978 Color_186ACI
N050.04.39.036 E019.48.08.978 N050.04.39.024 E019.48.09.083 Color_186ACI
N050.04.39.024 E019.48.09.083 N050.04.39.052 E019.48.09.170 Color_186ACI
N050.04.39.052 E019.48.09.170 N050.04.39.110 E019.48.09.218 Color_186ACI
N050.04.39.110 E019.48.09.218 N050.04.39.171 E019.48.09.206 Color_186ACI
N050.04.39.171 E019.48.09.206 N050.04.39.220 E019.48.09.137 Color_186ACI
N050.04.39.220 E019.48.09.137 N050.04.39.233 E019.48.09.057 Color_186ACI
N050.04.39.233 E019.48.09.057 N050.04.39.219 E019.48.08.975 Color_186ACI
N050.04.39.219 E019.48.08.975 N050.04.39.195 E019.48.08.930 Color_186ACI
N050.04.39.584 E019.48.11.938 N050.04.39.529 E019.48.11.902 Color_186ACI
N050.04.39.529 E019.48.11.902 N050.04.39.465 E019.48.11.922 Color_186ACI
N050.04.39.465 E019.48.11.922 N050.04.39.424 E019.48.11.986 Color_186ACI
N050.04.39.424 E019.48.11.986 N050.04.39.413 E019.48.12.091 Color_186ACI
N050.04.39.413 E019.48.12.091 N050.04.39.441 E019.48.12.178 Color_186ACI
N050.04.39.441 E019.48.12.178 N050.04.39.499 E019.48.12.226 Color_186ACI
N050.04.39.499 E019.48.12.226 N050.04.39.559 E019.48.12.214 Color_186ACI
N050.04.39.559 E019.48.12.214 N050.04.39.608 E019.48.12.145 Color_186ACI
N050.04.39.608 E019.48.12.145 N050.04.39.622 E019.48.12.065 Color_186ACI
N050.04.39.622 E019.48.12.065 N050.04.39.608 E019.48.11.983 Color_186ACI
N050.04.39.608 E019.48.11.983 N050.04.39.584 E019.48.11.938 Color_186ACI
N050.04.40.554 E019.48.11.548 N050.04.40.500 E019.48.11.512 Color_186ACI
N050.04.40.500 E019.48.11.512 N050.04.40.435 E019.48.11.532 Color_186ACI
N050.04.40.435 E019.48.11.532 N050.04.40.395 E019.48.11.596 Color_186ACI
N050.04.40.395 E019.48.11.596 N050.04.40.383 E019.48.11.701 Color_186ACI
N050.04.40.383 E019.48.11.701 N050.04.40.411 E019.48.11.788 Color_186ACI
N050.04.40.411 E019.48.11.788 N050.04.40.469 E019.48.11.836 Color_186ACI
N050.04.40.469 E019.48.11.836 N050.04.40.530 E019.48.11.824 Color_186ACI
N050.04.40.530 E019.48.11.824 N050.04.40.579 E019.48.11.755 Color_186ACI
N050.04.40.579 E019.48.11.755 N050.04.40.593 E019.48.11.675 Color_186ACI
N050.04.40.593 E019.48.11.675 N050.04.40.579 E019.48.11.593 Color_186ACI
N050.04.40.579 E019.48.11.593 N050.04.40.554 E019.48.11.548 Color_186ACI
N050.04.40.167 E019.48.08.587 N050.04.40.112 E019.48.08.550 Color_186ACI
N050.04.40.112 E019.48.08.550 N050.04.40.048 E019.48.08.571 Color_186ACI
N050.04.40.048 E019.48.08.571 N050.04.40.007 E019.48.08.634 Color_186ACI
N050.04.40.007 E019.48.08.634 N050.04.39.996 E019.48.08.739 Color_186ACI
N050.04.39.996 E019.48.08.739 N050.04.40.024 E019.48.08.826 Color_186ACI
N050.04.40.024 E019.48.08.826 N050.04.40.082 E019.48.08.875 Color_186ACI
N050.04.40.082 E019.48.08.875 N050.04.40.142 E019.48.08.863 Color_186ACI
N050.04.40.142 E019.48.08.863 N050.04.40.191 E019.48.08.794 Color_186ACI
N050.04.40.191 E019.48.08.794 N050.04.40.205 E019.48.08.713 Color_186ACI
N050.04.40.205 E019.48.08.713 N050.04.40.191 E019.48.08.632 Color_186ACI
N050.04.40.191 E019.48.08.632 N050.04.40.167 E019.48.08.587 Color_186ACI
N050.04.39.746 E019.48.05.602 N050.04.39.692 E019.48.05.566 Color_186ACI
N050.04.39.692 E019.48.05.566 N050.04.39.627 E019.48.05.586 Color_186ACI
N050.04.39.627 E019.48.05.586 N050.04.39.587 E019.48.05.650 Color_186ACI
N050.04.39.587 E019.48.05.650 N050.04.39.575 E019.48.05.755 Color_186ACI
N050.04.39.575 E019.48.05.755 N050.04.39.603 E019.48.05.842 Color_186ACI
N050.04.39.603 E019.48.05.842 N050.04.39.661 E019.48.05.890 Color_186ACI
N050.04.39.661 E019.48.05.890 N050.04.39.722 E019.48.05.879 Color_186ACI
N050.04.39.722 E019.48.05.879 N050.04.39.771 E019.48.05.809 Color_186ACI
N050.04.39.771 E019.48.05.809 N050.04.39.784 E019.48.05.729 Color_186ACI
N050.04.39.784 E019.48.05.729 N050.04.39.770 E019.48.05.648 Color_186ACI
N050.04.39.770 E019.48.05.648 N050.04.39.746 E019.48.05.602 Color_186ACI
N050.04.39.337 E019.48.02.658 N050.04.39.283 E019.48.02.622 Color_186ACI
N050.04.39.283 E019.48.02.622 N050.04.39.218 E019.48.02.642 Color_186ACI
N050.04.39.218 E019.48.02.642 N050.04.39.178 E019.48.02.706 Color_186ACI
N050.04.39.178 E019.48.02.706 N050.04.39.166 E019.48.02.811 Color_186ACI
N050.04.39.166 E019.48.02.811 N050.04.39.194 E019.48.02.898 Color_186ACI
N050.04.39.194 E019.48.02.898 N050.04.39.252 E019.48.02.946 Color_186ACI
N050.04.39.252 E019.48.02.946 N050.04.39.313 E019.48.02.935 Color_186ACI
N050.04.39.313 E019.48.02.935 N050.04.39.362 E019.48.02.865 Color_186ACI
N050.04.39.362 E019.48.02.865 N050.04.39.375 E019.48.02.785 Color_186ACI
N050.04.39.375 E019.48.02.785 N050.04.39.361 E019.48.02.703 Color_186ACI
N050.04.39.361 E019.48.02.703 N050.04.39.337 E019.48.02.658 Color_186ACI
N050.04.38.947 E019.47.59.777 N050.04.38.893 E019.47.59.741 Color_186ACI
N050.04.38.893 E019.47.59.741 N050.04.38.829 E019.47.59.761 Color_186ACI
N050.04.38.829 E019.47.59.761 N050.04.38.788 E019.47.59.824 Color_186ACI
N050.04.38.788 E019.47.59.824 N050.04.38.777 E019.47.59.929 Color_186ACI
N050.04.38.777 E019.47.59.929 N050.04.38.804 E019.48.00.017 Color_186ACI
N050.04.38.804 E019.48.00.017 N050.04.38.862 E019.48.00.065 Color_186ACI
N050.04.38.862 E019.48.00.065 N050.04.38.923 E019.48.00.053 Color_186ACI
N050.04.38.923 E019.48.00.053 N050.04.38.972 E019.47.59.984 Color_186ACI
N050.04.38.972 E019.47.59.984 N050.04.38.986 E019.47.59.904 Color_186ACI
N050.04.38.986 E019.47.59.904 N050.04.38.972 E019.47.59.822 Color_186ACI
N050.04.38.972 E019.47.59.822 N050.04.38.947 E019.47.59.777 Color_186ACI
N050.04.34.791 E019.47.58.408 N050.04.34.737 E019.47.58.372 Color_186ACI
N050.04.34.737 E019.47.58.372 N050.04.34.672 E019.47.58.392 Color_186ACI
N050.04.34.672 E019.47.58.392 N050.04.34.632 E019.47.58.456 Color_186ACI
N050.04.34.632 E019.47.58.456 N050.04.34.620 E019.47.58.561 Color_186ACI
N050.04.34.620 E019.47.58.561 N050.04.34.648 E019.47.58.648 Color_186ACI
N050.04.34.648 E019.47.58.648 N050.04.34.706 E019.47.58.696 Color_186ACI
N050.04.34.706 E019.47.58.696 N050.04.34.767 E019.47.58.684 Color_186ACI
N050.04.34.767 E019.47.58.684 N050.04.34.816 E019.47.58.615 Color_186ACI
N050.04.34.816 E019.47.58.615 N050.04.34.829 E019.47.58.535 Color_186ACI
N050.04.34.829 E019.47.58.535 N050.04.34.816 E019.47.58.453 Color_186ACI
N050.04.34.816 E019.47.58.453 N050.04.34.791 E019.47.58.408 Color_186ACI
N050.04.35.942 E019.47.59.185 N050.04.35.888 E019.47.59.149 Color_186ACI
N050.04.35.888 E019.47.59.149 N050.04.35.823 E019.47.59.169 Color_186ACI
N050.04.35.823 E019.47.59.169 N050.04.35.783 E019.47.59.233 Color_186ACI
N050.04.35.783 E019.47.59.233 N050.04.35.772 E019.47.59.338 Color_186ACI
N050.04.35.772 E019.47.59.338 N050.04.35.799 E019.47.59.425 Color_186ACI
N050.04.35.799 E019.47.59.425 N050.04.35.857 E019.47.59.473 Color_186ACI
N050.04.35.857 E019.47.59.473 N050.04.35.918 E019.47.59.461 Color_186ACI
N050.04.35.918 E019.47.59.461 N050.04.35.967 E019.47.59.392 Color_186ACI
N050.04.35.967 E019.47.59.392 N050.04.35.981 E019.47.59.312 Color_186ACI
N050.04.35.981 E019.47.59.312 N050.04.35.967 E019.47.59.230 Color_186ACI
N050.04.35.967 E019.47.59.230 N050.04.35.942 E019.47.59.185 Color_186ACI
N050.04.36.328 E019.47.59.260 N050.04.36.274 E019.47.59.223 Color_186ACI
N050.04.36.274 E019.47.59.223 N050.04.36.209 E019.47.59.243 Color_186ACI
N050.04.36.209 E019.47.59.243 N050.04.36.169 E019.47.59.307 Color_186ACI
N050.04.36.169 E019.47.59.307 N050.04.36.157 E019.47.59.412 Color_186ACI
N050.04.36.157 E019.47.59.412 N050.04.36.185 E019.47.59.499 Color_186ACI
N050.04.36.185 E019.47.59.499 N050.04.36.243 E019.47.59.548 Color_186ACI
N050.04.36.243 E019.47.59.548 N050.04.36.304 E019.47.59.536 Color_186ACI
N050.04.36.304 E019.47.59.536 N050.04.36.353 E019.47.59.466 Color_186ACI
N050.04.36.353 E019.47.59.466 N050.04.36.366 E019.47.59.386 Color_186ACI
N050.04.36.366 E019.47.59.386 N050.04.36.352 E019.47.59.305 Color_186ACI
N050.04.36.352 E019.47.59.305 N050.04.36.328 E019.47.59.260 Color_186ACI
N050.04.36.768 E019.47.59.270 N050.04.36.714 E019.47.59.233 Color_186ACI
N050.04.36.714 E019.47.59.233 N050.04.36.649 E019.47.59.253 Color_186ACI
N050.04.36.649 E019.47.59.253 N050.04.36.609 E019.47.59.317 Color_186ACI
N050.04.36.609 E019.47.59.317 N050.04.36.597 E019.47.59.422 Color_186ACI
N050.04.36.597 E019.47.59.422 N050.04.36.625 E019.47.59.509 Color_186ACI
N050.04.36.625 E019.47.59.509 N050.04.36.683 E019.47.59.558 Color_186ACI
N050.04.36.683 E019.47.59.558 N050.04.36.744 E019.47.59.546 Color_186ACI
N050.04.36.744 E019.47.59.546 N050.04.36.793 E019.47.59.477 Color_186ACI
N050.04.36.793 E019.47.59.477 N050.04.36.807 E019.47.59.396 Color_186ACI
N050.04.36.807 E019.47.59.396 N050.04.36.793 E019.47.59.315 Color_186ACI
N050.04.36.793 E019.47.59.315 N050.04.36.768 E019.47.59.270 Color_186ACI
N050.04.37.103 E019.47.58.860 N050.04.37.049 E019.47.58.824 Color_186ACI
N050.04.37.049 E019.47.58.824 N050.04.36.984 E019.47.58.844 Color_186ACI
N050.04.36.984 E019.47.58.844 N050.04.36.944 E019.47.58.908 Color_186ACI
N050.04.36.944 E019.47.58.908 N050.04.36.932 E019.47.59.013 Color_186ACI
N050.04.36.932 E019.47.59.013 N050.04.36.960 E019.47.59.100 Color_186ACI
N050.04.36.960 E019.47.59.100 N050.04.37.018 E019.47.59.148 Color_186ACI
N050.04.37.018 E019.47.59.148 N050.04.37.079 E019.47.59.137 Color_186ACI
N050.04.37.079 E019.47.59.137 N050.04.37.128 E019.47.59.067 Color_186ACI
N050.04.37.128 E019.47.59.067 N050.04.37.141 E019.47.58.987 Color_186ACI
N050.04.37.141 E019.47.58.987 N050.04.37.127 E019.47.58.906 Color_186ACI
N050.04.37.127 E019.47.58.906 N050.04.37.103 E019.47.58.860 Color_186ACI
N050.04.37.429 E019.47.58.442 N050.04.37.375 E019.47.58.406 Color_186ACI
N050.04.37.375 E019.47.58.406 N050.04.37.310 E019.47.58.426 Color_186ACI
N050.04.37.310 E019.47.58.426 N050.04.37.269 E019.47.58.489 Color_186ACI
N050.04.37.269 E019.47.58.489 N050.04.37.258 E019.47.58.594 Color_186ACI
N050.04.37.258 E019.47.58.594 N050.04.37.286 E019.47.58.682 Color_186ACI
N050.04.37.286 E019.47.58.682 N050.04.37.344 E019.47.58.730 Color_186ACI
N050.04.37.344 E019.47.58.730 N050.04.37.404 E019.47.58.718 Color_186ACI
N050.04.37.404 E019.47.58.718 N050.04.37.453 E019.47.58.649 Color_186ACI
N050.04.37.453 E019.47.58.649 N050.04.37.467 E019.47.58.569 Color_186ACI
N050.04.37.467 E019.47.58.569 N050.04.37.453 E019.47.58.487 Color_186ACI
N050.04.37.453 E019.47.58.487 N050.04.37.429 E019.47.58.442 Color_186ACI
N050.04.37.493 E019.47.57.799 N050.04.37.439 E019.47.57.762 Color_186ACI
N050.04.37.439 E019.47.57.762 N050.04.37.374 E019.47.57.782 Color_186ACI
N050.04.37.374 E019.47.57.782 N050.04.37.334 E019.47.57.846 Color_186ACI
N050.04.37.334 E019.47.57.846 N050.04.37.322 E019.47.57.951 Color_186ACI
N050.04.37.322 E019.47.57.951 N050.04.37.350 E019.47.58.038 Color_186ACI
N050.04.37.350 E019.47.58.038 N050.04.37.408 E019.47.58.087 Color_186ACI
N050.04.37.408 E019.47.58.087 N050.04.37.469 E019.47.58.075 Color_186ACI
N050.04.37.469 E019.47.58.075 N050.04.37.518 E019.47.58.006 Color_186ACI
N050.04.37.518 E019.47.58.006 N050.04.37.531 E019.47.57.925 Color_186ACI
N050.04.37.531 E019.47.57.925 N050.04.37.517 E019.47.57.844 Color_186ACI
N050.04.37.517 E019.47.57.844 N050.04.37.493 E019.47.57.799 Color_186ACI
N050.04.37.572 E019.47.57.140 N050.04.37.518 E019.47.57.103 Color_186ACI
N050.04.37.518 E019.47.57.103 N050.04.37.453 E019.47.57.123 Color_186ACI
N050.04.37.453 E019.47.57.123 N050.04.37.413 E019.47.57.187 Color_186ACI
N050.04.37.413 E019.47.57.187 N050.04.37.401 E019.47.57.292 Color_186ACI
N050.04.37.401 E019.47.57.292 N050.04.37.429 E019.47.57.379 Color_186ACI
N050.04.37.429 E019.47.57.379 N050.04.37.487 E019.47.57.428 Color_186ACI
N050.04.37.487 E019.47.57.428 N050.04.37.548 E019.47.57.416 Color_186ACI
N050.04.37.548 E019.47.57.416 N050.04.37.597 E019.47.57.347 Color_186ACI
N050.04.37.597 E019.47.57.347 N050.04.37.610 E019.47.57.266 Color_186ACI
N050.04.37.610 E019.47.57.266 N050.04.37.597 E019.47.57.185 Color_186ACI
N050.04.37.597 E019.47.57.185 N050.04.37.572 E019.47.57.140 Color_186ACI
N050.04.38.543 E019.47.56.891 N050.04.38.489 E019.47.56.855 Color_186ACI
N050.04.38.489 E019.47.56.855 N050.04.38.424 E019.47.56.875 Color_186ACI
N050.04.38.424 E019.47.56.875 N050.04.38.384 E019.47.56.939 Color_186ACI
N050.04.38.384 E019.47.56.939 N050.04.38.372 E019.47.57.044 Color_186ACI
N050.04.38.372 E019.47.57.044 N050.04.38.400 E019.47.57.131 Color_186ACI
N050.04.38.400 E019.47.57.131 N050.04.38.458 E019.47.57.179 Color_186ACI
N050.04.38.458 E019.47.57.179 N050.04.38.519 E019.47.57.167 Color_186ACI
N050.04.38.519 E019.47.57.167 N050.04.38.568 E019.47.57.098 Color_186ACI
N050.04.38.568 E019.47.57.098 N050.04.38.582 E019.47.57.018 Color_186ACI
N050.04.38.582 E019.47.57.018 N050.04.38.568 E019.47.56.936 Color_186ACI
N050.04.38.568 E019.47.56.936 N050.04.38.543 E019.47.56.891 Color_186ACI
N050.04.38.231 E019.47.54.630 N050.04.38.177 E019.47.54.594 Color_186ACI
N050.04.38.177 E019.47.54.594 N050.04.38.112 E019.47.54.614 Color_186ACI
N050.04.38.112 E019.47.54.614 N050.04.38.072 E019.47.54.677 Color_186ACI
N050.04.38.072 E019.47.54.677 N050.04.38.060 E019.47.54.782 Color_186ACI
N050.04.38.060 E019.47.54.782 N050.04.38.088 E019.47.54.870 Color_186ACI
N050.04.38.088 E019.47.54.870 N050.04.38.146 E019.47.54.918 Color_186ACI
N050.04.38.146 E019.47.54.918 N050.04.38.206 E019.47.54.906 Color_186ACI
N050.04.38.206 E019.47.54.906 N050.04.38.255 E019.47.54.837 Color_186ACI
N050.04.38.255 E019.47.54.837 N050.04.38.269 E019.47.54.757 Color_186ACI
N050.04.38.269 E019.47.54.757 N050.04.38.255 E019.47.54.675 Color_186ACI
N050.04.38.255 E019.47.54.675 N050.04.38.231 E019.47.54.630 Color_186ACI
N050.04.37.276 E019.47.54.949 N050.04.37.222 E019.47.54.913 Color_186ACI
N050.04.37.222 E019.47.54.913 N050.04.37.157 E019.47.54.933 Color_186ACI
N050.04.37.157 E019.47.54.933 N050.04.37.117 E019.47.54.997 Color_186ACI
N050.04.37.117 E019.47.54.997 N050.04.37.105 E019.47.55.102 Color_186ACI
N050.04.37.105 E019.47.55.102 N050.04.37.133 E019.47.55.189 Color_186ACI
N050.04.37.133 E019.47.55.189 N050.04.37.191 E019.47.55.237 Color_186ACI
N050.04.37.191 E019.47.55.237 N050.04.37.252 E019.47.55.226 Color_186ACI
N050.04.37.252 E019.47.55.226 N050.04.37.301 E019.47.55.156 Color_186ACI
N050.04.37.301 E019.47.55.156 N050.04.37.314 E019.47.55.076 Color_186ACI
N050.04.37.314 E019.47.55.076 N050.04.37.300 E019.47.54.994 Color_186ACI
N050.04.37.300 E019.47.54.994 N050.04.37.276 E019.47.54.949 Color_186ACI
N050.04.36.956 E019.47.52.586 N050.04.36.902 E019.47.52.550 Color_186ACI
N050.04.36.902 E019.47.52.550 N050.04.36.837 E019.47.52.570 Color_186ACI
N050.04.36.837 E019.47.52.570 N050.04.36.797 E019.47.52.634 Color_186ACI
N050.04.36.797 E019.47.52.634 N050.04.36.785 E019.47.52.739 Color_186ACI
N050.04.36.785 E019.47.52.739 N050.04.36.813 E019.47.52.826 Color_186ACI
N050.04.36.813 E019.47.52.826 N050.04.36.871 E019.47.52.874 Color_186ACI
N050.04.36.871 E019.47.52.874 N050.04.36.932 E019.47.52.862 Color_186ACI
N050.04.36.932 E019.47.52.862 N050.04.36.981 E019.47.52.793 Color_186ACI
N050.04.36.981 E019.47.52.793 N050.04.36.994 E019.47.52.713 Color_186ACI
N050.04.36.994 E019.47.52.713 N050.04.36.981 E019.47.52.631 Color_186ACI
N050.04.36.981 E019.47.52.631 N050.04.36.956 E019.47.52.586 Color_186ACI
N050.04.37.924 E019.47.52.246 N050.04.37.870 E019.47.52.210 Color_186ACI
N050.04.37.870 E019.47.52.210 N050.04.37.805 E019.47.52.230 Color_186ACI
N050.04.37.805 E019.47.52.230 N050.04.37.765 E019.47.52.294 Color_186ACI
N050.04.37.765 E019.47.52.294 N050.04.37.753 E019.47.52.399 Color_186ACI
N050.04.37.753 E019.47.52.399 N050.04.37.781 E019.47.52.486 Color_186ACI
N050.04.37.781 E019.47.52.486 N050.04.37.839 E019.47.52.534 Color_186ACI
N050.04.37.839 E019.47.52.534 N050.04.37.899 E019.47.52.523 Color_186ACI
N050.04.37.899 E019.47.52.523 N050.04.37.948 E019.47.52.453 Color_186ACI
N050.04.37.948 E019.47.52.453 N050.04.37.962 E019.47.52.373 Color_186ACI
N050.04.37.962 E019.47.52.373 N050.04.37.948 E019.47.52.291 Color_186ACI
N050.04.37.948 E019.47.52.291 N050.04.37.924 E019.47.52.246 Color_186ACI
N050.04.37.524 E019.47.49.484 N050.04.37.470 E019.47.49.448 Color_186ACI
N050.04.37.470 E019.47.49.448 N050.04.37.405 E019.47.49.468 Color_186ACI
N050.04.37.405 E019.47.49.468 N050.04.37.365 E019.47.49.532 Color_186ACI
N050.04.37.365 E019.47.49.532 N050.04.37.353 E019.47.49.637 Color_186ACI
N050.04.37.353 E019.47.49.637 N050.04.37.381 E019.47.49.724 Color_186ACI
N050.04.37.381 E019.47.49.724 N050.04.37.439 E019.47.49.772 Color_186ACI
N050.04.37.439 E019.47.49.772 N050.04.37.500 E019.47.49.760 Color_186ACI
N050.04.37.500 E019.47.49.760 N050.04.37.549 E019.47.49.691 Color_186ACI
N050.04.37.549 E019.47.49.691 N050.04.37.562 E019.47.49.611 Color_186ACI
N050.04.37.562 E019.47.49.611 N050.04.37.548 E019.47.49.529 Color_186ACI
N050.04.37.548 E019.47.49.529 N050.04.37.524 E019.47.49.484 Color_186ACI
N050.04.36.622 E019.47.50.472 N050.04.36.568 E019.47.50.436 Color_186ACI
N050.04.36.568 E019.47.50.436 N050.04.36.503 E019.47.50.456 Color_186ACI
N050.04.36.503 E019.47.50.456 N050.04.36.463 E019.47.50.519 Color_186ACI
N050.04.36.463 E019.47.50.519 N050.04.36.451 E019.47.50.624 Color_186ACI
N050.04.36.451 E019.47.50.624 N050.04.36.479 E019.47.50.712 Color_186ACI
N050.04.36.479 E019.47.50.712 N050.04.36.537 E019.47.50.760 Color_186ACI
N050.04.36.537 E019.47.50.760 N050.04.36.598 E019.47.50.748 Color_186ACI
N050.04.36.598 E019.47.50.748 N050.04.36.647 E019.47.50.679 Color_186ACI
N050.04.36.647 E019.47.50.679 N050.04.36.660 E019.47.50.599 Color_186ACI
N050.04.36.660 E019.47.50.599 N050.04.36.647 E019.47.50.517 Color_186ACI
N050.04.36.647 E019.47.50.517 N050.04.36.622 E019.47.50.472 Color_186ACI
N050.04.36.335 E019.47.50.384 N050.04.36.281 E019.47.50.348 Color_186ACI
N050.04.36.281 E019.47.50.348 N050.04.36.217 E019.47.50.368 Color_186ACI
N050.04.36.217 E019.47.50.368 N050.04.36.176 E019.47.50.432 Color_186ACI
N050.04.36.176 E019.47.50.432 N050.04.36.165 E019.47.50.537 Color_186ACI
N050.04.36.165 E019.47.50.537 N050.04.36.192 E019.47.50.624 Color_186ACI
N050.04.36.192 E019.47.50.624 N050.04.36.250 E019.47.50.672 Color_186ACI
N050.04.36.250 E019.47.50.672 N050.04.36.311 E019.47.50.660 Color_186ACI
N050.04.36.311 E019.47.50.660 N050.04.36.360 E019.47.50.591 Color_186ACI
N050.04.36.360 E019.47.50.591 N050.04.36.374 E019.47.50.511 Color_186ACI
N050.04.36.374 E019.47.50.511 N050.04.36.360 E019.47.50.429 Color_186ACI
N050.04.36.360 E019.47.50.429 N050.04.36.335 E019.47.50.384 Color_186ACI
N050.04.35.514 E019.47.52.354 N050.04.35.460 E019.47.52.318 Color_186ACI
N050.04.35.460 E019.47.52.318 N050.04.35.396 E019.47.52.338 Color_186ACI
N050.04.35.396 E019.47.52.338 N050.04.35.355 E019.47.52.402 Color_186ACI
N050.04.35.355 E019.47.52.402 N050.04.35.344 E019.47.52.507 Color_186ACI
N050.04.35.344 E019.47.52.507 N050.04.35.371 E019.47.52.594 Color_186ACI
N050.04.35.371 E019.47.52.594 N050.04.35.429 E019.47.52.642 Color_186ACI
N050.04.35.429 E019.47.52.642 N050.04.35.490 E019.47.52.631 Color_186ACI
N050.04.35.490 E019.47.52.631 N050.04.35.539 E019.47.52.561 Color_186ACI
N050.04.35.539 E019.47.52.561 N050.04.35.553 E019.47.52.481 Color_186ACI
N050.04.35.553 E019.47.52.481 N050.04.35.539 E019.47.52.399 Color_186ACI
N050.04.35.539 E019.47.52.399 N050.04.35.514 E019.47.52.354 Color_186ACI
N050.04.34.558 E019.47.54.711 N050.04.34.504 E019.47.54.674 Color_186ACI
N050.04.34.504 E019.47.54.674 N050.04.34.439 E019.47.54.694 Color_186ACI
N050.04.34.439 E019.47.54.694 N050.04.34.399 E019.47.54.758 Color_186ACI
N050.04.34.399 E019.47.54.758 N050.04.34.387 E019.47.54.863 Color_186ACI
N050.04.34.387 E019.47.54.863 N050.04.34.415 E019.47.54.950 Color_186ACI
N050.04.34.415 E019.47.54.950 N050.04.34.473 E019.47.54.999 Color_186ACI
N050.04.34.473 E019.47.54.999 N050.04.34.534 E019.47.54.987 Color_186ACI
N050.04.34.534 E019.47.54.987 N050.04.34.583 E019.47.54.917 Color_186ACI
N050.04.34.583 E019.47.54.917 N050.04.34.596 E019.47.54.837 Color_186ACI
N050.04.34.596 E019.47.54.837 N050.04.34.583 E019.47.54.756 Color_186ACI
N050.04.34.583 E019.47.54.756 N050.04.34.558 E019.47.54.711 Color_186ACI
N050.04.33.565 E019.47.57.143 N050.04.33.511 E019.47.57.107 Color_186ACI
N050.04.33.511 E019.47.57.107 N050.04.33.446 E019.47.57.127 Color_186ACI
N050.04.33.446 E019.47.57.127 N050.04.33.406 E019.47.57.191 Color_186ACI
N050.04.33.406 E019.47.57.191 N050.04.33.394 E019.47.57.296 Color_186ACI
N050.04.33.394 E019.47.57.296 N050.04.33.422 E019.47.57.383 Color_186ACI
N050.04.33.422 E019.47.57.383 N050.04.33.480 E019.47.57.431 Color_186ACI
N050.04.33.480 E019.47.57.431 N050.04.33.541 E019.47.57.419 Color_186ACI
N050.04.33.541 E019.47.57.419 N050.04.33.590 E019.47.57.350 Color_186ACI
N050.04.33.590 E019.47.57.350 N050.04.33.603 E019.47.57.270 Color_186ACI
N050.04.33.603 E019.47.57.270 N050.04.33.590 E019.47.57.188 Color_186ACI
N050.04.33.590 E019.47.57.188 N050.04.33.565 E019.47.57.143 Color_186ACI
N050.04.33.689 E019.47.57.650 N050.04.33.635 E019.47.57.614 Color_186ACI
N050.04.33.635 E019.47.57.614 N050.04.33.570 E019.47.57.634 Color_186ACI
N050.04.33.570 E019.47.57.634 N050.04.33.530 E019.47.57.698 Color_186ACI
N050.04.33.530 E019.47.57.698 N050.04.33.518 E019.47.57.803 Color_186ACI
N050.04.33.518 E019.47.57.803 N050.04.33.546 E019.47.57.890 Color_186ACI
N050.04.33.546 E019.47.57.890 N050.04.33.604 E019.47.57.938 Color_186ACI
N050.04.33.604 E019.47.57.938 N050.04.33.664 E019.47.57.927 Color_186ACI
N050.04.33.664 E019.47.57.927 N050.04.33.713 E019.47.57.857 Color_186ACI
N050.04.33.713 E019.47.57.857 N050.04.33.727 E019.47.57.777 Color_186ACI
N050.04.33.727 E019.47.57.777 N050.04.33.713 E019.47.57.695 Color_186ACI
N050.04.33.713 E019.47.57.695 N050.04.33.689 E019.47.57.650 Color_186ACI
N050.04.32.856 E019.47.58.989 N050.04.32.801 E019.47.58.953 Color_186ACI
N050.04.32.801 E019.47.58.953 N050.04.32.737 E019.47.58.973 Color_186ACI
N050.04.32.737 E019.47.58.973 N050.04.32.696 E019.47.59.037 Color_186ACI
N050.04.32.696 E019.47.59.037 N050.04.32.685 E019.47.59.142 Color_186ACI
N050.04.32.685 E019.47.59.142 N050.04.32.713 E019.47.59.229 Color_186ACI
N050.04.32.713 E019.47.59.229 N050.04.32.771 E019.47.59.277 Color_186ACI
N050.04.32.771 E019.47.59.277 N050.04.32.831 E019.47.59.266 Color_186ACI
N050.04.32.831 E019.47.59.266 N050.04.32.880 E019.47.59.196 Color_186ACI
N050.04.32.880 E019.47.59.196 N050.04.32.894 E019.47.59.116 Color_186ACI
N050.04.32.894 E019.47.59.116 N050.04.32.880 E019.47.59.035 Color_186ACI
N050.04.32.880 E019.47.59.035 N050.04.32.856 E019.47.58.989 Color_186ACI
N050.04.32.412 E019.47.58.977 N050.04.32.358 E019.47.58.940 Color_186ACI
N050.04.32.358 E019.47.58.940 N050.04.32.293 E019.47.58.960 Color_186ACI
N050.04.32.293 E019.47.58.960 N050.04.32.253 E019.47.59.024 Color_186ACI
N050.04.32.253 E019.47.59.024 N050.04.32.241 E019.47.59.129 Color_186ACI
N050.04.32.241 E019.47.59.129 N050.04.32.269 E019.47.59.216 Color_186ACI
N050.04.32.269 E019.47.59.216 N050.04.32.327 E019.47.59.265 Color_186ACI
N050.04.32.327 E019.47.59.265 N050.04.32.387 E019.47.59.253 Color_186ACI
N050.04.32.387 E019.47.59.253 N050.04.32.436 E019.47.59.183 Color_186ACI
N050.04.32.436 E019.47.59.183 N050.04.32.450 E019.47.59.103 Color_186ACI
N050.04.32.450 E019.47.59.103 N050.04.32.436 E019.47.59.022 Color_186ACI
N050.04.32.436 E019.47.59.022 N050.04.32.412 E019.47.58.977 Color_186ACI
N050.04.31.284 E019.47.59.343 N050.04.31.230 E019.47.59.307 Color_186ACI
N050.04.31.230 E019.47.59.307 N050.04.31.165 E019.47.59.327 Color_186ACI
N050.04.31.165 E019.47.59.327 N050.04.31.125 E019.47.59.391 Color_186ACI
N050.04.31.125 E019.47.59.391 N050.04.31.113 E019.47.59.496 Color_186ACI
N050.04.31.113 E019.47.59.496 N050.04.31.141 E019.47.59.583 Color_186ACI
N050.04.31.141 E019.47.59.583 N050.04.31.199 E019.47.59.631 Color_186ACI
N050.04.31.199 E019.47.59.631 N050.04.31.260 E019.47.59.620 Color_186ACI
N050.04.31.260 E019.47.59.620 N050.04.31.309 E019.47.59.550 Color_186ACI
N050.04.31.309 E019.47.59.550 N050.04.31.322 E019.47.59.470 Color_186ACI
N050.04.31.322 E019.47.59.470 N050.04.31.308 E019.47.59.388 Color_186ACI
N050.04.31.308 E019.47.59.388 N050.04.31.284 E019.47.59.343 Color_186ACI
N050.04.29.900 E019.47.58.204 N050.04.29.846 E019.47.58.168 Color_186ACI
N050.04.29.846 E019.47.58.168 N050.04.29.781 E019.47.58.188 Color_186ACI
N050.04.29.781 E019.47.58.188 N050.04.29.741 E019.47.58.252 Color_186ACI
N050.04.29.741 E019.47.58.252 N050.04.29.729 E019.47.58.357 Color_186ACI
N050.04.29.729 E019.47.58.357 N050.04.29.757 E019.47.58.444 Color_186ACI
N050.04.29.757 E019.47.58.444 N050.04.29.815 E019.47.58.492 Color_186ACI
N050.04.29.815 E019.47.58.492 N050.04.29.876 E019.47.58.480 Color_186ACI
N050.04.29.876 E019.47.58.480 N050.04.29.925 E019.47.58.411 Color_186ACI
N050.04.29.925 E019.47.58.411 N050.04.29.938 E019.47.58.331 Color_186ACI
N050.04.29.938 E019.47.58.331 N050.04.29.925 E019.47.58.249 Color_186ACI
N050.04.29.925 E019.47.58.249 N050.04.29.900 E019.47.58.204 Color_186ACI
N050.04.31.072 E019.47.57.823 N050.04.31.018 E019.47.57.787 Color_186ACI
N050.04.31.018 E019.47.57.787 N050.04.30.953 E019.47.57.807 Color_186ACI
N050.04.30.953 E019.47.57.807 N050.04.30.913 E019.47.57.871 Color_186ACI
N050.04.30.913 E019.47.57.871 N050.04.30.901 E019.47.57.976 Color_186ACI
N050.04.30.901 E019.47.57.976 N050.04.30.929 E019.47.58.063 Color_186ACI
N050.04.30.929 E019.47.58.063 N050.04.30.987 E019.47.58.111 Color_186ACI
N050.04.30.987 E019.47.58.111 N050.04.31.047 E019.47.58.100 Color_186ACI
N050.04.31.047 E019.47.58.100 N050.04.31.097 E019.47.58.030 Color_186ACI
N050.04.31.097 E019.47.58.030 N050.04.31.110 E019.47.57.950 Color_186ACI
N050.04.31.110 E019.47.57.950 N050.04.31.096 E019.47.57.869 Color_186ACI
N050.04.31.096 E019.47.57.869 N050.04.31.072 E019.47.57.823 Color_186ACI
N050.04.32.229 E019.47.57.080 N050.04.32.175 E019.47.57.044 Color_186ACI
N050.04.32.175 E019.47.57.044 N050.04.32.110 E019.47.57.064 Color_186ACI
N050.04.32.110 E019.47.57.064 N050.04.32.070 E019.47.57.128 Color_186ACI
N050.04.32.070 E019.47.57.128 N050.04.32.058 E019.47.57.233 Color_186ACI
N050.04.32.058 E019.47.57.233 N050.04.32.086 E019.47.57.320 Color_186ACI
N050.04.32.086 E019.47.57.320 N050.04.32.144 E019.47.57.368 Color_186ACI
N050.04.32.144 E019.47.57.368 N050.04.32.205 E019.47.57.357 Color_186ACI
N050.04.32.205 E019.47.57.357 N050.04.32.254 E019.47.57.287 Color_186ACI
N050.04.32.254 E019.47.57.287 N050.04.32.267 E019.47.57.207 Color_186ACI
N050.04.32.267 E019.47.57.207 N050.04.32.254 E019.47.57.125 Color_186ACI
N050.04.32.254 E019.47.57.125 N050.04.32.229 E019.47.57.080 Color_186ACI
N050.04.32.561 E019.47.56.672 N050.04.32.506 E019.47.56.636 Color_186ACI
N050.04.32.506 E019.47.56.636 N050.04.32.442 E019.47.56.656 Color_186ACI
N050.04.32.442 E019.47.56.656 N050.04.32.401 E019.47.56.720 Color_186ACI
N050.04.32.401 E019.47.56.720 N050.04.32.390 E019.47.56.825 Color_186ACI
N050.04.32.390 E019.47.56.825 N050.04.32.418 E019.47.56.912 Color_186ACI
N050.04.32.418 E019.47.56.912 N050.04.32.476 E019.47.56.960 Color_186ACI
N050.04.32.476 E019.47.56.960 N050.04.32.536 E019.47.56.949 Color_186ACI
N050.04.32.536 E019.47.56.949 N050.04.32.585 E019.47.56.879 Color_186ACI
N050.04.32.585 E019.47.56.879 N050.04.32.599 E019.47.56.799 Color_186ACI
N050.04.32.599 E019.47.56.799 N050.04.32.585 E019.47.56.718 Color_186ACI
N050.04.32.585 E019.47.56.718 N050.04.32.561 E019.47.56.672 Color_186ACI
N050.04.32.931 E019.47.55.829 N050.04.32.877 E019.47.55.793 Color_186ACI
N050.04.32.877 E019.47.55.793 N050.04.32.812 E019.47.55.813 Color_186ACI
N050.04.32.812 E019.47.55.813 N050.04.32.772 E019.47.55.877 Color_186ACI
N050.04.32.772 E019.47.55.877 N050.04.32.760 E019.47.55.981 Color_186ACI
N050.04.32.760 E019.47.55.981 N050.04.32.788 E019.47.56.069 Color_186ACI
N050.04.32.788 E019.47.56.069 N050.04.32.846 E019.47.56.117 Color_186ACI
N050.04.32.846 E019.47.56.117 N050.04.32.907 E019.47.56.105 Color_186ACI
N050.04.32.907 E019.47.56.105 N050.04.32.956 E019.47.56.036 Color_186ACI
N050.04.32.956 E019.47.56.036 N050.04.32.970 E019.47.55.956 Color_186ACI
N050.04.32.970 E019.47.55.956 N050.04.32.956 E019.47.55.874 Color_186ACI
N050.04.32.956 E019.47.55.874 N050.04.32.931 E019.47.55.829 Color_186ACI
N050.04.33.722 E019.47.53.887 N050.04.33.667 E019.47.53.851 Color_186ACI
N050.04.33.667 E019.47.53.851 N050.04.33.603 E019.47.53.871 Color_186ACI
N050.04.33.603 E019.47.53.871 N050.04.33.562 E019.47.53.934 Color_186ACI
N050.04.33.562 E019.47.53.934 N050.04.33.551 E019.47.54.039 Color_186ACI
N050.04.33.551 E019.47.54.039 N050.04.33.579 E019.47.54.127 Color_186ACI
N050.04.33.579 E019.47.54.127 N050.04.33.637 E019.47.54.175 Color_186ACI
N050.04.33.637 E019.47.54.175 N050.04.33.697 E019.47.54.163 Color_186ACI
N050.04.33.697 E019.47.54.163 N050.04.33.746 E019.47.54.094 Color_186ACI
N050.04.33.746 E019.47.54.094 N050.04.33.760 E019.47.54.014 Color_186ACI
N050.04.33.760 E019.47.54.014 N050.04.33.746 E019.47.53.932 Color_186ACI
N050.04.33.746 E019.47.53.932 N050.04.33.722 E019.47.53.887 Color_186ACI
N050.04.34.644 E019.47.51.616 N050.04.34.590 E019.47.51.580 Color_186ACI
N050.04.34.590 E019.47.51.580 N050.04.34.525 E019.47.51.600 Color_186ACI
N050.04.34.525 E019.47.51.600 N050.04.34.485 E019.47.51.664 Color_186ACI
N050.04.34.485 E019.47.51.664 N050.04.34.473 E019.47.51.769 Color_186ACI
N050.04.34.473 E019.47.51.769 N050.04.34.501 E019.47.51.856 Color_186ACI
N050.04.34.501 E019.47.51.856 N050.04.34.559 E019.47.51.904 Color_186ACI
N050.04.34.559 E019.47.51.904 N050.04.34.620 E019.47.51.893 Color_186ACI
N050.04.34.620 E019.47.51.893 N050.04.34.669 E019.47.51.823 Color_186ACI
N050.04.34.669 E019.47.51.823 N050.04.34.682 E019.47.51.743 Color_186ACI
N050.04.34.682 E019.47.51.743 N050.04.34.669 E019.47.51.661 Color_186ACI
N050.04.34.669 E019.47.51.661 N050.04.34.644 E019.47.51.616 Color_186ACI
N050.04.35.622 E019.47.49.194 N050.04.35.568 E019.47.49.158 Color_186ACI
N050.04.35.568 E019.47.49.158 N050.04.35.504 E019.47.49.178 Color_186ACI
N050.04.35.504 E019.47.49.178 N050.04.35.463 E019.47.49.242 Color_186ACI
N050.04.35.463 E019.47.49.242 N050.04.35.452 E019.47.49.346 Color_186ACI
N050.04.35.452 E019.47.49.346 N050.04.35.480 E019.47.49.434 Color_186ACI
N050.04.35.480 E019.47.49.434 N050.04.35.537 E019.47.49.482 Color_186ACI
N050.04.35.537 E019.47.49.482 N050.04.35.598 E019.47.49.470 Color_186ACI
N050.04.35.598 E019.47.49.470 N050.04.35.647 E019.47.49.401 Color_186ACI
N050.04.35.647 E019.47.49.401 N050.04.35.661 E019.47.49.321 Color_186ACI
N050.04.35.661 E019.47.49.321 N050.04.35.647 E019.47.49.239 Color_186ACI
N050.04.35.647 E019.47.49.239 N050.04.35.622 E019.47.49.194 Color_186ACI
N050.04.35.993 E019.47.47.976 N050.04.35.939 E019.47.47.940 Color_186ACI
N050.04.35.939 E019.47.47.940 N050.04.35.875 E019.47.47.960 Color_186ACI
N050.04.35.875 E019.47.47.960 N050.04.35.834 E019.47.48.024 Color_186ACI
N050.04.35.834 E019.47.48.024 N050.04.35.823 E019.47.48.129 Color_186ACI
N050.04.35.823 E019.47.48.129 N050.04.35.850 E019.47.48.216 Color_186ACI
N050.04.35.850 E019.47.48.216 N050.04.35.908 E019.47.48.264 Color_186ACI
N050.04.35.908 E019.47.48.264 N050.04.35.969 E019.47.48.252 Color_186ACI
N050.04.35.969 E019.47.48.252 N050.04.36.018 E019.47.48.183 Color_186ACI
N050.04.36.018 E019.47.48.183 N050.04.36.032 E019.47.48.103 Color_186ACI
N050.04.36.032 E019.47.48.103 N050.04.36.018 E019.47.48.021 Color_186ACI
N050.04.36.018 E019.47.48.021 N050.04.35.993 E019.47.47.976 Color_186ACI
N050.04.36.082 E019.47.47.196 N050.04.36.027 E019.47.47.159 Color_186ACI
N050.04.36.027 E019.47.47.159 N050.04.35.963 E019.47.47.179 Color_186ACI
N050.04.35.963 E019.47.47.179 N050.04.35.922 E019.47.47.243 Color_186ACI
N050.04.35.922 E019.47.47.243 N050.04.35.911 E019.47.47.348 Color_186ACI
N050.04.35.911 E019.47.47.348 N050.04.35.939 E019.47.47.435 Color_186ACI
N050.04.35.939 E019.47.47.435 N050.04.35.997 E019.47.47.484 Color_186ACI
N050.04.35.997 E019.47.47.484 N050.04.36.057 E019.47.47.472 Color_186ACI
N050.04.36.057 E019.47.47.472 N050.04.36.106 E019.47.47.402 Color_186ACI
N050.04.36.106 E019.47.47.402 N050.04.36.120 E019.47.47.322 Color_186ACI
N050.04.36.120 E019.47.47.322 N050.04.36.106 E019.47.47.241 Color_186ACI
N050.04.36.106 E019.47.47.241 N050.04.36.082 E019.47.47.196 Color_186ACI
N050.04.36.046 E019.47.46.518 N050.04.35.992 E019.47.46.482 Color_186ACI
N050.04.35.992 E019.47.46.482 N050.04.35.927 E019.47.46.502 Color_186ACI
N050.04.35.927 E019.47.46.502 N050.04.35.887 E019.47.46.566 Color_186ACI
N050.04.35.887 E019.47.46.566 N050.04.35.875 E019.47.46.671 Color_186ACI
N050.04.35.875 E019.47.46.671 N050.04.35.903 E019.47.46.758 Color_186ACI
N050.04.35.903 E019.47.46.758 N050.04.35.961 E019.47.46.806 Color_186ACI
N050.04.35.961 E019.47.46.806 N050.04.36.021 E019.47.46.794 Color_186ACI
N050.04.36.021 E019.47.46.794 N050.04.36.070 E019.47.46.725 Color_186ACI
N050.04.36.070 E019.47.46.725 N050.04.36.084 E019.47.46.645 Color_186ACI
N050.04.36.084 E019.47.46.645 N050.04.36.070 E019.47.46.563 Color_186ACI
N050.04.36.070 E019.47.46.563 N050.04.36.046 E019.47.46.518 Color_186ACI
N050.04.37.118 E019.47.46.505 N050.04.37.064 E019.47.46.468 Color_186ACI
N050.04.37.064 E019.47.46.468 N050.04.37.000 E019.47.46.488 Color_186ACI
N050.04.37.000 E019.47.46.488 N050.04.36.959 E019.47.46.552 Color_186ACI
N050.04.36.959 E019.47.46.552 N050.04.36.948 E019.47.46.657 Color_186ACI
N050.04.36.948 E019.47.46.657 N050.04.36.975 E019.47.46.744 Color_186ACI
N050.04.36.975 E019.47.46.744 N050.04.37.033 E019.47.46.793 Color_186ACI
N050.04.37.033 E019.47.46.793 N050.04.37.094 E019.47.46.781 Color_186ACI
N050.04.37.094 E019.47.46.781 N050.04.37.143 E019.47.46.711 Color_186ACI
N050.04.37.143 E019.47.46.711 N050.04.37.157 E019.47.46.631 Color_186ACI
N050.04.37.157 E019.47.46.631 N050.04.37.143 E019.47.46.550 Color_186ACI
N050.04.37.143 E019.47.46.550 N050.04.37.118 E019.47.46.505 Color_186ACI
N050.04.35.754 E019.47.43.911 N050.04.35.700 E019.47.43.874 Color_186ACI
N050.04.35.700 E019.47.43.874 N050.04.35.635 E019.47.43.894 Color_186ACI
N050.04.35.635 E019.47.43.894 N050.04.35.595 E019.47.43.958 Color_186ACI
N050.04.35.595 E019.47.43.958 N050.04.35.583 E019.47.44.063 Color_186ACI
N050.04.35.583 E019.47.44.063 N050.04.35.611 E019.47.44.150 Color_186ACI
N050.04.35.611 E019.47.44.150 N050.04.35.669 E019.47.44.199 Color_186ACI
N050.04.35.669 E019.47.44.199 N050.04.35.730 E019.47.44.187 Color_186ACI
N050.04.35.730 E019.47.44.187 N050.04.35.779 E019.47.44.117 Color_186ACI
N050.04.35.779 E019.47.44.117 N050.04.35.792 E019.47.44.037 Color_186ACI
N050.04.35.792 E019.47.44.037 N050.04.35.778 E019.47.43.956 Color_186ACI
N050.04.35.778 E019.47.43.956 N050.04.35.754 E019.47.43.911 Color_186ACI
N050.04.36.722 E019.47.43.586 N050.04.36.668 E019.47.43.550 Color_186ACI
N050.04.36.668 E019.47.43.550 N050.04.36.604 E019.47.43.570 Color_186ACI
N050.04.36.604 E019.47.43.570 N050.04.36.563 E019.47.43.634 Color_186ACI
N050.04.36.563 E019.47.43.634 N050.04.36.552 E019.47.43.739 Color_186ACI
N050.04.36.552 E019.47.43.739 N050.04.36.579 E019.47.43.826 Color_186ACI
N050.04.36.579 E019.47.43.826 N050.04.36.637 E019.47.43.874 Color_186ACI
N050.04.36.637 E019.47.43.874 N050.04.36.698 E019.47.43.863 Color_186ACI
N050.04.36.698 E019.47.43.863 N050.04.36.747 E019.47.43.793 Color_186ACI
N050.04.36.747 E019.47.43.793 N050.04.36.761 E019.47.43.713 Color_186ACI
N050.04.36.761 E019.47.43.713 N050.04.36.747 E019.47.43.632 Color_186ACI
N050.04.36.747 E019.47.43.632 N050.04.36.722 E019.47.43.586 Color_186ACI
N050.04.35.339 E019.47.40.908 N050.04.35.285 E019.47.40.872 Color_186ACI
N050.04.35.285 E019.47.40.872 N050.04.35.221 E019.47.40.892 Color_186ACI
N050.04.35.221 E019.47.40.892 N050.04.35.180 E019.47.40.956 Color_186ACI
N050.04.35.180 E019.47.40.956 N050.04.35.169 E019.47.41.061 Color_186ACI
N050.04.35.169 E019.47.41.061 N050.04.35.197 E019.47.41.148 Color_186ACI
N050.04.35.197 E019.47.41.148 N050.04.35.255 E019.47.41.196 Color_186ACI
N050.04.35.255 E019.47.41.196 N050.04.35.315 E019.47.41.184 Color_186ACI
N050.04.35.315 E019.47.41.184 N050.04.35.364 E019.47.41.115 Color_186ACI
N050.04.35.364 E019.47.41.115 N050.04.35.378 E019.47.41.035 Color_186ACI
N050.04.35.378 E019.47.41.035 N050.04.35.364 E019.47.40.953 Color_186ACI
N050.04.35.364 E019.47.40.953 N050.04.35.339 E019.47.40.908 Color_186ACI
N050.04.36.311 E019.47.40.579 N050.04.36.257 E019.47.40.543 Color_186ACI
N050.04.36.257 E019.47.40.543 N050.04.36.192 E019.47.40.563 Color_186ACI
N050.04.36.192 E019.47.40.563 N050.04.36.151 E019.47.40.627 Color_186ACI
N050.04.36.151 E019.47.40.627 N050.04.36.140 E019.47.40.732 Color_186ACI
N050.04.36.140 E019.47.40.732 N050.04.36.168 E019.47.40.819 Color_186ACI
N050.04.36.168 E019.47.40.819 N050.04.36.226 E019.47.40.867 Color_186ACI
N050.04.36.226 E019.47.40.867 N050.04.36.286 E019.47.40.855 Color_186ACI
N050.04.36.286 E019.47.40.855 N050.04.36.335 E019.47.40.786 Color_186ACI
N050.04.36.335 E019.47.40.786 N050.04.36.349 E019.47.40.706 Color_186ACI
N050.04.36.349 E019.47.40.706 N050.04.36.335 E019.47.40.624 Color_186ACI
N050.04.36.335 E019.47.40.624 N050.04.36.311 E019.47.40.579 Color_186ACI
N050.04.34.936 E019.47.37.927 N050.04.34.882 E019.47.37.891 Color_186ACI
N050.04.34.882 E019.47.37.891 N050.04.34.817 E019.47.37.911 Color_186ACI
N050.04.34.817 E019.47.37.911 N050.04.34.777 E019.47.37.974 Color_186ACI
N050.04.34.777 E019.47.37.974 N050.04.34.765 E019.47.38.079 Color_186ACI
N050.04.34.765 E019.47.38.079 N050.04.34.793 E019.47.38.167 Color_186ACI
N050.04.34.793 E019.47.38.167 N050.04.34.851 E019.47.38.215 Color_186ACI
N050.04.34.851 E019.47.38.215 N050.04.34.912 E019.47.38.203 Color_186ACI
N050.04.34.912 E019.47.38.203 N050.04.34.961 E019.47.38.134 Color_186ACI
N050.04.34.961 E019.47.38.134 N050.04.34.974 E019.47.38.054 Color_186ACI
N050.04.34.974 E019.47.38.054 N050.04.34.961 E019.47.37.972 Color_186ACI
N050.04.34.961 E019.47.37.972 N050.04.34.936 E019.47.37.927 Color_186ACI
N050.04.35.905 E019.47.37.607 N050.04.35.851 E019.47.37.570 Color_186ACI
N050.04.35.851 E019.47.37.570 N050.04.35.786 E019.47.37.590 Color_186ACI
N050.04.35.786 E019.47.37.590 N050.04.35.746 E019.47.37.654 Color_186ACI
N050.04.35.746 E019.47.37.654 N050.04.35.734 E019.47.37.759 Color_186ACI
N050.04.35.734 E019.47.37.759 N050.04.35.762 E019.47.37.846 Color_186ACI
N050.04.35.762 E019.47.37.846 N050.04.35.820 E019.47.37.895 Color_186ACI
N050.04.35.820 E019.47.37.895 N050.04.35.881 E019.47.37.883 Color_186ACI
N050.04.35.881 E019.47.37.883 N050.04.35.930 E019.47.37.813 Color_186ACI
N050.04.35.930 E019.47.37.813 N050.04.35.944 E019.47.37.733 Color_186ACI
N050.04.35.944 E019.47.37.733 N050.04.35.930 E019.47.37.652 Color_186ACI
N050.04.35.930 E019.47.37.652 N050.04.35.905 E019.47.37.607 Color_186ACI
N050.04.34.530 E019.47.34.957 N050.04.34.476 E019.47.34.920 Color_186ACI
N050.04.34.476 E019.47.34.920 N050.04.34.411 E019.47.34.941 Color_186ACI
N050.04.34.411 E019.47.34.941 N050.04.34.371 E019.47.35.004 Color_186ACI
N050.04.34.371 E019.47.35.004 N050.04.34.359 E019.47.35.109 Color_186ACI
N050.04.34.359 E019.47.35.109 N050.04.34.387 E019.47.35.197 Color_186ACI
N050.04.34.387 E019.47.35.197 N050.04.34.445 E019.47.35.245 Color_186ACI
N050.04.34.445 E019.47.35.245 N050.04.34.506 E019.47.35.233 Color_186ACI
N050.04.34.506 E019.47.35.233 N050.04.34.555 E019.47.35.164 Color_186ACI
N050.04.34.555 E019.47.35.164 N050.04.34.569 E019.47.35.084 Color_186ACI
N050.04.34.569 E019.47.35.084 N050.04.34.555 E019.47.35.002 Color_186ACI
N050.04.34.555 E019.47.35.002 N050.04.34.530 E019.47.34.957 Color_186ACI
N050.04.34.133 E019.47.32.069 N050.04.34.079 E019.47.32.033 Color_186ACI
N050.04.34.079 E019.47.32.033 N050.04.34.014 E019.47.32.053 Color_186ACI
N050.04.34.014 E019.47.32.053 N050.04.33.974 E019.47.32.117 Color_186ACI
N050.04.33.974 E019.47.32.117 N050.04.33.962 E019.47.32.222 Color_186ACI
N050.04.33.962 E019.47.32.222 N050.04.33.990 E019.47.32.309 Color_186ACI
N050.04.33.990 E019.47.32.309 N050.04.34.048 E019.47.32.357 Color_186ACI
N050.04.34.048 E019.47.32.357 N050.04.34.109 E019.47.32.345 Color_186ACI
N050.04.34.109 E019.47.32.345 N050.04.34.158 E019.47.32.276 Color_186ACI
N050.04.34.158 E019.47.32.276 N050.04.34.171 E019.47.32.196 Color_186ACI
N050.04.34.171 E019.47.32.196 N050.04.34.157 E019.47.32.114 Color_186ACI
N050.04.34.157 E019.47.32.114 N050.04.34.133 E019.47.32.069 Color_186ACI
N050.04.35.492 E019.47.34.610 N050.04.35.438 E019.47.34.574 Color_186ACI
N050.04.35.438 E019.47.34.574 N050.04.35.373 E019.47.34.594 Color_186ACI
N050.04.35.373 E019.47.34.594 N050.04.35.333 E019.47.34.658 Color_186ACI
N050.04.35.333 E019.47.34.658 N050.04.35.321 E019.47.34.763 Color_186ACI
N050.04.35.321 E019.47.34.763 N050.04.35.349 E019.47.34.850 Color_186ACI
N050.04.35.349 E019.47.34.850 N050.04.35.407 E019.47.34.898 Color_186ACI
N050.04.35.407 E019.47.34.898 N050.04.35.468 E019.47.34.887 Color_186ACI
N050.04.35.468 E019.47.34.887 N050.04.35.517 E019.47.34.817 Color_186ACI
N050.04.35.517 E019.47.34.817 N050.04.35.530 E019.47.34.737 Color_186ACI
N050.04.35.530 E019.47.34.737 N050.04.35.517 E019.47.34.655 Color_186ACI
N050.04.35.517 E019.47.34.655 N050.04.35.492 E019.47.34.610 Color_186ACI
N050.04.42.337 E019.47.29.915 N050.04.42.283 E019.47.29.878 Color_186ACI
N050.04.42.283 E019.47.29.878 N050.04.42.218 E019.47.29.899 Color_186ACI
N050.04.42.218 E019.47.29.899 N050.04.42.178 E019.47.29.962 Color_186ACI
N050.04.42.178 E019.47.29.962 N050.04.42.166 E019.47.30.067 Color_186ACI
N050.04.42.166 E019.47.30.067 N050.04.42.194 E019.47.30.155 Color_186ACI
N050.04.42.194 E019.47.30.155 N050.04.42.252 E019.47.30.203 Color_186ACI
N050.04.42.252 E019.47.30.203 N050.04.42.313 E019.47.30.191 Color_186ACI
N050.04.42.313 E019.47.30.191 N050.04.42.362 E019.47.30.122 Color_186ACI
N050.04.42.362 E019.47.30.122 N050.04.42.375 E019.47.30.042 Color_186ACI
N050.04.42.375 E019.47.30.042 N050.04.42.362 E019.47.29.960 Color_186ACI
N050.04.42.362 E019.47.29.960 N050.04.42.337 E019.47.29.915 Color_186ACI
N050.04.42.160 E019.47.29.457 N050.04.42.106 E019.47.29.421 Color_186ACI
N050.04.42.106 E019.47.29.421 N050.04.42.041 E019.47.29.441 Color_186ACI
N050.04.42.041 E019.47.29.441 N050.04.42.001 E019.47.29.505 Color_186ACI
N050.04.42.001 E019.47.29.505 N050.04.41.989 E019.47.29.609 Color_186ACI
N050.04.41.989 E019.47.29.609 N050.04.42.017 E019.47.29.697 Color_186ACI
N050.04.42.017 E019.47.29.697 N050.04.42.075 E019.47.29.745 Color_186ACI
N050.04.42.075 E019.47.29.745 N050.04.42.136 E019.47.29.733 Color_186ACI
N050.04.42.136 E019.47.29.733 N050.04.42.185 E019.47.29.664 Color_186ACI
N050.04.42.185 E019.47.29.664 N050.04.42.198 E019.47.29.584 Color_186ACI
N050.04.42.198 E019.47.29.584 N050.04.42.184 E019.47.29.502 Color_186ACI
N050.04.42.184 E019.47.29.502 N050.04.42.160 E019.47.29.457 Color_186ACI
N050.04.41.795 E019.47.29.031 N050.04.41.741 E019.47.28.995 Color_186ACI
N050.04.41.741 E019.47.28.995 N050.04.41.677 E019.47.29.015 Color_186ACI
N050.04.41.677 E019.47.29.015 N050.04.41.636 E019.47.29.079 Color_186ACI
N050.04.41.636 E019.47.29.079 N050.04.41.625 E019.47.29.184 Color_186ACI
N050.04.41.625 E019.47.29.184 N050.04.41.653 E019.47.29.271 Color_186ACI
N050.04.41.653 E019.47.29.271 N050.04.41.710 E019.47.29.319 Color_186ACI
N050.04.41.710 E019.47.29.319 N050.04.41.771 E019.47.29.308 Color_186ACI
N050.04.41.771 E019.47.29.308 N050.04.41.820 E019.47.29.238 Color_186ACI
N050.04.41.820 E019.47.29.238 N050.04.41.834 E019.47.29.158 Color_186ACI
N050.04.41.834 E019.47.29.158 N050.04.41.820 E019.47.29.076 Color_186ACI
N050.04.41.820 E019.47.29.076 N050.04.41.795 E019.47.29.031 Color_186ACI
N050.04.41.636 E019.47.26.000 N050.04.41.581 E019.47.25.964 Color_186ACI
N050.04.41.581 E019.47.25.964 N050.04.41.517 E019.47.25.984 Color_186ACI
N050.04.41.517 E019.47.25.984 N050.04.41.476 E019.47.26.048 Color_186ACI
N050.04.41.476 E019.47.26.048 N050.04.41.465 E019.47.26.153 Color_186ACI
N050.04.41.465 E019.47.26.153 N050.04.41.493 E019.47.26.240 Color_186ACI
N050.04.41.493 E019.47.26.240 N050.04.41.551 E019.47.26.288 Color_186ACI
N050.04.41.551 E019.47.26.288 N050.04.41.611 E019.47.26.277 Color_186ACI
N050.04.41.611 E019.47.26.277 N050.04.41.660 E019.47.26.207 Color_186ACI
N050.04.41.660 E019.47.26.207 N050.04.41.674 E019.47.26.127 Color_186ACI
N050.04.41.674 E019.47.26.127 N050.04.41.660 E019.47.26.045 Color_186ACI
N050.04.41.660 E019.47.26.045 N050.04.41.636 E019.47.26.000 Color_186ACI
N050.04.41.473 E019.47.26.508 N050.04.41.419 E019.47.26.471 Color_186ACI
N050.04.41.419 E019.47.26.471 N050.04.41.354 E019.47.26.492 Color_186ACI
N050.04.41.354 E019.47.26.492 N050.04.41.313 E019.47.26.555 Color_186ACI
N050.04.41.313 E019.47.26.555 N050.04.41.302 E019.47.26.660 Color_186ACI
N050.04.41.302 E019.47.26.660 N050.04.41.330 E019.47.26.747 Color_186ACI
N050.04.41.330 E019.47.26.747 N050.04.41.388 E019.47.26.796 Color_186ACI
N050.04.41.388 E019.47.26.796 N050.04.41.448 E019.47.26.784 Color_186ACI
N050.04.41.448 E019.47.26.784 N050.04.41.497 E019.47.26.715 Color_186ACI
N050.04.41.497 E019.47.26.715 N050.04.41.511 E019.47.26.634 Color_186ACI
N050.04.41.511 E019.47.26.634 N050.04.41.497 E019.47.26.553 Color_186ACI
N050.04.41.497 E019.47.26.553 N050.04.41.473 E019.47.26.508 Color_186ACI
N050.04.41.252 E019.47.27.033 N050.04.41.198 E019.47.26.996 Color_186ACI
N050.04.41.198 E019.47.26.996 N050.04.41.133 E019.47.27.017 Color_186ACI
N050.04.41.133 E019.47.27.017 N050.04.41.093 E019.47.27.080 Color_186ACI
N050.04.41.093 E019.47.27.080 N050.04.41.081 E019.47.27.185 Color_186ACI
N050.04.41.081 E019.47.27.185 N050.04.41.109 E019.47.27.272 Color_186ACI
N050.04.41.109 E019.47.27.272 N050.04.41.167 E019.47.27.321 Color_186ACI
N050.04.41.167 E019.47.27.321 N050.04.41.228 E019.47.27.309 Color_186ACI
N050.04.41.228 E019.47.27.309 N050.04.41.277 E019.47.27.240 Color_186ACI
N050.04.41.277 E019.47.27.240 N050.04.41.290 E019.47.27.159 Color_186ACI
N050.04.41.290 E019.47.27.159 N050.04.41.276 E019.47.27.078 Color_186ACI
N050.04.41.276 E019.47.27.078 N050.04.41.252 E019.47.27.033 Color_186ACI
N050.04.41.415 E019.47.28.667 N050.04.41.361 E019.47.28.631 Color_186ACI
N050.04.41.361 E019.47.28.631 N050.04.41.296 E019.47.28.651 Color_186ACI
N050.04.41.296 E019.47.28.651 N050.04.41.255 E019.47.28.715 Color_186ACI
N050.04.41.255 E019.47.28.715 N050.04.41.244 E019.47.28.820 Color_186ACI
N050.04.41.244 E019.47.28.820 N050.04.41.272 E019.47.28.907 Color_186ACI
N050.04.41.272 E019.47.28.907 N050.04.41.330 E019.47.28.955 Color_186ACI
N050.04.41.330 E019.47.28.955 N050.04.41.390 E019.47.28.944 Color_186ACI
N050.04.41.390 E019.47.28.944 N050.04.41.439 E019.47.28.874 Color_186ACI
N050.04.41.439 E019.47.28.874 N050.04.41.453 E019.47.28.794 Color_186ACI
N050.04.41.453 E019.47.28.794 N050.04.41.439 E019.47.28.712 Color_186ACI
N050.04.41.439 E019.47.28.712 N050.04.41.415 E019.47.28.667 Color_186ACI
N050.04.41.023 E019.47.28.620 N050.04.40.969 E019.47.28.584 Color_186ACI
N050.04.40.969 E019.47.28.584 N050.04.40.904 E019.47.28.604 Color_186ACI
N050.04.40.904 E019.47.28.604 N050.04.40.864 E019.47.28.668 Color_186ACI
N050.04.40.864 E019.47.28.668 N050.04.40.852 E019.47.28.773 Color_186ACI
N050.04.40.852 E019.47.28.773 N050.04.40.880 E019.47.28.860 Color_186ACI
N050.04.40.880 E019.47.28.860 N050.04.40.938 E019.47.28.908 Color_186ACI
N050.04.40.938 E019.47.28.908 N050.04.40.998 E019.47.28.896 Color_186ACI
N050.04.40.998 E019.47.28.896 N050.04.41.047 E019.47.28.827 Color_186ACI
N050.04.41.047 E019.47.28.827 N050.04.41.061 E019.47.28.747 Color_186ACI
N050.04.41.061 E019.47.28.747 N050.04.41.047 E019.47.28.665 Color_186ACI
N050.04.41.047 E019.47.28.665 N050.04.41.023 E019.47.28.620 Color_186ACI
N050.04.40.886 E019.47.27.318 N050.04.40.831 E019.47.27.282 Color_186ACI
N050.04.40.831 E019.47.27.282 N050.04.40.767 E019.47.27.302 Color_186ACI
N050.04.40.767 E019.47.27.302 N050.04.40.726 E019.47.27.366 Color_186ACI
N050.04.40.726 E019.47.27.366 N050.04.40.715 E019.47.27.471 Color_186ACI
N050.04.40.715 E019.47.27.471 N050.04.40.743 E019.47.27.558 Color_186ACI
N050.04.40.743 E019.47.27.558 N050.04.40.801 E019.47.27.606 Color_186ACI
N050.04.40.801 E019.47.27.606 N050.04.40.861 E019.47.27.595 Color_186ACI
N050.04.40.861 E019.47.27.595 N050.04.40.910 E019.47.27.525 Color_186ACI
N050.04.40.910 E019.47.27.525 N050.04.40.924 E019.47.27.445 Color_186ACI
N050.04.40.924 E019.47.27.445 N050.04.40.910 E019.47.27.363 Color_186ACI
N050.04.40.910 E019.47.27.363 N050.04.40.886 E019.47.27.318 Color_186ACI
N050.04.40.534 E019.47.27.599 N050.04.40.480 E019.47.27.563 Color_186ACI
N050.04.40.480 E019.47.27.563 N050.04.40.415 E019.47.27.583 Color_186ACI
N050.04.40.415 E019.47.27.583 N050.04.40.375 E019.47.27.647 Color_186ACI
N050.04.40.375 E019.47.27.647 N050.04.40.363 E019.47.27.752 Color_186ACI
N050.04.40.363 E019.47.27.752 N050.04.40.391 E019.47.27.839 Color_186ACI
N050.04.40.391 E019.47.27.839 N050.04.40.449 E019.47.27.887 Color_186ACI
N050.04.40.449 E019.47.27.887 N050.04.40.509 E019.47.27.876 Color_186ACI
N050.04.40.509 E019.47.27.876 N050.04.40.559 E019.47.27.806 Color_186ACI
N050.04.40.559 E019.47.27.806 N050.04.40.572 E019.47.27.726 Color_186ACI
N050.04.40.572 E019.47.27.726 N050.04.40.558 E019.47.27.645 Color_186ACI
N050.04.40.558 E019.47.27.645 N050.04.40.534 E019.47.27.599 Color_186ACI
N050.04.40.634 E019.47.28.596 N050.04.40.579 E019.47.28.560 Color_186ACI
N050.04.40.579 E019.47.28.560 N050.04.40.515 E019.47.28.580 Color_186ACI
N050.04.40.515 E019.47.28.580 N050.04.40.474 E019.47.28.644 Color_186ACI
N050.04.40.474 E019.47.28.644 N050.04.40.463 E019.47.28.749 Color_186ACI
N050.04.40.463 E019.47.28.749 N050.04.40.491 E019.47.28.836 Color_186ACI
N050.04.40.491 E019.47.28.836 N050.04.40.549 E019.47.28.884 Color_186ACI
N050.04.40.549 E019.47.28.884 N050.04.40.609 E019.47.28.872 Color_186ACI
N050.04.40.609 E019.47.28.872 N050.04.40.658 E019.47.28.803 Color_186ACI
N050.04.40.658 E019.47.28.803 N050.04.40.672 E019.47.28.723 Color_186ACI
N050.04.40.672 E019.47.28.723 N050.04.40.658 E019.47.28.641 Color_186ACI
N050.04.40.658 E019.47.28.641 N050.04.40.634 E019.47.28.596 Color_186ACI
N050.04.39.223 E019.47.28.047 N050.04.39.169 E019.47.28.010 Color_186ACI
N050.04.39.169 E019.47.28.010 N050.04.39.104 E019.47.28.030 Color_186ACI
N050.04.39.104 E019.47.28.030 N050.04.39.064 E019.47.28.094 Color_186ACI
N050.04.39.064 E019.47.28.094 N050.04.39.052 E019.47.28.199 Color_186ACI
N050.04.39.052 E019.47.28.199 N050.04.39.080 E019.47.28.286 Color_186ACI
N050.04.39.080 E019.47.28.286 N050.04.39.138 E019.47.28.335 Color_186ACI
N050.04.39.138 E019.47.28.335 N050.04.39.199 E019.47.28.323 Color_186ACI
N050.04.39.199 E019.47.28.323 N050.04.39.248 E019.47.28.253 Color_186ACI
N050.04.39.248 E019.47.28.253 N050.04.39.261 E019.47.28.173 Color_186ACI
N050.04.39.261 E019.47.28.173 N050.04.39.247 E019.47.28.092 Color_186ACI
N050.04.39.247 E019.47.28.092 N050.04.39.223 E019.47.28.047 Color_186ACI
N050.04.39.361 E019.47.29.024 N050.04.39.307 E019.47.28.987 Color_186ACI
N050.04.39.307 E019.47.28.987 N050.04.39.242 E019.47.29.008 Color_186ACI
N050.04.39.242 E019.47.29.008 N050.04.39.202 E019.47.29.071 Color_186ACI
N050.04.39.202 E019.47.29.071 N050.04.39.190 E019.47.29.176 Color_186ACI
N050.04.39.190 E019.47.29.176 N050.04.39.218 E019.47.29.264 Color_186ACI
N050.04.39.218 E019.47.29.264 N050.04.39.276 E019.47.29.312 Color_186ACI
N050.04.39.276 E019.47.29.312 N050.04.39.337 E019.47.29.300 Color_186ACI
N050.04.39.337 E019.47.29.300 N050.04.39.386 E019.47.29.231 Color_186ACI
N050.04.39.386 E019.47.29.231 N050.04.39.399 E019.47.29.151 Color_186ACI
N050.04.39.399 E019.47.29.151 N050.04.39.385 E019.47.29.069 Color_186ACI
N050.04.39.385 E019.47.29.069 N050.04.39.361 E019.47.29.024 Color_186ACI
N050.04.37.595 E019.47.28.585 N050.04.37.541 E019.47.28.549 Color_186ACI
N050.04.37.541 E019.47.28.549 N050.04.37.477 E019.47.28.569 Color_186ACI
N050.04.37.477 E019.47.28.569 N050.04.37.436 E019.47.28.633 Color_186ACI
N050.04.37.436 E019.47.28.633 N050.04.37.425 E019.47.28.738 Color_186ACI
N050.04.37.425 E019.47.28.738 N050.04.37.452 E019.47.28.825 Color_186ACI
N050.04.37.452 E019.47.28.825 N050.04.37.510 E019.47.28.873 Color_186ACI
N050.04.37.510 E019.47.28.873 N050.04.37.571 E019.47.28.861 Color_186ACI
N050.04.37.571 E019.47.28.861 N050.04.37.620 E019.47.28.792 Color_186ACI
N050.04.37.620 E019.47.28.792 N050.04.37.634 E019.47.28.712 Color_186ACI
N050.04.37.634 E019.47.28.712 N050.04.37.620 E019.47.28.630 Color_186ACI
N050.04.37.620 E019.47.28.630 N050.04.37.595 E019.47.28.585 Color_186ACI
N050.04.37.722 E019.47.29.558 N050.04.37.668 E019.47.29.522 Color_186ACI
N050.04.37.668 E019.47.29.522 N050.04.37.603 E019.47.29.542 Color_186ACI
N050.04.37.603 E019.47.29.542 N050.04.37.563 E019.47.29.605 Color_186ACI
N050.04.37.563 E019.47.29.605 N050.04.37.552 E019.47.29.710 Color_186ACI
N050.04.37.552 E019.47.29.710 N050.04.37.579 E019.47.29.798 Color_186ACI
N050.04.37.579 E019.47.29.798 N050.04.37.637 E019.47.29.846 Color_186ACI
N050.04.37.637 E019.47.29.846 N050.04.37.698 E019.47.29.834 Color_186ACI
N050.04.37.698 E019.47.29.834 N050.04.37.747 E019.47.29.765 Color_186ACI
N050.04.37.747 E019.47.29.765 N050.04.37.761 E019.47.29.685 Color_186ACI
N050.04.37.761 E019.47.29.685 N050.04.37.747 E019.47.29.603 Color_186ACI
N050.04.37.747 E019.47.29.603 N050.04.37.722 E019.47.29.558 Color_186ACI
N050.04.34.565 E019.47.27.671 N050.04.34.511 E019.47.27.635 Color_186ACI
N050.04.34.511 E019.47.27.635 N050.04.34.446 E019.47.27.655 Color_186ACI
N050.04.34.446 E019.47.27.655 N050.04.34.405 E019.47.27.719 Color_186ACI
N050.04.34.405 E019.47.27.719 N050.04.34.394 E019.47.27.824 Color_186ACI
N050.04.34.394 E019.47.27.824 N050.04.34.422 E019.47.27.911 Color_186ACI
N050.04.34.422 E019.47.27.911 N050.04.34.480 E019.47.27.959 Color_186ACI
N050.04.34.480 E019.47.27.959 N050.04.34.540 E019.47.27.947 Color_186ACI
N050.04.34.540 E019.47.27.947 N050.04.34.589 E019.47.27.878 Color_186ACI
N050.04.34.589 E019.47.27.878 N050.04.34.603 E019.47.27.798 Color_186ACI
N050.04.34.603 E019.47.27.798 N050.04.34.589 E019.47.27.716 Color_186ACI
N050.04.34.589 E019.47.27.716 N050.04.34.565 E019.47.27.671 Color_186ACI
N050.04.34.935 E019.47.28.700 N050.04.34.881 E019.47.28.664 Color_186ACI
N050.04.34.881 E019.47.28.664 N050.04.34.816 E019.47.28.684 Color_186ACI
N050.04.34.816 E019.47.28.684 N050.04.34.775 E019.47.28.748 Color_186ACI
N050.04.34.775 E019.47.28.748 N050.04.34.764 E019.47.28.853 Color_186ACI
N050.04.34.764 E019.47.28.853 N050.04.34.792 E019.47.28.940 Color_186ACI
N050.04.34.792 E019.47.28.940 N050.04.34.850 E019.47.28.988 Color_186ACI
N050.04.34.850 E019.47.28.988 N050.04.34.910 E019.47.28.976 Color_186ACI
N050.04.34.910 E019.47.28.976 N050.04.34.959 E019.47.28.907 Color_186ACI
N050.04.34.959 E019.47.28.907 N050.04.34.973 E019.47.28.827 Color_186ACI
N050.04.34.973 E019.47.28.827 N050.04.34.959 E019.47.28.745 Color_186ACI
N050.04.34.959 E019.47.28.745 N050.04.34.935 E019.47.28.700 Color_186ACI
N050.04.35.152 E019.47.28.898 N050.04.35.098 E019.47.28.862 Color_186ACI
N050.04.35.098 E019.47.28.862 N050.04.35.033 E019.47.28.882 Color_186ACI
N050.04.35.033 E019.47.28.882 N050.04.34.993 E019.47.28.946 Color_186ACI
N050.04.34.993 E019.47.28.946 N050.04.34.981 E019.47.29.051 Color_186ACI
N050.04.34.981 E019.47.29.051 N050.04.35.009 E019.47.29.138 Color_186ACI
N050.04.35.009 E019.47.29.138 N050.04.35.067 E019.47.29.186 Color_186ACI
N050.04.35.067 E019.47.29.186 N050.04.35.128 E019.47.29.174 Color_186ACI
N050.04.35.128 E019.47.29.174 N050.04.35.177 E019.47.29.105 Color_186ACI
N050.04.35.177 E019.47.29.105 N050.04.35.190 E019.47.29.025 Color_186ACI
N050.04.35.190 E019.47.29.025 N050.04.35.177 E019.47.28.943 Color_186ACI
N050.04.35.177 E019.47.28.943 N050.04.35.152 E019.47.28.898 Color_186ACI
N050.04.35.357 E019.47.29.076 N050.04.35.303 E019.47.29.040 Color_186ACI
N050.04.35.303 E019.47.29.040 N050.04.35.238 E019.47.29.060 Color_186ACI
N050.04.35.238 E019.47.29.060 N050.04.35.198 E019.47.29.124 Color_186ACI
N050.04.35.198 E019.47.29.124 N050.04.35.187 E019.47.29.229 Color_186ACI
N050.04.35.187 E019.47.29.229 N050.04.35.214 E019.47.29.316 Color_186ACI
N050.04.35.214 E019.47.29.316 N050.04.35.272 E019.47.29.364 Color_186ACI
N050.04.35.272 E019.47.29.364 N050.04.35.333 E019.47.29.352 Color_186ACI
N050.04.35.333 E019.47.29.352 N050.04.35.382 E019.47.29.283 Color_186ACI
N050.04.35.382 E019.47.29.283 N050.04.35.396 E019.47.29.203 Color_186ACI
N050.04.35.396 E019.47.29.203 N050.04.35.382 E019.47.29.121 Color_186ACI
N050.04.35.382 E019.47.29.121 N050.04.35.357 E019.47.29.076 Color_186ACI
N050.04.35.651 E019.47.29.106 N050.04.35.597 E019.47.29.070 Color_186ACI
N050.04.35.597 E019.47.29.070 N050.04.35.532 E019.47.29.090 Color_186ACI
N050.04.35.532 E019.47.29.090 N050.04.35.492 E019.47.29.154 Color_186ACI
N050.04.35.492 E019.47.29.154 N050.04.35.480 E019.47.29.259 Color_186ACI
N050.04.35.480 E019.47.29.259 N050.04.35.508 E019.47.29.346 Color_186ACI
N050.04.35.508 E019.47.29.346 N050.04.35.566 E019.47.29.394 Color_186ACI
N050.04.35.566 E019.47.29.394 N050.04.35.627 E019.47.29.382 Color_186ACI
N050.04.35.627 E019.47.29.382 N050.04.35.676 E019.47.29.313 Color_186ACI
N050.04.35.676 E019.47.29.313 N050.04.35.689 E019.47.29.233 Color_186ACI
N050.04.35.689 E019.47.29.233 N050.04.35.675 E019.47.29.151 Color_186ACI
N050.04.35.675 E019.47.29.151 N050.04.35.651 E019.47.29.106 Color_186ACI
N050.04.35.960 E019.47.29.121 N050.04.35.906 E019.47.29.085 Color_186ACI
N050.04.35.906 E019.47.29.085 N050.04.35.841 E019.47.29.105 Color_186ACI
N050.04.35.841 E019.47.29.105 N050.04.35.801 E019.47.29.169 Color_186ACI
N050.04.35.801 E019.47.29.169 N050.04.35.789 E019.47.29.273 Color_186ACI
N050.04.35.789 E019.47.29.273 N050.04.35.817 E019.47.29.361 Color_186ACI
N050.04.35.817 E019.47.29.361 N050.04.35.875 E019.47.29.409 Color_186ACI
N050.04.35.875 E019.47.29.409 N050.04.35.936 E019.47.29.397 Color_186ACI
N050.04.35.936 E019.47.29.397 N050.04.35.985 E019.47.29.328 Color_186ACI
N050.04.35.985 E019.47.29.328 N050.04.35.998 E019.47.29.248 Color_186ACI
N050.04.35.998 E019.47.29.248 N050.04.35.984 E019.47.29.166 Color_186ACI
N050.04.35.984 E019.47.29.166 N050.04.35.960 E019.47.29.121 Color_186ACI
N050.04.35.123 E019.47.31.807 N050.04.35.069 E019.47.31.771 Color_186ACI
N050.04.35.069 E019.47.31.771 N050.04.35.005 E019.47.31.791 Color_186ACI
N050.04.35.005 E019.47.31.791 N050.04.34.964 E019.47.31.855 Color_186ACI
N050.04.34.964 E019.47.31.855 N050.04.34.953 E019.47.31.960 Color_186ACI
N050.04.34.953 E019.47.31.960 N050.04.34.980 E019.47.32.047 Color_186ACI
N050.04.34.980 E019.47.32.047 N050.04.35.038 E019.47.32.095 Color_186ACI
N050.04.35.038 E019.47.32.095 N050.04.35.099 E019.47.32.084 Color_186ACI
N050.04.35.099 E019.47.32.084 N050.04.35.148 E019.47.32.014 Color_186ACI
N050.04.35.148 E019.47.32.014 N050.04.35.162 E019.47.31.934 Color_186ACI
N050.04.35.162 E019.47.31.934 N050.04.35.148 E019.47.31.853 Color_186ACI
N050.04.35.148 E019.47.31.853 N050.04.35.123 E019.47.31.807 Color_186ACI
N050.04.35.259 E019.47.31.183 N050.04.35.204 E019.47.31.147 Color_186ACI
N050.04.35.204 E019.47.31.147 N050.04.35.140 E019.47.31.167 Color_186ACI
N050.04.35.140 E019.47.31.167 N050.04.35.099 E019.47.31.231 Color_186ACI
N050.04.35.099 E019.47.31.231 N050.04.35.088 E019.47.31.336 Color_186ACI
N050.04.35.088 E019.47.31.336 N050.04.35.116 E019.47.31.423 Color_186ACI
N050.04.35.116 E019.47.31.423 N050.04.35.174 E019.47.31.471 Color_186ACI
N050.04.35.174 E019.47.31.471 N050.04.35.234 E019.47.31.460 Color_186ACI
N050.04.35.234 E019.47.31.460 N050.04.35.283 E019.47.31.390 Color_186ACI
N050.04.35.283 E019.47.31.390 N050.04.35.297 E019.47.31.310 Color_186ACI
N050.04.35.297 E019.47.31.310 N050.04.35.283 E019.47.31.229 Color_186ACI
N050.04.35.283 E019.47.31.229 N050.04.35.259 E019.47.31.183 Color_186ACI
N050.04.35.389 E019.47.30.877 N050.04.35.334 E019.47.30.841 Color_186ACI
N050.04.35.334 E019.47.30.841 N050.04.35.270 E019.47.30.861 Color_186ACI
N050.04.35.270 E019.47.30.861 N050.04.35.229 E019.47.30.925 Color_186ACI
N050.04.35.229 E019.47.30.925 N050.04.35.218 E019.47.31.030 Color_186ACI
N050.04.35.218 E019.47.31.030 N050.04.35.246 E019.47.31.117 Color_186ACI
N050.04.35.246 E019.47.31.117 N050.04.35.304 E019.47.31.165 Color_186ACI
N050.04.35.304 E019.47.31.165 N050.04.35.364 E019.47.31.153 Color_186ACI
N050.04.35.364 E019.47.31.153 N050.04.35.413 E019.47.31.084 Color_186ACI
N050.04.35.413 E019.47.31.084 N050.04.35.427 E019.47.31.004 Color_186ACI
N050.04.35.427 E019.47.31.004 N050.04.35.413 E019.47.30.922 Color_186ACI
N050.04.35.413 E019.47.30.922 N050.04.35.389 E019.47.30.877 Color_186ACI
N050.04.35.541 E019.47.30.577 N050.04.35.487 E019.47.30.541 Color_186ACI
N050.04.35.487 E019.47.30.541 N050.04.35.422 E019.47.30.561 Color_186ACI
N050.04.35.422 E019.47.30.561 N050.04.35.382 E019.47.30.625 Color_186ACI
N050.04.35.382 E019.47.30.625 N050.04.35.370 E019.47.30.730 Color_186ACI
N050.04.35.370 E019.47.30.730 N050.04.35.398 E019.47.30.817 Color_186ACI
N050.04.35.398 E019.47.30.817 N050.04.35.456 E019.47.30.865 Color_186ACI
N050.04.35.456 E019.47.30.865 N050.04.35.517 E019.47.30.853 Color_186ACI
N050.04.35.517 E019.47.30.853 N050.04.35.566 E019.47.30.784 Color_186ACI
N050.04.35.566 E019.47.30.784 N050.04.35.579 E019.47.30.704 Color_186ACI
N050.04.35.579 E019.47.30.704 N050.04.35.565 E019.47.30.622 Color_186ACI
N050.04.35.565 E019.47.30.622 N050.04.35.541 E019.47.30.577 Color_186ACI
N050.04.35.819 E019.47.30.357 N050.04.35.765 E019.47.30.321 Color_186ACI
N050.04.35.765 E019.47.30.321 N050.04.35.700 E019.47.30.341 Color_186ACI
N050.04.35.700 E019.47.30.341 N050.04.35.660 E019.47.30.405 Color_186ACI
N050.04.35.660 E019.47.30.405 N050.04.35.648 E019.47.30.510 Color_186ACI
N050.04.35.648 E019.47.30.510 N050.04.35.676 E019.47.30.597 Color_186ACI
N050.04.35.676 E019.47.30.597 N050.04.35.734 E019.47.30.645 Color_186ACI
N050.04.35.734 E019.47.30.645 N050.04.35.795 E019.47.30.634 Color_186ACI
N050.04.35.795 E019.47.30.634 N050.04.35.844 E019.47.30.564 Color_186ACI
N050.04.35.844 E019.47.30.564 N050.04.35.857 E019.47.30.484 Color_186ACI
N050.04.35.857 E019.47.30.484 N050.04.35.843 E019.47.30.403 Color_186ACI
N050.04.35.843 E019.47.30.403 N050.04.35.819 E019.47.30.357 Color_186ACI
N050.04.36.119 E019.47.30.084 N050.04.36.065 E019.47.30.048 Color_186ACI
N050.04.36.065 E019.47.30.048 N050.04.36.001 E019.47.30.068 Color_186ACI
N050.04.36.001 E019.47.30.068 N050.04.35.960 E019.47.30.132 Color_186ACI
N050.04.35.960 E019.47.30.132 N050.04.35.949 E019.47.30.237 Color_186ACI
N050.04.35.949 E019.47.30.237 N050.04.35.977 E019.47.30.324 Color_186ACI
N050.04.35.977 E019.47.30.324 N050.04.36.034 E019.47.30.372 Color_186ACI
N050.04.36.034 E019.47.30.372 N050.04.36.095 E019.47.30.361 Color_186ACI
N050.04.36.095 E019.47.30.361 N050.04.36.144 E019.47.30.291 Color_186ACI
N050.04.36.144 E019.47.30.291 N050.04.36.158 E019.47.30.211 Color_186ACI
N050.04.36.158 E019.47.30.211 N050.04.36.144 E019.47.30.130 Color_186ACI
N050.04.36.144 E019.47.30.130 N050.04.36.119 E019.47.30.084 Color_186ACI
;park_dots N000.00.00.000 E000.00.00.000 N000.00.00.000 E000.00.00.000
N050.04.26.931 E019.48.18.957 N050.04.26.877 E019.48.18.921 Color_44ACI
N050.04.26.877 E019.48.18.921 N050.04.26.812 E019.48.18.941 Color_44ACI
N050.04.26.812 E019.48.18.941 N050.04.26.772 E019.48.19.005 Color_44ACI
N050.04.26.772 E019.48.19.005 N050.04.26.760 E019.48.19.110 Color_44ACI
N050.04.26.760 E019.48.19.110 N050.04.26.788 E019.48.19.197 Color_44ACI
N050.04.26.788 E019.48.19.197 N050.04.26.846 E019.48.19.245 Color_44ACI
N050.04.26.846 E019.48.19.245 N050.04.26.907 E019.48.19.234 Color_44ACI
N050.04.26.907 E019.48.19.234 N050.04.26.956 E019.48.19.164 Color_44ACI
N050.04.26.956 E019.48.19.164 N050.04.26.969 E019.48.19.084 Color_44ACI
N050.04.26.969 E019.48.19.084 N050.04.26.956 E019.48.19.003 Color_44ACI
N050.04.26.956 E019.48.19.003 N050.04.26.931 E019.48.18.957 Color_44ACI
N050.04.26.968 E019.48.18.703 N050.04.26.913 E019.48.18.667 Color_44ACI
N050.04.26.913 E019.48.18.667 N050.04.26.849 E019.48.18.687 Color_44ACI
N050.04.26.849 E019.48.18.687 N050.04.26.808 E019.48.18.751 Color_44ACI
N050.04.26.808 E019.48.18.751 N050.04.26.797 E019.48.18.856 Color_44ACI
N050.04.26.797 E019.48.18.856 N050.04.26.825 E019.48.18.943 Color_44ACI
N050.04.26.825 E019.48.18.943 N050.04.26.883 E019.48.18.991 Color_44ACI
N050.04.26.883 E019.48.18.991 N050.04.26.943 E019.48.18.979 Color_44ACI
N050.04.26.943 E019.48.18.979 N050.04.26.992 E019.48.18.910 Color_44ACI
N050.04.26.992 E019.48.18.910 N050.04.27.006 E019.48.18.830 Color_44ACI
N050.04.27.006 E019.48.18.830 N050.04.26.992 E019.48.18.748 Color_44ACI
N050.04.26.992 E019.48.18.748 N050.04.26.968 E019.48.18.703 Color_44ACI
N050.04.28.169 E019.48.18.966 N050.04.28.115 E019.48.18.930 Color_44ACI
N050.04.28.115 E019.48.18.930 N050.04.28.051 E019.48.18.950 Color_44ACI
N050.04.28.051 E019.48.18.950 N050.04.28.010 E019.48.19.014 Color_44ACI
N050.04.28.010 E019.48.19.014 N050.04.27.999 E019.48.19.119 Color_44ACI
N050.04.27.999 E019.48.19.119 N050.04.28.026 E019.48.19.206 Color_44ACI
N050.04.28.026 E019.48.19.206 N050.04.28.084 E019.48.19.254 Color_44ACI
N050.04.28.084 E019.48.19.254 N050.04.28.145 E019.48.19.242 Color_44ACI
N050.04.28.145 E019.48.19.242 N050.04.28.194 E019.48.19.173 Color_44ACI
N050.04.28.194 E019.48.19.173 N050.04.28.208 E019.48.19.093 Color_44ACI
N050.04.28.208 E019.48.19.093 N050.04.28.194 E019.48.19.011 Color_44ACI
N050.04.28.194 E019.48.19.011 N050.04.28.169 E019.48.18.966 Color_44ACI
N050.04.28.118 E019.48.19.234 N050.04.28.064 E019.48.19.198 Color_44ACI
N050.04.28.064 E019.48.19.198 N050.04.27.999 E019.48.19.218 Color_44ACI
N050.04.27.999 E019.48.19.218 N050.04.27.959 E019.48.19.282 Color_44ACI
N050.04.27.959 E019.48.19.282 N050.04.27.947 E019.48.19.387 Color_44ACI
N050.04.27.947 E019.48.19.387 N050.04.27.975 E019.48.19.474 Color_44ACI
N050.04.27.975 E019.48.19.474 N050.04.28.033 E019.48.19.522 Color_44ACI
N050.04.28.033 E019.48.19.522 N050.04.28.093 E019.48.19.510 Color_44ACI
N050.04.28.093 E019.48.19.510 N050.04.28.143 E019.48.19.441 Color_44ACI
N050.04.28.143 E019.48.19.441 N050.04.28.156 E019.48.19.361 Color_44ACI
N050.04.28.156 E019.48.19.361 N050.04.28.142 E019.48.19.279 Color_44ACI
N050.04.28.142 E019.48.19.279 N050.04.28.118 E019.48.19.234 Color_44ACI
N050.04.29.378 E019.48.19.842 N050.04.29.324 E019.48.19.806 Color_44ACI
N050.04.29.324 E019.48.19.806 N050.04.29.260 E019.48.19.826 Color_44ACI
N050.04.29.260 E019.48.19.826 N050.04.29.219 E019.48.19.890 Color_44ACI
N050.04.29.219 E019.48.19.890 N050.04.29.208 E019.48.19.994 Color_44ACI
N050.04.29.208 E019.48.19.994 N050.04.29.235 E019.48.20.082 Color_44ACI
N050.04.29.235 E019.48.20.082 N050.04.29.293 E019.48.20.130 Color_44ACI
N050.04.29.293 E019.48.20.130 N050.04.29.354 E019.48.20.118 Color_44ACI
N050.04.29.354 E019.48.20.118 N050.04.29.403 E019.48.20.049 Color_44ACI
N050.04.29.403 E019.48.20.049 N050.04.29.417 E019.48.19.969 Color_44ACI
N050.04.29.417 E019.48.19.969 N050.04.29.403 E019.48.19.887 Color_44ACI
N050.04.29.403 E019.48.19.887 N050.04.29.378 E019.48.19.842 Color_44ACI
N050.04.29.435 E019.48.19.569 N050.04.29.380 E019.48.19.533 Color_44ACI
N050.04.29.380 E019.48.19.533 N050.04.29.316 E019.48.19.553 Color_44ACI
N050.04.29.316 E019.48.19.553 N050.04.29.275 E019.48.19.617 Color_44ACI
N050.04.29.275 E019.48.19.617 N050.04.29.264 E019.48.19.722 Color_44ACI
N050.04.29.264 E019.48.19.722 N050.04.29.292 E019.48.19.809 Color_44ACI
N050.04.29.292 E019.48.19.809 N050.04.29.350 E019.48.19.857 Color_44ACI
N050.04.29.350 E019.48.19.857 N050.04.29.410 E019.48.19.846 Color_44ACI
N050.04.29.410 E019.48.19.846 N050.04.29.459 E019.48.19.776 Color_44ACI
N050.04.29.459 E019.48.19.776 N050.04.29.473 E019.48.19.696 Color_44ACI
N050.04.29.473 E019.48.19.696 N050.04.29.459 E019.48.19.615 Color_44ACI
N050.04.29.459 E019.48.19.615 N050.04.29.435 E019.48.19.569 Color_44ACI
N050.04.26.009 E019.48.16.072 N050.04.25.955 E019.48.16.036 Color_44ACI
N050.04.25.955 E019.48.16.036 N050.04.25.890 E019.48.16.056 Color_44ACI
N050.04.25.890 E019.48.16.056 N050.04.25.850 E019.48.16.119 Color_44ACI
N050.04.25.850 E019.48.16.119 N050.04.25.838 E019.48.16.224 Color_44ACI
N050.04.25.838 E019.48.16.224 N050.04.25.866 E019.48.16.312 Color_44ACI
N050.04.25.866 E019.48.16.312 N050.04.25.924 E019.48.16.360 Color_44ACI
N050.04.25.924 E019.48.16.360 N050.04.25.985 E019.48.16.348 Color_44ACI
N050.04.25.985 E019.48.16.348 N050.04.26.034 E019.48.16.279 Color_44ACI
N050.04.26.034 E019.48.16.279 N050.04.26.047 E019.48.16.199 Color_44ACI
N050.04.26.047 E019.48.16.199 N050.04.26.034 E019.48.16.117 Color_44ACI
N050.04.26.034 E019.48.16.117 N050.04.26.009 E019.48.16.072 Color_44ACI
N050.04.25.079 E019.48.17.223 N050.04.25.025 E019.48.17.186 Color_44ACI
N050.04.25.025 E019.48.17.186 N050.04.24.960 E019.48.17.206 Color_44ACI
N050.04.24.960 E019.48.17.206 N050.04.24.919 E019.48.17.270 Color_44ACI
N050.04.24.919 E019.48.17.270 N050.04.24.908 E019.48.17.375 Color_44ACI
N050.04.24.908 E019.48.17.375 N050.04.24.936 E019.48.17.462 Color_44ACI
N050.04.24.936 E019.48.17.462 N050.04.24.994 E019.48.17.511 Color_44ACI
N050.04.24.994 E019.48.17.511 N050.04.25.054 E019.48.17.499 Color_44ACI
N050.04.25.054 E019.48.17.499 N050.04.25.103 E019.48.17.429 Color_44ACI
N050.04.25.103 E019.48.17.429 N050.04.25.117 E019.48.17.349 Color_44ACI
N050.04.25.117 E019.48.17.349 N050.04.25.103 E019.48.17.268 Color_44ACI
N050.04.25.103 E019.48.17.268 N050.04.25.079 E019.48.17.223 Color_44ACI
N050.04.24.945 E019.48.17.412 N050.04.24.891 E019.48.17.375 Color_44ACI
N050.04.24.891 E019.48.17.375 N050.04.24.826 E019.48.17.396 Color_44ACI
N050.04.24.826 E019.48.17.396 N050.04.24.786 E019.48.17.459 Color_44ACI
N050.04.24.786 E019.48.17.459 N050.04.24.775 E019.48.17.564 Color_44ACI
N050.04.24.775 E019.48.17.564 N050.04.24.802 E019.48.17.651 Color_44ACI
N050.04.24.802 E019.48.17.651 N050.04.24.860 E019.48.17.700 Color_44ACI
N050.04.24.860 E019.48.17.700 N050.04.24.921 E019.48.17.688 Color_44ACI
N050.04.24.921 E019.48.17.688 N050.04.24.970 E019.48.17.619 Color_44ACI
N050.04.24.970 E019.48.17.619 N050.04.24.984 E019.48.17.538 Color_44ACI
N050.04.24.984 E019.48.17.538 N050.04.24.970 E019.48.17.457 Color_44ACI
N050.04.24.970 E019.48.17.457 N050.04.24.945 E019.48.17.412 Color_44ACI
N050.04.24.525 E019.48.16.556 N050.04.24.471 E019.48.16.519 Color_44ACI
N050.04.24.471 E019.48.16.519 N050.04.24.406 E019.48.16.540 Color_44ACI
N050.04.24.406 E019.48.16.540 N050.04.24.366 E019.48.16.603 Color_44ACI
N050.04.24.366 E019.48.16.603 N050.04.24.354 E019.48.16.708 Color_44ACI
N050.04.24.354 E019.48.16.708 N050.04.24.382 E019.48.16.796 Color_44ACI
N050.04.24.382 E019.48.16.796 N050.04.24.440 E019.48.16.844 Color_44ACI
N050.04.24.440 E019.48.16.844 N050.04.24.500 E019.48.16.832 Color_44ACI
N050.04.24.500 E019.48.16.832 N050.04.24.550 E019.48.16.763 Color_44ACI
N050.04.24.550 E019.48.16.763 N050.04.24.563 E019.48.16.682 Color_44ACI
N050.04.24.563 E019.48.16.682 N050.04.24.549 E019.48.16.601 Color_44ACI
N050.04.24.549 E019.48.16.601 N050.04.24.525 E019.48.16.556 Color_44ACI
N050.04.24.135 E019.48.13.760 N050.04.24.081 E019.48.13.724 Color_44ACI
N050.04.24.081 E019.48.13.724 N050.04.24.016 E019.48.13.744 Color_44ACI
N050.04.24.016 E019.48.13.744 N050.04.23.976 E019.48.13.807 Color_44ACI
N050.04.23.976 E019.48.13.807 N050.04.23.964 E019.48.13.912 Color_44ACI
N050.04.23.964 E019.48.13.912 N050.04.23.992 E019.48.14.000 Color_44ACI
N050.04.23.992 E019.48.14.000 N050.04.24.050 E019.48.14.048 Color_44ACI
N050.04.24.050 E019.48.14.048 N050.04.24.111 E019.48.14.036 Color_44ACI
N050.04.24.111 E019.48.14.036 N050.04.24.160 E019.48.13.967 Color_44ACI
N050.04.24.160 E019.48.13.967 N050.04.24.173 E019.48.13.887 Color_44ACI
N050.04.24.173 E019.48.13.887 N050.04.24.159 E019.48.13.805 Color_44ACI
N050.04.24.159 E019.48.13.805 N050.04.24.135 E019.48.13.760 Color_44ACI
N050.04.23.775 E019.48.11.021 N050.04.23.721 E019.48.10.985 Color_44ACI
N050.04.23.721 E019.48.10.985 N050.04.23.656 E019.48.11.005 Color_44ACI
N050.04.23.656 E019.48.11.005 N050.04.23.615 E019.48.11.069 Color_44ACI
N050.04.23.615 E019.48.11.069 N050.04.23.604 E019.48.11.174 Color_44ACI
N050.04.23.604 E019.48.11.174 N050.04.23.632 E019.48.11.261 Color_44ACI
N050.04.23.632 E019.48.11.261 N050.04.23.690 E019.48.11.309 Color_44ACI
N050.04.23.690 E019.48.11.309 N050.04.23.750 E019.48.11.297 Color_44ACI
N050.04.23.750 E019.48.11.297 N050.04.23.799 E019.48.11.228 Color_44ACI
N050.04.23.799 E019.48.11.228 N050.04.23.813 E019.48.11.148 Color_44ACI
N050.04.23.813 E019.48.11.148 N050.04.23.799 E019.48.11.066 Color_44ACI
N050.04.23.799 E019.48.11.066 N050.04.23.775 E019.48.11.021 Color_44ACI
N050.04.23.274 E019.48.07.591 N050.04.23.220 E019.48.07.554 Color_44ACI
N050.04.23.220 E019.48.07.554 N050.04.23.155 E019.48.07.575 Color_44ACI
N050.04.23.155 E019.48.07.575 N050.04.23.115 E019.48.07.638 Color_44ACI
N050.04.23.115 E019.48.07.638 N050.04.23.103 E019.48.07.743 Color_44ACI
N050.04.23.103 E019.48.07.743 N050.04.23.131 E019.48.07.830 Color_44ACI
N050.04.23.131 E019.48.07.830 N050.04.23.189 E019.48.07.879 Color_44ACI
N050.04.23.189 E019.48.07.879 N050.04.23.250 E019.48.07.867 Color_44ACI
N050.04.23.250 E019.48.07.867 N050.04.23.299 E019.48.07.798 Color_44ACI
N050.04.23.299 E019.48.07.798 N050.04.23.312 E019.48.07.717 Color_44ACI
N050.04.23.312 E019.48.07.717 N050.04.23.298 E019.48.07.636 Color_44ACI
N050.04.23.298 E019.48.07.636 N050.04.23.274 E019.48.07.591 Color_44ACI
N050.04.22.918 E019.48.04.825 N050.04.22.864 E019.48.04.789 Color_44ACI
N050.04.22.864 E019.48.04.789 N050.04.22.799 E019.48.04.809 Color_44ACI
N050.04.22.799 E019.48.04.809 N050.04.22.758 E019.48.04.873 Color_44ACI
N050.04.22.758 E019.48.04.873 N050.04.22.747 E019.48.04.978 Color_44ACI
N050.04.22.747 E019.48.04.978 N050.04.22.775 E019.48.05.065 Color_44ACI
N050.04.22.775 E019.48.05.065 N050.04.22.833 E019.48.05.113 Color_44ACI
N050.04.22.833 E019.48.05.113 N050.04.22.893 E019.48.05.102 Color_44ACI
N050.04.22.893 E019.48.05.102 N050.04.22.942 E019.48.05.032 Color_44ACI
N050.04.22.942 E019.48.05.032 N050.04.22.956 E019.48.04.952 Color_44ACI
N050.04.22.956 E019.48.04.952 N050.04.22.942 E019.48.04.870 Color_44ACI
N050.04.22.942 E019.48.04.870 N050.04.22.918 E019.48.04.825 Color_44ACI
N050.04.22.532 E019.48.02.087 N050.04.22.478 E019.48.02.050 Color_44ACI
N050.04.22.478 E019.48.02.050 N050.04.22.413 E019.48.02.071 Color_44ACI
N050.04.22.413 E019.48.02.071 N050.04.22.373 E019.48.02.134 Color_44ACI
N050.04.22.373 E019.48.02.134 N050.04.22.361 E019.48.02.239 Color_44ACI
N050.04.22.361 E019.48.02.239 N050.04.22.389 E019.48.02.326 Color_44ACI
N050.04.22.389 E019.48.02.326 N050.04.22.447 E019.48.02.375 Color_44ACI
N050.04.22.447 E019.48.02.375 N050.04.22.508 E019.48.02.363 Color_44ACI
N050.04.22.508 E019.48.02.363 N050.04.22.557 E019.48.02.294 Color_44ACI
N050.04.22.557 E019.48.02.294 N050.04.22.570 E019.48.02.213 Color_44ACI
N050.04.22.570 E019.48.02.213 N050.04.22.556 E019.48.02.132 Color_44ACI
N050.04.22.556 E019.48.02.132 N050.04.22.532 E019.48.02.087 Color_44ACI
N050.04.28.483 E019.48.12.356 N050.04.28.429 E019.48.12.320 Color_44ACI
N050.04.28.429 E019.48.12.320 N050.04.28.364 E019.48.12.340 Color_44ACI
N050.04.28.364 E019.48.12.340 N050.04.28.323 E019.48.12.404 Color_44ACI
N050.04.28.323 E019.48.12.404 N050.04.28.312 E019.48.12.509 Color_44ACI
N050.04.28.312 E019.48.12.509 N050.04.28.340 E019.48.12.596 Color_44ACI
N050.04.28.340 E019.48.12.596 N050.04.28.398 E019.48.12.644 Color_44ACI
N050.04.28.398 E019.48.12.644 N050.04.28.458 E019.48.12.633 Color_44ACI
N050.04.28.458 E019.48.12.633 N050.04.28.507 E019.48.12.563 Color_44ACI
N050.04.28.507 E019.48.12.563 N050.04.28.521 E019.48.12.483 Color_44ACI
N050.04.28.521 E019.48.12.483 N050.04.28.507 E019.48.12.401 Color_44ACI
N050.04.28.507 E019.48.12.401 N050.04.28.483 E019.48.12.356 Color_44ACI
N050.04.27.982 E019.48.08.578 N050.04.27.928 E019.48.08.542 Color_44ACI
N050.04.27.928 E019.48.08.542 N050.04.27.863 E019.48.08.562 Color_44ACI
N050.04.27.863 E019.48.08.562 N050.04.27.823 E019.48.08.626 Color_44ACI
N050.04.27.823 E019.48.08.626 N050.04.27.811 E019.48.08.731 Color_44ACI
N050.04.27.811 E019.48.08.731 N050.04.27.839 E019.48.08.818 Color_44ACI
N050.04.27.839 E019.48.08.818 N050.04.27.897 E019.48.08.866 Color_44ACI
N050.04.27.897 E019.48.08.866 N050.04.27.958 E019.48.08.855 Color_44ACI
N050.04.27.958 E019.48.08.855 N050.04.28.007 E019.48.08.785 Color_44ACI
N050.04.28.007 E019.48.08.785 N050.04.28.020 E019.48.08.705 Color_44ACI
N050.04.28.020 E019.48.08.705 N050.04.28.007 E019.48.08.624 Color_44ACI
N050.04.28.007 E019.48.08.624 N050.04.27.982 E019.48.08.578 Color_44ACI
N050.04.28.312 E019.48.06.417 N050.04.28.257 E019.48.06.381 Color_44ACI
N050.04.28.257 E019.48.06.381 N050.04.28.193 E019.48.06.401 Color_44ACI
N050.04.28.193 E019.48.06.401 N050.04.28.152 E019.48.06.465 Color_44ACI
N050.04.28.152 E019.48.06.465 N050.04.28.141 E019.48.06.569 Color_44ACI
N050.04.28.141 E019.48.06.569 N050.04.28.169 E019.48.06.657 Color_44ACI
N050.04.28.169 E019.48.06.657 N050.04.28.227 E019.48.06.705 Color_44ACI
N050.04.28.227 E019.48.06.705 N050.04.28.287 E019.48.06.693 Color_44ACI
N050.04.28.287 E019.48.06.693 N050.04.28.336 E019.48.06.624 Color_44ACI
N050.04.28.336 E019.48.06.624 N050.04.28.350 E019.48.06.544 Color_44ACI
N050.04.28.350 E019.48.06.544 N050.04.28.336 E019.48.06.462 Color_44ACI
N050.04.28.336 E019.48.06.462 N050.04.28.312 E019.48.06.417 Color_44ACI
N050.04.28.059 E019.48.04.567 N050.04.28.005 E019.48.04.531 Color_44ACI
N050.04.28.005 E019.48.04.531 N050.04.27.940 E019.48.04.551 Color_44ACI
N050.04.27.940 E019.48.04.551 N050.04.27.900 E019.48.04.615 Color_44ACI
N050.04.27.900 E019.48.04.615 N050.04.27.888 E019.48.04.720 Color_44ACI
N050.04.27.888 E019.48.04.720 N050.04.27.916 E019.48.04.807 Color_44ACI
N050.04.27.916 E019.48.04.807 N050.04.27.974 E019.48.04.855 Color_44ACI
N050.04.27.974 E019.48.04.855 N050.04.28.035 E019.48.04.844 Color_44ACI
N050.04.28.035 E019.48.04.844 N050.04.28.084 E019.48.04.774 Color_44ACI
N050.04.28.084 E019.48.04.774 N050.04.28.097 E019.48.04.694 Color_44ACI
N050.04.28.097 E019.48.04.694 N050.04.28.083 E019.48.04.613 Color_44ACI
N050.04.28.083 E019.48.04.613 N050.04.28.059 E019.48.04.567 Color_44ACI
N050.04.27.818 E019.48.02.758 N050.04.27.764 E019.48.02.722 Color_44ACI
N050.04.27.764 E019.48.02.722 N050.04.27.699 E019.48.02.742 Color_44ACI
N050.04.27.699 E019.48.02.742 N050.04.27.659 E019.48.02.806 Color_44ACI
N050.04.27.659 E019.48.02.806 N050.04.27.647 E019.48.02.911 Color_44ACI
N050.04.27.647 E019.48.02.911 N050.04.27.675 E019.48.02.998 Color_44ACI
N050.04.27.675 E019.48.02.998 N050.04.27.733 E019.48.03.046 Color_44ACI
N050.04.27.733 E019.48.03.046 N050.04.27.794 E019.48.03.035 Color_44ACI
N050.04.27.794 E019.48.03.035 N050.04.27.843 E019.48.02.965 Color_44ACI
N050.04.27.843 E019.48.02.965 N050.04.27.857 E019.48.02.885 Color_44ACI
N050.04.27.857 E019.48.02.885 N050.04.27.843 E019.48.02.803 Color_44ACI
N050.04.27.843 E019.48.02.803 N050.04.27.818 E019.48.02.758 Color_44ACI
N050.04.29.524 E019.48.04.666 N050.04.29.470 E019.48.04.630 Color_44ACI
N050.04.29.470 E019.48.04.630 N050.04.29.405 E019.48.04.650 Color_44ACI
N050.04.29.405 E019.48.04.650 N050.04.29.365 E019.48.04.713 Color_44ACI
N050.04.29.365 E019.48.04.713 N050.04.29.353 E019.48.04.818 Color_44ACI
N050.04.29.353 E019.48.04.818 N050.04.29.381 E019.48.04.906 Color_44ACI
N050.04.29.381 E019.48.04.906 N050.04.29.439 E019.48.04.954 Color_44ACI
N050.04.29.439 E019.48.04.954 N050.04.29.499 E019.48.04.942 Color_44ACI
N050.04.29.499 E019.48.04.942 N050.04.29.548 E019.48.04.873 Color_44ACI
N050.04.29.548 E019.48.04.873 N050.04.29.562 E019.48.04.793 Color_44ACI
N050.04.29.562 E019.48.04.793 N050.04.29.548 E019.48.04.711 Color_44ACI
N050.04.29.548 E019.48.04.711 N050.04.29.524 E019.48.04.666 Color_44ACI
N050.04.34.764 E019.48.11.589 N050.04.34.710 E019.48.11.553 Color_44ACI
N050.04.34.710 E019.48.11.553 N050.04.34.645 E019.48.11.573 Color_44ACI
N050.04.34.645 E019.48.11.573 N050.04.34.605 E019.48.11.637 Color_44ACI
N050.04.34.605 E019.48.11.637 N050.04.34.593 E019.48.11.742 Color_44ACI
N050.04.34.593 E019.48.11.742 N050.04.34.621 E019.48.11.829 Color_44ACI
N050.04.34.621 E019.48.11.829 N050.04.34.679 E019.48.11.877 Color_44ACI
N050.04.34.679 E019.48.11.877 N050.04.34.740 E019.48.11.865 Color_44ACI
N050.04.34.740 E019.48.11.865 N050.04.34.789 E019.48.11.796 Color_44ACI
N050.04.34.789 E019.48.11.796 N050.04.34.802 E019.48.11.716 Color_44ACI
N050.04.34.802 E019.48.11.716 N050.04.34.788 E019.48.11.634 Color_44ACI
N050.04.34.788 E019.48.11.634 N050.04.34.764 E019.48.11.589 Color_44ACI
N050.04.36.052 E019.48.11.215 N050.04.35.998 E019.48.11.178 Color_44ACI
N050.04.35.998 E019.48.11.178 N050.04.35.933 E019.48.11.198 Color_44ACI
N050.04.35.933 E019.48.11.198 N050.04.35.893 E019.48.11.262 Color_44ACI
N050.04.35.893 E019.48.11.262 N050.04.35.881 E019.48.11.367 Color_44ACI
N050.04.35.881 E019.48.11.367 N050.04.35.909 E019.48.11.454 Color_44ACI
N050.04.35.909 E019.48.11.454 N050.04.35.967 E019.48.11.503 Color_44ACI
N050.04.35.967 E019.48.11.503 N050.04.36.028 E019.48.11.491 Color_44ACI
N050.04.36.028 E019.48.11.491 N050.04.36.077 E019.48.11.422 Color_44ACI
N050.04.36.077 E019.48.11.422 N050.04.36.090 E019.48.11.341 Color_44ACI
N050.04.36.090 E019.48.11.341 N050.04.36.076 E019.48.11.260 Color_44ACI
N050.04.36.076 E019.48.11.260 N050.04.36.052 E019.48.11.215 Color_44ACI
N050.04.37.328 E019.48.10.760 N050.04.37.274 E019.48.10.724 Color_44ACI
N050.04.37.274 E019.48.10.724 N050.04.37.209 E019.48.10.744 Color_44ACI
N050.04.37.209 E019.48.10.744 N050.04.37.169 E019.48.10.808 Color_44ACI
N050.04.37.169 E019.48.10.808 N050.04.37.157 E019.48.10.913 Color_44ACI
N050.04.37.157 E019.48.10.913 N050.04.37.185 E019.48.11.000 Color_44ACI
N050.04.37.185 E019.48.11.000 N050.04.37.243 E019.48.11.048 Color_44ACI
N050.04.37.243 E019.48.11.048 N050.04.37.304 E019.48.11.037 Color_44ACI
N050.04.37.304 E019.48.11.037 N050.04.37.353 E019.48.10.967 Color_44ACI
N050.04.37.353 E019.48.10.967 N050.04.37.366 E019.48.10.887 Color_44ACI
N050.04.37.366 E019.48.10.887 N050.04.37.352 E019.48.10.806 Color_44ACI
N050.04.37.352 E019.48.10.806 N050.04.37.328 E019.48.10.760 Color_44ACI
N050.04.33.715 E019.48.01.410 N050.04.33.661 E019.48.01.373 Color_44ACI
N050.04.33.661 E019.48.01.373 N050.04.33.596 E019.48.01.394 Color_44ACI
N050.04.33.596 E019.48.01.394 N050.04.33.556 E019.48.01.457 Color_44ACI
N050.04.33.556 E019.48.01.457 N050.04.33.544 E019.48.01.562 Color_44ACI
N050.04.33.544 E019.48.01.562 N050.04.33.572 E019.48.01.650 Color_44ACI
N050.04.33.572 E019.48.01.650 N050.04.33.630 E019.48.01.698 Color_44ACI
N050.04.33.630 E019.48.01.698 N050.04.33.690 E019.48.01.686 Color_44ACI
N050.04.33.690 E019.48.01.686 N050.04.33.739 E019.48.01.617 Color_44ACI
N050.04.33.739 E019.48.01.617 N050.04.33.753 E019.48.01.537 Color_44ACI
N050.04.33.753 E019.48.01.537 N050.04.33.739 E019.48.01.455 Color_44ACI
N050.04.33.739 E019.48.01.455 N050.04.33.715 E019.48.01.410 Color_44ACI
N050.04.36.138 E019.47.56.063 N050.04.36.084 E019.47.56.026 Color_44ACI
N050.04.36.084 E019.47.56.026 N050.04.36.019 E019.47.56.046 Color_44ACI
N050.04.36.019 E019.47.56.046 N050.04.35.979 E019.47.56.110 Color_44ACI
N050.04.35.979 E019.47.56.110 N050.04.35.967 E019.47.56.215 Color_44ACI
N050.04.35.967 E019.47.56.215 N050.04.35.995 E019.47.56.302 Color_44ACI
N050.04.35.995 E019.47.56.302 N050.04.36.053 E019.47.56.351 Color_44ACI
N050.04.36.053 E019.47.56.351 N050.04.36.114 E019.47.56.339 Color_44ACI
N050.04.36.114 E019.47.56.339 N050.04.36.163 E019.47.56.269 Color_44ACI
N050.04.36.163 E019.47.56.269 N050.04.36.176 E019.47.56.189 Color_44ACI
N050.04.36.176 E019.47.56.189 N050.04.36.162 E019.47.56.108 Color_44ACI
N050.04.36.162 E019.47.56.108 N050.04.36.138 E019.47.56.063 Color_44ACI
;rwy_ctr_lights N000.00.00.000 E000.00.00.000 N000.00.00.000 E000.00.00.000
N000.23.36.754 E000.07.25.742 N000.24.03.618 W000.06.12.393 Color_252ACI
N000.24.03.618 W000.06.12.393 N000.15.48.769 W000.19.04.582 Color_252ACI
N000.15.48.769 W000.19.04.582 N000.03.34.133 W000.24.19.520 Color_252ACI
N000.03.34.133 W000.24.19.520 S000.11.56.186 W000.21.08.366 Color_252ACI
S000.11.56.186 W000.21.08.366 S000.21.38.931 W000.10.24.928 Color_252ACI
S000.21.38.931 W000.10.24.928 S000.23.25.524 E000.04.41.777 Color_252ACI
S000.23.25.524 E000.04.41.777 S000.16.41.556 E000.17.09.471 Color_252ACI
S000.16.41.556 E000.17.09.471 S000.02.56.264 E000.23.58.483 Color_252ACI
S000.02.56.264 E000.23.58.483 N000.09.17.523 E000.22.33.191 Color_252ACI
N000.09.17.523 E000.22.33.191 N000.19.25.434 E000.15.08.431 Color_252ACI
N000.19.25.434 E000.15.08.431 N000.23.36.754 E000.07.25.742 Color_252ACI
N050.04.29.130 E019.45.44.459 N050.04.29.120 E019.45.44.369 Color_252ACI
N050.04.29.120 E019.45.44.369 N050.04.29.073 E019.45.44.296 Color_252ACI
N050.04.29.073 E019.45.44.296 N050.04.29.017 E019.45.44.278 Color_252ACI
N050.04.29.017 E019.45.44.278 N050.04.28.954 E019.45.44.321 Color_252ACI
N050.04.28.954 E019.45.44.321 N050.04.28.923 E019.45.44.405 Color_252ACI
N050.04.28.923 E019.45.44.405 N050.04.28.929 E019.45.44.507 Color_252ACI
N050.04.28.929 E019.45.44.507 N050.04.28.969 E019.45.44.580 Color_252ACI
N050.04.28.969 E019.45.44.580 N050.04.29.033 E019.45.44.605 Color_252ACI
N050.04.29.033 E019.45.44.605 N050.04.29.083 E019.45.44.579 Color_252ACI
N050.04.29.083 E019.45.44.579 N050.04.29.119 E019.45.44.516 Color_252ACI
N050.04.29.119 E019.45.44.516 N050.04.29.130 E019.45.44.459 Color_252ACI
N050.04.29.335 E019.45.45.960 N050.04.29.325 E019.45.45.870 Color_252ACI
N050.04.29.325 E019.45.45.870 N050.04.29.279 E019.45.45.797 Color_252ACI
N050.04.29.279 E019.45.45.797 N050.04.29.222 E019.45.45.779 Color_252ACI
N050.04.29.222 E019.45.45.779 N050.04.29.159 E019.45.45.822 Color_252ACI
N050.04.29.159 E019.45.45.822 N050.04.29.128 E019.45.45.906 Color_252ACI
N050.04.29.128 E019.45.45.906 N050.04.29.134 E019.45.46.008 Color_252ACI
N050.04.29.134 E019.45.46.008 N050.04.29.174 E019.45.46.081 Color_252ACI
N050.04.29.174 E019.45.46.081 N050.04.29.238 E019.45.46.106 Color_252ACI
N050.04.29.238 E019.45.46.106 N050.04.29.288 E019.45.46.080 Color_252ACI
N050.04.29.288 E019.45.46.080 N050.04.29.325 E019.45.46.017 Color_252ACI
N050.04.29.325 E019.45.46.017 N050.04.29.335 E019.45.45.960 Color_252ACI
N050.04.29.538 E019.45.47.443 N050.04.29.528 E019.45.47.352 Color_252ACI
N050.04.29.528 E019.45.47.352 N050.04.29.481 E019.45.47.279 Color_252ACI
N050.04.29.481 E019.45.47.279 N050.04.29.425 E019.45.47.262 Color_252ACI
N050.04.29.425 E019.45.47.262 N050.04.29.362 E019.45.47.305 Color_252ACI
N050.04.29.362 E019.45.47.305 N050.04.29.331 E019.45.47.389 Color_252ACI
N050.04.29.331 E019.45.47.389 N050.04.29.337 E019.45.47.491 Color_252ACI
N050.04.29.337 E019.45.47.491 N050.04.29.377 E019.45.47.563 Color_252ACI
N050.04.29.377 E019.45.47.563 N050.04.29.441 E019.45.47.589 Color_252ACI
N050.04.29.441 E019.45.47.589 N050.04.29.491 E019.45.47.562 Color_252ACI
N050.04.29.491 E019.45.47.562 N050.04.29.527 E019.45.47.499 Color_252ACI
N050.04.29.527 E019.45.47.499 N050.04.29.538 E019.45.47.443 Color_252ACI
N050.04.29.742 E019.45.48.932 N050.04.29.732 E019.45.48.842 Color_252ACI
N050.04.29.732 E019.45.48.842 N050.04.29.685 E019.45.48.769 Color_252ACI
N050.04.29.685 E019.45.48.769 N050.04.29.629 E019.45.48.751 Color_252ACI
N050.04.29.629 E019.45.48.751 N050.04.29.566 E019.45.48.794 Color_252ACI
N050.04.29.566 E019.45.48.794 N050.04.29.535 E019.45.48.878 Color_252ACI
N050.04.29.535 E019.45.48.878 N050.04.29.541 E019.45.48.980 Color_252ACI
N050.04.29.541 E019.45.48.980 N050.04.29.580 E019.45.49.053 Color_252ACI
N050.04.29.580 E019.45.49.053 N050.04.29.645 E019.45.49.078 Color_252ACI
N050.04.29.645 E019.45.49.078 N050.04.29.695 E019.45.49.052 Color_252ACI
N050.04.29.695 E019.45.49.052 N050.04.29.731 E019.45.48.989 Color_252ACI
N050.04.29.731 E019.45.48.989 N050.04.29.742 E019.45.48.932 Color_252ACI
N050.04.28.232 E019.45.51.008 N050.04.28.221 E019.45.50.918 Color_252ACI
N050.04.28.221 E019.45.50.918 N050.04.28.175 E019.45.50.845 Color_252ACI
N050.04.28.175 E019.45.50.845 N050.04.28.118 E019.45.50.828 Color_252ACI
N050.04.28.118 E019.45.50.828 N050.04.28.056 E019.45.50.870 Color_252ACI
N050.04.28.056 E019.45.50.870 N050.04.28.024 E019.45.50.954 Color_252ACI
N050.04.28.024 E019.45.50.954 N050.04.28.031 E019.45.51.056 Color_252ACI
N050.04.28.031 E019.45.51.056 N050.04.28.070 E019.45.51.129 Color_252ACI
N050.04.28.070 E019.45.51.129 N050.04.28.134 E019.45.51.154 Color_252ACI
N050.04.28.134 E019.45.51.154 N050.04.28.185 E019.45.51.128 Color_252ACI
N050.04.28.185 E019.45.51.128 N050.04.28.221 E019.45.51.065 Color_252ACI
N050.04.28.221 E019.45.51.065 N050.04.28.232 E019.45.51.008 Color_252ACI
N050.04.28.509 E019.45.50.916 N050.04.28.498 E019.45.50.826 Color_252ACI
N050.04.28.498 E019.45.50.826 N050.04.28.452 E019.45.50.753 Color_252ACI
N050.04.28.452 E019.45.50.753 N050.04.28.396 E019.45.50.736 Color_252ACI
N050.04.28.396 E019.45.50.736 N050.04.28.333 E019.45.50.778 Color_252ACI
N050.04.28.333 E019.45.50.778 N050.04.28.302 E019.45.50.862 Color_252ACI
N050.04.28.302 E019.45.50.862 N050.04.28.308 E019.45.50.964 Color_252ACI
N050.04.28.308 E019.45.50.964 N050.04.28.347 E019.45.51.037 Color_252ACI
N050.04.28.347 E019.45.51.037 N050.04.28.411 E019.45.51.062 Color_252ACI
N050.04.28.411 E019.45.51.062 N050.04.28.462 E019.45.51.036 Color_252ACI
N050.04.28.462 E019.45.51.036 N050.04.28.498 E019.45.50.973 Color_252ACI
N050.04.28.498 E019.45.50.973 N050.04.28.509 E019.45.50.916 Color_252ACI
N050.04.28.802 E019.45.50.819 N050.04.28.791 E019.45.50.729 Color_252ACI
N050.04.28.791 E019.45.50.729 N050.04.28.745 E019.45.50.656 Color_252ACI
N050.04.28.745 E019.45.50.656 N050.04.28.689 E019.45.50.638 Color_252ACI
N050.04.28.689 E019.45.50.638 N050.04.28.626 E019.45.50.681 Color_252ACI
N050.04.28.626 E019.45.50.681 N050.04.28.595 E019.45.50.765 Color_252ACI
N050.04.28.595 E019.45.50.765 N050.04.28.601 E019.45.50.867 Color_252ACI
N050.04.28.601 E019.45.50.867 N050.04.28.640 E019.45.50.940 Color_252ACI
N050.04.28.640 E019.45.50.940 N050.04.28.705 E019.45.50.965 Color_252ACI
N050.04.28.705 E019.45.50.965 N050.04.28.755 E019.45.50.939 Color_252ACI
N050.04.28.755 E019.45.50.939 N050.04.28.791 E019.45.50.876 Color_252ACI
N050.04.28.791 E019.45.50.876 N050.04.28.802 E019.45.50.819 Color_252ACI
N050.04.29.085 E019.45.50.725 N050.04.29.074 E019.45.50.635 Color_252ACI
N050.04.29.074 E019.45.50.635 N050.04.29.028 E019.45.50.562 Color_252ACI
N050.04.29.028 E019.45.50.562 N050.04.28.971 E019.45.50.544 Color_252ACI
N050.04.28.971 E019.45.50.544 N050.04.28.909 E019.45.50.587 Color_252ACI
N050.04.28.909 E019.45.50.587 N050.04.28.877 E019.45.50.671 Color_252ACI
N050.04.28.877 E019.45.50.671 N050.04.28.883 E019.45.50.773 Color_252ACI
N050.04.28.883 E019.45.50.773 N050.04.28.923 E019.45.50.846 Color_252ACI
N050.04.28.923 E019.45.50.846 N050.04.28.987 E019.45.50.871 Color_252ACI
N050.04.28.987 E019.45.50.871 N050.04.29.038 E019.45.50.845 Color_252ACI
N050.04.29.038 E019.45.50.845 N050.04.29.074 E019.45.50.782 Color_252ACI
N050.04.29.074 E019.45.50.782 N050.04.29.085 E019.45.50.725 Color_252ACI
N050.04.29.374 E019.45.50.629 N050.04.29.364 E019.45.50.539 Color_252ACI
N050.04.29.364 E019.45.50.539 N050.04.29.317 E019.45.50.465 Color_252ACI
N050.04.29.317 E019.45.50.465 N050.04.29.261 E019.45.50.448 Color_252ACI
N050.04.29.261 E019.45.50.448 N050.04.29.198 E019.45.50.491 Color_252ACI
N050.04.29.198 E019.45.50.491 N050.04.29.167 E019.45.50.575 Color_252ACI
N050.04.29.167 E019.45.50.575 N050.04.29.173 E019.45.50.677 Color_252ACI
N050.04.29.173 E019.45.50.677 N050.04.29.213 E019.45.50.749 Color_252ACI
N050.04.29.213 E019.45.50.749 N050.04.29.277 E019.45.50.775 Color_252ACI
N050.04.29.277 E019.45.50.775 N050.04.29.327 E019.45.50.749 Color_252ACI
N050.04.29.327 E019.45.50.749 N050.04.29.363 E019.45.50.686 Color_252ACI
N050.04.29.363 E019.45.50.686 N050.04.29.374 E019.45.50.629 Color_252ACI
N050.04.29.657 E019.45.50.535 N050.04.29.646 E019.45.50.445 Color_252ACI
N050.04.29.646 E019.45.50.445 N050.04.29.600 E019.45.50.372 Color_252ACI
N050.04.29.600 E019.45.50.372 N050.04.29.543 E019.45.50.354 Color_252ACI
N050.04.29.543 E019.45.50.354 N050.04.29.481 E019.45.50.397 Color_252ACI
N050.04.29.481 E019.45.50.397 N050.04.29.449 E019.45.50.481 Color_252ACI
N050.04.29.449 E019.45.50.481 N050.04.29.455 E019.45.50.583 Color_252ACI
N050.04.29.455 E019.45.50.583 N050.04.29.495 E019.45.50.656 Color_252ACI
N050.04.29.495 E019.45.50.656 N050.04.29.559 E019.45.50.681 Color_252ACI
N050.04.29.559 E019.45.50.681 N050.04.29.610 E019.45.50.655 Color_252ACI
N050.04.29.610 E019.45.50.655 N050.04.29.646 E019.45.50.592 Color_252ACI
N050.04.29.646 E019.45.50.592 N050.04.29.657 E019.45.50.535 Color_252ACI
N050.04.29.949 E019.45.50.438 N050.04.29.939 E019.45.50.347 Color_252ACI
N050.04.29.939 E019.45.50.347 N050.04.29.893 E019.45.50.274 Color_252ACI
N050.04.29.893 E019.45.50.274 N050.04.29.836 E019.45.50.257 Color_252ACI
N050.04.29.836 E019.45.50.257 N050.04.29.774 E019.45.50.300 Color_252ACI
N050.04.29.774 E019.45.50.300 N050.04.29.742 E019.45.50.384 Color_252ACI
N050.04.29.742 E019.45.50.384 N050.04.29.748 E019.45.50.486 Color_252ACI
N050.04.29.748 E019.45.50.486 N050.04.29.788 E019.45.50.558 Color_252ACI
N050.04.29.788 E019.45.50.558 N050.04.29.852 E019.45.50.584 Color_252ACI
N050.04.29.852 E019.45.50.584 N050.04.29.902 E019.45.50.557 Color_252ACI
N050.04.29.902 E019.45.50.557 N050.04.29.939 E019.45.50.494 Color_252ACI
N050.04.29.939 E019.45.50.494 N050.04.29.949 E019.45.50.438 Color_252ACI
N050.04.30.240 E019.45.50.341 N050.04.30.229 E019.45.50.251 Color_252ACI
N050.04.30.229 E019.45.50.251 N050.04.30.183 E019.45.50.178 Color_252ACI
N050.04.30.183 E019.45.50.178 N050.04.30.126 E019.45.50.161 Color_252ACI
N050.04.30.126 E019.45.50.161 N050.04.30.064 E019.45.50.203 Color_252ACI
N050.04.30.064 E019.45.50.203 N050.04.30.032 E019.45.50.288 Color_252ACI
N050.04.30.032 E019.45.50.288 N050.04.30.038 E019.45.50.389 Color_252ACI
N050.04.30.038 E019.45.50.389 N050.04.30.078 E019.45.50.462 Color_252ACI
N050.04.30.078 E019.45.50.462 N050.04.30.142 E019.45.50.488 Color_252ACI
N050.04.30.142 E019.45.50.488 N050.04.30.193 E019.45.50.461 Color_252ACI
N050.04.30.193 E019.45.50.461 N050.04.30.229 E019.45.50.398 Color_252ACI
N050.04.30.229 E019.45.50.398 N050.04.30.240 E019.45.50.341 Color_252ACI
N050.04.30.526 E019.45.50.246 N050.04.30.516 E019.45.50.156 Color_252ACI
N050.04.30.516 E019.45.50.156 N050.04.30.469 E019.45.50.083 Color_252ACI
N050.04.30.469 E019.45.50.083 N050.04.30.413 E019.45.50.065 Color_252ACI
N050.04.30.413 E019.45.50.065 N050.04.30.350 E019.45.50.108 Color_252ACI
N050.04.30.350 E019.45.50.108 N050.04.30.319 E019.45.50.192 Color_252ACI
N050.04.30.319 E019.45.50.192 N050.04.30.325 E019.45.50.294 Color_252ACI
N050.04.30.325 E019.45.50.294 N050.04.30.365 E019.45.50.367 Color_252ACI
N050.04.30.365 E019.45.50.367 N050.04.30.429 E019.45.50.392 Color_252ACI
N050.04.30.429 E019.45.50.392 N050.04.30.479 E019.45.50.366 Color_252ACI
N050.04.30.479 E019.45.50.366 N050.04.30.515 E019.45.50.303 Color_252ACI
N050.04.30.515 E019.45.50.303 N050.04.30.526 E019.45.50.246 Color_252ACI
N050.04.30.801 E019.45.50.155 N050.04.30.791 E019.45.50.065 Color_252ACI
N050.04.30.791 E019.45.50.065 N050.04.30.745 E019.45.49.991 Color_252ACI
N050.04.30.745 E019.45.49.991 N050.04.30.688 E019.45.49.974 Color_252ACI
N050.04.30.688 E019.45.49.974 N050.04.30.626 E019.45.50.017 Color_252ACI
N050.04.30.626 E019.45.50.017 N050.04.30.594 E019.45.50.101 Color_252ACI
N050.04.30.594 E019.45.50.101 N050.04.30.600 E019.45.50.203 Color_252ACI
N050.04.30.600 E019.45.50.203 N050.04.30.640 E019.45.50.275 Color_252ACI
N050.04.30.640 E019.45.50.275 N050.04.30.704 E019.45.50.301 Color_252ACI
N050.04.30.704 E019.45.50.301 N050.04.30.755 E019.45.50.274 Color_252ACI
N050.04.30.755 E019.45.50.274 N050.04.30.791 E019.45.50.211 Color_252ACI
N050.04.30.791 E019.45.50.211 N050.04.30.801 E019.45.50.155 Color_252ACI
N050.04.31.087 E019.45.50.060 N050.04.31.076 E019.45.49.970 Color_252ACI
N050.04.31.076 E019.45.49.970 N050.04.31.030 E019.45.49.897 Color_252ACI
N050.04.31.030 E019.45.49.897 N050.04.30.974 E019.45.49.879 Color_252ACI
N050.04.30.974 E019.45.49.879 N050.04.30.911 E019.45.49.922 Color_252ACI
N050.04.30.911 E019.45.49.922 N050.04.30.880 E019.45.50.006 Color_252ACI
N050.04.30.880 E019.45.50.006 N050.04.30.886 E019.45.50.108 Color_252ACI
N050.04.30.886 E019.45.50.108 N050.04.30.925 E019.45.50.181 Color_252ACI
N050.04.30.925 E019.45.50.181 N050.04.30.989 E019.45.50.206 Color_252ACI
N050.04.30.989 E019.45.50.206 N050.04.31.040 E019.45.50.180 Color_252ACI
N050.04.31.040 E019.45.50.180 N050.04.31.076 E019.45.50.117 Color_252ACI
N050.04.31.076 E019.45.50.117 N050.04.31.087 E019.45.50.060 Color_252ACI
N050.04.31.387 E019.45.49.960 N050.04.31.377 E019.45.49.870 Color_252ACI
N050.04.31.377 E019.45.49.870 N050.04.31.330 E019.45.49.797 Color_252ACI
N050.04.31.330 E019.45.49.797 N050.04.31.274 E019.45.49.779 Color_252ACI
N050.04.31.274 E019.45.49.779 N050.04.31.211 E019.45.49.822 Color_252ACI
N050.04.31.211 E019.45.49.822 N050.04.31.180 E019.45.49.906 Color_252ACI
N050.04.31.180 E019.45.49.906 N050.04.31.186 E019.45.50.008 Color_252ACI
N050.04.31.186 E019.45.50.008 N050.04.31.226 E019.45.50.081 Color_252ACI
N050.04.31.226 E019.45.50.081 N050.04.31.290 E019.45.50.106 Color_252ACI
N050.04.31.290 E019.45.50.106 N050.04.31.340 E019.45.50.080 Color_252ACI
N050.04.31.340 E019.45.50.080 N050.04.31.376 E019.45.50.017 Color_252ACI
N050.04.31.376 E019.45.50.017 N050.04.31.387 E019.45.49.960 Color_252ACI
N050.04.31.673 E019.45.49.865 N050.04.31.663 E019.45.49.775 Color_252ACI
N050.04.31.663 E019.45.49.775 N050.04.31.616 E019.45.49.702 Color_252ACI
N050.04.31.616 E019.45.49.702 N050.04.31.560 E019.45.49.685 Color_252ACI
N050.04.31.560 E019.45.49.685 N050.04.31.497 E019.45.49.727 Color_252ACI
N050.04.31.497 E019.45.49.727 N050.04.31.466 E019.45.49.811 Color_252ACI
N050.04.31.466 E019.45.49.811 N050.04.31.472 E019.45.49.913 Color_252ACI
N050.04.31.472 E019.45.49.913 N050.04.31.511 E019.45.49.986 Color_252ACI
N050.04.31.511 E019.45.49.986 N050.04.31.576 E019.45.50.011 Color_252ACI
N050.04.31.576 E019.45.50.011 N050.04.31.626 E019.45.49.985 Color_252ACI
N050.04.31.626 E019.45.49.985 N050.04.31.662 E019.45.49.922 Color_252ACI
N050.04.31.662 E019.45.49.922 N050.04.31.673 E019.45.49.865 Color_252ACI
N050.04.30.152 E019.45.51.932 N050.04.30.142 E019.45.51.842 Color_252ACI
N050.04.30.142 E019.45.51.842 N050.04.30.096 E019.45.51.769 Color_252ACI
N050.04.30.096 E019.45.51.769 N050.04.30.039 E019.45.51.751 Color_252ACI
N050.04.30.039 E019.45.51.751 N050.04.29.977 E019.45.51.794 Color_252ACI
N050.04.29.977 E019.45.51.794 N050.04.29.945 E019.45.51.878 Color_252ACI
N050.04.29.945 E019.45.51.878 N050.04.29.951 E019.45.51.980 Color_252ACI
N050.04.29.951 E019.45.51.980 N050.04.29.991 E019.45.52.053 Color_252ACI
N050.04.29.991 E019.45.52.053 N050.04.30.055 E019.45.52.078 Color_252ACI
N050.04.30.055 E019.45.52.078 N050.04.30.105 E019.45.52.052 Color_252ACI
N050.04.30.105 E019.45.52.052 N050.04.30.142 E019.45.51.989 Color_252ACI
N050.04.30.142 E019.45.51.989 N050.04.30.152 E019.45.51.932 Color_252ACI
N050.04.30.355 E019.45.53.411 N050.04.30.344 E019.45.53.321 Color_252ACI
N050.04.30.344 E019.45.53.321 N050.04.30.298 E019.45.53.247 Color_252ACI
N050.04.30.298 E019.45.53.247 N050.04.30.241 E019.45.53.230 Color_252ACI
N050.04.30.241 E019.45.53.230 N050.04.30.179 E019.45.53.273 Color_252ACI
N050.04.30.179 E019.45.53.273 N050.04.30.147 E019.45.53.357 Color_252ACI
N050.04.30.147 E019.45.53.357 N050.04.30.154 E019.45.53.459 Color_252ACI
N050.04.30.154 E019.45.53.459 N050.04.30.193 E019.45.53.531 Color_252ACI
N050.04.30.193 E019.45.53.531 N050.04.30.257 E019.45.53.557 Color_252ACI
N050.04.30.257 E019.45.53.557 N050.04.30.308 E019.45.53.531 Color_252ACI
N050.04.30.308 E019.45.53.531 N050.04.30.344 E019.45.53.468 Color_252ACI
N050.04.30.344 E019.45.53.468 N050.04.30.355 E019.45.53.411 Color_252ACI
N050.04.30.561 E019.45.54.919 N050.04.30.551 E019.45.54.829 Color_252ACI
N050.04.30.551 E019.45.54.829 N050.04.30.504 E019.45.54.756 Color_252ACI
N050.04.30.504 E019.45.54.756 N050.04.30.448 E019.45.54.738 Color_252ACI
N050.04.30.448 E019.45.54.738 N050.04.30.385 E019.45.54.781 Color_252ACI
N050.04.30.385 E019.45.54.781 N050.04.30.354 E019.45.54.865 Color_252ACI
N050.04.30.354 E019.45.54.865 N050.04.30.360 E019.45.54.967 Color_252ACI
N050.04.30.360 E019.45.54.967 N050.04.30.400 E019.45.55.040 Color_252ACI
N050.04.30.400 E019.45.55.040 N050.04.30.464 E019.45.55.065 Color_252ACI
N050.04.30.464 E019.45.55.065 N050.04.30.514 E019.45.55.039 Color_252ACI
N050.04.30.514 E019.45.55.039 N050.04.30.550 E019.45.54.976 Color_252ACI
N050.04.30.550 E019.45.54.976 N050.04.30.561 E019.45.54.919 Color_252ACI
N050.04.30.763 E019.45.56.398 N050.04.30.753 E019.45.56.307 Color_252ACI
N050.04.30.753 E019.45.56.307 N050.04.30.706 E019.45.56.234 Color_252ACI
N050.04.30.706 E019.45.56.234 N050.04.30.650 E019.45.56.217 Color_252ACI
N050.04.30.650 E019.45.56.217 N050.04.30.587 E019.45.56.260 Color_252ACI
N050.04.30.587 E019.45.56.260 N050.04.30.556 E019.45.56.344 Color_252ACI
N050.04.30.556 E019.45.56.344 N050.04.30.562 E019.45.56.446 Color_252ACI
N050.04.30.562 E019.45.56.446 N050.04.30.602 E019.45.56.518 Color_252ACI
N050.04.30.602 E019.45.56.518 N050.04.30.666 E019.45.56.544 Color_252ACI
N050.04.30.666 E019.45.56.544 N050.04.30.716 E019.45.56.517 Color_252ACI
N050.04.30.716 E019.45.56.517 N050.04.30.753 E019.45.56.454 Color_252ACI
N050.04.30.753 E019.45.56.454 N050.04.30.763 E019.45.56.398 Color_252ACI
N050.04.30.968 E019.45.57.891 N050.04.30.957 E019.45.57.801 Color_252ACI
N050.04.30.957 E019.45.57.801 N050.04.30.911 E019.45.57.728 Color_252ACI
N050.04.30.911 E019.45.57.728 N050.04.30.854 E019.45.57.710 Color_252ACI
N050.04.30.854 E019.45.57.710 N050.04.30.792 E019.45.57.753 Color_252ACI
N050.04.30.792 E019.45.57.753 N050.04.30.760 E019.45.57.837 Color_252ACI
N050.04.30.760 E019.45.57.837 N050.04.30.766 E019.45.57.939 Color_252ACI
N050.04.30.766 E019.45.57.939 N050.04.30.806 E019.45.58.012 Color_252ACI
N050.04.30.806 E019.45.58.012 N050.04.30.870 E019.45.58.037 Color_252ACI
N050.04.30.870 E019.45.58.037 N050.04.30.921 E019.45.58.011 Color_252ACI
N050.04.30.921 E019.45.58.011 N050.04.30.957 E019.45.57.948 Color_252ACI
N050.04.30.957 E019.45.57.948 N050.04.30.968 E019.45.57.891 Color_252ACI
N050.04.31.174 E019.45.59.400 N050.04.31.164 E019.45.59.310 Color_252ACI
N050.04.31.164 E019.45.59.310 N050.04.31.117 E019.45.59.237 Color_252ACI
N050.04.31.117 E019.45.59.237 N050.04.31.061 E019.45.59.220 Color_252ACI
N050.04.31.061 E019.45.59.220 N050.04.30.998 E019.45.59.262 Color_252ACI
N050.04.30.998 E019.45.59.262 N050.04.30.967 E019.45.59.347 Color_252ACI
N050.04.30.967 E019.45.59.347 N050.04.30.973 E019.45.59.448 Color_252ACI
N050.04.30.973 E019.45.59.448 N050.04.31.013 E019.45.59.521 Color_252ACI
N050.04.31.013 E019.45.59.521 N050.04.31.077 E019.45.59.547 Color_252ACI
N050.04.31.077 E019.45.59.547 N050.04.31.127 E019.45.59.520 Color_252ACI
N050.04.31.127 E019.45.59.520 N050.04.31.163 E019.45.59.457 Color_252ACI
N050.04.31.163 E019.45.59.457 N050.04.31.174 E019.45.59.400 Color_252ACI
N050.04.31.377 E019.46.00.885 N050.04.31.367 E019.46.00.795 Color_252ACI
N050.04.31.367 E019.46.00.795 N050.04.31.320 E019.46.00.722 Color_252ACI
N050.04.31.320 E019.46.00.722 N050.04.31.264 E019.46.00.705 Color_252ACI
N050.04.31.264 E019.46.00.705 N050.04.31.201 E019.46.00.747 Color_252ACI
N050.04.31.201 E019.46.00.747 N050.04.31.170 E019.46.00.831 Color_252ACI
N050.04.31.170 E019.46.00.831 N050.04.31.176 E019.46.00.933 Color_252ACI
N050.04.31.176 E019.46.00.933 N050.04.31.216 E019.46.01.006 Color_252ACI
N050.04.31.216 E019.46.01.006 N050.04.31.280 E019.46.01.031 Color_252ACI
N050.04.31.280 E019.46.01.031 N050.04.31.330 E019.46.01.005 Color_252ACI
N050.04.31.330 E019.46.01.005 N050.04.31.366 E019.46.00.942 Color_252ACI
N050.04.31.366 E019.46.00.942 N050.04.31.377 E019.46.00.885 Color_252ACI
N050.04.31.580 E019.46.02.365 N050.04.31.569 E019.46.02.274 Color_252ACI
N050.04.31.569 E019.46.02.274 N050.04.31.523 E019.46.02.201 Color_252ACI
N050.04.31.523 E019.46.02.201 N050.04.31.466 E019.46.02.184 Color_252ACI
N050.04.31.466 E019.46.02.184 N050.04.31.404 E019.46.02.226 Color_252ACI
N050.04.31.404 E019.46.02.226 N050.04.31.372 E019.46.02.311 Color_252ACI
N050.04.31.372 E019.46.02.311 N050.04.31.378 E019.46.02.413 Color_252ACI
N050.04.31.378 E019.46.02.413 N050.04.31.418 E019.46.02.485 Color_252ACI
N050.04.31.418 E019.46.02.485 N050.04.31.482 E019.46.02.511 Color_252ACI
N050.04.31.482 E019.46.02.511 N050.04.31.533 E019.46.02.484 Color_252ACI
N050.04.31.533 E019.46.02.484 N050.04.31.569 E019.46.02.421 Color_252ACI
N050.04.31.569 E019.46.02.421 N050.04.31.580 E019.46.02.365 Color_252ACI
N050.04.31.795 E019.46.03.941 N050.04.31.785 E019.46.03.850 Color_252ACI
N050.04.31.785 E019.46.03.850 N050.04.31.738 E019.46.03.777 Color_252ACI
N050.04.31.738 E019.46.03.777 N050.04.31.682 E019.46.03.760 Color_252ACI
N050.04.31.682 E019.46.03.760 N050.04.31.619 E019.46.03.803 Color_252ACI
N050.04.31.619 E019.46.03.803 N050.04.31.588 E019.46.03.887 Color_252ACI
N050.04.31.588 E019.46.03.887 N050.04.31.594 E019.46.03.989 Color_252ACI
N050.04.31.594 E019.46.03.989 N050.04.31.634 E019.46.04.061 Color_252ACI
N050.04.31.634 E019.46.04.061 N050.04.31.698 E019.46.04.087 Color_252ACI
N050.04.31.698 E019.46.04.087 N050.04.31.748 E019.46.04.060 Color_252ACI
N050.04.31.748 E019.46.04.060 N050.04.31.784 E019.46.03.997 Color_252ACI
N050.04.31.784 E019.46.03.997 N050.04.31.795 E019.46.03.941 Color_252ACI
N050.04.29.046 E019.46.05.774 N050.04.29.036 E019.46.05.684 Color_252ACI
N050.04.29.036 E019.46.05.684 N050.04.28.990 E019.46.05.611 Color_252ACI
N050.04.28.990 E019.46.05.611 N050.04.28.933 E019.46.05.593 Color_252ACI
N050.04.28.933 E019.46.05.593 N050.04.28.871 E019.46.05.636 Color_252ACI
N050.04.28.871 E019.46.05.636 N050.04.28.839 E019.46.05.720 Color_252ACI
N050.04.28.839 E019.46.05.720 N050.04.28.845 E019.46.05.822 Color_252ACI
N050.04.28.845 E019.46.05.822 N050.04.28.885 E019.46.05.895 Color_252ACI
N050.04.28.885 E019.46.05.895 N050.04.28.949 E019.46.05.920 Color_252ACI
N050.04.28.949 E019.46.05.920 N050.04.29.000 E019.46.05.894 Color_252ACI
N050.04.29.000 E019.46.05.894 N050.04.29.036 E019.46.05.831 Color_252ACI
N050.04.29.036 E019.46.05.831 N050.04.29.046 E019.46.05.774 Color_252ACI
N050.04.29.335 E019.46.05.678 N050.04.29.325 E019.46.05.588 Color_252ACI
N050.04.29.325 E019.46.05.588 N050.04.29.279 E019.46.05.515 Color_252ACI
N050.04.29.279 E019.46.05.515 N050.04.29.222 E019.46.05.497 Color_252ACI
N050.04.29.222 E019.46.05.497 N050.04.29.160 E019.46.05.540 Color_252ACI
N050.04.29.160 E019.46.05.540 N050.04.29.128 E019.46.05.624 Color_252ACI
N050.04.29.128 E019.46.05.624 N050.04.29.134 E019.46.05.726 Color_252ACI
N050.04.29.134 E019.46.05.726 N050.04.29.174 E019.46.05.799 Color_252ACI
N050.04.29.174 E019.46.05.799 N050.04.29.238 E019.46.05.824 Color_252ACI
N050.04.29.238 E019.46.05.824 N050.04.29.289 E019.46.05.798 Color_252ACI
N050.04.29.289 E019.46.05.798 N050.04.29.325 E019.46.05.735 Color_252ACI
N050.04.29.325 E019.46.05.735 N050.04.29.335 E019.46.05.678 Color_252ACI
N050.04.29.616 E019.46.05.585 N050.04.29.606 E019.46.05.495 Color_252ACI
N050.04.29.606 E019.46.05.495 N050.04.29.559 E019.46.05.421 Color_252ACI
N050.04.29.559 E019.46.05.421 N050.04.29.503 E019.46.05.404 Color_252ACI
N050.04.29.503 E019.46.05.404 N050.04.29.440 E019.46.05.447 Color_252ACI
N050.04.29.440 E019.46.05.447 N050.04.29.409 E019.46.05.531 Color_252ACI
N050.04.29.409 E019.46.05.531 N050.04.29.415 E019.46.05.633 Color_252ACI
N050.04.29.415 E019.46.05.633 N050.04.29.455 E019.46.05.705 Color_252ACI
N050.04.29.455 E019.46.05.705 N050.04.29.519 E019.46.05.731 Color_252ACI
N050.04.29.519 E019.46.05.731 N050.04.29.569 E019.46.05.705 Color_252ACI
N050.04.29.569 E019.46.05.705 N050.04.29.605 E019.46.05.642 Color_252ACI
N050.04.29.605 E019.46.05.642 N050.04.29.616 E019.46.05.585 Color_252ACI
N050.04.29.904 E019.46.05.489 N050.04.29.894 E019.46.05.399 Color_252ACI
N050.04.29.894 E019.46.05.399 N050.04.29.847 E019.46.05.326 Color_252ACI
N050.04.29.847 E019.46.05.326 N050.04.29.791 E019.46.05.308 Color_252ACI
N050.04.29.791 E019.46.05.308 N050.04.29.728 E019.46.05.351 Color_252ACI
N050.04.29.728 E019.46.05.351 N050.04.29.697 E019.46.05.435 Color_252ACI
N050.04.29.697 E019.46.05.435 N050.04.29.703 E019.46.05.537 Color_252ACI
N050.04.29.703 E019.46.05.537 N050.04.29.742 E019.46.05.610 Color_252ACI
N050.04.29.742 E019.46.05.610 N050.04.29.807 E019.46.05.635 Color_252ACI
N050.04.29.807 E019.46.05.635 N050.04.29.857 E019.46.05.609 Color_252ACI
N050.04.29.857 E019.46.05.609 N050.04.29.893 E019.46.05.546 Color_252ACI
N050.04.29.893 E019.46.05.546 N050.04.29.904 E019.46.05.489 Color_252ACI
N050.04.30.189 E019.46.05.395 N050.04.30.178 E019.46.05.304 Color_252ACI
N050.04.30.178 E019.46.05.304 N050.04.30.132 E019.46.05.231 Color_252ACI
N050.04.30.132 E019.46.05.231 N050.04.30.075 E019.46.05.214 Color_252ACI
N050.04.30.075 E019.46.05.214 N050.04.30.013 E019.46.05.257 Color_252ACI
N050.04.30.013 E019.46.05.257 N050.04.29.981 E019.46.05.341 Color_252ACI
N050.04.29.981 E019.46.05.341 N050.04.29.987 E019.46.05.443 Color_252ACI
N050.04.29.987 E019.46.05.443 N050.04.30.027 E019.46.05.515 Color_252ACI
N050.04.30.027 E019.46.05.515 N050.04.30.091 E019.46.05.541 Color_252ACI
N050.04.30.091 E019.46.05.541 N050.04.30.142 E019.46.05.514 Color_252ACI
N050.04.30.142 E019.46.05.514 N050.04.30.178 E019.46.05.451 Color_252ACI
N050.04.30.178 E019.46.05.451 N050.04.30.189 E019.46.05.395 Color_252ACI
N050.04.30.463 E019.46.05.304 N050.04.30.453 E019.46.05.213 Color_252ACI
N050.04.30.453 E019.46.05.213 N050.04.30.406 E019.46.05.140 Color_252ACI
N050.04.30.406 E019.46.05.140 N050.04.30.350 E019.46.05.123 Color_252ACI
N050.04.30.350 E019.46.05.123 N050.04.30.287 E019.46.05.165 Color_252ACI
N050.04.30.287 E019.46.05.165 N050.04.30.256 E019.46.05.250 Color_252ACI
N050.04.30.256 E019.46.05.250 N050.04.30.262 E019.46.05.352 Color_252ACI
N050.04.30.262 E019.46.05.352 N050.04.30.302 E019.46.05.424 Color_252ACI
N050.04.30.302 E019.46.05.424 N050.04.30.366 E019.46.05.450 Color_252ACI
N050.04.30.366 E019.46.05.450 N050.04.30.416 E019.46.05.423 Color_252ACI
N050.04.30.416 E019.46.05.423 N050.04.30.452 E019.46.05.360 Color_252ACI
N050.04.30.452 E019.46.05.360 N050.04.30.463 E019.46.05.304 Color_252ACI
N050.04.30.776 E019.46.05.200 N050.04.30.766 E019.46.05.109 Color_252ACI
N050.04.30.766 E019.46.05.109 N050.04.30.720 E019.46.05.036 Color_252ACI
N050.04.30.720 E019.46.05.036 N050.04.30.663 E019.46.05.019 Color_252ACI
N050.04.30.663 E019.46.05.019 N050.04.30.601 E019.46.05.061 Color_252ACI
N050.04.30.601 E019.46.05.061 N050.04.30.569 E019.46.05.146 Color_252ACI
N050.04.30.569 E019.46.05.146 N050.04.30.575 E019.46.05.248 Color_252ACI
N050.04.30.575 E019.46.05.248 N050.04.30.615 E019.46.05.320 Color_252ACI
N050.04.30.615 E019.46.05.320 N050.04.30.679 E019.46.05.346 Color_252ACI
N050.04.30.679 E019.46.05.346 N050.04.30.729 E019.46.05.319 Color_252ACI
N050.04.30.729 E019.46.05.319 N050.04.30.766 E019.46.05.256 Color_252ACI
N050.04.30.766 E019.46.05.256 N050.04.30.776 E019.46.05.200 Color_252ACI
N050.04.31.058 E019.46.05.106 N050.04.31.048 E019.46.05.016 Color_252ACI
N050.04.31.048 E019.46.05.016 N050.04.31.001 E019.46.04.943 Color_252ACI
N050.04.31.001 E019.46.04.943 N050.04.30.945 E019.46.04.925 Color_252ACI
N050.04.30.945 E019.46.04.925 N050.04.30.882 E019.46.04.968 Color_252ACI
N050.04.30.882 E019.46.04.968 N050.04.30.851 E019.46.05.052 Color_252ACI
N050.04.30.851 E019.46.05.052 N050.04.30.857 E019.46.05.154 Color_252ACI
N050.04.30.857 E019.46.05.154 N050.04.30.896 E019.46.05.227 Color_252ACI
N050.04.30.896 E019.46.05.227 N050.04.30.961 E019.46.05.252 Color_252ACI
N050.04.30.961 E019.46.05.252 N050.04.31.011 E019.46.05.226 Color_252ACI
N050.04.31.011 E019.46.05.226 N050.04.31.047 E019.46.05.163 Color_252ACI
N050.04.31.047 E019.46.05.163 N050.04.31.058 E019.46.05.106 Color_252ACI
N050.04.31.334 E019.46.05.014 N050.04.31.324 E019.46.04.924 Color_252ACI
N050.04.31.324 E019.46.04.924 N050.04.31.277 E019.46.04.851 Color_252ACI
N050.04.31.277 E019.46.04.851 N050.04.31.221 E019.46.04.833 Color_252ACI
N050.04.31.221 E019.46.04.833 N050.04.31.158 E019.46.04.876 Color_252ACI
N050.04.31.158 E019.46.04.876 N050.04.31.127 E019.46.04.960 Color_252ACI
N050.04.31.127 E019.46.04.960 N050.04.31.133 E019.46.05.062 Color_252ACI
N050.04.31.133 E019.46.05.062 N050.04.31.173 E019.46.05.135 Color_252ACI
N050.04.31.173 E019.46.05.135 N050.04.31.237 E019.46.05.160 Color_252ACI
N050.04.31.237 E019.46.05.160 N050.04.31.287 E019.46.05.134 Color_252ACI
N050.04.31.287 E019.46.05.134 N050.04.31.323 E019.46.05.071 Color_252ACI
N050.04.31.323 E019.46.05.071 N050.04.31.334 E019.46.05.014 Color_252ACI
N050.04.31.615 E019.46.04.921 N050.04.31.605 E019.46.04.831 Color_252ACI
N050.04.31.605 E019.46.04.831 N050.04.31.558 E019.46.04.757 Color_252ACI
N050.04.31.558 E019.46.04.757 N050.04.31.502 E019.46.04.740 Color_252ACI
N050.04.31.502 E019.46.04.740 N050.04.31.439 E019.46.04.783 Color_252ACI
N050.04.31.439 E019.46.04.783 N050.04.31.408 E019.46.04.867 Color_252ACI
N050.04.31.408 E019.46.04.867 N050.04.31.414 E019.46.04.969 Color_252ACI
N050.04.31.414 E019.46.04.969 N050.04.31.454 E019.46.05.041 Color_252ACI
N050.04.31.454 E019.46.05.041 N050.04.31.518 E019.46.05.067 Color_252ACI
N050.04.31.518 E019.46.05.067 N050.04.31.568 E019.46.05.041 Color_252ACI
N050.04.31.568 E019.46.05.041 N050.04.31.604 E019.46.04.978 Color_252ACI
N050.04.31.604 E019.46.04.978 N050.04.31.615 E019.46.04.921 Color_252ACI
N050.04.31.918 E019.46.04.820 N050.04.31.907 E019.46.04.730 Color_252ACI
N050.04.31.907 E019.46.04.730 N050.04.31.861 E019.46.04.657 Color_252ACI
N050.04.31.861 E019.46.04.657 N050.04.31.805 E019.46.04.640 Color_252ACI
N050.04.31.805 E019.46.04.640 N050.04.31.742 E019.46.04.682 Color_252ACI
N050.04.31.742 E019.46.04.682 N050.04.31.711 E019.46.04.766 Color_252ACI
N050.04.31.711 E019.46.04.766 N050.04.31.717 E019.46.04.868 Color_252ACI
N050.04.31.717 E019.46.04.868 N050.04.31.756 E019.46.04.941 Color_252ACI
N050.04.31.756 E019.46.04.941 N050.04.31.821 E019.46.04.967 Color_252ACI
N050.04.31.821 E019.46.04.967 N050.04.31.871 E019.46.04.940 Color_252ACI
N050.04.31.871 E019.46.04.940 N050.04.31.907 E019.46.04.877 Color_252ACI
N050.04.31.907 E019.46.04.877 N050.04.31.918 E019.46.04.820 Color_252ACI
N050.04.32.212 E019.46.04.723 N050.04.32.201 E019.46.04.632 Color_252ACI
N050.04.32.201 E019.46.04.632 N050.04.32.155 E019.46.04.559 Color_252ACI
N050.04.32.155 E019.46.04.559 N050.04.32.099 E019.46.04.542 Color_252ACI
N050.04.32.099 E019.46.04.542 N050.04.32.036 E019.46.04.585 Color_252ACI
N050.04.32.036 E019.46.04.585 N050.04.32.005 E019.46.04.669 Color_252ACI
N050.04.32.005 E019.46.04.669 N050.04.32.011 E019.46.04.771 Color_252ACI
N050.04.32.011 E019.46.04.771 N050.04.32.050 E019.46.04.843 Color_252ACI
N050.04.32.050 E019.46.04.843 N050.04.32.115 E019.46.04.869 Color_252ACI
N050.04.32.115 E019.46.04.869 N050.04.32.165 E019.46.04.842 Color_252ACI
N050.04.32.165 E019.46.04.842 N050.04.32.201 E019.46.04.779 Color_252ACI
N050.04.32.201 E019.46.04.779 N050.04.32.212 E019.46.04.723 Color_252ACI
N050.04.32.495 E019.46.04.629 N050.04.32.484 E019.46.04.538 Color_252ACI
N050.04.32.484 E019.46.04.538 N050.04.32.438 E019.46.04.465 Color_252ACI
N050.04.32.438 E019.46.04.465 N050.04.32.381 E019.46.04.448 Color_252ACI
N050.04.32.381 E019.46.04.448 N050.04.32.319 E019.46.04.491 Color_252ACI
N050.04.32.319 E019.46.04.491 N050.04.32.287 E019.46.04.575 Color_252ACI
N050.04.32.287 E019.46.04.575 N050.04.32.294 E019.46.04.677 Color_252ACI
N050.04.32.294 E019.46.04.677 N050.04.32.333 E019.46.04.749 Color_252ACI
N050.04.32.333 E019.46.04.749 N050.04.32.397 E019.46.04.775 Color_252ACI
N050.04.32.397 E019.46.04.775 N050.04.32.448 E019.46.04.748 Color_252ACI
N050.04.32.448 E019.46.04.748 N050.04.32.484 E019.46.04.685 Color_252ACI
N050.04.32.484 E019.46.04.685 N050.04.32.495 E019.46.04.629 Color_252ACI
N050.04.32.774 E019.46.04.536 N050.04.32.763 E019.46.04.446 Color_252ACI
N050.04.32.763 E019.46.04.446 N050.04.32.717 E019.46.04.373 Color_252ACI
N050.04.32.717 E019.46.04.373 N050.04.32.661 E019.46.04.355 Color_252ACI
N050.04.32.661 E019.46.04.355 N050.04.32.598 E019.46.04.398 Color_252ACI
N050.04.32.598 E019.46.04.398 N050.04.32.567 E019.46.04.482 Color_252ACI
N050.04.32.567 E019.46.04.482 N050.04.32.573 E019.46.04.584 Color_252ACI
N050.04.32.573 E019.46.04.584 N050.04.32.612 E019.46.04.657 Color_252ACI
N050.04.32.612 E019.46.04.657 N050.04.32.676 E019.46.04.682 Color_252ACI
N050.04.32.676 E019.46.04.682 N050.04.32.727 E019.46.04.656 Color_252ACI
N050.04.32.727 E019.46.04.656 N050.04.32.763 E019.46.04.593 Color_252ACI
N050.04.32.763 E019.46.04.593 N050.04.32.774 E019.46.04.536 Color_252ACI
N050.04.33.065 E019.46.04.439 N050.04.33.055 E019.46.04.349 Color_252ACI
N050.04.33.055 E019.46.04.349 N050.04.33.008 E019.46.04.276 Color_252ACI
N050.04.33.008 E019.46.04.276 N050.04.32.952 E019.46.04.258 Color_252ACI
N050.04.32.952 E019.46.04.258 N050.04.32.889 E019.46.04.301 Color_252ACI
N050.04.32.889 E019.46.04.301 N050.04.32.858 E019.46.04.385 Color_252ACI
N050.04.32.858 E019.46.04.385 N050.04.32.864 E019.46.04.487 Color_252ACI
N050.04.32.864 E019.46.04.487 N050.04.32.904 E019.46.04.560 Color_252ACI
N050.04.32.904 E019.46.04.560 N050.04.32.968 E019.46.04.585 Color_252ACI
N050.04.32.968 E019.46.04.585 N050.04.33.018 E019.46.04.559 Color_252ACI
N050.04.33.018 E019.46.04.559 N050.04.33.054 E019.46.04.496 Color_252ACI
N050.04.33.054 E019.46.04.496 N050.04.33.065 E019.46.04.439 Color_252ACI
N050.04.33.344 E019.46.04.347 N050.04.33.334 E019.46.04.256 Color_252ACI
N050.04.33.334 E019.46.04.256 N050.04.33.288 E019.46.04.183 Color_252ACI
N050.04.33.288 E019.46.04.183 N050.04.33.231 E019.46.04.166 Color_252ACI
N050.04.33.231 E019.46.04.166 N050.04.33.168 E019.46.04.208 Color_252ACI
N050.04.33.168 E019.46.04.208 N050.04.33.137 E019.46.04.293 Color_252ACI
N050.04.33.137 E019.46.04.293 N050.04.33.143 E019.46.04.395 Color_252ACI
N050.04.33.143 E019.46.04.395 N050.04.33.183 E019.46.04.467 Color_252ACI
N050.04.33.183 E019.46.04.467 N050.04.33.247 E019.46.04.493 Color_252ACI
N050.04.33.247 E019.46.04.493 N050.04.33.297 E019.46.04.466 Color_252ACI
N050.04.33.297 E019.46.04.466 N050.04.33.334 E019.46.04.403 Color_252ACI
N050.04.33.334 E019.46.04.403 N050.04.33.344 E019.46.04.347 Color_252ACI
N050.04.33.633 E019.46.04.251 N050.04.33.623 E019.46.04.160 Color_252ACI
N050.04.33.623 E019.46.04.160 N050.04.33.577 E019.46.04.087 Color_252ACI
N050.04.33.577 E019.46.04.087 N050.04.33.520 E019.46.04.070 Color_252ACI
N050.04.33.520 E019.46.04.070 N050.04.33.457 E019.46.04.112 Color_252ACI
N050.04.33.457 E019.46.04.112 N050.04.33.426 E019.46.04.197 Color_252ACI
N050.04.33.426 E019.46.04.197 N050.04.33.432 E019.46.04.299 Color_252ACI
N050.04.33.432 E019.46.04.299 N050.04.33.472 E019.46.04.371 Color_252ACI
N050.04.33.472 E019.46.04.371 N050.04.33.536 E019.46.04.397 Color_252ACI
N050.04.33.536 E019.46.04.397 N050.04.33.586 E019.46.04.370 Color_252ACI
N050.04.33.586 E019.46.04.370 N050.04.33.623 E019.46.04.307 Color_252ACI
N050.04.33.623 E019.46.04.307 N050.04.33.633 E019.46.04.251 Color_252ACI
N050.04.33.934 E019.46.04.151 N050.04.33.923 E019.46.04.060 Color_252ACI
N050.04.33.923 E019.46.04.060 N050.04.33.877 E019.46.03.987 Color_252ACI
N050.04.33.877 E019.46.03.987 N050.04.33.821 E019.46.03.970 Color_252ACI
N050.04.33.821 E019.46.03.970 N050.04.33.758 E019.46.04.013 Color_252ACI
N050.04.33.758 E019.46.04.013 N050.04.33.727 E019.46.04.097 Color_252ACI
N050.04.33.727 E019.46.04.097 N050.04.33.733 E019.46.04.199 Color_252ACI
N050.04.33.733 E019.46.04.199 N050.04.33.772 E019.46.04.271 Color_252ACI
N050.04.33.772 E019.46.04.271 N050.04.33.837 E019.46.04.297 Color_252ACI
N050.04.33.837 E019.46.04.297 N050.04.33.887 E019.46.04.270 Color_252ACI
N050.04.33.887 E019.46.04.270 N050.04.33.923 E019.46.04.207 Color_252ACI
N050.04.33.923 E019.46.04.207 N050.04.33.934 E019.46.04.151 Color_252ACI
N050.04.34.205 E019.46.04.061 N050.04.34.195 E019.46.03.970 Color_252ACI
N050.04.34.195 E019.46.03.970 N050.04.34.148 E019.46.03.897 Color_252ACI
N050.04.34.148 E019.46.03.897 N050.04.34.092 E019.46.03.880 Color_252ACI
N050.04.34.092 E019.46.03.880 N050.04.34.029 E019.46.03.922 Color_252ACI
N050.04.34.029 E019.46.03.922 N050.04.33.998 E019.46.04.007 Color_252ACI
N050.04.33.998 E019.46.04.007 N050.04.34.004 E019.46.04.109 Color_252ACI
N050.04.34.004 E019.46.04.109 N050.04.34.044 E019.46.04.181 Color_252ACI
N050.04.34.044 E019.46.04.181 N050.04.34.108 E019.46.04.207 Color_252ACI
N050.04.34.108 E019.46.04.207 N050.04.34.158 E019.46.04.180 Color_252ACI
N050.04.34.158 E019.46.04.180 N050.04.34.195 E019.46.04.117 Color_252ACI
N050.04.34.195 E019.46.04.117 N050.04.34.205 E019.46.04.061 Color_252ACI
N050.04.34.501 E019.46.03.962 N050.04.34.491 E019.46.03.872 Color_252ACI
N050.04.34.491 E019.46.03.872 N050.04.34.445 E019.46.03.799 Color_252ACI
N050.04.34.445 E019.46.03.799 N050.04.34.388 E019.46.03.781 Color_252ACI
N050.04.34.388 E019.46.03.781 N050.04.34.325 E019.46.03.824 Color_252ACI
N050.04.34.325 E019.46.03.824 N050.04.34.294 E019.46.03.908 Color_252ACI
N050.04.34.294 E019.46.03.908 N050.04.34.300 E019.46.04.010 Color_252ACI
N050.04.34.300 E019.46.04.010 N050.04.34.340 E019.46.04.083 Color_252ACI
N050.04.34.340 E019.46.04.083 N050.04.34.404 E019.46.04.108 Color_252ACI
N050.04.34.404 E019.46.04.108 N050.04.34.454 E019.46.04.082 Color_252ACI
N050.04.34.454 E019.46.04.082 N050.04.34.491 E019.46.04.019 Color_252ACI
N050.04.34.491 E019.46.04.019 N050.04.34.501 E019.46.03.962 Color_252ACI
N050.04.34.789 E019.46.03.867 N050.04.34.779 E019.46.03.776 Color_252ACI
N050.04.34.779 E019.46.03.776 N050.04.34.732 E019.46.03.703 Color_252ACI
N050.04.34.732 E019.46.03.703 N050.04.34.676 E019.46.03.686 Color_252ACI
N050.04.34.676 E019.46.03.686 N050.04.34.613 E019.46.03.729 Color_252ACI
N050.04.34.613 E019.46.03.729 N050.04.34.582 E019.46.03.813 Color_252ACI
N050.04.34.582 E019.46.03.813 N050.04.34.588 E019.46.03.915 Color_252ACI
N050.04.34.588 E019.46.03.915 N050.04.34.628 E019.46.03.987 Color_252ACI
N050.04.34.628 E019.46.03.987 N050.04.34.692 E019.46.04.013 Color_252ACI
N050.04.34.692 E019.46.04.013 N050.04.34.742 E019.46.03.986 Color_252ACI
N050.04.34.742 E019.46.03.986 N050.04.34.778 E019.46.03.923 Color_252ACI
N050.04.34.778 E019.46.03.923 N050.04.34.789 E019.46.03.867 Color_252ACI
N050.04.53.244 E019.48.45.151 N050.04.53.234 E019.48.45.060 Color_252ACI
N050.04.53.234 E019.48.45.060 N050.04.53.187 E019.48.44.987 Color_252ACI
N050.04.53.187 E019.48.44.987 N050.04.53.131 E019.48.44.970 Color_252ACI
N050.04.53.131 E019.48.44.970 N050.04.53.068 E019.48.45.012 Color_252ACI
N050.04.53.068 E019.48.45.012 N050.04.53.037 E019.48.45.097 Color_252ACI
N050.04.53.037 E019.48.45.097 N050.04.53.043 E019.48.45.199 Color_252ACI
N050.04.53.043 E019.48.45.199 N050.04.53.083 E019.48.45.271 Color_252ACI
N050.04.53.083 E019.48.45.271 N050.04.53.147 E019.48.45.297 Color_252ACI
N050.04.53.147 E019.48.45.297 N050.04.53.197 E019.48.45.270 Color_252ACI
N050.04.53.197 E019.48.45.270 N050.04.53.233 E019.48.45.207 Color_252ACI
N050.04.53.233 E019.48.45.207 N050.04.53.244 E019.48.45.151 Color_252ACI
N050.04.53.531 E019.48.45.056 N050.04.53.521 E019.48.44.965 Color_252ACI
N050.04.53.521 E019.48.44.965 N050.04.53.474 E019.48.44.892 Color_252ACI
N050.04.53.474 E019.48.44.892 N050.04.53.418 E019.48.44.875 Color_252ACI
N050.04.53.418 E019.48.44.875 N050.04.53.355 E019.48.44.917 Color_252ACI
N050.04.53.355 E019.48.44.917 N050.04.53.324 E019.48.45.002 Color_252ACI
N050.04.53.324 E019.48.45.002 N050.04.53.330 E019.48.45.104 Color_252ACI
N050.04.53.330 E019.48.45.104 N050.04.53.370 E019.48.45.176 Color_252ACI
N050.04.53.370 E019.48.45.176 N050.04.53.434 E019.48.45.202 Color_252ACI
N050.04.53.434 E019.48.45.202 N050.04.53.484 E019.48.45.175 Color_252ACI
N050.04.53.484 E019.48.45.175 N050.04.53.520 E019.48.45.112 Color_252ACI
N050.04.53.520 E019.48.45.112 N050.04.53.531 E019.48.45.056 Color_252ACI
N050.04.54.102 E019.48.44.867 N050.04.54.091 E019.48.44.776 Color_252ACI
N050.04.54.091 E019.48.44.776 N050.04.54.045 E019.48.44.703 Color_252ACI
N050.04.54.045 E019.48.44.703 N050.04.53.988 E019.48.44.686 Color_252ACI
N050.04.53.988 E019.48.44.686 N050.04.53.926 E019.48.44.729 Color_252ACI
N050.04.53.926 E019.48.44.729 N050.04.53.894 E019.48.44.813 Color_252ACI
N050.04.53.894 E019.48.44.813 N050.04.53.900 E019.48.44.915 Color_252ACI
N050.04.53.900 E019.48.44.915 N050.04.53.940 E019.48.44.987 Color_252ACI
N050.04.53.940 E019.48.44.987 N050.04.54.004 E019.48.45.013 Color_252ACI
N050.04.54.004 E019.48.45.013 N050.04.54.055 E019.48.44.986 Color_252ACI
N050.04.54.055 E019.48.44.986 N050.04.54.091 E019.48.44.923 Color_252ACI
N050.04.54.091 E019.48.44.923 N050.04.54.102 E019.48.44.867 Color_252ACI
N050.04.54.386 E019.48.44.772 N050.04.54.376 E019.48.44.682 Color_252ACI
N050.04.54.376 E019.48.44.682 N050.04.54.330 E019.48.44.609 Color_252ACI
N050.04.54.330 E019.48.44.609 N050.04.54.273 E019.48.44.592 Color_252ACI
N050.04.54.273 E019.48.44.592 N050.04.54.211 E019.48.44.634 Color_252ACI
N050.04.54.211 E019.48.44.634 N050.04.54.179 E019.48.44.719 Color_252ACI
N050.04.54.179 E019.48.44.719 N050.04.54.185 E019.48.44.820 Color_252ACI
N050.04.54.185 E019.48.44.820 N050.04.54.225 E019.48.44.893 Color_252ACI
N050.04.54.225 E019.48.44.893 N050.04.54.289 E019.48.44.919 Color_252ACI
N050.04.54.289 E019.48.44.919 N050.04.54.340 E019.48.44.892 Color_252ACI
N050.04.54.340 E019.48.44.892 N050.04.54.376 E019.48.44.829 Color_252ACI
N050.04.54.376 E019.48.44.829 N050.04.54.386 E019.48.44.772 Color_252ACI
N050.04.53.038 E019.48.43.635 N050.04.53.028 E019.48.43.545 Color_252ACI
N050.04.53.028 E019.48.43.545 N050.04.52.981 E019.48.43.472 Color_252ACI
N050.04.52.981 E019.48.43.472 N050.04.52.925 E019.48.43.454 Color_252ACI
N050.04.52.925 E019.48.43.454 N050.04.52.862 E019.48.43.497 Color_252ACI
N050.04.52.862 E019.48.43.497 N050.04.52.831 E019.48.43.581 Color_252ACI
N050.04.52.831 E019.48.43.581 N050.04.52.837 E019.48.43.683 Color_252ACI
N050.04.52.837 E019.48.43.683 N050.04.52.877 E019.48.43.756 Color_252ACI
N050.04.52.877 E019.48.43.756 N050.04.52.941 E019.48.43.781 Color_252ACI
N050.04.52.941 E019.48.43.781 N050.04.52.991 E019.48.43.755 Color_252ACI
N050.04.52.991 E019.48.43.755 N050.04.53.027 E019.48.43.692 Color_252ACI
N050.04.53.027 E019.48.43.692 N050.04.53.038 E019.48.43.635 Color_252ACI
N050.04.53.315 E019.48.43.543 N050.04.53.305 E019.48.43.453 Color_252ACI
N050.04.53.305 E019.48.43.453 N050.04.53.259 E019.48.43.380 Color_252ACI
N050.04.53.259 E019.48.43.380 N050.04.53.202 E019.48.43.362 Color_252ACI
N050.04.53.202 E019.48.43.362 N050.04.53.140 E019.48.43.405 Color_252ACI
N050.04.53.140 E019.48.43.405 N050.04.53.108 E019.48.43.489 Color_252ACI
N050.04.53.108 E019.48.43.489 N050.04.53.114 E019.48.43.591 Color_252ACI
N050.04.53.114 E019.48.43.591 N050.04.53.154 E019.48.43.664 Color_252ACI
N050.04.53.154 E019.48.43.664 N050.04.53.218 E019.48.43.689 Color_252ACI
N050.04.53.218 E019.48.43.689 N050.04.53.268 E019.48.43.663 Color_252ACI
N050.04.53.268 E019.48.43.663 N050.04.53.305 E019.48.43.600 Color_252ACI
N050.04.53.305 E019.48.43.600 N050.04.53.315 E019.48.43.543 Color_252ACI
N050.04.53.895 E019.48.43.351 N050.04.53.885 E019.48.43.261 Color_252ACI
N050.04.53.885 E019.48.43.261 N050.04.53.839 E019.48.43.188 Color_252ACI
N050.04.53.839 E019.48.43.188 N050.04.53.782 E019.48.43.170 Color_252ACI
N050.04.53.782 E019.48.43.170 N050.04.53.720 E019.48.43.213 Color_252ACI
N050.04.53.720 E019.48.43.213 N050.04.53.688 E019.48.43.297 Color_252ACI
N050.04.53.688 E019.48.43.297 N050.04.53.694 E019.48.43.399 Color_252ACI
N050.04.53.694 E019.48.43.399 N050.04.53.734 E019.48.43.472 Color_252ACI
N050.04.53.734 E019.48.43.472 N050.04.53.798 E019.48.43.497 Color_252ACI
N050.04.53.798 E019.48.43.497 N050.04.53.849 E019.48.43.471 Color_252ACI
N050.04.53.849 E019.48.43.471 N050.04.53.885 E019.48.43.408 Color_252ACI
N050.04.53.885 E019.48.43.408 N050.04.53.895 E019.48.43.351 Color_252ACI
N050.04.54.166 E019.48.43.262 N050.04.54.156 E019.48.43.171 Color_252ACI
N050.04.54.156 E019.48.43.171 N050.04.54.109 E019.48.43.098 Color_252ACI
N050.04.54.109 E019.48.43.098 N050.04.54.053 E019.48.43.081 Color_252ACI
N050.04.54.053 E019.48.43.081 N050.04.53.990 E019.48.43.124 Color_252ACI
N050.04.53.990 E019.48.43.124 N050.04.53.959 E019.48.43.208 Color_252ACI
N050.04.53.959 E019.48.43.208 N050.04.53.965 E019.48.43.310 Color_252ACI
N050.04.53.965 E019.48.43.310 N050.04.54.004 E019.48.43.382 Color_252ACI
N050.04.54.004 E019.48.43.382 N050.04.54.069 E019.48.43.408 Color_252ACI
N050.04.54.069 E019.48.43.408 N050.04.54.119 E019.48.43.381 Color_252ACI
N050.04.54.119 E019.48.43.381 N050.04.54.155 E019.48.43.318 Color_252ACI
N050.04.54.155 E019.48.43.318 N050.04.54.166 E019.48.43.262 Color_252ACI
N050.04.52.821 E019.48.42.134 N050.04.52.810 E019.48.42.044 Color_252ACI
N050.04.52.810 E019.48.42.044 N050.04.52.764 E019.48.41.971 Color_252ACI
N050.04.52.764 E019.48.41.971 N050.04.52.708 E019.48.41.953 Color_252ACI
N050.04.52.708 E019.48.41.953 N050.04.52.645 E019.48.41.996 Color_252ACI
N050.04.52.645 E019.48.41.996 N050.04.52.614 E019.48.42.080 Color_252ACI
N050.04.52.614 E019.48.42.080 N050.04.52.620 E019.48.42.182 Color_252ACI
N050.04.52.620 E019.48.42.182 N050.04.52.659 E019.48.42.255 Color_252ACI
N050.04.52.659 E019.48.42.255 N050.04.52.724 E019.48.42.280 Color_252ACI
N050.04.52.724 E019.48.42.280 N050.04.52.774 E019.48.42.254 Color_252ACI
N050.04.52.774 E019.48.42.254 N050.04.52.810 E019.48.42.191 Color_252ACI
N050.04.52.810 E019.48.42.191 N050.04.52.821 E019.48.42.134 Color_252ACI
N050.04.53.110 E019.48.42.038 N050.04.53.100 E019.48.41.948 Color_252ACI
N050.04.53.100 E019.48.41.948 N050.04.53.053 E019.48.41.875 Color_252ACI
N050.04.53.053 E019.48.41.875 N050.04.52.997 E019.48.41.858 Color_252ACI
N050.04.52.997 E019.48.41.858 N050.04.52.934 E019.48.41.900 Color_252ACI
N050.04.52.934 E019.48.41.900 N050.04.52.903 E019.48.41.985 Color_252ACI
N050.04.52.903 E019.48.41.985 N050.04.52.909 E019.48.42.086 Color_252ACI
N050.04.52.909 E019.48.42.086 N050.04.52.949 E019.48.42.159 Color_252ACI
N050.04.52.949 E019.48.42.159 N050.04.53.013 E019.48.42.185 Color_252ACI
N050.04.53.013 E019.48.42.185 N050.04.53.063 E019.48.42.158 Color_252ACI
N050.04.53.063 E019.48.42.158 N050.04.53.099 E019.48.42.095 Color_252ACI
N050.04.53.099 E019.48.42.095 N050.04.53.110 E019.48.42.038 Color_252ACI
N050.04.53.688 E019.48.41.847 N050.04.53.678 E019.48.41.757 Color_252ACI
N050.04.53.678 E019.48.41.757 N050.04.53.632 E019.48.41.684 Color_252ACI
N050.04.53.632 E019.48.41.684 N050.04.53.575 E019.48.41.666 Color_252ACI
N050.04.53.575 E019.48.41.666 N050.04.53.513 E019.48.41.709 Color_252ACI
N050.04.53.513 E019.48.41.709 N050.04.53.481 E019.48.41.793 Color_252ACI
N050.04.53.481 E019.48.41.793 N050.04.53.487 E019.48.41.895 Color_252ACI
N050.04.53.487 E019.48.41.895 N050.04.53.527 E019.48.41.968 Color_252ACI
N050.04.53.527 E019.48.41.968 N050.04.53.591 E019.48.41.993 Color_252ACI
N050.04.53.591 E019.48.41.993 N050.04.53.642 E019.48.41.967 Color_252ACI
N050.04.53.642 E019.48.41.967 N050.04.53.678 E019.48.41.904 Color_252ACI
N050.04.53.678 E019.48.41.904 N050.04.53.688 E019.48.41.847 Color_252ACI
N050.04.53.974 E019.48.41.752 N050.04.53.964 E019.48.41.662 Color_252ACI
N050.04.53.964 E019.48.41.662 N050.04.53.917 E019.48.41.589 Color_252ACI
N050.04.53.917 E019.48.41.589 N050.04.53.861 E019.48.41.572 Color_252ACI
N050.04.53.861 E019.48.41.572 N050.04.53.798 E019.48.41.614 Color_252ACI
N050.04.53.798 E019.48.41.614 N050.04.53.767 E019.48.41.698 Color_252ACI
N050.04.53.767 E019.48.41.698 N050.04.53.773 E019.48.41.800 Color_252ACI
N050.04.53.773 E019.48.41.800 N050.04.53.813 E019.48.41.873 Color_252ACI
N050.04.53.813 E019.48.41.873 N050.04.53.877 E019.48.41.899 Color_252ACI
N050.04.53.877 E019.48.41.899 N050.04.53.927 E019.48.41.872 Color_252ACI
N050.04.53.927 E019.48.41.872 N050.04.53.963 E019.48.41.809 Color_252ACI
N050.04.53.963 E019.48.41.809 N050.04.53.974 E019.48.41.752 Color_252ACI
N050.04.52.627 E019.48.40.651 N050.04.52.616 E019.48.40.561 Color_252ACI
N050.04.52.616 E019.48.40.561 N050.04.52.570 E019.48.40.488 Color_252ACI
N050.04.52.570 E019.48.40.488 N050.04.52.513 E019.48.40.470 Color_252ACI
N050.04.52.513 E019.48.40.470 N050.04.52.451 E019.48.40.513 Color_252ACI
N050.04.52.451 E019.48.40.513 N050.04.52.419 E019.48.40.597 Color_252ACI
N050.04.52.419 E019.48.40.597 N050.04.52.425 E019.48.40.699 Color_252ACI
N050.04.52.425 E019.48.40.699 N050.04.52.465 E019.48.40.772 Color_252ACI
N050.04.52.465 E019.48.40.772 N050.04.52.529 E019.48.40.797 Color_252ACI
N050.04.52.529 E019.48.40.797 N050.04.52.580 E019.48.40.771 Color_252ACI
N050.04.52.580 E019.48.40.771 N050.04.52.616 E019.48.40.708 Color_252ACI
N050.04.52.616 E019.48.40.708 N050.04.52.627 E019.48.40.651 Color_252ACI
N050.04.52.910 E019.48.40.557 N050.04.52.900 E019.48.40.467 Color_252ACI
N050.04.52.900 E019.48.40.467 N050.04.52.853 E019.48.40.394 Color_252ACI
N050.04.52.853 E019.48.40.394 N050.04.52.797 E019.48.40.377 Color_252ACI
N050.04.52.797 E019.48.40.377 N050.04.52.734 E019.48.40.419 Color_252ACI
N050.04.52.734 E019.48.40.419 N050.04.52.703 E019.48.40.503 Color_252ACI
N050.04.52.703 E019.48.40.503 N050.04.52.709 E019.48.40.605 Color_252ACI
N050.04.52.709 E019.48.40.605 N050.04.52.749 E019.48.40.678 Color_252ACI
N050.04.52.749 E019.48.40.678 N050.04.52.813 E019.48.40.703 Color_252ACI
N050.04.52.813 E019.48.40.703 N050.04.52.863 E019.48.40.677 Color_252ACI
N050.04.52.863 E019.48.40.677 N050.04.52.899 E019.48.40.614 Color_252ACI
N050.04.52.899 E019.48.40.614 N050.04.52.910 E019.48.40.557 Color_252ACI
N050.04.53.497 E019.48.40.363 N050.04.53.487 E019.48.40.273 Color_252ACI
N050.04.53.487 E019.48.40.273 N050.04.53.440 E019.48.40.200 Color_252ACI
N050.04.53.440 E019.48.40.200 N050.04.53.384 E019.48.40.182 Color_252ACI
N050.04.53.384 E019.48.40.182 N050.04.53.321 E019.48.40.225 Color_252ACI
N050.04.53.321 E019.48.40.225 N050.04.53.290 E019.48.40.309 Color_252ACI
N050.04.53.290 E019.48.40.309 N050.04.53.296 E019.48.40.411 Color_252ACI
N050.04.53.296 E019.48.40.411 N050.04.53.336 E019.48.40.484 Color_252ACI
N050.04.53.336 E019.48.40.484 N050.04.53.400 E019.48.40.509 Color_252ACI
N050.04.53.400 E019.48.40.509 N050.04.53.450 E019.48.40.483 Color_252ACI
N050.04.53.450 E019.48.40.483 N050.04.53.486 E019.48.40.420 Color_252ACI
N050.04.53.486 E019.48.40.420 N050.04.53.497 E019.48.40.363 Color_252ACI
N050.04.53.776 E019.48.40.271 N050.04.53.765 E019.48.40.181 Color_252ACI
N050.04.53.765 E019.48.40.181 N050.04.53.719 E019.48.40.107 Color_252ACI
N050.04.53.719 E019.48.40.107 N050.04.53.662 E019.48.40.090 Color_252ACI
N050.04.53.662 E019.48.40.090 N050.04.53.600 E019.48.40.133 Color_252ACI
N050.04.53.600 E019.48.40.133 N050.04.53.568 E019.48.40.217 Color_252ACI
N050.04.53.568 E019.48.40.217 N050.04.53.574 E019.48.40.319 Color_252ACI
N050.04.53.574 E019.48.40.319 N050.04.53.614 E019.48.40.391 Color_252ACI
N050.04.53.614 E019.48.40.391 N050.04.53.678 E019.48.40.417 Color_252ACI
N050.04.53.678 E019.48.40.417 N050.04.53.729 E019.48.40.390 Color_252ACI
N050.04.53.729 E019.48.40.390 N050.04.53.765 E019.48.40.327 Color_252ACI
N050.04.53.765 E019.48.40.327 N050.04.53.776 E019.48.40.271 Color_252ACI
N050.04.52.420 E019.48.39.157 N050.04.52.409 E019.48.39.066 Color_252ACI
N050.04.52.409 E019.48.39.066 N050.04.52.363 E019.48.38.993 Color_252ACI
N050.04.52.363 E019.48.38.993 N050.04.52.306 E019.48.38.976 Color_252ACI
N050.04.52.306 E019.48.38.976 N050.04.52.244 E019.48.39.018 Color_252ACI
N050.04.52.244 E019.48.39.018 N050.04.52.212 E019.48.39.103 Color_252ACI
N050.04.52.212 E019.48.39.103 N050.04.52.219 E019.48.39.205 Color_252ACI
N050.04.52.219 E019.48.39.205 N050.04.52.258 E019.48.39.277 Color_252ACI
N050.04.52.258 E019.48.39.277 N050.04.52.322 E019.48.39.303 Color_252ACI
N050.04.52.322 E019.48.39.303 N050.04.52.373 E019.48.39.276 Color_252ACI
N050.04.52.373 E019.48.39.276 N050.04.52.409 E019.48.39.213 Color_252ACI
N050.04.52.409 E019.48.39.213 N050.04.52.420 E019.48.39.157 Color_252ACI
N050.04.52.700 E019.48.39.064 N050.04.52.689 E019.48.38.973 Color_252ACI
N050.04.52.689 E019.48.38.973 N050.04.52.643 E019.48.38.900 Color_252ACI
N050.04.52.643 E019.48.38.900 N050.04.52.587 E019.48.38.883 Color_252ACI
N050.04.52.587 E019.48.38.883 N050.04.52.524 E019.48.38.926 Color_252ACI
N050.04.52.524 E019.48.38.926 N050.04.52.493 E019.48.39.010 Color_252ACI
N050.04.52.493 E019.48.39.010 N050.04.52.499 E019.48.39.112 Color_252ACI
N050.04.52.499 E019.48.39.112 N050.04.52.538 E019.48.39.184 Color_252ACI
N050.04.52.538 E019.48.39.184 N050.04.52.603 E019.48.39.210 Color_252ACI
N050.04.52.603 E019.48.39.210 N050.04.52.653 E019.48.39.183 Color_252ACI
N050.04.52.653 E019.48.39.183 N050.04.52.689 E019.48.39.120 Color_252ACI
N050.04.52.689 E019.48.39.120 N050.04.52.700 E019.48.39.064 Color_252ACI
N050.04.53.282 E019.48.38.871 N050.04.53.271 E019.48.38.781 Color_252ACI
N050.04.53.271 E019.48.38.781 N050.04.53.225 E019.48.38.708 Color_252ACI
N050.04.53.225 E019.48.38.708 N050.04.53.169 E019.48.38.690 Color_252ACI
N050.04.53.169 E019.48.38.690 N050.04.53.106 E019.48.38.733 Color_252ACI
N050.04.53.106 E019.48.38.733 N050.04.53.075 E019.48.38.817 Color_252ACI
N050.04.53.075 E019.48.38.817 N050.04.53.081 E019.48.38.919 Color_252ACI
N050.04.53.081 E019.48.38.919 N050.04.53.120 E019.48.38.992 Color_252ACI
N050.04.53.120 E019.48.38.992 N050.04.53.185 E019.48.39.017 Color_252ACI
N050.04.53.185 E019.48.39.017 N050.04.53.235 E019.48.38.991 Color_252ACI
N050.04.53.235 E019.48.38.991 N050.04.53.271 E019.48.38.928 Color_252ACI
N050.04.53.271 E019.48.38.928 N050.04.53.282 E019.48.38.871 Color_252ACI
N050.04.53.557 E019.48.38.780 N050.04.53.546 E019.48.38.690 Color_252ACI
N050.04.53.546 E019.48.38.690 N050.04.53.500 E019.48.38.617 Color_252ACI
N050.04.53.500 E019.48.38.617 N050.04.53.443 E019.48.38.599 Color_252ACI
N050.04.53.443 E019.48.38.599 N050.04.53.381 E019.48.38.642 Color_252ACI
N050.04.53.381 E019.48.38.642 N050.04.53.349 E019.48.38.726 Color_252ACI
N050.04.53.349 E019.48.38.726 N050.04.53.356 E019.48.38.828 Color_252ACI
N050.04.53.356 E019.48.38.828 N050.04.53.395 E019.48.38.901 Color_252ACI
N050.04.53.395 E019.48.38.901 N050.04.53.459 E019.48.38.926 Color_252ACI
N050.04.53.459 E019.48.38.926 N050.04.53.510 E019.48.38.900 Color_252ACI
N050.04.53.510 E019.48.38.900 N050.04.53.546 E019.48.38.837 Color_252ACI
N050.04.53.546 E019.48.38.837 N050.04.53.557 E019.48.38.780 Color_252ACI
N050.04.52.210 E019.48.37.646 N050.04.52.199 E019.48.37.556 Color_252ACI
N050.04.52.199 E019.48.37.556 N050.04.52.153 E019.48.37.483 Color_252ACI
N050.04.52.153 E019.48.37.483 N050.04.52.097 E019.48.37.466 Color_252ACI
N050.04.52.097 E019.48.37.466 N050.04.52.034 E019.48.37.508 Color_252ACI
N050.04.52.034 E019.48.37.508 N050.04.52.003 E019.48.37.592 Color_252ACI
N050.04.52.003 E019.48.37.592 N050.04.52.009 E019.48.37.694 Color_252ACI
N050.04.52.009 E019.48.37.694 N050.04.52.048 E019.48.37.767 Color_252ACI
N050.04.52.048 E019.48.37.767 N050.04.52.113 E019.48.37.792 Color_252ACI
N050.04.52.113 E019.48.37.792 N050.04.52.163 E019.48.37.766 Color_252ACI
N050.04.52.163 E019.48.37.766 N050.04.52.199 E019.48.37.703 Color_252ACI
N050.04.52.199 E019.48.37.703 N050.04.52.210 E019.48.37.646 Color_252ACI
N050.04.52.494 E019.48.37.552 N050.04.52.483 E019.48.37.462 Color_252ACI
N050.04.52.483 E019.48.37.462 N050.04.52.437 E019.48.37.389 Color_252ACI
N050.04.52.437 E019.48.37.389 N050.04.52.380 E019.48.37.372 Color_252ACI
N050.04.52.380 E019.48.37.372 N050.04.52.318 E019.48.37.414 Color_252ACI
N050.04.52.318 E019.48.37.414 N050.04.52.286 E019.48.37.499 Color_252ACI
N050.04.52.286 E019.48.37.499 N050.04.52.292 E019.48.37.600 Color_252ACI
N050.04.52.292 E019.48.37.600 N050.04.52.332 E019.48.37.673 Color_252ACI
N050.04.52.332 E019.48.37.673 N050.04.52.396 E019.48.37.699 Color_252ACI
N050.04.52.396 E019.48.37.699 N050.04.52.447 E019.48.37.672 Color_252ACI
N050.04.52.447 E019.48.37.672 N050.04.52.483 E019.48.37.609 Color_252ACI
N050.04.52.483 E019.48.37.609 N050.04.52.494 E019.48.37.552 Color_252ACI
N050.04.53.069 E019.48.37.362 N050.04.53.059 E019.48.37.272 Color_252ACI
N050.04.53.059 E019.48.37.272 N050.04.53.012 E019.48.37.198 Color_252ACI
N050.04.53.012 E019.48.37.198 N050.04.52.956 E019.48.37.181 Color_252ACI
N050.04.52.956 E019.48.37.181 N050.04.52.893 E019.48.37.224 Color_252ACI
N050.04.52.893 E019.48.37.224 N050.04.52.862 E019.48.37.308 Color_252ACI
N050.04.52.862 E019.48.37.308 N050.04.52.868 E019.48.37.410 Color_252ACI
N050.04.52.868 E019.48.37.410 N050.04.52.908 E019.48.37.482 Color_252ACI
N050.04.52.908 E019.48.37.482 N050.04.52.972 E019.48.37.508 Color_252ACI
N050.04.52.972 E019.48.37.508 N050.04.53.022 E019.48.37.482 Color_252ACI
N050.04.53.022 E019.48.37.482 N050.04.53.058 E019.48.37.419 Color_252ACI
N050.04.53.058 E019.48.37.419 N050.04.53.069 E019.48.37.362 Color_252ACI
N050.04.53.357 E019.48.37.267 N050.04.53.346 E019.48.37.176 Color_252ACI
N050.04.53.346 E019.48.37.176 N050.04.53.300 E019.48.37.103 Color_252ACI
N050.04.53.300 E019.48.37.103 N050.04.53.244 E019.48.37.086 Color_252ACI
N050.04.53.244 E019.48.37.086 N050.04.53.181 E019.48.37.129 Color_252ACI
N050.04.53.181 E019.48.37.129 N050.04.53.150 E019.48.37.213 Color_252ACI
N050.04.53.150 E019.48.37.213 N050.04.53.156 E019.48.37.315 Color_252ACI
N050.04.53.156 E019.48.37.315 N050.04.53.195 E019.48.37.387 Color_252ACI
N050.04.53.195 E019.48.37.387 N050.04.53.259 E019.48.37.413 Color_252ACI
N050.04.53.259 E019.48.37.413 N050.04.53.310 E019.48.37.386 Color_252ACI
N050.04.53.310 E019.48.37.386 N050.04.53.346 E019.48.37.323 Color_252ACI
N050.04.53.346 E019.48.37.323 N050.04.53.357 E019.48.37.267 Color_252ACI
N050.04.51.998 E019.48.36.148 N050.04.51.987 E019.48.36.058 Color_252ACI
N050.04.51.987 E019.48.36.058 N050.04.51.941 E019.48.35.985 Color_252ACI
N050.04.51.941 E019.48.35.985 N050.04.51.885 E019.48.35.967 Color_252ACI
N050.04.51.885 E019.48.35.967 N050.04.51.822 E019.48.36.010 Color_252ACI
N050.04.51.822 E019.48.36.010 N050.04.51.791 E019.48.36.094 Color_252ACI
N050.04.51.791 E019.48.36.094 N050.04.51.797 E019.48.36.196 Color_252ACI
N050.04.51.797 E019.48.36.196 N050.04.51.836 E019.48.36.269 Color_252ACI
N050.04.51.836 E019.48.36.269 N050.04.51.901 E019.48.36.294 Color_252ACI
N050.04.51.901 E019.48.36.294 N050.04.51.951 E019.48.36.268 Color_252ACI
N050.04.51.951 E019.48.36.268 N050.04.51.987 E019.48.36.205 Color_252ACI
N050.04.51.987 E019.48.36.205 N050.04.51.998 E019.48.36.148 Color_252ACI
N050.04.52.295 E019.48.36.050 N050.04.52.284 E019.48.35.960 Color_252ACI
N050.04.52.284 E019.48.35.960 N050.04.52.238 E019.48.35.886 Color_252ACI
N050.04.52.238 E019.48.35.886 N050.04.52.181 E019.48.35.869 Color_252ACI
N050.04.52.181 E019.48.35.869 N050.04.52.119 E019.48.35.912 Color_252ACI
N050.04.52.119 E019.48.35.912 N050.04.52.087 E019.48.35.996 Color_252ACI
N050.04.52.087 E019.48.35.996 N050.04.52.094 E019.48.36.098 Color_252ACI
N050.04.52.094 E019.48.36.098 N050.04.52.133 E019.48.36.170 Color_252ACI
N050.04.52.133 E019.48.36.170 N050.04.52.197 E019.48.36.196 Color_252ACI
N050.04.52.197 E019.48.36.196 N050.04.52.248 E019.48.36.170 Color_252ACI
N050.04.52.248 E019.48.36.170 N050.04.52.284 E019.48.36.107 Color_252ACI
N050.04.52.284 E019.48.36.107 N050.04.52.295 E019.48.36.050 Color_252ACI
N050.04.52.863 E019.48.35.862 N050.04.52.853 E019.48.35.771 Color_252ACI
N050.04.52.853 E019.48.35.771 N050.04.52.806 E019.48.35.698 Color_252ACI
N050.04.52.806 E019.48.35.698 N050.04.52.750 E019.48.35.681 Color_252ACI
N050.04.52.750 E019.48.35.681 N050.04.52.687 E019.48.35.724 Color_252ACI
N050.04.52.687 E019.48.35.724 N050.04.52.656 E019.48.35.808 Color_252ACI
N050.04.52.656 E019.48.35.808 N050.04.52.662 E019.48.35.910 Color_252ACI
N050.04.52.662 E019.48.35.910 N050.04.52.702 E019.48.35.982 Color_252ACI
N050.04.52.702 E019.48.35.982 N050.04.52.766 E019.48.36.008 Color_252ACI
N050.04.52.766 E019.48.36.008 N050.04.52.816 E019.48.35.981 Color_252ACI
N050.04.52.816 E019.48.35.981 N050.04.52.852 E019.48.35.918 Color_252ACI
N050.04.52.852 E019.48.35.918 N050.04.52.863 E019.48.35.862 Color_252ACI
N050.04.53.144 E019.48.35.769 N050.04.53.134 E019.48.35.678 Color_252ACI
N050.04.53.134 E019.48.35.678 N050.04.53.087 E019.48.35.605 Color_252ACI
N050.04.53.087 E019.48.35.605 N050.04.53.031 E019.48.35.588 Color_252ACI
N050.04.53.031 E019.48.35.588 N050.04.52.968 E019.48.35.631 Color_252ACI
N050.04.52.968 E019.48.35.631 N050.04.52.937 E019.48.35.715 Color_252ACI
N050.04.52.937 E019.48.35.715 N050.04.52.943 E019.48.35.817 Color_252ACI
N050.04.52.943 E019.48.35.817 N050.04.52.983 E019.48.35.889 Color_252ACI
N050.04.52.983 E019.48.35.889 N050.04.53.047 E019.48.35.915 Color_252ACI
N050.04.53.047 E019.48.35.915 N050.04.53.097 E019.48.35.888 Color_252ACI
N050.04.53.097 E019.48.35.888 N050.04.53.133 E019.48.35.825 Color_252ACI
N050.04.53.133 E019.48.35.825 N050.04.53.144 E019.48.35.769 Color_252ACI
N050.04.51.801 E019.48.34.671 N050.04.51.791 E019.48.34.581 Color_252ACI
N050.04.51.791 E019.48.34.581 N050.04.51.744 E019.48.34.507 Color_252ACI
N050.04.51.744 E019.48.34.507 N050.04.51.688 E019.48.34.490 Color_252ACI
N050.04.51.688 E019.48.34.490 N050.04.51.625 E019.48.34.533 Color_252ACI
N050.04.51.625 E019.48.34.533 N050.04.51.594 E019.48.34.617 Color_252ACI
N050.04.51.594 E019.48.34.617 N050.04.51.600 E019.48.34.719 Color_252ACI
N050.04.51.600 E019.48.34.719 N050.04.51.640 E019.48.34.792 Color_252ACI
N050.04.51.640 E019.48.34.792 N050.04.51.704 E019.48.34.817 Color_252ACI
N050.04.51.704 E019.48.34.817 N050.04.51.754 E019.48.34.791 Color_252ACI
N050.04.51.754 E019.48.34.791 N050.04.51.790 E019.48.34.728 Color_252ACI
N050.04.51.790 E019.48.34.728 N050.04.51.801 E019.48.34.671 Color_252ACI
N050.04.52.097 E019.48.34.573 N050.04.52.087 E019.48.34.483 Color_252ACI
N050.04.52.087 E019.48.34.483 N050.04.52.040 E019.48.34.409 Color_252ACI
N050.04.52.040 E019.48.34.409 N050.04.51.984 E019.48.34.392 Color_252ACI
N050.04.51.984 E019.48.34.392 N050.04.51.921 E019.48.34.435 Color_252ACI
N050.04.51.921 E019.48.34.435 N050.04.51.890 E019.48.34.519 Color_252ACI
N050.04.51.890 E019.48.34.519 N050.04.51.896 E019.48.34.621 Color_252ACI
N050.04.51.896 E019.48.34.621 N050.04.51.936 E019.48.34.693 Color_252ACI
N050.04.51.936 E019.48.34.693 N050.04.52.000 E019.48.34.719 Color_252ACI
N050.04.52.000 E019.48.34.719 N050.04.52.050 E019.48.34.693 Color_252ACI
N050.04.52.050 E019.48.34.693 N050.04.52.086 E019.48.34.630 Color_252ACI
N050.04.52.086 E019.48.34.630 N050.04.52.097 E019.48.34.573 Color_252ACI
N050.04.52.666 E019.48.34.385 N050.04.52.655 E019.48.34.294 Color_252ACI
N050.04.52.655 E019.48.34.294 N050.04.52.609 E019.48.34.221 Color_252ACI
N050.04.52.609 E019.48.34.221 N050.04.52.553 E019.48.34.204 Color_252ACI
N050.04.52.553 E019.48.34.204 N050.04.52.490 E019.48.34.247 Color_252ACI
N050.04.52.490 E019.48.34.247 N050.04.52.459 E019.48.34.331 Color_252ACI
N050.04.52.459 E019.48.34.331 N050.04.52.465 E019.48.34.433 Color_252ACI
N050.04.52.465 E019.48.34.433 N050.04.52.504 E019.48.34.505 Color_252ACI
N050.04.52.504 E019.48.34.505 N050.04.52.569 E019.48.34.531 Color_252ACI
N050.04.52.569 E019.48.34.531 N050.04.52.619 E019.48.34.504 Color_252ACI
N050.04.52.619 E019.48.34.504 N050.04.52.655 E019.48.34.441 Color_252ACI
N050.04.52.655 E019.48.34.441 N050.04.52.666 E019.48.34.385 Color_252ACI
N050.04.52.945 E019.48.34.292 N050.04.52.935 E019.48.34.202 Color_252ACI
N050.04.52.935 E019.48.34.202 N050.04.52.888 E019.48.34.129 Color_252ACI
N050.04.52.888 E019.48.34.129 N050.04.52.832 E019.48.34.111 Color_252ACI
N050.04.52.832 E019.48.34.111 N050.04.52.769 E019.48.34.154 Color_252ACI
N050.04.52.769 E019.48.34.154 N050.04.52.738 E019.48.34.238 Color_252ACI
N050.04.52.738 E019.48.34.238 N050.04.52.744 E019.48.34.340 Color_252ACI
N050.04.52.744 E019.48.34.340 N050.04.52.784 E019.48.34.413 Color_252ACI
N050.04.52.784 E019.48.34.413 N050.04.52.848 E019.48.34.438 Color_252ACI
N050.04.52.848 E019.48.34.438 N050.04.52.898 E019.48.34.412 Color_252ACI
N050.04.52.898 E019.48.34.412 N050.04.52.934 E019.48.34.349 Color_252ACI
N050.04.52.934 E019.48.34.349 N050.04.52.945 E019.48.34.292 Color_252ACI
N050.04.51.581 E019.48.33.172 N050.04.51.571 E019.48.33.082 Color_252ACI
N050.04.51.571 E019.48.33.082 N050.04.51.525 E019.48.33.009 Color_252ACI
N050.04.51.525 E019.48.33.009 N050.04.51.468 E019.48.32.991 Color_252ACI
N050.04.51.468 E019.48.32.991 N050.04.51.406 E019.48.33.034 Color_252ACI
N050.04.51.406 E019.48.33.034 N050.04.51.374 E019.48.33.118 Color_252ACI
N050.04.51.374 E019.48.33.118 N050.04.51.380 E019.48.33.220 Color_252ACI
N050.04.51.380 E019.48.33.220 N050.04.51.420 E019.48.33.293 Color_252ACI
N050.04.51.420 E019.48.33.293 N050.04.51.484 E019.48.33.318 Color_252ACI
N050.04.51.484 E019.48.33.318 N050.04.51.535 E019.48.33.292 Color_252ACI
N050.04.51.535 E019.48.33.292 N050.04.51.571 E019.48.33.229 Color_252ACI
N050.04.51.571 E019.48.33.229 N050.04.51.581 E019.48.33.172 Color_252ACI
N050.04.51.899 E019.48.33.067 N050.04.51.888 E019.48.32.977 Color_252ACI
N050.04.51.888 E019.48.32.977 N050.04.51.842 E019.48.32.904 Color_252ACI
N050.04.51.842 E019.48.32.904 N050.04.51.785 E019.48.32.886 Color_252ACI
N050.04.51.785 E019.48.32.886 N050.04.51.723 E019.48.32.929 Color_252ACI
N050.04.51.723 E019.48.32.929 N050.04.51.691 E019.48.33.013 Color_252ACI
N050.04.51.691 E019.48.33.013 N050.04.51.697 E019.48.33.115 Color_252ACI
N050.04.51.697 E019.48.33.115 N050.04.51.737 E019.48.33.188 Color_252ACI
N050.04.51.737 E019.48.33.188 N050.04.51.801 E019.48.33.213 Color_252ACI
N050.04.51.801 E019.48.33.213 N050.04.51.852 E019.48.33.187 Color_252ACI
N050.04.51.852 E019.48.33.187 N050.04.51.888 E019.48.33.124 Color_252ACI
N050.04.51.888 E019.48.33.124 N050.04.51.899 E019.48.33.067 Color_252ACI
N050.04.52.452 E019.48.32.884 N050.04.52.442 E019.48.32.794 Color_252ACI
N050.04.52.442 E019.48.32.794 N050.04.52.395 E019.48.32.720 Color_252ACI
N050.04.52.395 E019.48.32.720 N050.04.52.339 E019.48.32.703 Color_252ACI
N050.04.52.339 E019.48.32.703 N050.04.52.276 E019.48.32.746 Color_252ACI
N050.04.52.276 E019.48.32.746 N050.04.52.245 E019.48.32.830 Color_252ACI
N050.04.52.245 E019.48.32.830 N050.04.52.251 E019.48.32.932 Color_252ACI
N050.04.52.251 E019.48.32.932 N050.04.52.291 E019.48.33.004 Color_252ACI
N050.04.52.291 E019.48.33.004 N050.04.52.355 E019.48.33.030 Color_252ACI
N050.04.52.355 E019.48.33.030 N050.04.52.405 E019.48.33.004 Color_252ACI
N050.04.52.405 E019.48.33.004 N050.04.52.441 E019.48.32.941 Color_252ACI
N050.04.52.441 E019.48.32.941 N050.04.52.452 E019.48.32.884 Color_252ACI
N050.04.52.744 E019.48.32.787 N050.04.52.734 E019.48.32.697 Color_252ACI
N050.04.52.734 E019.48.32.697 N050.04.52.688 E019.48.32.624 Color_252ACI
N050.04.52.688 E019.48.32.624 N050.04.52.631 E019.48.32.606 Color_252ACI
N050.04.52.631 E019.48.32.606 N050.04.52.569 E019.48.32.649 Color_252ACI
N050.04.52.569 E019.48.32.649 N050.04.52.537 E019.48.32.733 Color_252ACI
N050.04.52.537 E019.48.32.733 N050.04.52.543 E019.48.32.835 Color_252ACI
N050.04.52.543 E019.48.32.835 N050.04.52.583 E019.48.32.908 Color_252ACI
N050.04.52.583 E019.48.32.908 N050.04.52.647 E019.48.32.933 Color_252ACI
N050.04.52.647 E019.48.32.933 N050.04.52.697 E019.48.32.907 Color_252ACI
N050.04.52.697 E019.48.32.907 N050.04.52.734 E019.48.32.844 Color_252ACI
N050.04.52.734 E019.48.32.844 N050.04.52.744 E019.48.32.787 Color_252ACI
N050.04.51.394 E019.48.31.691 N050.04.51.384 E019.48.31.601 Color_252ACI
N050.04.51.384 E019.48.31.601 N050.04.51.338 E019.48.31.528 Color_252ACI
N050.04.51.338 E019.48.31.528 N050.04.51.281 E019.48.31.510 Color_252ACI
N050.04.51.281 E019.48.31.510 N050.04.51.218 E019.48.31.553 Color_252ACI
N050.04.51.218 E019.48.31.553 N050.04.51.187 E019.48.31.637 Color_252ACI
N050.04.51.187 E019.48.31.637 N050.04.51.193 E019.48.31.739 Color_252ACI
N050.04.51.193 E019.48.31.739 N050.04.51.233 E019.48.31.812 Color_252ACI
N050.04.51.233 E019.48.31.812 N050.04.51.297 E019.48.31.837 Color_252ACI
N050.04.51.297 E019.48.31.837 N050.04.51.347 E019.48.31.811 Color_252ACI
N050.04.51.347 E019.48.31.811 N050.04.51.384 E019.48.31.748 Color_252ACI
N050.04.51.384 E019.48.31.748 N050.04.51.394 E019.48.31.691 Color_252ACI
N050.04.51.684 E019.48.31.595 N050.04.51.674 E019.48.31.505 Color_252ACI
N050.04.51.674 E019.48.31.505 N050.04.51.627 E019.48.31.432 Color_252ACI
N050.04.51.627 E019.48.31.432 N050.04.51.571 E019.48.31.414 Color_252ACI
N050.04.51.571 E019.48.31.414 N050.04.51.508 E019.48.31.457 Color_252ACI
N050.04.51.508 E019.48.31.457 N050.04.51.477 E019.48.31.541 Color_252ACI
N050.04.51.477 E019.48.31.541 N050.04.51.483 E019.48.31.643 Color_252ACI
N050.04.51.483 E019.48.31.643 N050.04.51.523 E019.48.31.716 Color_252ACI
N050.04.51.523 E019.48.31.716 N050.04.51.587 E019.48.31.741 Color_252ACI
N050.04.51.587 E019.48.31.741 N050.04.51.637 E019.48.31.715 Color_252ACI
N050.04.51.637 E019.48.31.715 N050.04.51.673 E019.48.31.652 Color_252ACI
N050.04.51.673 E019.48.31.652 N050.04.51.684 E019.48.31.595 Color_252ACI
N050.04.52.251 E019.48.31.408 N050.04.52.240 E019.48.31.317 Color_252ACI
N050.04.52.240 E019.48.31.317 N050.04.52.194 E019.48.31.244 Color_252ACI
N050.04.52.194 E019.48.31.244 N050.04.52.138 E019.48.31.227 Color_252ACI
N050.04.52.138 E019.48.31.227 N050.04.52.075 E019.48.31.269 Color_252ACI
N050.04.52.075 E019.48.31.269 N050.04.52.044 E019.48.31.354 Color_252ACI
N050.04.52.044 E019.48.31.354 N050.04.52.050 E019.48.31.456 Color_252ACI
N050.04.52.050 E019.48.31.456 N050.04.52.089 E019.48.31.528 Color_252ACI
N050.04.52.089 E019.48.31.528 N050.04.52.153 E019.48.31.554 Color_252ACI
N050.04.52.153 E019.48.31.554 N050.04.52.204 E019.48.31.527 Color_252ACI
N050.04.52.204 E019.48.31.527 N050.04.52.240 E019.48.31.464 Color_252ACI
N050.04.52.240 E019.48.31.464 N050.04.52.251 E019.48.31.408 Color_252ACI
N050.04.52.557 E019.48.31.306 N050.04.52.546 E019.48.31.216 Color_252ACI
N050.04.52.546 E019.48.31.216 N050.04.52.500 E019.48.31.143 Color_252ACI
N050.04.52.500 E019.48.31.143 N050.04.52.444 E019.48.31.125 Color_252ACI
N050.04.52.444 E019.48.31.125 N050.04.52.381 E019.48.31.168 Color_252ACI
N050.04.52.381 E019.48.31.168 N050.04.52.350 E019.48.31.252 Color_252ACI
N050.04.52.350 E019.48.31.252 N050.04.52.356 E019.48.31.354 Color_252ACI
N050.04.52.356 E019.48.31.354 N050.04.52.395 E019.48.31.427 Color_252ACI
N050.04.52.395 E019.48.31.427 N050.04.52.460 E019.48.31.452 Color_252ACI
N050.04.52.460 E019.48.31.452 N050.04.52.510 E019.48.31.426 Color_252ACI
N050.04.52.510 E019.48.31.426 N050.04.52.546 E019.48.31.363 Color_252ACI
N050.04.52.546 E019.48.31.363 N050.04.52.557 E019.48.31.306 Color_252ACI
N050.04.51.203 E019.48.30.226 N050.04.51.192 E019.48.30.135 Color_252ACI
N050.04.51.192 E019.48.30.135 N050.04.51.146 E019.48.30.062 Color_252ACI
N050.04.51.146 E019.48.30.062 N050.04.51.089 E019.48.30.045 Color_252ACI
N050.04.51.089 E019.48.30.045 N050.04.51.027 E019.48.30.087 Color_252ACI
N050.04.51.027 E019.48.30.087 N050.04.50.995 E019.48.30.172 Color_252ACI
N050.04.50.995 E019.48.30.172 N050.04.51.002 E019.48.30.274 Color_252ACI
N050.04.51.002 E019.48.30.274 N050.04.51.041 E019.48.30.346 Color_252ACI
N050.04.51.041 E019.48.30.346 N050.04.51.105 E019.48.30.372 Color_252ACI
N050.04.51.105 E019.48.30.372 N050.04.51.156 E019.48.30.345 Color_252ACI
N050.04.51.156 E019.48.30.345 N050.04.51.192 E019.48.30.282 Color_252ACI
N050.04.51.192 E019.48.30.282 N050.04.51.203 E019.48.30.226 Color_252ACI
N050.04.51.489 E019.48.30.131 N050.04.51.478 E019.48.30.041 Color_252ACI
N050.04.51.478 E019.48.30.041 N050.04.51.432 E019.48.29.967 Color_252ACI
N050.04.51.432 E019.48.29.967 N050.04.51.375 E019.48.29.950 Color_252ACI
N050.04.51.375 E019.48.29.950 N050.04.51.313 E019.48.29.993 Color_252ACI
N050.04.51.313 E019.48.29.993 N050.04.51.281 E019.48.30.077 Color_252ACI
N050.04.51.281 E019.48.30.077 N050.04.51.287 E019.48.30.179 Color_252ACI
N050.04.51.287 E019.48.30.179 N050.04.51.327 E019.48.30.251 Color_252ACI
N050.04.51.327 E019.48.30.251 N050.04.51.391 E019.48.30.277 Color_252ACI
N050.04.51.391 E019.48.30.277 N050.04.51.442 E019.48.30.250 Color_252ACI
N050.04.51.442 E019.48.30.250 N050.04.51.478 E019.48.30.187 Color_252ACI
N050.04.51.478 E019.48.30.187 N050.04.51.489 E019.48.30.131 Color_252ACI
N050.04.52.049 E019.48.29.945 N050.04.52.039 E019.48.29.855 Color_252ACI
N050.04.52.039 E019.48.29.855 N050.04.51.993 E019.48.29.782 Color_252ACI
N050.04.51.993 E019.48.29.782 N050.04.51.936 E019.48.29.764 Color_252ACI
N050.04.51.936 E019.48.29.764 N050.04.51.874 E019.48.29.807 Color_252ACI
N050.04.51.874 E019.48.29.807 N050.04.51.842 E019.48.29.891 Color_252ACI
N050.04.51.842 E019.48.29.891 N050.04.51.848 E019.48.29.993 Color_252ACI
N050.04.51.848 E019.48.29.993 N050.04.51.888 E019.48.30.066 Color_252ACI
N050.04.51.888 E019.48.30.066 N050.04.51.952 E019.48.30.091 Color_252ACI
N050.04.51.952 E019.48.30.091 N050.04.52.003 E019.48.30.065 Color_252ACI
N050.04.52.003 E019.48.30.065 N050.04.52.039 E019.48.30.002 Color_252ACI
N050.04.52.039 E019.48.30.002 N050.04.52.049 E019.48.29.945 Color_252ACI
N050.04.52.337 E019.48.29.850 N050.04.52.327 E019.48.29.760 Color_252ACI
N050.04.52.327 E019.48.29.760 N050.04.52.280 E019.48.29.687 Color_252ACI
N050.04.52.280 E019.48.29.687 N050.04.52.224 E019.48.29.669 Color_252ACI
N050.04.52.224 E019.48.29.669 N050.04.52.161 E019.48.29.712 Color_252ACI
N050.04.52.161 E019.48.29.712 N050.04.52.130 E019.48.29.796 Color_252ACI
N050.04.52.130 E019.48.29.796 N050.04.52.136 E019.48.29.898 Color_252ACI
N050.04.52.136 E019.48.29.898 N050.04.52.176 E019.48.29.971 Color_252ACI
N050.04.52.176 E019.48.29.971 N050.04.52.240 E019.48.29.996 Color_252ACI
N050.04.52.240 E019.48.29.996 N050.04.52.290 E019.48.29.970 Color_252ACI
N050.04.52.290 E019.48.29.970 N050.04.52.326 E019.48.29.907 Color_252ACI
N050.04.52.326 E019.48.29.907 N050.04.52.337 E019.48.29.850 Color_252ACI
N050.04.50.990 E019.48.28.714 N050.04.50.979 E019.48.28.623 Color_252ACI
N050.04.50.979 E019.48.28.623 N050.04.50.933 E019.48.28.550 Color_252ACI
N050.04.50.933 E019.48.28.550 N050.04.50.876 E019.48.28.533 Color_252ACI
N050.04.50.876 E019.48.28.533 N050.04.50.814 E019.48.28.575 Color_252ACI
N050.04.50.814 E019.48.28.575 N050.04.50.782 E019.48.28.660 Color_252ACI
N050.04.50.782 E019.48.28.660 N050.04.50.789 E019.48.28.762 Color_252ACI
N050.04.50.789 E019.48.28.762 N050.04.50.828 E019.48.28.834 Color_252ACI
N050.04.50.828 E019.48.28.834 N050.04.50.892 E019.48.28.860 Color_252ACI
N050.04.50.892 E019.48.28.860 N050.04.50.943 E019.48.28.833 Color_252ACI
N050.04.50.943 E019.48.28.833 N050.04.50.979 E019.48.28.770 Color_252ACI
N050.04.50.979 E019.48.28.770 N050.04.50.990 E019.48.28.714 Color_252ACI
N050.04.51.285 E019.48.28.616 N050.04.51.274 E019.48.28.526 Color_252ACI
N050.04.51.274 E019.48.28.526 N050.04.51.228 E019.48.28.452 Color_252ACI
N050.04.51.228 E019.48.28.452 N050.04.51.171 E019.48.28.435 Color_252ACI
N050.04.51.171 E019.48.28.435 N050.04.51.109 E019.48.28.478 Color_252ACI
N050.04.51.109 E019.48.28.478 N050.04.51.077 E019.48.28.562 Color_252ACI
N050.04.51.077 E019.48.28.562 N050.04.51.084 E019.48.28.664 Color_252ACI
N050.04.51.084 E019.48.28.664 N050.04.51.123 E019.48.28.736 Color_252ACI
N050.04.51.123 E019.48.28.736 N050.04.51.187 E019.48.28.762 Color_252ACI
N050.04.51.187 E019.48.28.762 N050.04.51.238 E019.48.28.736 Color_252ACI
N050.04.51.238 E019.48.28.736 N050.04.51.274 E019.48.28.673 Color_252ACI
N050.04.51.274 E019.48.28.673 N050.04.51.285 E019.48.28.616 Color_252ACI
N050.04.51.849 E019.48.28.429 N050.04.51.839 E019.48.28.339 Color_252ACI
N050.04.51.839 E019.48.28.339 N050.04.51.793 E019.48.28.266 Color_252ACI
N050.04.51.793 E019.48.28.266 N050.04.51.736 E019.48.28.248 Color_252ACI
N050.04.51.736 E019.48.28.248 N050.04.51.674 E019.48.28.291 Color_252ACI
N050.04.51.674 E019.48.28.291 N050.04.51.642 E019.48.28.375 Color_252ACI
N050.04.51.642 E019.48.28.375 N050.04.51.648 E019.48.28.477 Color_252ACI
N050.04.51.648 E019.48.28.477 N050.04.51.688 E019.48.28.550 Color_252ACI
N050.04.51.688 E019.48.28.550 N050.04.51.752 E019.48.28.575 Color_252ACI
N050.04.51.752 E019.48.28.575 N050.04.51.803 E019.48.28.549 Color_252ACI
N050.04.51.803 E019.48.28.549 N050.04.51.839 E019.48.28.486 Color_252ACI
N050.04.51.839 E019.48.28.486 N050.04.51.849 E019.48.28.429 Color_252ACI
N050.04.52.148 E019.48.28.330 N050.04.52.138 E019.48.28.240 Color_252ACI
N050.04.52.138 E019.48.28.240 N050.04.52.091 E019.48.28.167 Color_252ACI
N050.04.52.091 E019.48.28.167 N050.04.52.035 E019.48.28.149 Color_252ACI
N050.04.52.035 E019.48.28.149 N050.04.51.972 E019.48.28.192 Color_252ACI
N050.04.51.972 E019.48.28.192 N050.04.51.941 E019.48.28.276 Color_252ACI
N050.04.51.941 E019.48.28.276 N050.04.51.947 E019.48.28.378 Color_252ACI
N050.04.51.947 E019.48.28.378 N050.04.51.987 E019.48.28.451 Color_252ACI
N050.04.51.987 E019.48.28.451 N050.04.52.051 E019.48.28.476 Color_252ACI
N050.04.52.051 E019.48.28.476 N050.04.52.101 E019.48.28.450 Color_252ACI
N050.04.52.101 E019.48.28.450 N050.04.52.137 E019.48.28.387 Color_252ACI
N050.04.52.137 E019.48.28.387 N050.04.52.148 E019.48.28.330 Color_252ACI
N050.04.50.789 E019.48.27.199 N050.04.50.779 E019.48.27.109 Color_252ACI
N050.04.50.779 E019.48.27.109 N050.04.50.733 E019.48.27.036 Color_252ACI
N050.04.50.733 E019.48.27.036 N050.04.50.676 E019.48.27.018 Color_252ACI
N050.04.50.676 E019.48.27.018 N050.04.50.614 E019.48.27.061 Color_252ACI
N050.04.50.614 E019.48.27.061 N050.04.50.582 E019.48.27.145 Color_252ACI
N050.04.50.582 E019.48.27.145 N050.04.50.588 E019.48.27.247 Color_252ACI
N050.04.50.588 E019.48.27.247 N050.04.50.628 E019.48.27.320 Color_252ACI
N050.04.50.628 E019.48.27.320 N050.04.50.692 E019.48.27.345 Color_252ACI
N050.04.50.692 E019.48.27.345 N050.04.50.743 E019.48.27.319 Color_252ACI
N050.04.50.743 E019.48.27.319 N050.04.50.779 E019.48.27.256 Color_252ACI
N050.04.50.779 E019.48.27.256 N050.04.50.789 E019.48.27.199 Color_252ACI
N050.04.51.072 E019.48.27.106 N050.04.51.062 E019.48.27.015 Color_252ACI
N050.04.51.062 E019.48.27.015 N050.04.51.015 E019.48.26.942 Color_252ACI
N050.04.51.015 E019.48.26.942 N050.04.50.959 E019.48.26.925 Color_252ACI
N050.04.50.959 E019.48.26.925 N050.04.50.896 E019.48.26.968 Color_252ACI
N050.04.50.896 E019.48.26.968 N050.04.50.865 E019.48.27.052 Color_252ACI
N050.04.50.865 E019.48.27.052 N050.04.50.871 E019.48.27.154 Color_252ACI
N050.04.50.871 E019.48.27.154 N050.04.50.911 E019.48.27.226 Color_252ACI
N050.04.50.911 E019.48.27.226 N050.04.50.975 E019.48.27.252 Color_252ACI
N050.04.50.975 E019.48.27.252 N050.04.51.025 E019.48.27.225 Color_252ACI
N050.04.51.025 E019.48.27.225 N050.04.51.061 E019.48.27.162 Color_252ACI
N050.04.51.061 E019.48.27.162 N050.04.51.072 E019.48.27.106 Color_252ACI
N050.04.51.647 E019.48.26.916 N050.04.51.636 E019.48.26.825 Color_252ACI
N050.04.51.636 E019.48.26.825 N050.04.51.590 E019.48.26.752 Color_252ACI
N050.04.51.590 E019.48.26.752 N050.04.51.534 E019.48.26.735 Color_252ACI
N050.04.51.534 E019.48.26.735 N050.04.51.471 E019.48.26.777 Color_252ACI
N050.04.51.471 E019.48.26.777 N050.04.51.440 E019.48.26.862 Color_252ACI
N050.04.51.440 E019.48.26.862 N050.04.51.446 E019.48.26.963 Color_252ACI
N050.04.51.446 E019.48.26.963 N050.04.51.485 E019.48.27.036 Color_252ACI
N050.04.51.485 E019.48.27.036 N050.04.51.550 E019.48.27.062 Color_252ACI
N050.04.51.550 E019.48.27.062 N050.04.51.600 E019.48.27.035 Color_252ACI
N050.04.51.600 E019.48.27.035 N050.04.51.636 E019.48.26.972 Color_252ACI
N050.04.51.636 E019.48.26.972 N050.04.51.647 E019.48.26.916 Color_252ACI
N050.04.51.939 E019.48.26.819 N050.04.51.928 E019.48.26.729 Color_252ACI
N050.04.51.928 E019.48.26.729 N050.04.51.882 E019.48.26.655 Color_252ACI
N050.04.51.882 E019.48.26.655 N050.04.51.826 E019.48.26.638 Color_252ACI
N050.04.51.826 E019.48.26.638 N050.04.51.763 E019.48.26.681 Color_252ACI
N050.04.51.763 E019.48.26.681 N050.04.51.732 E019.48.26.765 Color_252ACI
N050.04.51.732 E019.48.26.765 N050.04.51.738 E019.48.26.867 Color_252ACI
N050.04.51.738 E019.48.26.867 N050.04.51.777 E019.48.26.939 Color_252ACI
N050.04.51.777 E019.48.26.939 N050.04.51.841 E019.48.26.965 Color_252ACI
N050.04.51.841 E019.48.26.965 N050.04.51.892 E019.48.26.938 Color_252ACI
N050.04.51.892 E019.48.26.938 N050.04.51.928 E019.48.26.876 Color_252ACI
N050.04.51.928 E019.48.26.876 N050.04.51.939 E019.48.26.819 Color_252ACI
N050.04.51.727 E019.48.25.346 N050.04.51.716 E019.48.25.255 Color_252ACI
N050.04.51.716 E019.48.25.255 N050.04.51.670 E019.48.25.182 Color_252ACI
N050.04.51.670 E019.48.25.182 N050.04.51.613 E019.48.25.165 Color_252ACI
N050.04.51.613 E019.48.25.165 N050.04.51.551 E019.48.25.207 Color_252ACI
N050.04.51.551 E019.48.25.207 N050.04.51.519 E019.48.25.292 Color_252ACI
N050.04.51.519 E019.48.25.292 N050.04.51.526 E019.48.25.394 Color_252ACI
N050.04.51.526 E019.48.25.394 N050.04.51.565 E019.48.25.466 Color_252ACI
N050.04.51.565 E019.48.25.466 N050.04.51.629 E019.48.25.492 Color_252ACI
N050.04.51.629 E019.48.25.492 N050.04.51.680 E019.48.25.465 Color_252ACI
N050.04.51.680 E019.48.25.465 N050.04.51.716 E019.48.25.402 Color_252ACI
N050.04.51.716 E019.48.25.402 N050.04.51.727 E019.48.25.346 Color_252ACI
N050.04.51.450 E019.48.25.437 N050.04.51.439 E019.48.25.347 Color_252ACI
N050.04.51.439 E019.48.25.347 N050.04.51.393 E019.48.25.274 Color_252ACI
N050.04.51.393 E019.48.25.274 N050.04.51.336 E019.48.25.256 Color_252ACI
N050.04.51.336 E019.48.25.256 N050.04.51.274 E019.48.25.299 Color_252ACI
N050.04.51.274 E019.48.25.299 N050.04.51.242 E019.48.25.383 Color_252ACI
N050.04.51.242 E019.48.25.383 N050.04.51.249 E019.48.25.485 Color_252ACI
N050.04.51.249 E019.48.25.485 N050.04.51.288 E019.48.25.558 Color_252ACI
N050.04.51.288 E019.48.25.558 N050.04.51.352 E019.48.25.583 Color_252ACI
N050.04.51.352 E019.48.25.583 N050.04.51.403 E019.48.25.557 Color_252ACI
N050.04.51.403 E019.48.25.557 N050.04.51.439 E019.48.25.494 Color_252ACI
N050.04.51.439 E019.48.25.494 N050.04.51.450 E019.48.25.437 Color_252ACI
N050.04.50.879 E019.48.25.626 N050.04.50.868 E019.48.25.536 Color_252ACI
N050.04.50.868 E019.48.25.536 N050.04.50.822 E019.48.25.463 Color_252ACI
N050.04.50.822 E019.48.25.463 N050.04.50.766 E019.48.25.445 Color_252ACI
N050.04.50.766 E019.48.25.445 N050.04.50.703 E019.48.25.488 Color_252ACI
N050.04.50.703 E019.48.25.488 N050.04.50.672 E019.48.25.572 Color_252ACI
N050.04.50.672 E019.48.25.572 N050.04.50.678 E019.48.25.674 Color_252ACI
N050.04.50.678 E019.48.25.674 N050.04.50.717 E019.48.25.747 Color_252ACI
N050.04.50.717 E019.48.25.747 N050.04.50.782 E019.48.25.772 Color_252ACI
N050.04.50.782 E019.48.25.772 N050.04.50.832 E019.48.25.746 Color_252ACI
N050.04.50.832 E019.48.25.746 N050.04.50.868 E019.48.25.683 Color_252ACI
N050.04.50.868 E019.48.25.683 N050.04.50.879 E019.48.25.626 Color_252ACI
N050.04.50.587 E019.48.25.723 N050.04.50.577 E019.48.25.632 Color_252ACI
N050.04.50.577 E019.48.25.632 N050.04.50.530 E019.48.25.559 Color_252ACI
N050.04.50.530 E019.48.25.559 N050.04.50.474 E019.48.25.542 Color_252ACI
N050.04.50.474 E019.48.25.542 N050.04.50.411 E019.48.25.585 Color_252ACI
N050.04.50.411 E019.48.25.585 N050.04.50.380 E019.48.25.669 Color_252ACI
N050.04.50.380 E019.48.25.669 N050.04.50.386 E019.48.25.771 Color_252ACI
N050.04.50.386 E019.48.25.771 N050.04.50.426 E019.48.25.843 Color_252ACI
N050.04.50.426 E019.48.25.843 N050.04.50.490 E019.48.25.869 Color_252ACI
N050.04.50.490 E019.48.25.869 N050.04.50.540 E019.48.25.842 Color_252ACI
N050.04.50.540 E019.48.25.842 N050.04.50.576 E019.48.25.779 Color_252ACI
N050.04.50.576 E019.48.25.779 N050.04.50.587 E019.48.25.723 Color_252ACI
N050.04.50.373 E019.48.24.261 N050.04.50.362 E019.48.24.170 Color_252ACI
N050.04.50.362 E019.48.24.170 N050.04.50.316 E019.48.24.097 Color_252ACI
N050.04.50.316 E019.48.24.097 N050.04.50.260 E019.48.24.080 Color_252ACI
N050.04.50.260 E019.48.24.080 N050.04.50.197 E019.48.24.122 Color_252ACI
N050.04.50.197 E019.48.24.122 N050.04.50.166 E019.48.24.207 Color_252ACI
N050.04.50.166 E019.48.24.207 N050.04.50.172 E019.48.24.308 Color_252ACI
N050.04.50.172 E019.48.24.308 N050.04.50.211 E019.48.24.381 Color_252ACI
N050.04.50.211 E019.48.24.381 N050.04.50.276 E019.48.24.407 Color_252ACI
N050.04.50.276 E019.48.24.407 N050.04.50.326 E019.48.24.380 Color_252ACI
N050.04.50.326 E019.48.24.380 N050.04.50.362 E019.48.24.317 Color_252ACI
N050.04.50.362 E019.48.24.317 N050.04.50.373 E019.48.24.261 Color_252ACI
N050.04.50.675 E019.48.24.160 N050.04.50.665 E019.48.24.070 Color_252ACI
N050.04.50.665 E019.48.24.070 N050.04.50.619 E019.48.23.997 Color_252ACI
N050.04.50.619 E019.48.23.997 N050.04.50.562 E019.48.23.980 Color_252ACI
N050.04.50.562 E019.48.23.980 N050.04.50.500 E019.48.24.022 Color_252ACI
N050.04.50.500 E019.48.24.022 N050.04.50.468 E019.48.24.106 Color_252ACI
N050.04.50.468 E019.48.24.106 N050.04.50.474 E019.48.24.208 Color_252ACI
N050.04.50.474 E019.48.24.208 N050.04.50.514 E019.48.24.281 Color_252ACI
N050.04.50.514 E019.48.24.281 N050.04.50.578 E019.48.24.306 Color_252ACI
N050.04.50.578 E019.48.24.306 N050.04.50.629 E019.48.24.280 Color_252ACI
N050.04.50.629 E019.48.24.280 N050.04.50.665 E019.48.24.217 Color_252ACI
N050.04.50.665 E019.48.24.217 N050.04.50.675 E019.48.24.160 Color_252ACI
N050.04.51.252 E019.48.23.969 N050.04.51.242 E019.48.23.879 Color_252ACI
N050.04.51.242 E019.48.23.879 N050.04.51.195 E019.48.23.806 Color_252ACI
N050.04.51.195 E019.48.23.806 N050.04.51.139 E019.48.23.789 Color_252ACI
N050.04.51.139 E019.48.23.789 N050.04.51.076 E019.48.23.831 Color_252ACI
N050.04.51.076 E019.48.23.831 N050.04.51.045 E019.48.23.916 Color_252ACI
N050.04.51.045 E019.48.23.916 N050.04.51.051 E019.48.24.017 Color_252ACI
N050.04.51.051 E019.48.24.017 N050.04.51.091 E019.48.24.090 Color_252ACI
N050.04.51.091 E019.48.24.090 N050.04.51.155 E019.48.24.116 Color_252ACI
N050.04.51.155 E019.48.24.116 N050.04.51.205 E019.48.24.089 Color_252ACI
N050.04.51.205 E019.48.24.089 N050.04.51.241 E019.48.24.026 Color_252ACI
N050.04.51.241 E019.48.24.026 N050.04.51.252 E019.48.23.969 Color_252ACI
N050.04.51.530 E019.48.23.877 N050.04.51.520 E019.48.23.787 Color_252ACI
N050.04.51.520 E019.48.23.787 N050.04.51.474 E019.48.23.714 Color_252ACI
N050.04.51.474 E019.48.23.714 N050.04.51.417 E019.48.23.697 Color_252ACI
N050.04.51.417 E019.48.23.697 N050.04.51.354 E019.48.23.739 Color_252ACI
N050.04.51.354 E019.48.23.739 N050.04.51.323 E019.48.23.823 Color_252ACI
N050.04.51.323 E019.48.23.823 N050.04.51.329 E019.48.23.925 Color_252ACI
N050.04.51.329 E019.48.23.925 N050.04.51.369 E019.48.23.998 Color_252ACI
N050.04.51.369 E019.48.23.998 N050.04.51.433 E019.48.24.023 Color_252ACI
N050.04.51.433 E019.48.24.023 N050.04.51.483 E019.48.23.997 Color_252ACI
N050.04.51.483 E019.48.23.997 N050.04.51.520 E019.48.23.934 Color_252ACI
N050.04.51.520 E019.48.23.934 N050.04.51.530 E019.48.23.877 Color_252ACI
N050.04.50.178 E019.48.22.738 N050.04.50.168 E019.48.22.648 Color_252ACI
N050.04.50.168 E019.48.22.648 N050.04.50.122 E019.48.22.574 Color_252ACI
N050.04.50.122 E019.48.22.574 N050.04.50.065 E019.48.22.557 Color_252ACI
N050.04.50.065 E019.48.22.557 N050.04.50.003 E019.48.22.600 Color_252ACI
N050.04.50.003 E019.48.22.600 N050.04.49.971 E019.48.22.684 Color_252ACI
N050.04.49.971 E019.48.22.684 N050.04.49.977 E019.48.22.786 Color_252ACI
N050.04.49.977 E019.48.22.786 N050.04.50.017 E019.48.22.858 Color_252ACI
N050.04.50.017 E019.48.22.858 N050.04.50.081 E019.48.22.884 Color_252ACI
N050.04.50.081 E019.48.22.884 N050.04.50.132 E019.48.22.857 Color_252ACI
N050.04.50.132 E019.48.22.857 N050.04.50.168 E019.48.22.795 Color_252ACI
N050.04.50.168 E019.48.22.795 N050.04.50.178 E019.48.22.738 Color_252ACI
N050.04.50.463 E019.48.22.644 N050.04.50.453 E019.48.22.553 Color_252ACI
N050.04.50.453 E019.48.22.553 N050.04.50.407 E019.48.22.480 Color_252ACI
N050.04.50.407 E019.48.22.480 N050.04.50.350 E019.48.22.463 Color_252ACI
N050.04.50.350 E019.48.22.463 N050.04.50.288 E019.48.22.505 Color_252ACI
N050.04.50.288 E019.48.22.505 N050.04.50.256 E019.48.22.590 Color_252ACI
N050.04.50.256 E019.48.22.590 N050.04.50.262 E019.48.22.692 Color_252ACI
N050.04.50.262 E019.48.22.692 N050.04.50.302 E019.48.22.764 Color_252ACI
N050.04.50.302 E019.48.22.764 N050.04.50.366 E019.48.22.790 Color_252ACI
N050.04.50.366 E019.48.22.790 N050.04.50.417 E019.48.22.763 Color_252ACI
N050.04.50.417 E019.48.22.763 N050.04.50.453 E019.48.22.700 Color_252ACI
N050.04.50.453 E019.48.22.700 N050.04.50.463 E019.48.22.644 Color_252ACI
N050.04.51.049 E019.48.22.450 N050.04.51.038 E019.48.22.359 Color_252ACI
N050.04.51.038 E019.48.22.359 N050.04.50.992 E019.48.22.286 Color_252ACI
N050.04.50.992 E019.48.22.286 N050.04.50.935 E019.48.22.269 Color_252ACI
N050.04.50.935 E019.48.22.269 N050.04.50.873 E019.48.22.312 Color_252ACI
N050.04.50.873 E019.48.22.312 N050.04.50.841 E019.48.22.396 Color_252ACI
N050.04.50.841 E019.48.22.396 N050.04.50.848 E019.48.22.498 Color_252ACI
N050.04.50.848 E019.48.22.498 N050.04.50.887 E019.48.22.570 Color_252ACI
N050.04.50.887 E019.48.22.570 N050.04.50.951 E019.48.22.596 Color_252ACI
N050.04.50.951 E019.48.22.596 N050.04.51.002 E019.48.22.569 Color_252ACI
N050.04.51.002 E019.48.22.569 N050.04.51.038 E019.48.22.506 Color_252ACI
N050.04.51.038 E019.48.22.506 N050.04.51.049 E019.48.22.450 Color_252ACI
N050.04.51.336 E019.48.22.355 N050.04.51.325 E019.48.22.264 Color_252ACI
N050.04.51.325 E019.48.22.264 N050.04.51.279 E019.48.22.191 Color_252ACI
N050.04.51.279 E019.48.22.191 N050.04.51.223 E019.48.22.174 Color_252ACI
N050.04.51.223 E019.48.22.174 N050.04.51.160 E019.48.22.217 Color_252ACI
N050.04.51.160 E019.48.22.217 N050.04.51.129 E019.48.22.301 Color_252ACI
N050.04.51.129 E019.48.22.301 N050.04.51.135 E019.48.22.403 Color_252ACI
N050.04.51.135 E019.48.22.403 N050.04.51.174 E019.48.22.475 Color_252ACI
N050.04.51.174 E019.48.22.475 N050.04.51.239 E019.48.22.501 Color_252ACI
N050.04.51.239 E019.48.22.501 N050.04.51.289 E019.48.22.474 Color_252ACI
N050.04.51.289 E019.48.22.474 N050.04.51.325 E019.48.22.411 Color_252ACI
N050.04.51.325 E019.48.22.411 N050.04.51.336 E019.48.22.355 Color_252ACI
N050.04.49.988 E019.48.21.265 N050.04.49.978 E019.48.21.174 Color_252ACI
N050.04.49.978 E019.48.21.174 N050.04.49.932 E019.48.21.101 Color_252ACI
N050.04.49.932 E019.48.21.101 N050.04.49.875 E019.48.21.084 Color_252ACI
N050.04.49.875 E019.48.21.084 N050.04.49.813 E019.48.21.127 Color_252ACI
N050.04.49.813 E019.48.21.127 N050.04.49.781 E019.48.21.211 Color_252ACI
N050.04.49.781 E019.48.21.211 N050.04.49.787 E019.48.21.313 Color_252ACI
N050.04.49.787 E019.48.21.313 N050.04.49.827 E019.48.21.385 Color_252ACI
N050.04.49.827 E019.48.21.385 N050.04.49.891 E019.48.21.411 Color_252ACI
N050.04.49.891 E019.48.21.411 N050.04.49.941 E019.48.21.384 Color_252ACI
N050.04.49.941 E019.48.21.384 N050.04.49.978 E019.48.21.321 Color_252ACI
N050.04.49.978 E019.48.21.321 N050.04.49.988 E019.48.21.265 Color_252ACI
N050.04.50.255 E019.48.21.177 N050.04.50.244 E019.48.21.086 Color_252ACI
N050.04.50.244 E019.48.21.086 N050.04.50.198 E019.48.21.013 Color_252ACI
N050.04.50.198 E019.48.21.013 N050.04.50.141 E019.48.20.996 Color_252ACI
N050.04.50.141 E019.48.20.996 N050.04.50.079 E019.48.21.038 Color_252ACI
N050.04.50.079 E019.48.21.038 N050.04.50.047 E019.48.21.123 Color_252ACI
N050.04.50.047 E019.48.21.123 N050.04.50.053 E019.48.21.225 Color_252ACI
N050.04.50.053 E019.48.21.225 N050.04.50.093 E019.48.21.297 Color_252ACI
N050.04.50.093 E019.48.21.297 N050.04.50.157 E019.48.21.323 Color_252ACI
N050.04.50.157 E019.48.21.323 N050.04.50.208 E019.48.21.296 Color_252ACI
N050.04.50.208 E019.48.21.296 N050.04.50.244 E019.48.21.233 Color_252ACI
N050.04.50.244 E019.48.21.233 N050.04.50.255 E019.48.21.177 Color_252ACI
N050.04.50.836 E019.48.20.984 N050.04.50.826 E019.48.20.894 Color_252ACI
N050.04.50.826 E019.48.20.894 N050.04.50.779 E019.48.20.821 Color_252ACI
N050.04.50.779 E019.48.20.821 N050.04.50.723 E019.48.20.803 Color_252ACI
N050.04.50.723 E019.48.20.803 N050.04.50.660 E019.48.20.846 Color_252ACI
N050.04.50.660 E019.48.20.846 N050.04.50.629 E019.48.20.930 Color_252ACI
N050.04.50.629 E019.48.20.930 N050.04.50.635 E019.48.21.032 Color_252ACI
N050.04.50.635 E019.48.21.032 N050.04.50.675 E019.48.21.105 Color_252ACI
N050.04.50.675 E019.48.21.105 N050.04.50.739 E019.48.21.130 Color_252ACI
N050.04.50.739 E019.48.21.130 N050.04.50.789 E019.48.21.104 Color_252ACI
N050.04.50.789 E019.48.21.104 N050.04.50.825 E019.48.21.041 Color_252ACI
N050.04.50.825 E019.48.21.041 N050.04.50.836 E019.48.20.984 Color_252ACI
N050.04.51.111 E019.48.20.893 N050.04.51.101 E019.48.20.803 Color_252ACI
N050.04.51.101 E019.48.20.803 N050.04.51.055 E019.48.20.729 Color_252ACI
N050.04.51.055 E019.48.20.729 N050.04.50.998 E019.48.20.712 Color_252ACI
N050.04.50.998 E019.48.20.712 N050.04.50.936 E019.48.20.755 Color_252ACI
N050.04.50.936 E019.48.20.755 N050.04.50.904 E019.48.20.839 Color_252ACI
N050.04.50.904 E019.48.20.839 N050.04.50.910 E019.48.20.941 Color_252ACI
N050.04.50.910 E019.48.20.941 N050.04.50.950 E019.48.21.013 Color_252ACI
N050.04.50.950 E019.48.21.013 N050.04.51.014 E019.48.21.039 Color_252ACI
N050.04.51.014 E019.48.21.039 N050.04.51.065 E019.48.21.013 Color_252ACI
N050.04.51.065 E019.48.21.013 N050.04.51.101 E019.48.20.950 Color_252ACI
N050.04.51.101 E019.48.20.950 N050.04.51.111 E019.48.20.893 Color_252ACI
N050.04.49.765 E019.48.19.752 N050.04.49.754 E019.48.19.662 Color_252ACI
N050.04.49.754 E019.48.19.662 N050.04.49.708 E019.48.19.589 Color_252ACI
N050.04.49.708 E019.48.19.589 N050.04.49.652 E019.48.19.571 Color_252ACI
N050.04.49.652 E019.48.19.571 N050.04.49.589 E019.48.19.614 Color_252ACI
N050.04.49.589 E019.48.19.614 N050.04.49.558 E019.48.19.698 Color_252ACI
N050.04.49.558 E019.48.19.698 N050.04.49.564 E019.48.19.800 Color_252ACI
N050.04.49.564 E019.48.19.800 N050.04.49.603 E019.48.19.873 Color_252ACI
N050.04.49.603 E019.48.19.873 N050.04.49.668 E019.48.19.898 Color_252ACI
N050.04.49.668 E019.48.19.898 N050.04.49.718 E019.48.19.872 Color_252ACI
N050.04.49.718 E019.48.19.872 N050.04.49.754 E019.48.19.809 Color_252ACI
N050.04.49.754 E019.48.19.809 N050.04.49.765 E019.48.19.752 Color_252ACI
N050.04.50.068 E019.48.19.652 N050.04.50.058 E019.48.19.561 Color_252ACI
N050.04.50.058 E019.48.19.561 N050.04.50.012 E019.48.19.488 Color_252ACI
N050.04.50.012 E019.48.19.488 N050.04.49.955 E019.48.19.471 Color_252ACI
N050.04.49.955 E019.48.19.471 N050.04.49.893 E019.48.19.514 Color_252ACI
N050.04.49.893 E019.48.19.514 N050.04.49.861 E019.48.19.598 Color_252ACI
N050.04.49.861 E019.48.19.598 N050.04.49.867 E019.48.19.700 Color_252ACI
N050.04.49.867 E019.48.19.700 N050.04.49.907 E019.48.19.772 Color_252ACI
N050.04.49.907 E019.48.19.772 N050.04.49.971 E019.48.19.798 Color_252ACI
N050.04.49.971 E019.48.19.798 N050.04.50.022 E019.48.19.771 Color_252ACI
N050.04.50.022 E019.48.19.771 N050.04.50.058 E019.48.19.708 Color_252ACI
N050.04.50.058 E019.48.19.708 N050.04.50.068 E019.48.19.652 Color_252ACI
N050.04.50.633 E019.48.19.465 N050.04.50.623 E019.48.19.374 Color_252ACI
N050.04.50.623 E019.48.19.374 N050.04.50.576 E019.48.19.301 Color_252ACI
N050.04.50.576 E019.48.19.301 N050.04.50.520 E019.48.19.284 Color_252ACI
N050.04.50.520 E019.48.19.284 N050.04.50.457 E019.48.19.327 Color_252ACI
N050.04.50.457 E019.48.19.327 N050.04.50.426 E019.48.19.411 Color_252ACI
N050.04.50.426 E019.48.19.411 N050.04.50.432 E019.48.19.513 Color_252ACI
N050.04.50.432 E019.48.19.513 N050.04.50.472 E019.48.19.585 Color_252ACI
N050.04.50.472 E019.48.19.585 N050.04.50.536 E019.48.19.611 Color_252ACI
N050.04.50.536 E019.48.19.611 N050.04.50.586 E019.48.19.584 Color_252ACI
N050.04.50.586 E019.48.19.584 N050.04.50.623 E019.48.19.521 Color_252ACI
N050.04.50.623 E019.48.19.521 N050.04.50.633 E019.48.19.465 Color_252ACI
N050.04.50.920 E019.48.19.370 N050.04.50.909 E019.48.19.279 Color_252ACI
N050.04.50.909 E019.48.19.279 N050.04.50.863 E019.48.19.206 Color_252ACI
N050.04.50.863 E019.48.19.206 N050.04.50.807 E019.48.19.189 Color_252ACI
N050.04.50.807 E019.48.19.189 N050.04.50.744 E019.48.19.232 Color_252ACI
N050.04.50.744 E019.48.19.232 N050.04.50.713 E019.48.19.316 Color_252ACI
N050.04.50.713 E019.48.19.316 N050.04.50.719 E019.48.19.418 Color_252ACI
N050.04.50.719 E019.48.19.418 N050.04.50.758 E019.48.19.490 Color_252ACI
N050.04.50.758 E019.48.19.490 N050.04.50.822 E019.48.19.516 Color_252ACI
N050.04.50.822 E019.48.19.516 N050.04.50.873 E019.48.19.489 Color_252ACI
N050.04.50.873 E019.48.19.489 N050.04.50.909 E019.48.19.426 Color_252ACI
N050.04.50.909 E019.48.19.426 N050.04.50.920 E019.48.19.370 Color_252ACI
N050.04.49.551 E019.48.18.287 N050.04.49.540 E019.48.18.197 Color_252ACI
N050.04.49.540 E019.48.18.197 N050.04.49.494 E019.48.18.124 Color_252ACI
N050.04.49.494 E019.48.18.124 N050.04.49.437 E019.48.18.106 Color_252ACI
N050.04.49.437 E019.48.18.106 N050.04.49.375 E019.48.18.149 Color_252ACI
N050.04.49.375 E019.48.18.149 N050.04.49.343 E019.48.18.233 Color_252ACI
N050.04.49.343 E019.48.18.233 N050.04.49.349 E019.48.18.335 Color_252ACI
N050.04.49.349 E019.48.18.335 N050.04.49.389 E019.48.18.408 Color_252ACI
N050.04.49.389 E019.48.18.408 N050.04.49.453 E019.48.18.433 Color_252ACI
N050.04.49.453 E019.48.18.433 N050.04.49.504 E019.48.18.407 Color_252ACI
N050.04.49.504 E019.48.18.407 N050.04.49.540 E019.48.18.344 Color_252ACI
N050.04.49.540 E019.48.18.344 N050.04.49.551 E019.48.18.287 Color_252ACI
N050.04.49.863 E019.48.18.184 N050.04.49.853 E019.48.18.093 Color_252ACI
N050.04.49.853 E019.48.18.093 N050.04.49.806 E019.48.18.020 Color_252ACI
N050.04.49.806 E019.48.18.020 N050.04.49.750 E019.48.18.003 Color_252ACI
N050.04.49.750 E019.48.18.003 N050.04.49.687 E019.48.18.046 Color_252ACI
N050.04.49.687 E019.48.18.046 N050.04.49.656 E019.48.18.130 Color_252ACI
N050.04.49.656 E019.48.18.130 N050.04.49.662 E019.48.18.232 Color_252ACI
N050.04.49.662 E019.48.18.232 N050.04.49.702 E019.48.18.304 Color_252ACI
N050.04.49.702 E019.48.18.304 N050.04.49.766 E019.48.18.330 Color_252ACI
N050.04.49.766 E019.48.18.330 N050.04.49.816 E019.48.18.303 Color_252ACI
N050.04.49.816 E019.48.18.303 N050.04.49.852 E019.48.18.240 Color_252ACI
N050.04.49.852 E019.48.18.240 N050.04.49.863 E019.48.18.184 Color_252ACI
N050.04.50.436 E019.48.17.994 N050.04.50.425 E019.48.17.904 Color_252ACI
N050.04.50.425 E019.48.17.904 N050.04.50.379 E019.48.17.831 Color_252ACI
N050.04.50.379 E019.48.17.831 N050.04.50.322 E019.48.17.813 Color_252ACI
N050.04.50.322 E019.48.17.813 N050.04.50.260 E019.48.17.856 Color_252ACI
N050.04.50.260 E019.48.17.856 N050.04.50.228 E019.48.17.940 Color_252ACI
N050.04.50.228 E019.48.17.940 N050.04.50.234 E019.48.18.042 Color_252ACI
N050.04.50.234 E019.48.18.042 N050.04.50.274 E019.48.18.115 Color_252ACI
N050.04.50.274 E019.48.18.115 N050.04.50.338 E019.48.18.140 Color_252ACI
N050.04.50.338 E019.48.18.140 N050.04.50.389 E019.48.18.114 Color_252ACI
N050.04.50.389 E019.48.18.114 N050.04.50.425 E019.48.18.051 Color_252ACI
N050.04.50.425 E019.48.18.051 N050.04.50.436 E019.48.17.994 Color_252ACI
N050.04.50.714 E019.48.17.902 N050.04.50.703 E019.48.17.812 Color_252ACI
N050.04.50.703 E019.48.17.812 N050.04.50.657 E019.48.17.739 Color_252ACI
N050.04.50.657 E019.48.17.739 N050.04.50.601 E019.48.17.721 Color_252ACI
N050.04.50.601 E019.48.17.721 N050.04.50.538 E019.48.17.764 Color_252ACI
N050.04.50.538 E019.48.17.764 N050.04.50.507 E019.48.17.848 Color_252ACI
N050.04.50.507 E019.48.17.848 N050.04.50.513 E019.48.17.950 Color_252ACI
N050.04.50.513 E019.48.17.950 N050.04.50.552 E019.48.18.023 Color_252ACI
N050.04.50.552 E019.48.18.023 N050.04.50.617 E019.48.18.048 Color_252ACI
N050.04.50.617 E019.48.18.048 N050.04.50.667 E019.48.18.022 Color_252ACI
N050.04.50.667 E019.48.18.022 N050.04.50.703 E019.48.17.959 Color_252ACI
N050.04.50.703 E019.48.17.959 N050.04.50.714 E019.48.17.902 Color_252ACI
N050.04.49.357 E019.48.16.795 N050.04.49.346 E019.48.16.704 Color_252ACI
N050.04.49.346 E019.48.16.704 N050.04.49.300 E019.48.16.631 Color_252ACI
N050.04.49.300 E019.48.16.631 N050.04.49.243 E019.48.16.614 Color_252ACI
N050.04.49.243 E019.48.16.614 N050.04.49.181 E019.48.16.657 Color_252ACI
N050.04.49.181 E019.48.16.657 N050.04.49.149 E019.48.16.741 Color_252ACI
N050.04.49.149 E019.48.16.741 N050.04.49.156 E019.48.16.843 Color_252ACI
N050.04.49.156 E019.48.16.843 N050.04.49.195 E019.48.16.915 Color_252ACI
N050.04.49.195 E019.48.16.915 N050.04.49.259 E019.48.16.941 Color_252ACI
N050.04.49.259 E019.48.16.941 N050.04.49.310 E019.48.16.914 Color_252ACI
N050.04.49.310 E019.48.16.914 N050.04.49.346 E019.48.16.851 Color_252ACI
N050.04.49.346 E019.48.16.851 N050.04.49.357 E019.48.16.795 Color_252ACI
N050.04.49.648 E019.48.16.698 N050.04.49.638 E019.48.16.608 Color_252ACI
N050.04.49.638 E019.48.16.608 N050.04.49.591 E019.48.16.535 Color_252ACI
N050.04.49.591 E019.48.16.535 N050.04.49.535 E019.48.16.517 Color_252ACI
N050.04.49.535 E019.48.16.517 N050.04.49.472 E019.48.16.560 Color_252ACI
N050.04.49.472 E019.48.16.560 N050.04.49.441 E019.48.16.644 Color_252ACI
N050.04.49.441 E019.48.16.644 N050.04.49.447 E019.48.16.746 Color_252ACI
N050.04.49.447 E019.48.16.746 N050.04.49.487 E019.48.16.819 Color_252ACI
N050.04.49.487 E019.48.16.819 N050.04.49.551 E019.48.16.844 Color_252ACI
N050.04.49.551 E019.48.16.844 N050.04.49.601 E019.48.16.818 Color_252ACI
N050.04.49.601 E019.48.16.818 N050.04.49.637 E019.48.16.755 Color_252ACI
N050.04.49.637 E019.48.16.755 N050.04.49.648 E019.48.16.698 Color_252ACI
N050.04.50.227 E019.48.16.507 N050.04.50.216 E019.48.16.416 Color_252ACI
N050.04.50.216 E019.48.16.416 N050.04.50.170 E019.48.16.343 Color_252ACI
N050.04.50.170 E019.48.16.343 N050.04.50.113 E019.48.16.326 Color_252ACI
N050.04.50.113 E019.48.16.326 N050.04.50.051 E019.48.16.369 Color_252ACI
N050.04.50.051 E019.48.16.369 N050.04.50.019 E019.48.16.453 Color_252ACI
N050.04.50.019 E019.48.16.453 N050.04.50.025 E019.48.16.555 Color_252ACI
N050.04.50.025 E019.48.16.555 N050.04.50.065 E019.48.16.627 Color_252ACI
N050.04.50.065 E019.48.16.627 N050.04.50.129 E019.48.16.653 Color_252ACI
N050.04.50.129 E019.48.16.653 N050.04.50.180 E019.48.16.626 Color_252ACI
N050.04.50.180 E019.48.16.626 N050.04.50.216 E019.48.16.563 Color_252ACI
N050.04.50.216 E019.48.16.563 N050.04.50.227 E019.48.16.507 Color_252ACI
N050.04.50.520 E019.48.16.409 N050.04.50.510 E019.48.16.319 Color_252ACI
N050.04.50.510 E019.48.16.319 N050.04.50.464 E019.48.16.246 Color_252ACI
N050.04.50.464 E019.48.16.246 N050.04.50.407 E019.48.16.229 Color_252ACI
N050.04.50.407 E019.48.16.229 N050.04.50.345 E019.48.16.271 Color_252ACI
N050.04.50.345 E019.48.16.271 N050.04.50.313 E019.48.16.355 Color_252ACI
N050.04.50.313 E019.48.16.355 N050.04.50.319 E019.48.16.457 Color_252ACI
N050.04.50.319 E019.48.16.457 N050.04.50.359 E019.48.16.530 Color_252ACI
N050.04.50.359 E019.48.16.530 N050.04.50.423 E019.48.16.556 Color_252ACI
N050.04.50.423 E019.48.16.556 N050.04.50.473 E019.48.16.529 Color_252ACI
N050.04.50.473 E019.48.16.529 N050.04.50.510 E019.48.16.466 Color_252ACI
N050.04.50.510 E019.48.16.466 N050.04.50.520 E019.48.16.409 Color_252ACI
N050.04.47.440 E019.48.15.869 N050.04.47.429 E019.48.15.778 Color_252ACI
N050.04.47.429 E019.48.15.778 N050.04.47.383 E019.48.15.705 Color_252ACI
N050.04.47.383 E019.48.15.705 N050.04.47.326 E019.48.15.688 Color_252ACI
N050.04.47.326 E019.48.15.688 N050.04.47.264 E019.48.15.731 Color_252ACI
N050.04.47.264 E019.48.15.731 N050.04.47.232 E019.48.15.815 Color_252ACI
N050.04.47.232 E019.48.15.815 N050.04.47.239 E019.48.15.917 Color_252ACI
N050.04.47.239 E019.48.15.917 N050.04.47.278 E019.48.15.989 Color_252ACI
N050.04.47.278 E019.48.15.989 N050.04.47.342 E019.48.16.015 Color_252ACI
N050.04.47.342 E019.48.16.015 N050.04.47.393 E019.48.15.988 Color_252ACI
N050.04.47.393 E019.48.15.988 N050.04.47.429 E019.48.15.925 Color_252ACI
N050.04.47.429 E019.48.15.925 N050.04.47.440 E019.48.15.869 Color_252ACI
N050.04.47.722 E019.48.15.775 N050.04.47.711 E019.48.15.685 Color_252ACI
N050.04.47.711 E019.48.15.685 N050.04.47.665 E019.48.15.612 Color_252ACI
N050.04.47.665 E019.48.15.612 N050.04.47.609 E019.48.15.595 Color_252ACI
N050.04.47.609 E019.48.15.595 N050.04.47.546 E019.48.15.637 Color_252ACI
N050.04.47.546 E019.48.15.637 N050.04.47.515 E019.48.15.721 Color_252ACI
N050.04.47.515 E019.48.15.721 N050.04.47.521 E019.48.15.823 Color_252ACI
N050.04.47.521 E019.48.15.823 N050.04.47.560 E019.48.15.896 Color_252ACI
N050.04.47.560 E019.48.15.896 N050.04.47.625 E019.48.15.921 Color_252ACI
N050.04.47.625 E019.48.15.921 N050.04.47.675 E019.48.15.895 Color_252ACI
N050.04.47.675 E019.48.15.895 N050.04.47.711 E019.48.15.832 Color_252ACI
N050.04.47.711 E019.48.15.832 N050.04.47.722 E019.48.15.775 Color_252ACI
N050.04.48.016 E019.48.15.678 N050.04.48.006 E019.48.15.587 Color_252ACI
N050.04.48.006 E019.48.15.587 N050.04.47.960 E019.48.15.514 Color_252ACI
N050.04.47.960 E019.48.15.514 N050.04.47.903 E019.48.15.497 Color_252ACI
N050.04.47.903 E019.48.15.497 N050.04.47.841 E019.48.15.540 Color_252ACI
N050.04.47.841 E019.48.15.540 N050.04.47.809 E019.48.15.624 Color_252ACI
N050.04.47.809 E019.48.15.624 N050.04.47.815 E019.48.15.726 Color_252ACI
N050.04.47.815 E019.48.15.726 N050.04.47.855 E019.48.15.798 Color_252ACI
N050.04.47.855 E019.48.15.798 N050.04.47.919 E019.48.15.824 Color_252ACI
N050.04.47.919 E019.48.15.824 N050.04.47.970 E019.48.15.797 Color_252ACI
N050.04.47.970 E019.48.15.797 N050.04.48.006 E019.48.15.734 Color_252ACI
N050.04.48.006 E019.48.15.734 N050.04.48.016 E019.48.15.678 Color_252ACI
N050.04.48.310 E019.48.15.581 N050.04.48.300 E019.48.15.490 Color_252ACI
N050.04.48.300 E019.48.15.490 N050.04.48.253 E019.48.15.417 Color_252ACI
N050.04.48.253 E019.48.15.417 N050.04.48.197 E019.48.15.400 Color_252ACI
N050.04.48.197 E019.48.15.400 N050.04.48.134 E019.48.15.442 Color_252ACI
N050.04.48.134 E019.48.15.442 N050.04.48.103 E019.48.15.527 Color_252ACI
N050.04.48.103 E019.48.15.527 N050.04.48.109 E019.48.15.629 Color_252ACI
N050.04.48.109 E019.48.15.629 N050.04.48.149 E019.48.15.701 Color_252ACI
N050.04.48.149 E019.48.15.701 N050.04.48.213 E019.48.15.727 Color_252ACI
N050.04.48.213 E019.48.15.727 N050.04.48.263 E019.48.15.700 Color_252ACI
N050.04.48.263 E019.48.15.700 N050.04.48.299 E019.48.15.637 Color_252ACI
N050.04.48.299 E019.48.15.637 N050.04.48.310 E019.48.15.581 Color_252ACI
N050.04.48.577 E019.48.15.492 N050.04.48.567 E019.48.15.402 Color_252ACI
N050.04.48.567 E019.48.15.402 N050.04.48.521 E019.48.15.329 Color_252ACI
N050.04.48.521 E019.48.15.329 N050.04.48.464 E019.48.15.311 Color_252ACI
N050.04.48.464 E019.48.15.311 N050.04.48.402 E019.48.15.354 Color_252ACI
N050.04.48.402 E019.48.15.354 N050.04.48.370 E019.48.15.438 Color_252ACI
N050.04.48.370 E019.48.15.438 N050.04.48.376 E019.48.15.540 Color_252ACI
N050.04.48.376 E019.48.15.540 N050.04.48.416 E019.48.15.613 Color_252ACI
N050.04.48.416 E019.48.15.613 N050.04.48.480 E019.48.15.638 Color_252ACI
N050.04.48.480 E019.48.15.638 N050.04.48.531 E019.48.15.612 Color_252ACI
N050.04.48.531 E019.48.15.612 N050.04.48.567 E019.48.15.549 Color_252ACI
N050.04.48.567 E019.48.15.549 N050.04.48.577 E019.48.15.492 Color_252ACI
N050.04.48.877 E019.48.15.393 N050.04.48.867 E019.48.15.302 Color_252ACI
N050.04.48.867 E019.48.15.302 N050.04.48.821 E019.48.15.229 Color_252ACI
N050.04.48.821 E019.48.15.229 N050.04.48.764 E019.48.15.212 Color_252ACI
N050.04.48.764 E019.48.15.212 N050.04.48.702 E019.48.15.255 Color_252ACI
N050.04.48.702 E019.48.15.255 N050.04.48.670 E019.48.15.339 Color_252ACI
N050.04.48.670 E019.48.15.339 N050.04.48.676 E019.48.15.441 Color_252ACI
N050.04.48.676 E019.48.15.441 N050.04.48.716 E019.48.15.513 Color_252ACI
N050.04.48.716 E019.48.15.513 N050.04.48.780 E019.48.15.539 Color_252ACI
N050.04.48.780 E019.48.15.539 N050.04.48.831 E019.48.15.512 Color_252ACI
N050.04.48.831 E019.48.15.512 N050.04.48.867 E019.48.15.449 Color_252ACI
N050.04.48.867 E019.48.15.449 N050.04.48.877 E019.48.15.393 Color_252ACI
N050.04.49.166 E019.48.15.297 N050.04.49.155 E019.48.15.207 Color_252ACI
N050.04.49.155 E019.48.15.207 N050.04.49.109 E019.48.15.134 Color_252ACI
N050.04.49.109 E019.48.15.134 N050.04.49.053 E019.48.15.116 Color_252ACI
N050.04.49.053 E019.48.15.116 N050.04.48.990 E019.48.15.159 Color_252ACI
N050.04.48.990 E019.48.15.159 N050.04.48.959 E019.48.15.243 Color_252ACI
N050.04.48.959 E019.48.15.243 N050.04.48.965 E019.48.15.345 Color_252ACI
N050.04.48.965 E019.48.15.345 N050.04.49.004 E019.48.15.418 Color_252ACI
N050.04.49.004 E019.48.15.418 N050.04.49.069 E019.48.15.443 Color_252ACI
N050.04.49.069 E019.48.15.443 N050.04.49.119 E019.48.15.417 Color_252ACI
N050.04.49.119 E019.48.15.417 N050.04.49.155 E019.48.15.354 Color_252ACI
N050.04.49.155 E019.48.15.354 N050.04.49.166 E019.48.15.297 Color_252ACI
N050.04.49.450 E019.48.15.203 N050.04.49.440 E019.48.15.113 Color_252ACI
N050.04.49.440 E019.48.15.113 N050.04.49.394 E019.48.15.040 Color_252ACI
N050.04.49.394 E019.48.15.040 N050.04.49.337 E019.48.15.022 Color_252ACI
N050.04.49.337 E019.48.15.022 N050.04.49.275 E019.48.15.065 Color_252ACI
N050.04.49.275 E019.48.15.065 N050.04.49.243 E019.48.15.149 Color_252ACI
N050.04.49.243 E019.48.15.149 N050.04.49.249 E019.48.15.251 Color_252ACI
N050.04.49.249 E019.48.15.251 N050.04.49.289 E019.48.15.324 Color_252ACI
N050.04.49.289 E019.48.15.324 N050.04.49.353 E019.48.15.349 Color_252ACI
N050.04.49.353 E019.48.15.349 N050.04.49.404 E019.48.15.323 Color_252ACI
N050.04.49.404 E019.48.15.323 N050.04.49.440 E019.48.15.260 Color_252ACI
N050.04.49.440 E019.48.15.260 N050.04.49.450 E019.48.15.203 Color_252ACI
N050.04.50.025 E019.48.15.013 N050.04.50.015 E019.48.14.923 Color_252ACI
N050.04.50.015 E019.48.14.923 N050.04.49.968 E019.48.14.849 Color_252ACI
N050.04.49.968 E019.48.14.849 N050.04.49.912 E019.48.14.832 Color_252ACI
N050.04.49.912 E019.48.14.832 N050.04.49.849 E019.48.14.875 Color_252ACI
N050.04.49.849 E019.48.14.875 N050.04.49.818 E019.48.14.959 Color_252ACI
N050.04.49.818 E019.48.14.959 N050.04.49.824 E019.48.15.061 Color_252ACI
N050.04.49.824 E019.48.15.061 N050.04.49.864 E019.48.15.133 Color_252ACI
N050.04.49.864 E019.48.15.133 N050.04.49.928 E019.48.15.159 Color_252ACI
N050.04.49.928 E019.48.15.159 N050.04.49.978 E019.48.15.133 Color_252ACI
N050.04.49.978 E019.48.15.133 N050.04.50.014 E019.48.15.070 Color_252ACI
N050.04.50.014 E019.48.15.070 N050.04.50.025 E019.48.15.013 Color_252ACI
N050.04.50.321 E019.48.14.915 N050.04.50.311 E019.48.14.825 Color_252ACI
N050.04.50.311 E019.48.14.825 N050.04.50.264 E019.48.14.751 Color_252ACI
N050.04.50.264 E019.48.14.751 N050.04.50.208 E019.48.14.734 Color_252ACI
N050.04.50.208 E019.48.14.734 N050.04.50.145 E019.48.14.777 Color_252ACI
N050.04.50.145 E019.48.14.777 N050.04.50.114 E019.48.14.861 Color_252ACI
N050.04.50.114 E019.48.14.861 N050.04.50.120 E019.48.14.963 Color_252ACI
N050.04.50.120 E019.48.14.963 N050.04.50.160 E019.48.15.035 Color_252ACI
N050.04.50.160 E019.48.15.035 N050.04.50.224 E019.48.15.061 Color_252ACI
N050.04.50.224 E019.48.15.061 N050.04.50.274 E019.48.15.034 Color_252ACI
N050.04.50.274 E019.48.15.034 N050.04.50.310 E019.48.14.972 Color_252ACI
N050.04.50.310 E019.48.14.972 N050.04.50.321 E019.48.14.915 Color_252ACI
N050.04.50.593 E019.48.14.825 N050.04.50.582 E019.48.14.735 Color_252ACI
N050.04.50.582 E019.48.14.735 N050.04.50.536 E019.48.14.662 Color_252ACI
N050.04.50.536 E019.48.14.662 N050.04.50.479 E019.48.14.644 Color_252ACI
N050.04.50.479 E019.48.14.644 N050.04.50.417 E019.48.14.687 Color_252ACI
N050.04.50.417 E019.48.14.687 N050.04.50.385 E019.48.14.771 Color_252ACI
N050.04.50.385 E019.48.14.771 N050.04.50.391 E019.48.14.873 Color_252ACI
N050.04.50.391 E019.48.14.873 N050.04.50.431 E019.48.14.946 Color_252ACI
N050.04.50.431 E019.48.14.946 N050.04.50.495 E019.48.14.971 Color_252ACI
N050.04.50.495 E019.48.14.971 N050.04.50.546 E019.48.14.945 Color_252ACI
N050.04.50.546 E019.48.14.945 N050.04.50.582 E019.48.14.882 Color_252ACI
N050.04.50.582 E019.48.14.882 N050.04.50.593 E019.48.14.825 Color_252ACI
N050.04.50.885 E019.48.14.728 N050.04.50.875 E019.48.14.638 Color_252ACI
N050.04.50.875 E019.48.14.638 N050.04.50.828 E019.48.14.565 Color_252ACI
N050.04.50.828 E019.48.14.565 N050.04.50.772 E019.48.14.547 Color_252ACI
N050.04.50.772 E019.48.14.547 N050.04.50.709 E019.48.14.590 Color_252ACI
N050.04.50.709 E019.48.14.590 N050.04.50.678 E019.48.14.674 Color_252ACI
N050.04.50.678 E019.48.14.674 N050.04.50.684 E019.48.14.776 Color_252ACI
N050.04.50.684 E019.48.14.776 N050.04.50.724 E019.48.14.849 Color_252ACI
N050.04.50.724 E019.48.14.849 N050.04.50.788 E019.48.14.874 Color_252ACI
N050.04.50.788 E019.48.14.874 N050.04.50.838 E019.48.14.848 Color_252ACI
N050.04.50.838 E019.48.14.848 N050.04.50.874 E019.48.14.785 Color_252ACI
N050.04.50.874 E019.48.14.785 N050.04.50.885 E019.48.14.728 Color_252ACI
N050.04.51.170 E019.48.14.634 N050.04.51.159 E019.48.14.544 Color_252ACI
N050.04.51.159 E019.48.14.544 N050.04.51.113 E019.48.14.470 Color_252ACI
N050.04.51.113 E019.48.14.470 N050.04.51.057 E019.48.14.453 Color_252ACI
N050.04.51.057 E019.48.14.453 N050.04.50.994 E019.48.14.496 Color_252ACI
N050.04.50.994 E019.48.14.496 N050.04.50.963 E019.48.14.580 Color_252ACI
N050.04.50.963 E019.48.14.580 N050.04.50.969 E019.48.14.682 Color_252ACI
N050.04.50.969 E019.48.14.682 N050.04.51.008 E019.48.14.754 Color_252ACI
N050.04.51.008 E019.48.14.754 N050.04.51.073 E019.48.14.780 Color_252ACI
N050.04.51.073 E019.48.14.780 N050.04.51.123 E019.48.14.754 Color_252ACI
N050.04.51.123 E019.48.14.754 N050.04.51.159 E019.48.14.691 Color_252ACI
N050.04.51.159 E019.48.14.691 N050.04.51.170 E019.48.14.634 Color_252ACI
N050.04.51.458 E019.48.14.538 N050.04.51.448 E019.48.14.448 Color_252ACI
N050.04.51.448 E019.48.14.448 N050.04.51.402 E019.48.14.375 Color_252ACI
N050.04.51.402 E019.48.14.375 N050.04.51.345 E019.48.14.358 Color_252ACI
N050.04.51.345 E019.48.14.358 N050.04.51.283 E019.48.14.400 Color_252ACI
N050.04.51.283 E019.48.14.400 N050.04.51.251 E019.48.14.484 Color_252ACI
N050.04.51.251 E019.48.14.484 N050.04.51.257 E019.48.14.586 Color_252ACI
N050.04.51.257 E019.48.14.586 N050.04.51.297 E019.48.14.659 Color_252ACI
N050.04.51.297 E019.48.14.659 N050.04.51.361 E019.48.14.685 Color_252ACI
N050.04.51.361 E019.48.14.685 N050.04.51.411 E019.48.14.658 Color_252ACI
N050.04.51.411 E019.48.14.658 N050.04.51.448 E019.48.14.595 Color_252ACI
N050.04.51.448 E019.48.14.595 N050.04.51.458 E019.48.14.538 Color_252ACI
N050.04.51.755 E019.48.14.440 N050.04.51.745 E019.48.14.350 Color_252ACI
N050.04.51.745 E019.48.14.350 N050.04.51.698 E019.48.14.277 Color_252ACI
N050.04.51.698 E019.48.14.277 N050.04.51.642 E019.48.14.259 Color_252ACI
N050.04.51.642 E019.48.14.259 N050.04.51.579 E019.48.14.302 Color_252ACI
N050.04.51.579 E019.48.14.302 N050.04.51.548 E019.48.14.386 Color_252ACI
N050.04.51.548 E019.48.14.386 N050.04.51.554 E019.48.14.488 Color_252ACI
N050.04.51.554 E019.48.14.488 N050.04.51.594 E019.48.14.561 Color_252ACI
N050.04.51.594 E019.48.14.561 N050.04.51.658 E019.48.14.586 Color_252ACI
N050.04.51.658 E019.48.14.586 N050.04.51.708 E019.48.14.560 Color_252ACI
N050.04.51.708 E019.48.14.560 N050.04.51.744 E019.48.14.497 Color_252ACI
N050.04.51.744 E019.48.14.497 N050.04.51.755 E019.48.14.440 Color_252ACI
N050.04.52.038 E019.48.14.347 N050.04.52.027 E019.48.14.256 Color_252ACI
N050.04.52.027 E019.48.14.256 N050.04.51.981 E019.48.14.183 Color_252ACI
N050.04.51.981 E019.48.14.183 N050.04.51.924 E019.48.14.166 Color_252ACI
N050.04.51.924 E019.48.14.166 N050.04.51.862 E019.48.14.209 Color_252ACI
N050.04.51.862 E019.48.14.209 N050.04.51.830 E019.48.14.293 Color_252ACI
N050.04.51.830 E019.48.14.293 N050.04.51.837 E019.48.14.395 Color_252ACI
N050.04.51.837 E019.48.14.395 N050.04.51.876 E019.48.14.467 Color_252ACI
N050.04.51.876 E019.48.14.467 N050.04.51.940 E019.48.14.493 Color_252ACI
N050.04.51.940 E019.48.14.493 N050.04.51.991 E019.48.14.466 Color_252ACI
N050.04.51.991 E019.48.14.466 N050.04.52.027 E019.48.14.403 Color_252ACI
N050.04.52.027 E019.48.14.403 N050.04.52.038 E019.48.14.347 Color_252ACI
N050.04.48.237 E019.48.14.032 N050.04.48.226 E019.48.13.941 Color_252ACI
N050.04.48.226 E019.48.13.941 N050.04.48.180 E019.48.13.868 Color_252ACI
N050.04.48.180 E019.48.13.868 N050.04.48.123 E019.48.13.851 Color_252ACI
N050.04.48.123 E019.48.13.851 N050.04.48.061 E019.48.13.894 Color_252ACI
N050.04.48.061 E019.48.13.894 N050.04.48.030 E019.48.13.978 Color_252ACI
N050.04.48.030 E019.48.13.978 N050.04.48.036 E019.48.14.080 Color_252ACI
N050.04.48.036 E019.48.14.080 N050.04.48.075 E019.48.14.152 Color_252ACI
N050.04.48.075 E019.48.14.152 N050.04.48.139 E019.48.14.178 Color_252ACI
N050.04.48.139 E019.48.14.178 N050.04.48.190 E019.48.14.151 Color_252ACI
N050.04.48.190 E019.48.14.151 N050.04.48.226 E019.48.14.088 Color_252ACI
N050.04.48.226 E019.48.14.088 N050.04.48.237 E019.48.14.032 Color_252ACI
N050.04.48.507 E019.48.13.942 N050.04.48.496 E019.48.13.852 Color_252ACI
N050.04.48.496 E019.48.13.852 N050.04.48.450 E019.48.13.779 Color_252ACI
N050.04.48.450 E019.48.13.779 N050.04.48.394 E019.48.13.762 Color_252ACI
N050.04.48.394 E019.48.13.762 N050.04.48.331 E019.48.13.804 Color_252ACI
N050.04.48.331 E019.48.13.804 N050.04.48.300 E019.48.13.888 Color_252ACI
N050.04.48.300 E019.48.13.888 N050.04.48.306 E019.48.13.990 Color_252ACI
N050.04.48.306 E019.48.13.990 N050.04.48.345 E019.48.14.063 Color_252ACI
N050.04.48.345 E019.48.14.063 N050.04.48.410 E019.48.14.089 Color_252ACI
N050.04.48.410 E019.48.14.089 N050.04.48.460 E019.48.14.062 Color_252ACI
N050.04.48.460 E019.48.14.062 N050.04.48.496 E019.48.13.999 Color_252ACI
N050.04.48.496 E019.48.13.999 N050.04.48.507 E019.48.13.942 Color_252ACI
N050.04.48.803 E019.48.13.844 N050.04.48.793 E019.48.13.754 Color_252ACI
N050.04.48.793 E019.48.13.754 N050.04.48.747 E019.48.13.681 Color_252ACI
N050.04.48.747 E019.48.13.681 N050.04.48.690 E019.48.13.663 Color_252ACI
N050.04.48.690 E019.48.13.663 N050.04.48.628 E019.48.13.706 Color_252ACI
N050.04.48.628 E019.48.13.706 N050.04.48.596 E019.48.13.790 Color_252ACI
N050.04.48.596 E019.48.13.790 N050.04.48.602 E019.48.13.892 Color_252ACI
N050.04.48.602 E019.48.13.892 N050.04.48.642 E019.48.13.965 Color_252ACI
N050.04.48.642 E019.48.13.965 N050.04.48.706 E019.48.13.990 Color_252ACI
N050.04.48.706 E019.48.13.990 N050.04.48.756 E019.48.13.964 Color_252ACI
N050.04.48.756 E019.48.13.964 N050.04.48.793 E019.48.13.901 Color_252ACI
N050.04.48.793 E019.48.13.901 N050.04.48.803 E019.48.13.844 Color_252ACI
N050.04.49.093 E019.48.13.748 N050.04.49.083 E019.48.13.658 Color_252ACI
N050.04.49.083 E019.48.13.658 N050.04.49.037 E019.48.13.585 Color_252ACI
N050.04.49.037 E019.48.13.585 N050.04.48.980 E019.48.13.567 Color_252ACI
N050.04.48.980 E019.48.13.567 N050.04.48.918 E019.48.13.610 Color_252ACI
N050.04.48.918 E019.48.13.610 N050.04.48.886 E019.48.13.694 Color_252ACI
N050.04.48.886 E019.48.13.694 N050.04.48.892 E019.48.13.796 Color_252ACI
N050.04.48.892 E019.48.13.796 N050.04.48.932 E019.48.13.869 Color_252ACI
N050.04.48.932 E019.48.13.869 N050.04.48.996 E019.48.13.894 Color_252ACI
N050.04.48.996 E019.48.13.894 N050.04.49.047 E019.48.13.868 Color_252ACI
N050.04.49.047 E019.48.13.868 N050.04.49.083 E019.48.13.805 Color_252ACI
N050.04.49.083 E019.48.13.805 N050.04.49.093 E019.48.13.748 Color_252ACI
N050.04.49.380 E019.48.13.653 N050.04.49.370 E019.48.13.563 Color_252ACI
N050.04.49.370 E019.48.13.563 N050.04.49.324 E019.48.13.490 Color_252ACI
N050.04.49.324 E019.48.13.490 N050.04.49.267 E019.48.13.472 Color_252ACI
N050.04.49.267 E019.48.13.472 N050.04.49.204 E019.48.13.515 Color_252ACI
N050.04.49.204 E019.48.13.515 N050.04.49.173 E019.48.13.599 Color_252ACI
N050.04.49.173 E019.48.13.599 N050.04.49.179 E019.48.13.701 Color_252ACI
N050.04.49.179 E019.48.13.701 N050.04.49.219 E019.48.13.774 Color_252ACI
N050.04.49.219 E019.48.13.774 N050.04.49.283 E019.48.13.799 Color_252ACI
N050.04.49.283 E019.48.13.799 N050.04.49.333 E019.48.13.773 Color_252ACI
N050.04.49.333 E019.48.13.773 N050.04.49.370 E019.48.13.710 Color_252ACI
N050.04.49.370 E019.48.13.710 N050.04.49.380 E019.48.13.653 Color_252ACI
N050.04.49.673 E019.48.13.556 N050.04.49.662 E019.48.13.466 Color_252ACI
N050.04.49.662 E019.48.13.466 N050.04.49.616 E019.48.13.393 Color_252ACI
N050.04.49.616 E019.48.13.393 N050.04.49.560 E019.48.13.376 Color_252ACI
N050.04.49.560 E019.48.13.376 N050.04.49.497 E019.48.13.418 Color_252ACI
N050.04.49.497 E019.48.13.418 N050.04.49.466 E019.48.13.502 Color_252ACI
N050.04.49.466 E019.48.13.502 N050.04.49.472 E019.48.13.604 Color_252ACI
N050.04.49.472 E019.48.13.604 N050.04.49.511 E019.48.13.677 Color_252ACI
N050.04.49.511 E019.48.13.677 N050.04.49.575 E019.48.13.703 Color_252ACI
N050.04.49.575 E019.48.13.703 N050.04.49.626 E019.48.13.676 Color_252ACI
N050.04.49.626 E019.48.13.676 N050.04.49.662 E019.48.13.613 Color_252ACI
N050.04.49.662 E019.48.13.613 N050.04.49.673 E019.48.13.556 Color_252ACI
N050.04.49.948 E019.48.13.465 N050.04.49.938 E019.48.13.375 Color_252ACI
N050.04.49.938 E019.48.13.375 N050.04.49.891 E019.48.13.302 Color_252ACI
N050.04.49.891 E019.48.13.302 N050.04.49.835 E019.48.13.284 Color_252ACI
N050.04.49.835 E019.48.13.284 N050.04.49.772 E019.48.13.327 Color_252ACI
N050.04.49.772 E019.48.13.327 N050.04.49.741 E019.48.13.411 Color_252ACI
N050.04.49.741 E019.48.13.411 N050.04.49.747 E019.48.13.513 Color_252ACI
N050.04.49.747 E019.48.13.513 N050.04.49.787 E019.48.13.586 Color_252ACI
N050.04.49.787 E019.48.13.586 N050.04.49.851 E019.48.13.611 Color_252ACI
N050.04.49.851 E019.48.13.611 N050.04.49.901 E019.48.13.585 Color_252ACI
N050.04.49.901 E019.48.13.585 N050.04.49.938 E019.48.13.522 Color_252ACI
N050.04.49.938 E019.48.13.522 N050.04.49.948 E019.48.13.465 Color_252ACI
N050.04.50.232 E019.48.13.371 N050.04.50.222 E019.48.13.281 Color_252ACI
N050.04.50.222 E019.48.13.281 N050.04.50.176 E019.48.13.208 Color_252ACI
N050.04.50.176 E019.48.13.208 N050.04.50.119 E019.48.13.190 Color_252ACI
N050.04.50.119 E019.48.13.190 N050.04.50.057 E019.48.13.233 Color_252ACI
N050.04.50.057 E019.48.13.233 N050.04.50.025 E019.48.13.317 Color_252ACI
N050.04.50.025 E019.48.13.317 N050.04.50.031 E019.48.13.419 Color_252ACI
N050.04.50.031 E019.48.13.419 N050.04.50.071 E019.48.13.492 Color_252ACI
N050.04.50.071 E019.48.13.492 N050.04.50.135 E019.48.13.517 Color_252ACI
N050.04.50.135 E019.48.13.517 N050.04.50.186 E019.48.13.491 Color_252ACI
N050.04.50.186 E019.48.13.491 N050.04.50.222 E019.48.13.428 Color_252ACI
N050.04.50.222 E019.48.13.428 N050.04.50.232 E019.48.13.371 Color_252ACI
N050.04.50.538 E019.48.13.270 N050.04.50.528 E019.48.13.180 Color_252ACI
N050.04.50.528 E019.48.13.180 N050.04.50.481 E019.48.13.106 Color_252ACI
N050.04.50.481 E019.48.13.106 N050.04.50.425 E019.48.13.089 Color_252ACI
N050.04.50.425 E019.48.13.089 N050.04.50.362 E019.48.13.132 Color_252ACI
N050.04.50.362 E019.48.13.132 N050.04.50.331 E019.48.13.216 Color_252ACI
N050.04.50.331 E019.48.13.216 N050.04.50.337 E019.48.13.318 Color_252ACI
N050.04.50.337 E019.48.13.318 N050.04.50.377 E019.48.13.391 Color_252ACI
N050.04.50.377 E019.48.13.391 N050.04.50.441 E019.48.13.416 Color_252ACI
N050.04.50.441 E019.48.13.416 N050.04.50.491 E019.48.13.390 Color_252ACI
N050.04.50.491 E019.48.13.390 N050.04.50.527 E019.48.13.327 Color_252ACI
N050.04.50.527 E019.48.13.327 N050.04.50.538 E019.48.13.270 Color_252ACI
N050.04.50.823 E019.48.13.176 N050.04.50.812 E019.48.13.085 Color_252ACI
N050.04.50.812 E019.48.13.085 N050.04.50.766 E019.48.13.012 Color_252ACI
N050.04.50.766 E019.48.13.012 N050.04.50.710 E019.48.12.995 Color_252ACI
N050.04.50.710 E019.48.12.995 N050.04.50.647 E019.48.13.038 Color_252ACI
N050.04.50.647 E019.48.13.038 N050.04.50.616 E019.48.13.122 Color_252ACI
N050.04.50.616 E019.48.13.122 N050.04.50.622 E019.48.13.224 Color_252ACI
N050.04.50.622 E019.48.13.224 N050.04.50.661 E019.48.13.296 Color_252ACI
N050.04.50.661 E019.48.13.296 N050.04.50.726 E019.48.13.322 Color_252ACI
N050.04.50.726 E019.48.13.322 N050.04.50.776 E019.48.13.295 Color_252ACI
N050.04.50.776 E019.48.13.295 N050.04.50.812 E019.48.13.232 Color_252ACI
N050.04.50.812 E019.48.13.232 N050.04.50.823 E019.48.13.176 Color_252ACI
N050.04.47.451 E019.47.58.443 N050.04.47.440 E019.47.58.353 Color_252ACI
N050.04.47.440 E019.47.58.353 N050.04.47.394 E019.47.58.280 Color_252ACI
N050.04.47.394 E019.47.58.280 N050.04.47.338 E019.47.58.262 Color_252ACI
N050.04.47.338 E019.47.58.262 N050.04.47.275 E019.47.58.305 Color_252ACI
N050.04.47.275 E019.47.58.305 N050.04.47.244 E019.47.58.389 Color_252ACI
N050.04.47.244 E019.47.58.389 N050.04.47.250 E019.47.58.491 Color_252ACI
N050.04.47.250 E019.47.58.491 N050.04.47.289 E019.47.58.564 Color_252ACI
N050.04.47.289 E019.47.58.564 N050.04.47.354 E019.47.58.589 Color_252ACI
N050.04.47.354 E019.47.58.589 N050.04.47.404 E019.47.58.563 Color_252ACI
N050.04.47.404 E019.47.58.563 N050.04.47.440 E019.47.58.500 Color_252ACI
N050.04.47.440 E019.47.58.500 N050.04.47.451 E019.47.58.443 Color_252ACI
N050.04.47.247 E019.47.56.955 N050.04.47.237 E019.47.56.864 Color_252ACI
N050.04.47.237 E019.47.56.864 N050.04.47.190 E019.47.56.791 Color_252ACI
N050.04.47.190 E019.47.56.791 N050.04.47.134 E019.47.56.774 Color_252ACI
N050.04.47.134 E019.47.56.774 N050.04.47.071 E019.47.56.817 Color_252ACI
N050.04.47.071 E019.47.56.817 N050.04.47.040 E019.47.56.901 Color_252ACI
N050.04.47.040 E019.47.56.901 N050.04.47.046 E019.47.57.003 Color_252ACI
N050.04.47.046 E019.47.57.003 N050.04.47.086 E019.47.57.075 Color_252ACI
N050.04.47.086 E019.47.57.075 N050.04.47.150 E019.47.57.101 Color_252ACI
N050.04.47.150 E019.47.57.101 N050.04.47.200 E019.47.57.074 Color_252ACI
N050.04.47.200 E019.47.57.074 N050.04.47.236 E019.47.57.011 Color_252ACI
N050.04.47.236 E019.47.57.011 N050.04.47.247 E019.47.56.955 Color_252ACI
N050.04.47.044 E019.47.55.466 N050.04.47.033 E019.47.55.376 Color_252ACI
N050.04.47.033 E019.47.55.376 N050.04.46.987 E019.47.55.303 Color_252ACI
N050.04.46.987 E019.47.55.303 N050.04.46.931 E019.47.55.285 Color_252ACI
N050.04.46.931 E019.47.55.285 N050.04.46.868 E019.47.55.328 Color_252ACI
N050.04.46.868 E019.47.55.328 N050.04.46.837 E019.47.55.412 Color_252ACI
N050.04.46.837 E019.47.55.412 N050.04.46.843 E019.47.55.514 Color_252ACI
N050.04.46.843 E019.47.55.514 N050.04.46.882 E019.47.55.587 Color_252ACI
N050.04.46.882 E019.47.55.587 N050.04.46.947 E019.47.55.612 Color_252ACI
N050.04.46.947 E019.47.55.612 N050.04.46.997 E019.47.55.586 Color_252ACI
N050.04.46.997 E019.47.55.586 N050.04.47.033 E019.47.55.523 Color_252ACI
N050.04.47.033 E019.47.55.523 N050.04.47.044 E019.47.55.466 Color_252ACI
N050.04.46.840 E019.47.53.978 N050.04.46.830 E019.47.53.887 Color_252ACI
N050.04.46.830 E019.47.53.887 N050.04.46.783 E019.47.53.814 Color_252ACI
N050.04.46.783 E019.47.53.814 N050.04.46.727 E019.47.53.797 Color_252ACI
N050.04.46.727 E019.47.53.797 N050.04.46.664 E019.47.53.840 Color_252ACI
N050.04.46.664 E019.47.53.840 N050.04.46.633 E019.47.53.924 Color_252ACI
N050.04.46.633 E019.47.53.924 N050.04.46.639 E019.47.54.026 Color_252ACI
N050.04.46.639 E019.47.54.026 N050.04.46.679 E019.47.54.098 Color_252ACI
N050.04.46.679 E019.47.54.098 N050.04.46.743 E019.47.54.124 Color_252ACI
N050.04.46.743 E019.47.54.124 N050.04.46.793 E019.47.54.097 Color_252ACI
N050.04.46.793 E019.47.54.097 N050.04.46.829 E019.47.54.034 Color_252ACI
N050.04.46.829 E019.47.54.034 N050.04.46.840 E019.47.53.978 Color_252ACI
N050.04.46.637 E019.47.52.489 N050.04.46.626 E019.47.52.399 Color_252ACI
N050.04.46.626 E019.47.52.399 N050.04.46.580 E019.47.52.326 Color_252ACI
N050.04.46.580 E019.47.52.326 N050.04.46.524 E019.47.52.308 Color_252ACI
N050.04.46.524 E019.47.52.308 N050.04.46.461 E019.47.52.351 Color_252ACI
N050.04.46.461 E019.47.52.351 N050.04.46.430 E019.47.52.435 Color_252ACI
N050.04.46.430 E019.47.52.435 N050.04.46.436 E019.47.52.537 Color_252ACI
N050.04.46.436 E019.47.52.537 N050.04.46.475 E019.47.52.610 Color_252ACI
N050.04.46.475 E019.47.52.610 N050.04.46.539 E019.47.52.635 Color_252ACI
N050.04.46.539 E019.47.52.635 N050.04.46.590 E019.47.52.609 Color_252ACI
N050.04.46.590 E019.47.52.609 N050.04.46.626 E019.47.52.546 Color_252ACI
N050.04.46.626 E019.47.52.546 N050.04.46.637 E019.47.52.489 Color_252ACI
N050.04.46.433 E019.47.51.001 N050.04.46.423 E019.47.50.911 Color_252ACI
N050.04.46.423 E019.47.50.911 N050.04.46.376 E019.47.50.837 Color_252ACI
N050.04.46.376 E019.47.50.837 N050.04.46.320 E019.47.50.820 Color_252ACI
N050.04.46.320 E019.47.50.820 N050.04.46.257 E019.47.50.863 Color_252ACI
N050.04.46.257 E019.47.50.863 N050.04.46.226 E019.47.50.947 Color_252ACI
N050.04.46.226 E019.47.50.947 N050.04.46.232 E019.47.51.049 Color_252ACI
N050.04.46.232 E019.47.51.049 N050.04.46.272 E019.47.51.121 Color_252ACI
N050.04.46.272 E019.47.51.121 N050.04.46.336 E019.47.51.147 Color_252ACI
N050.04.46.336 E019.47.51.147 N050.04.46.386 E019.47.51.120 Color_252ACI
N050.04.46.386 E019.47.51.120 N050.04.46.422 E019.47.51.057 Color_252ACI
N050.04.46.422 E019.47.51.057 N050.04.46.433 E019.47.51.001 Color_252ACI
N050.04.46.230 E019.47.49.512 N050.04.46.219 E019.47.49.422 Color_252ACI
N050.04.46.219 E019.47.49.422 N050.04.46.173 E019.47.49.349 Color_252ACI
N050.04.46.173 E019.47.49.349 N050.04.46.116 E019.47.49.332 Color_252ACI
N050.04.46.116 E019.47.49.332 N050.04.46.054 E019.47.49.374 Color_252ACI
N050.04.46.054 E019.47.49.374 N050.04.46.023 E019.47.49.458 Color_252ACI
N050.04.46.023 E019.47.49.458 N050.04.46.029 E019.47.49.560 Color_252ACI
N050.04.46.029 E019.47.49.560 N050.04.46.068 E019.47.49.633 Color_252ACI
N050.04.46.068 E019.47.49.633 N050.04.46.132 E019.47.49.659 Color_252ACI
N050.04.46.132 E019.47.49.659 N050.04.46.183 E019.47.49.632 Color_252ACI
N050.04.46.183 E019.47.49.632 N050.04.46.219 E019.47.49.569 Color_252ACI
N050.04.46.219 E019.47.49.569 N050.04.46.230 E019.47.49.512 Color_252ACI
N050.04.46.026 E019.47.48.024 N050.04.46.016 E019.47.47.934 Color_252ACI
N050.04.46.016 E019.47.47.934 N050.04.45.969 E019.47.47.860 Color_252ACI
N050.04.45.969 E019.47.47.860 N050.04.45.913 E019.47.47.843 Color_252ACI
N050.04.45.913 E019.47.47.843 N050.04.45.850 E019.47.47.886 Color_252ACI
N050.04.45.850 E019.47.47.886 N050.04.45.819 E019.47.47.970 Color_252ACI
N050.04.45.819 E019.47.47.970 N050.04.45.825 E019.47.48.072 Color_252ACI
N050.04.45.825 E019.47.48.072 N050.04.45.865 E019.47.48.144 Color_252ACI
N050.04.45.865 E019.47.48.144 N050.04.45.929 E019.47.48.170 Color_252ACI
N050.04.45.929 E019.47.48.170 N050.04.45.979 E019.47.48.144 Color_252ACI
N050.04.45.979 E019.47.48.144 N050.04.46.015 E019.47.48.081 Color_252ACI
N050.04.46.015 E019.47.48.081 N050.04.46.026 E019.47.48.024 Color_252ACI
N050.04.45.823 E019.47.46.535 N050.04.45.812 E019.47.46.445 Color_252ACI
N050.04.45.812 E019.47.46.445 N050.04.45.766 E019.47.46.372 Color_252ACI
N050.04.45.766 E019.47.46.372 N050.04.45.709 E019.47.46.355 Color_252ACI
N050.04.45.709 E019.47.46.355 N050.04.45.647 E019.47.46.397 Color_252ACI
N050.04.45.647 E019.47.46.397 N050.04.45.615 E019.47.46.482 Color_252ACI
N050.04.45.615 E019.47.46.482 N050.04.45.622 E019.47.46.583 Color_252ACI
N050.04.45.622 E019.47.46.583 N050.04.45.661 E019.47.46.656 Color_252ACI
N050.04.45.661 E019.47.46.656 N050.04.45.725 E019.47.46.682 Color_252ACI
N050.04.45.725 E019.47.46.682 N050.04.45.776 E019.47.46.655 Color_252ACI
N050.04.45.776 E019.47.46.655 N050.04.45.812 E019.47.46.592 Color_252ACI
N050.04.45.812 E019.47.46.592 N050.04.45.823 E019.47.46.535 Color_252ACI
N050.04.45.619 E019.47.45.047 N050.04.45.609 E019.47.44.957 Color_252ACI
N050.04.45.609 E019.47.44.957 N050.04.45.562 E019.47.44.884 Color_252ACI
N050.04.45.562 E019.47.44.884 N050.04.45.506 E019.47.44.866 Color_252ACI
N050.04.45.506 E019.47.44.866 N050.04.45.443 E019.47.44.909 Color_252ACI
N050.04.45.443 E019.47.44.909 N050.04.45.412 E019.47.44.993 Color_252ACI
N050.04.45.412 E019.47.44.993 N050.04.45.418 E019.47.45.095 Color_252ACI
N050.04.45.418 E019.47.45.095 N050.04.45.458 E019.47.45.168 Color_252ACI
N050.04.45.458 E019.47.45.168 N050.04.45.522 E019.47.45.193 Color_252ACI
N050.04.45.522 E019.47.45.193 N050.04.45.572 E019.47.45.167 Color_252ACI
N050.04.45.572 E019.47.45.167 N050.04.45.608 E019.47.45.104 Color_252ACI
N050.04.45.608 E019.47.45.104 N050.04.45.619 E019.47.45.047 Color_252ACI
N050.04.45.416 E019.47.43.559 N050.04.45.405 E019.47.43.468 Color_252ACI
N050.04.45.405 E019.47.43.468 N050.04.45.359 E019.47.43.395 Color_252ACI
N050.04.45.359 E019.47.43.395 N050.04.45.302 E019.47.43.378 Color_252ACI
N050.04.45.302 E019.47.43.378 N050.04.45.240 E019.47.43.420 Color_252ACI
N050.04.45.240 E019.47.43.420 N050.04.45.208 E019.47.43.505 Color_252ACI
N050.04.45.208 E019.47.43.505 N050.04.45.215 E019.47.43.607 Color_252ACI
N050.04.45.215 E019.47.43.607 N050.04.45.254 E019.47.43.679 Color_252ACI
N050.04.45.254 E019.47.43.679 N050.04.45.318 E019.47.43.705 Color_252ACI
N050.04.45.318 E019.47.43.705 N050.04.45.369 E019.47.43.678 Color_252ACI
N050.04.45.369 E019.47.43.678 N050.04.45.405 E019.47.43.615 Color_252ACI
N050.04.45.405 E019.47.43.615 N050.04.45.416 E019.47.43.559 Color_252ACI
N050.04.45.212 E019.47.42.070 N050.04.45.202 E019.47.41.980 Color_252ACI
N050.04.45.202 E019.47.41.980 N050.04.45.155 E019.47.41.907 Color_252ACI
N050.04.45.155 E019.47.41.907 N050.04.45.099 E019.47.41.889 Color_252ACI
N050.04.45.099 E019.47.41.889 N050.04.45.036 E019.47.41.932 Color_252ACI
N050.04.45.036 E019.47.41.932 N050.04.45.005 E019.47.42.016 Color_252ACI
N050.04.45.005 E019.47.42.016 N050.04.45.011 E019.47.42.118 Color_252ACI
N050.04.45.011 E019.47.42.118 N050.04.45.051 E019.47.42.191 Color_252ACI
N050.04.45.051 E019.47.42.191 N050.04.45.115 E019.47.42.216 Color_252ACI
N050.04.45.115 E019.47.42.216 N050.04.45.165 E019.47.42.190 Color_252ACI
N050.04.45.165 E019.47.42.190 N050.04.45.201 E019.47.42.127 Color_252ACI
N050.04.45.201 E019.47.42.127 N050.04.45.212 E019.47.42.070 Color_252ACI
N050.04.45.009 E019.47.40.582 N050.04.44.998 E019.47.40.491 Color_252ACI
N050.04.44.998 E019.47.40.491 N050.04.44.952 E019.47.40.418 Color_252ACI
N050.04.44.952 E019.47.40.418 N050.04.44.895 E019.47.40.401 Color_252ACI
N050.04.44.895 E019.47.40.401 N050.04.44.833 E019.47.40.443 Color_252ACI
N050.04.44.833 E019.47.40.443 N050.04.44.801 E019.47.40.528 Color_252ACI
N050.04.44.801 E019.47.40.528 N050.04.44.808 E019.47.40.630 Color_252ACI
N050.04.44.808 E019.47.40.630 N050.04.44.847 E019.47.40.702 Color_252ACI
N050.04.44.847 E019.47.40.702 N050.04.44.911 E019.47.40.728 Color_252ACI
N050.04.44.911 E019.47.40.728 N050.04.44.962 E019.47.40.701 Color_252ACI
N050.04.44.962 E019.47.40.701 N050.04.44.998 E019.47.40.638 Color_252ACI
N050.04.44.998 E019.47.40.638 N050.04.45.009 E019.47.40.582 Color_252ACI
N050.04.44.805 E019.47.39.093 N050.04.44.795 E019.47.39.003 Color_252ACI
N050.04.44.795 E019.47.39.003 N050.04.44.748 E019.47.38.930 Color_252ACI
N050.04.44.748 E019.47.38.930 N050.04.44.692 E019.47.38.912 Color_252ACI
N050.04.44.692 E019.47.38.912 N050.04.44.629 E019.47.38.955 Color_252ACI
N050.04.44.629 E019.47.38.955 N050.04.44.598 E019.47.39.039 Color_252ACI
N050.04.44.598 E019.47.39.039 N050.04.44.604 E019.47.39.141 Color_252ACI
N050.04.44.604 E019.47.39.141 N050.04.44.644 E019.47.39.214 Color_252ACI
N050.04.44.644 E019.47.39.214 N050.04.44.708 E019.47.39.239 Color_252ACI
N050.04.44.708 E019.47.39.239 N050.04.44.758 E019.47.39.213 Color_252ACI
N050.04.44.758 E019.47.39.213 N050.04.44.794 E019.47.39.150 Color_252ACI
N050.04.44.794 E019.47.39.150 N050.04.44.805 E019.47.39.093 Color_252ACI
N050.04.44.602 E019.47.37.605 N050.04.44.591 E019.47.37.514 Color_252ACI
N050.04.44.591 E019.47.37.514 N050.04.44.545 E019.47.37.441 Color_252ACI
N050.04.44.545 E019.47.37.441 N050.04.44.488 E019.47.37.424 Color_252ACI
N050.04.44.488 E019.47.37.424 N050.04.44.426 E019.47.37.467 Color_252ACI
N050.04.44.426 E019.47.37.467 N050.04.44.394 E019.47.37.551 Color_252ACI
N050.04.44.394 E019.47.37.551 N050.04.44.401 E019.47.37.653 Color_252ACI
N050.04.44.401 E019.47.37.653 N050.04.44.440 E019.47.37.725 Color_252ACI
N050.04.44.440 E019.47.37.725 N050.04.44.504 E019.47.37.751 Color_252ACI
N050.04.44.504 E019.47.37.751 N050.04.44.555 E019.47.37.724 Color_252ACI
N050.04.44.555 E019.47.37.724 N050.04.44.591 E019.47.37.661 Color_252ACI
N050.04.44.591 E019.47.37.661 N050.04.44.602 E019.47.37.605 Color_252ACI
N050.04.44.398 E019.47.36.116 N050.04.44.388 E019.47.36.026 Color_252ACI
N050.04.44.388 E019.47.36.026 N050.04.44.341 E019.47.35.953 Color_252ACI
N050.04.44.341 E019.47.35.953 N050.04.44.285 E019.47.35.935 Color_252ACI
N050.04.44.285 E019.47.35.935 N050.04.44.222 E019.47.35.978 Color_252ACI
N050.04.44.222 E019.47.35.978 N050.04.44.191 E019.47.36.062 Color_252ACI
N050.04.44.191 E019.47.36.062 N050.04.44.197 E019.47.36.164 Color_252ACI
N050.04.44.197 E019.47.36.164 N050.04.44.237 E019.47.36.237 Color_252ACI
N050.04.44.237 E019.47.36.237 N050.04.44.301 E019.47.36.262 Color_252ACI
N050.04.44.301 E019.47.36.262 N050.04.44.351 E019.47.36.236 Color_252ACI
N050.04.44.351 E019.47.36.236 N050.04.44.387 E019.47.36.173 Color_252ACI
N050.04.44.387 E019.47.36.173 N050.04.44.398 E019.47.36.116 Color_252ACI
N050.04.44.195 E019.47.34.628 N050.04.44.184 E019.47.34.537 Color_252ACI
N050.04.44.184 E019.47.34.537 N050.04.44.138 E019.47.34.464 Color_252ACI
N050.04.44.138 E019.47.34.464 N050.04.44.081 E019.47.34.447 Color_252ACI
N050.04.44.081 E019.47.34.447 N050.04.44.019 E019.47.34.490 Color_252ACI
N050.04.44.019 E019.47.34.490 N050.04.43.987 E019.47.34.574 Color_252ACI
N050.04.43.987 E019.47.34.574 N050.04.43.993 E019.47.34.676 Color_252ACI
N050.04.43.993 E019.47.34.676 N050.04.44.033 E019.47.34.748 Color_252ACI
N050.04.44.033 E019.47.34.748 N050.04.44.097 E019.47.34.774 Color_252ACI
N050.04.44.097 E019.47.34.774 N050.04.44.148 E019.47.34.747 Color_252ACI
N050.04.44.148 E019.47.34.747 N050.04.44.184 E019.47.34.684 Color_252ACI
N050.04.44.184 E019.47.34.684 N050.04.44.195 E019.47.34.628 Color_252ACI
N050.04.43.991 E019.47.33.139 N050.04.43.981 E019.47.33.049 Color_252ACI
N050.04.43.981 E019.47.33.049 N050.04.43.934 E019.47.32.976 Color_252ACI
N050.04.43.934 E019.47.32.976 N050.04.43.878 E019.47.32.958 Color_252ACI
N050.04.43.878 E019.47.32.958 N050.04.43.815 E019.47.33.001 Color_252ACI
N050.04.43.815 E019.47.33.001 N050.04.43.784 E019.47.33.085 Color_252ACI
N050.04.43.784 E019.47.33.085 N050.04.43.790 E019.47.33.187 Color_252ACI
N050.04.43.790 E019.47.33.187 N050.04.43.830 E019.47.33.260 Color_252ACI
N050.04.43.830 E019.47.33.260 N050.04.43.894 E019.47.33.285 Color_252ACI
N050.04.43.894 E019.47.33.285 N050.04.43.944 E019.47.33.259 Color_252ACI
N050.04.43.944 E019.47.33.259 N050.04.43.980 E019.47.33.196 Color_252ACI
N050.04.43.980 E019.47.33.196 N050.04.43.991 E019.47.33.139 Color_252ACI
N050.04.43.788 E019.47.31.651 N050.04.43.777 E019.47.31.561 Color_252ACI
N050.04.43.777 E019.47.31.561 N050.04.43.731 E019.47.31.487 Color_252ACI
N050.04.43.731 E019.47.31.487 N050.04.43.674 E019.47.31.470 Color_252ACI
N050.04.43.674 E019.47.31.470 N050.04.43.612 E019.47.31.513 Color_252ACI
N050.04.43.612 E019.47.31.513 N050.04.43.580 E019.47.31.597 Color_252ACI
N050.04.43.580 E019.47.31.597 N050.04.43.586 E019.47.31.699 Color_252ACI
N050.04.43.586 E019.47.31.699 N050.04.43.626 E019.47.31.771 Color_252ACI
N050.04.43.626 E019.47.31.771 N050.04.43.690 E019.47.31.797 Color_252ACI
N050.04.43.690 E019.47.31.797 N050.04.43.741 E019.47.31.770 Color_252ACI
N050.04.43.741 E019.47.31.770 N050.04.43.777 E019.47.31.707 Color_252ACI
N050.04.43.777 E019.47.31.707 N050.04.43.788 E019.47.31.651 Color_252ACI
N050.04.43.584 E019.47.30.162 N050.04.43.574 E019.47.30.072 Color_252ACI
N050.04.43.574 E019.47.30.072 N050.04.43.527 E019.47.29.999 Color_252ACI
N050.04.43.527 E019.47.29.999 N050.04.43.471 E019.47.29.982 Color_252ACI
N050.04.43.471 E019.47.29.982 N050.04.43.408 E019.47.30.024 Color_252ACI
N050.04.43.408 E019.47.30.024 N050.04.43.377 E019.47.30.108 Color_252ACI
N050.04.43.377 E019.47.30.108 N050.04.43.383 E019.47.30.210 Color_252ACI
N050.04.43.383 E019.47.30.210 N050.04.43.423 E019.47.30.283 Color_252ACI
N050.04.43.423 E019.47.30.283 N050.04.43.487 E019.47.30.308 Color_252ACI
N050.04.43.487 E019.47.30.308 N050.04.43.537 E019.47.30.282 Color_252ACI
N050.04.43.537 E019.47.30.282 N050.04.43.573 E019.47.30.219 Color_252ACI
N050.04.43.573 E019.47.30.219 N050.04.43.584 E019.47.30.162 Color_252ACI
N050.04.43.381 E019.47.28.674 N050.04.43.370 E019.47.28.584 Color_252ACI
N050.04.43.370 E019.47.28.584 N050.04.43.324 E019.47.28.510 Color_252ACI
N050.04.43.324 E019.47.28.510 N050.04.43.267 E019.47.28.493 Color_252ACI
N050.04.43.267 E019.47.28.493 N050.04.43.205 E019.47.28.536 Color_252ACI
N050.04.43.205 E019.47.28.536 N050.04.43.173 E019.47.28.620 Color_252ACI
N050.04.43.173 E019.47.28.620 N050.04.43.179 E019.47.28.722 Color_252ACI
N050.04.43.179 E019.47.28.722 N050.04.43.219 E019.47.28.794 Color_252ACI
N050.04.43.219 E019.47.28.794 N050.04.43.283 E019.47.28.820 Color_252ACI
N050.04.43.283 E019.47.28.820 N050.04.43.334 E019.47.28.794 Color_252ACI
N050.04.43.334 E019.47.28.794 N050.04.43.370 E019.47.28.731 Color_252ACI
N050.04.43.370 E019.47.28.731 N050.04.43.381 E019.47.28.674 Color_252ACI
N050.04.43.177 E019.47.27.185 N050.04.43.167 E019.47.27.095 Color_252ACI
N050.04.43.167 E019.47.27.095 N050.04.43.120 E019.47.27.022 Color_252ACI
N050.04.43.120 E019.47.27.022 N050.04.43.064 E019.47.27.005 Color_252ACI
N050.04.43.064 E019.47.27.005 N050.04.43.001 E019.47.27.047 Color_252ACI
N050.04.43.001 E019.47.27.047 N050.04.42.970 E019.47.27.132 Color_252ACI
N050.04.42.970 E019.47.27.132 N050.04.42.976 E019.47.27.233 Color_252ACI
N050.04.42.976 E019.47.27.233 N050.04.43.016 E019.47.27.306 Color_252ACI
N050.04.43.016 E019.47.27.306 N050.04.43.080 E019.47.27.332 Color_252ACI
N050.04.43.080 E019.47.27.332 N050.04.43.130 E019.47.27.305 Color_252ACI
N050.04.43.130 E019.47.27.305 N050.04.43.166 E019.47.27.242 Color_252ACI
N050.04.43.166 E019.47.27.242 N050.04.43.177 E019.47.27.185 Color_252ACI
N050.04.42.973 E019.47.25.697 N050.04.42.963 E019.47.25.607 Color_252ACI
N050.04.42.963 E019.47.25.607 N050.04.42.917 E019.47.25.534 Color_252ACI
N050.04.42.917 E019.47.25.534 N050.04.42.860 E019.47.25.516 Color_252ACI
N050.04.42.860 E019.47.25.516 N050.04.42.798 E019.47.25.559 Color_252ACI
N050.04.42.798 E019.47.25.559 N050.04.42.766 E019.47.25.643 Color_252ACI
N050.04.42.766 E019.47.25.643 N050.04.42.772 E019.47.25.745 Color_252ACI
N050.04.42.772 E019.47.25.745 N050.04.42.812 E019.47.25.818 Color_252ACI
N050.04.42.812 E019.47.25.818 N050.04.42.876 E019.47.25.843 Color_252ACI
N050.04.42.876 E019.47.25.843 N050.04.42.927 E019.47.25.817 Color_252ACI
N050.04.42.927 E019.47.25.817 N050.04.42.963 E019.47.25.754 Color_252ACI
N050.04.42.963 E019.47.25.754 N050.04.42.973 E019.47.25.697 Color_252ACI
N050.04.42.770 E019.47.24.209 N050.04.42.760 E019.47.24.118 Color_252ACI
N050.04.42.760 E019.47.24.118 N050.04.42.713 E019.47.24.045 Color_252ACI
N050.04.42.713 E019.47.24.045 N050.04.42.657 E019.47.24.028 Color_252ACI
N050.04.42.657 E019.47.24.028 N050.04.42.594 E019.47.24.070 Color_252ACI
N050.04.42.594 E019.47.24.070 N050.04.42.563 E019.47.24.155 Color_252ACI
N050.04.42.563 E019.47.24.155 N050.04.42.569 E019.47.24.257 Color_252ACI
N050.04.42.569 E019.47.24.257 N050.04.42.609 E019.47.24.329 Color_252ACI
N050.04.42.609 E019.47.24.329 N050.04.42.673 E019.47.24.355 Color_252ACI
N050.04.42.673 E019.47.24.355 N050.04.42.723 E019.47.24.328 Color_252ACI
N050.04.42.723 E019.47.24.328 N050.04.42.759 E019.47.24.265 Color_252ACI
N050.04.42.759 E019.47.24.265 N050.04.42.770 E019.47.24.209 Color_252ACI
N050.04.42.566 E019.47.22.720 N050.04.42.556 E019.47.22.630 Color_252ACI
N050.04.42.556 E019.47.22.630 N050.04.42.510 E019.47.22.557 Color_252ACI
N050.04.42.510 E019.47.22.557 N050.04.42.453 E019.47.22.539 Color_252ACI
N050.04.42.453 E019.47.22.539 N050.04.42.391 E019.47.22.582 Color_252ACI
N050.04.42.391 E019.47.22.582 N050.04.42.359 E019.47.22.666 Color_252ACI
N050.04.42.359 E019.47.22.666 N050.04.42.365 E019.47.22.768 Color_252ACI
N050.04.42.365 E019.47.22.768 N050.04.42.405 E019.47.22.841 Color_252ACI
N050.04.42.405 E019.47.22.841 N050.04.42.469 E019.47.22.866 Color_252ACI
N050.04.42.469 E019.47.22.866 N050.04.42.520 E019.47.22.840 Color_252ACI
N050.04.42.520 E019.47.22.840 N050.04.42.556 E019.47.22.777 Color_252ACI
N050.04.42.556 E019.47.22.777 N050.04.42.566 E019.47.22.720 Color_252ACI
N050.04.42.363 E019.47.21.232 N050.04.42.353 E019.47.21.141 Color_252ACI
N050.04.42.353 E019.47.21.141 N050.04.42.306 E019.47.21.068 Color_252ACI
N050.04.42.306 E019.47.21.068 N050.04.42.250 E019.47.21.051 Color_252ACI
N050.04.42.250 E019.47.21.051 N050.04.42.187 E019.47.21.093 Color_252ACI
N050.04.42.187 E019.47.21.093 N050.04.42.156 E019.47.21.178 Color_252ACI
N050.04.42.156 E019.47.21.178 N050.04.42.162 E019.47.21.280 Color_252ACI
N050.04.42.162 E019.47.21.280 N050.04.42.201 E019.47.21.352 Color_252ACI
N050.04.42.201 E019.47.21.352 N050.04.42.266 E019.47.21.378 Color_252ACI
N050.04.42.266 E019.47.21.378 N050.04.42.316 E019.47.21.351 Color_252ACI
N050.04.42.316 E019.47.21.351 N050.04.42.352 E019.47.21.288 Color_252ACI
N050.04.42.352 E019.47.21.288 N050.04.42.363 E019.47.21.232 Color_252ACI
N050.04.42.159 E019.47.19.743 N050.04.42.149 E019.47.19.653 Color_252ACI
N050.04.42.149 E019.47.19.653 N050.04.42.103 E019.47.19.580 Color_252ACI
N050.04.42.103 E019.47.19.580 N050.04.42.046 E019.47.19.562 Color_252ACI
N050.04.42.046 E019.47.19.562 N050.04.41.984 E019.47.19.605 Color_252ACI
N050.04.41.984 E019.47.19.605 N050.04.41.952 E019.47.19.689 Color_252ACI
N050.04.41.952 E019.47.19.689 N050.04.41.958 E019.47.19.791 Color_252ACI
N050.04.41.958 E019.47.19.791 N050.04.41.998 E019.47.19.864 Color_252ACI
N050.04.41.998 E019.47.19.864 N050.04.42.062 E019.47.19.889 Color_252ACI
N050.04.42.062 E019.47.19.889 N050.04.42.113 E019.47.19.863 Color_252ACI
N050.04.42.113 E019.47.19.863 N050.04.42.149 E019.47.19.800 Color_252ACI
N050.04.42.149 E019.47.19.800 N050.04.42.159 E019.47.19.743 Color_252ACI
N050.04.41.956 E019.47.18.255 N050.04.41.946 E019.47.18.164 Color_252ACI
N050.04.41.946 E019.47.18.164 N050.04.41.899 E019.47.18.091 Color_252ACI
N050.04.41.899 E019.47.18.091 N050.04.41.843 E019.47.18.074 Color_252ACI
N050.04.41.843 E019.47.18.074 N050.04.41.780 E019.47.18.117 Color_252ACI
N050.04.41.780 E019.47.18.117 N050.04.41.749 E019.47.18.201 Color_252ACI
N050.04.41.749 E019.47.18.201 N050.04.41.755 E019.47.18.303 Color_252ACI
N050.04.41.755 E019.47.18.303 N050.04.41.794 E019.47.18.375 Color_252ACI
N050.04.41.794 E019.47.18.375 N050.04.41.859 E019.47.18.401 Color_252ACI
N050.04.41.859 E019.47.18.401 N050.04.41.909 E019.47.18.374 Color_252ACI
N050.04.41.909 E019.47.18.374 N050.04.41.945 E019.47.18.311 Color_252ACI
N050.04.41.945 E019.47.18.311 N050.04.41.956 E019.47.18.255 Color_252ACI
N050.04.41.752 E019.47.16.766 N050.04.41.742 E019.47.16.676 Color_252ACI
N050.04.41.742 E019.47.16.676 N050.04.41.696 E019.47.16.603 Color_252ACI
N050.04.41.696 E019.47.16.603 N050.04.41.639 E019.47.16.585 Color_252ACI
N050.04.41.639 E019.47.16.585 N050.04.41.577 E019.47.16.628 Color_252ACI
N050.04.41.577 E019.47.16.628 N050.04.41.545 E019.47.16.712 Color_252ACI
N050.04.41.545 E019.47.16.712 N050.04.41.551 E019.47.16.814 Color_252ACI
N050.04.41.551 E019.47.16.814 N050.04.41.591 E019.47.16.887 Color_252ACI
N050.04.41.591 E019.47.16.887 N050.04.41.655 E019.47.16.912 Color_252ACI
N050.04.41.655 E019.47.16.912 N050.04.41.706 E019.47.16.886 Color_252ACI
N050.04.41.706 E019.47.16.886 N050.04.41.742 E019.47.16.823 Color_252ACI
N050.04.41.742 E019.47.16.823 N050.04.41.752 E019.47.16.766 Color_252ACI
N050.04.41.549 E019.47.15.278 N050.04.41.539 E019.47.15.187 Color_252ACI
N050.04.41.539 E019.47.15.187 N050.04.41.492 E019.47.15.114 Color_252ACI
N050.04.41.492 E019.47.15.114 N050.04.41.436 E019.47.15.097 Color_252ACI
N050.04.41.436 E019.47.15.097 N050.04.41.373 E019.47.15.140 Color_252ACI
N050.04.41.373 E019.47.15.140 N050.04.41.342 E019.47.15.224 Color_252ACI
N050.04.41.342 E019.47.15.224 N050.04.41.348 E019.47.15.326 Color_252ACI
N050.04.41.348 E019.47.15.326 N050.04.41.387 E019.47.15.398 Color_252ACI
N050.04.41.387 E019.47.15.398 N050.04.41.452 E019.47.15.424 Color_252ACI
N050.04.41.452 E019.47.15.424 N050.04.41.502 E019.47.15.397 Color_252ACI
N050.04.41.502 E019.47.15.397 N050.04.41.538 E019.47.15.334 Color_252ACI
N050.04.41.538 E019.47.15.334 N050.04.41.549 E019.47.15.278 Color_252ACI
N050.04.41.345 E019.47.13.789 N050.04.41.335 E019.47.13.699 Color_252ACI
N050.04.41.335 E019.47.13.699 N050.04.41.289 E019.47.13.626 Color_252ACI
N050.04.41.289 E019.47.13.626 N050.04.41.232 E019.47.13.608 Color_252ACI
N050.04.41.232 E019.47.13.608 N050.04.41.170 E019.47.13.651 Color_252ACI
N050.04.41.170 E019.47.13.651 N050.04.41.138 E019.47.13.735 Color_252ACI
N050.04.41.138 E019.47.13.735 N050.04.41.144 E019.47.13.837 Color_252ACI
N050.04.41.144 E019.47.13.837 N050.04.41.184 E019.47.13.910 Color_252ACI
N050.04.41.184 E019.47.13.910 N050.04.41.248 E019.47.13.935 Color_252ACI
N050.04.41.248 E019.47.13.935 N050.04.41.298 E019.47.13.909 Color_252ACI
N050.04.41.298 E019.47.13.909 N050.04.41.335 E019.47.13.846 Color_252ACI
N050.04.41.335 E019.47.13.846 N050.04.41.345 E019.47.13.789 Color_252ACI
N050.04.41.142 E019.47.12.301 N050.04.41.131 E019.47.12.210 Color_252ACI
N050.04.41.131 E019.47.12.210 N050.04.41.085 E019.47.12.137 Color_252ACI
N050.04.41.085 E019.47.12.137 N050.04.41.029 E019.47.12.120 Color_252ACI
N050.04.41.029 E019.47.12.120 N050.04.40.966 E019.47.12.163 Color_252ACI
N050.04.40.966 E019.47.12.163 N050.04.40.935 E019.47.12.247 Color_252ACI
N050.04.40.935 E019.47.12.247 N050.04.40.941 E019.47.12.349 Color_252ACI
N050.04.40.941 E019.47.12.349 N050.04.40.980 E019.47.12.421 Color_252ACI
N050.04.40.980 E019.47.12.421 N050.04.41.045 E019.47.12.447 Color_252ACI
N050.04.41.045 E019.47.12.447 N050.04.41.095 E019.47.12.420 Color_252ACI
N050.04.41.095 E019.47.12.420 N050.04.41.131 E019.47.12.357 Color_252ACI
N050.04.41.131 E019.47.12.357 N050.04.41.142 E019.47.12.301 Color_252ACI
N050.04.40.938 E019.47.10.812 N050.04.40.928 E019.47.10.722 Color_252ACI
N050.04.40.928 E019.47.10.722 N050.04.40.882 E019.47.10.649 Color_252ACI
N050.04.40.882 E019.47.10.649 N050.04.40.825 E019.47.10.632 Color_252ACI
N050.04.40.825 E019.47.10.632 N050.04.40.763 E019.47.10.674 Color_252ACI
N050.04.40.763 E019.47.10.674 N050.04.40.731 E019.47.10.758 Color_252ACI
N050.04.40.731 E019.47.10.758 N050.04.40.737 E019.47.10.860 Color_252ACI
N050.04.40.737 E019.47.10.860 N050.04.40.777 E019.47.10.933 Color_252ACI
N050.04.40.777 E019.47.10.933 N050.04.40.841 E019.47.10.958 Color_252ACI
N050.04.40.841 E019.47.10.958 N050.04.40.891 E019.47.10.932 Color_252ACI
N050.04.40.891 E019.47.10.932 N050.04.40.928 E019.47.10.869 Color_252ACI
N050.04.40.928 E019.47.10.869 N050.04.40.938 E019.47.10.812 Color_252ACI
N050.04.40.735 E019.47.09.324 N050.04.40.724 E019.47.09.234 Color_252ACI
N050.04.40.724 E019.47.09.234 N050.04.40.678 E019.47.09.160 Color_252ACI
N050.04.40.678 E019.47.09.160 N050.04.40.622 E019.47.09.143 Color_252ACI
N050.04.40.622 E019.47.09.143 N050.04.40.559 E019.47.09.186 Color_252ACI
N050.04.40.559 E019.47.09.186 N050.04.40.528 E019.47.09.270 Color_252ACI
N050.04.40.528 E019.47.09.270 N050.04.40.534 E019.47.09.372 Color_252ACI
N050.04.40.534 E019.47.09.372 N050.04.40.573 E019.47.09.444 Color_252ACI
N050.04.40.573 E019.47.09.444 N050.04.40.638 E019.47.09.470 Color_252ACI
N050.04.40.638 E019.47.09.470 N050.04.40.688 E019.47.09.444 Color_252ACI
N050.04.40.688 E019.47.09.444 N050.04.40.724 E019.47.09.381 Color_252ACI
N050.04.40.724 E019.47.09.381 N050.04.40.735 E019.47.09.324 Color_252ACI
N050.04.40.531 E019.47.07.835 N050.04.40.521 E019.47.07.745 Color_252ACI
N050.04.40.521 E019.47.07.745 N050.04.40.475 E019.47.07.672 Color_252ACI
N050.04.40.475 E019.47.07.672 N050.04.40.418 E019.47.07.655 Color_252ACI
N050.04.40.418 E019.47.07.655 N050.04.40.355 E019.47.07.697 Color_252ACI
N050.04.40.355 E019.47.07.697 N050.04.40.324 E019.47.07.781 Color_252ACI
N050.04.40.324 E019.47.07.781 N050.04.40.330 E019.47.07.883 Color_252ACI
N050.04.40.330 E019.47.07.883 N050.04.40.370 E019.47.07.956 Color_252ACI
N050.04.40.370 E019.47.07.956 N050.04.40.434 E019.47.07.982 Color_252ACI
N050.04.40.434 E019.47.07.982 N050.04.40.484 E019.47.07.955 Color_252ACI
N050.04.40.484 E019.47.07.955 N050.04.40.521 E019.47.07.892 Color_252ACI
N050.04.40.521 E019.47.07.892 N050.04.40.531 E019.47.07.835 Color_252ACI
N050.04.40.328 E019.47.06.347 N050.04.40.317 E019.47.06.257 Color_252ACI
N050.04.40.317 E019.47.06.257 N050.04.40.271 E019.47.06.184 Color_252ACI
N050.04.40.271 E019.47.06.184 N050.04.40.215 E019.47.06.166 Color_252ACI
N050.04.40.215 E019.47.06.166 N050.04.40.152 E019.47.06.209 Color_252ACI
N050.04.40.152 E019.47.06.209 N050.04.40.121 E019.47.06.293 Color_252ACI
N050.04.40.121 E019.47.06.293 N050.04.40.127 E019.47.06.395 Color_252ACI
N050.04.40.127 E019.47.06.395 N050.04.40.166 E019.47.06.468 Color_252ACI
N050.04.40.166 E019.47.06.468 N050.04.40.231 E019.47.06.493 Color_252ACI
N050.04.40.231 E019.47.06.493 N050.04.40.281 E019.47.06.467 Color_252ACI
N050.04.40.281 E019.47.06.467 N050.04.40.317 E019.47.06.404 Color_252ACI
N050.04.40.317 E019.47.06.404 N050.04.40.328 E019.47.06.347 Color_252ACI
N050.04.40.124 E019.47.04.859 N050.04.40.114 E019.47.04.768 Color_252ACI
N050.04.40.114 E019.47.04.768 N050.04.40.067 E019.47.04.695 Color_252ACI
N050.04.40.067 E019.47.04.695 N050.04.40.011 E019.47.04.678 Color_252ACI
N050.04.40.011 E019.47.04.678 N050.04.39.948 E019.47.04.720 Color_252ACI
N050.04.39.948 E019.47.04.720 N050.04.39.917 E019.47.04.805 Color_252ACI
N050.04.39.917 E019.47.04.805 N050.04.39.923 E019.47.04.906 Color_252ACI
N050.04.39.923 E019.47.04.906 N050.04.39.963 E019.47.04.979 Color_252ACI
N050.04.39.963 E019.47.04.979 N050.04.40.027 E019.47.05.005 Color_252ACI
N050.04.40.027 E019.47.05.005 N050.04.40.077 E019.47.04.978 Color_252ACI
N050.04.40.077 E019.47.04.978 N050.04.40.114 E019.47.04.915 Color_252ACI
N050.04.40.114 E019.47.04.915 N050.04.40.124 E019.47.04.859 Color_252ACI
N050.04.39.921 E019.47.03.370 N050.04.39.910 E019.47.03.280 Color_252ACI
N050.04.39.910 E019.47.03.280 N050.04.39.864 E019.47.03.207 Color_252ACI
N050.04.39.864 E019.47.03.207 N050.04.39.808 E019.47.03.189 Color_252ACI
N050.04.39.808 E019.47.03.189 N050.04.39.745 E019.47.03.232 Color_252ACI
N050.04.39.745 E019.47.03.232 N050.04.39.714 E019.47.03.316 Color_252ACI
N050.04.39.714 E019.47.03.316 N050.04.39.720 E019.47.03.418 Color_252ACI
N050.04.39.720 E019.47.03.418 N050.04.39.759 E019.47.03.491 Color_252ACI
N050.04.39.759 E019.47.03.491 N050.04.39.824 E019.47.03.516 Color_252ACI
N050.04.39.824 E019.47.03.516 N050.04.39.874 E019.47.03.490 Color_252ACI
N050.04.39.874 E019.47.03.490 N050.04.39.910 E019.47.03.427 Color_252ACI
N050.04.39.910 E019.47.03.427 N050.04.39.921 E019.47.03.370 Color_252ACI
N050.04.39.717 E019.47.01.882 N050.04.39.707 E019.47.01.791 Color_252ACI
N050.04.39.707 E019.47.01.791 N050.04.39.660 E019.47.01.718 Color_252ACI
N050.04.39.660 E019.47.01.718 N050.04.39.604 E019.47.01.701 Color_252ACI
N050.04.39.604 E019.47.01.701 N050.04.39.541 E019.47.01.743 Color_252ACI
N050.04.39.541 E019.47.01.743 N050.04.39.510 E019.47.01.828 Color_252ACI
N050.04.39.510 E019.47.01.828 N050.04.39.516 E019.47.01.930 Color_252ACI
N050.04.39.516 E019.47.01.930 N050.04.39.556 E019.47.02.002 Color_252ACI
N050.04.39.556 E019.47.02.002 N050.04.39.620 E019.47.02.028 Color_252ACI
N050.04.39.620 E019.47.02.028 N050.04.39.670 E019.47.02.001 Color_252ACI
N050.04.39.670 E019.47.02.001 N050.04.39.706 E019.47.01.938 Color_252ACI
N050.04.39.706 E019.47.01.938 N050.04.39.717 E019.47.01.882 Color_252ACI
N050.04.39.514 E019.47.00.393 N050.04.39.503 E019.47.00.303 Color_252ACI
N050.04.39.503 E019.47.00.303 N050.04.39.457 E019.47.00.230 Color_252ACI
N050.04.39.457 E019.47.00.230 N050.04.39.400 E019.47.00.212 Color_252ACI
N050.04.39.400 E019.47.00.212 N050.04.39.338 E019.47.00.255 Color_252ACI
N050.04.39.338 E019.47.00.255 N050.04.39.307 E019.47.00.339 Color_252ACI
N050.04.39.307 E019.47.00.339 N050.04.39.313 E019.47.00.441 Color_252ACI
N050.04.39.313 E019.47.00.441 N050.04.39.352 E019.47.00.514 Color_252ACI
N050.04.39.352 E019.47.00.514 N050.04.39.416 E019.47.00.539 Color_252ACI
N050.04.39.416 E019.47.00.539 N050.04.39.467 E019.47.00.513 Color_252ACI
N050.04.39.467 E019.47.00.513 N050.04.39.503 E019.47.00.450 Color_252ACI
N050.04.39.503 E019.47.00.450 N050.04.39.514 E019.47.00.393 Color_252ACI
N050.04.39.310 E019.46.58.905 N050.04.39.300 E019.46.58.814 Color_252ACI
N050.04.39.300 E019.46.58.814 N050.04.39.253 E019.46.58.741 Color_252ACI
N050.04.39.253 E019.46.58.741 N050.04.39.197 E019.46.58.724 Color_252ACI
N050.04.39.197 E019.46.58.724 N050.04.39.134 E019.46.58.767 Color_252ACI
N050.04.39.134 E019.46.58.767 N050.04.39.103 E019.46.58.851 Color_252ACI
N050.04.39.103 E019.46.58.851 N050.04.39.109 E019.46.58.953 Color_252ACI
N050.04.39.109 E019.46.58.953 N050.04.39.149 E019.46.59.025 Color_252ACI
N050.04.39.149 E019.46.59.025 N050.04.39.213 E019.46.59.051 Color_252ACI
N050.04.39.213 E019.46.59.051 N050.04.39.263 E019.46.59.024 Color_252ACI
N050.04.39.263 E019.46.59.024 N050.04.39.299 E019.46.58.961 Color_252ACI
N050.04.39.299 E019.46.58.961 N050.04.39.310 E019.46.58.905 Color_252ACI
N050.04.39.107 E019.46.57.416 N050.04.39.096 E019.46.57.326 Color_252ACI
N050.04.39.096 E019.46.57.326 N050.04.39.050 E019.46.57.253 Color_252ACI
N050.04.39.050 E019.46.57.253 N050.04.38.993 E019.46.57.235 Color_252ACI
N050.04.38.993 E019.46.57.235 N050.04.38.931 E019.46.57.278 Color_252ACI
N050.04.38.931 E019.46.57.278 N050.04.38.899 E019.46.57.362 Color_252ACI
N050.04.38.899 E019.46.57.362 N050.04.38.906 E019.46.57.464 Color_252ACI
N050.04.38.906 E019.46.57.464 N050.04.38.945 E019.46.57.537 Color_252ACI
N050.04.38.945 E019.46.57.537 N050.04.39.009 E019.46.57.562 Color_252ACI
N050.04.39.009 E019.46.57.562 N050.04.39.060 E019.46.57.536 Color_252ACI
N050.04.39.060 E019.46.57.536 N050.04.39.096 E019.46.57.473 Color_252ACI
N050.04.39.096 E019.46.57.473 N050.04.39.107 E019.46.57.416 Color_252ACI
N050.04.38.903 E019.46.55.928 N050.04.38.893 E019.46.55.837 Color_252ACI
N050.04.38.893 E019.46.55.837 N050.04.38.846 E019.46.55.764 Color_252ACI
N050.04.38.846 E019.46.55.764 N050.04.38.790 E019.46.55.747 Color_252ACI
N050.04.38.790 E019.46.55.747 N050.04.38.727 E019.46.55.790 Color_252ACI
N050.04.38.727 E019.46.55.790 N050.04.38.696 E019.46.55.874 Color_252ACI
N050.04.38.696 E019.46.55.874 N050.04.38.702 E019.46.55.976 Color_252ACI
N050.04.38.702 E019.46.55.976 N050.04.38.742 E019.46.56.048 Color_252ACI
N050.04.38.742 E019.46.56.048 N050.04.38.806 E019.46.56.074 Color_252ACI
N050.04.38.806 E019.46.56.074 N050.04.38.856 E019.46.56.047 Color_252ACI
N050.04.38.856 E019.46.56.047 N050.04.38.892 E019.46.55.984 Color_252ACI
N050.04.38.892 E019.46.55.984 N050.04.38.903 E019.46.55.928 Color_252ACI
N050.04.38.700 E019.46.54.439 N050.04.38.689 E019.46.54.349 Color_252ACI
N050.04.38.689 E019.46.54.349 N050.04.38.643 E019.46.54.276 Color_252ACI
N050.04.38.643 E019.46.54.276 N050.04.38.586 E019.46.54.258 Color_252ACI
N050.04.38.586 E019.46.54.258 N050.04.38.524 E019.46.54.301 Color_252ACI
N050.04.38.524 E019.46.54.301 N050.04.38.492 E019.46.54.385 Color_252ACI
N050.04.38.492 E019.46.54.385 N050.04.38.499 E019.46.54.487 Color_252ACI
N050.04.38.499 E019.46.54.487 N050.04.38.538 E019.46.54.560 Color_252ACI
N050.04.38.538 E019.46.54.560 N050.04.38.602 E019.46.54.585 Color_252ACI
N050.04.38.602 E019.46.54.585 N050.04.38.653 E019.46.54.559 Color_252ACI
N050.04.38.653 E019.46.54.559 N050.04.38.689 E019.46.54.496 Color_252ACI
N050.04.38.689 E019.46.54.496 N050.04.38.700 E019.46.54.439 Color_252ACI
N050.04.38.496 E019.46.52.951 N050.04.38.486 E019.46.52.860 Color_252ACI
N050.04.38.486 E019.46.52.860 N050.04.38.439 E019.46.52.787 Color_252ACI
N050.04.38.439 E019.46.52.787 N050.04.38.383 E019.46.52.770 Color_252ACI
N050.04.38.383 E019.46.52.770 N050.04.38.320 E019.46.52.813 Color_252ACI
N050.04.38.320 E019.46.52.813 N050.04.38.289 E019.46.52.897 Color_252ACI
N050.04.38.289 E019.46.52.897 N050.04.38.295 E019.46.52.999 Color_252ACI
N050.04.38.295 E019.46.52.999 N050.04.38.335 E019.46.53.071 Color_252ACI
N050.04.38.335 E019.46.53.071 N050.04.38.399 E019.46.53.097 Color_252ACI
N050.04.38.399 E019.46.53.097 N050.04.38.449 E019.46.53.070 Color_252ACI
N050.04.38.449 E019.46.53.070 N050.04.38.485 E019.46.53.007 Color_252ACI
N050.04.38.485 E019.46.53.007 N050.04.38.496 E019.46.52.951 Color_252ACI
N050.04.38.293 E019.46.51.462 N050.04.38.282 E019.46.51.372 Color_252ACI
N050.04.38.282 E019.46.51.372 N050.04.38.236 E019.46.51.299 Color_252ACI
N050.04.38.236 E019.46.51.299 N050.04.38.179 E019.46.51.282 Color_252ACI
N050.04.38.179 E019.46.51.282 N050.04.38.117 E019.46.51.324 Color_252ACI
N050.04.38.117 E019.46.51.324 N050.04.38.085 E019.46.51.408 Color_252ACI
N050.04.38.085 E019.46.51.408 N050.04.38.091 E019.46.51.510 Color_252ACI
N050.04.38.091 E019.46.51.510 N050.04.38.131 E019.46.51.583 Color_252ACI
N050.04.38.131 E019.46.51.583 N050.04.38.195 E019.46.51.608 Color_252ACI
N050.04.38.195 E019.46.51.608 N050.04.38.246 E019.46.51.582 Color_252ACI
N050.04.38.246 E019.46.51.582 N050.04.38.282 E019.46.51.519 Color_252ACI
N050.04.38.282 E019.46.51.519 N050.04.38.293 E019.46.51.462 Color_252ACI
N050.04.38.089 E019.46.49.974 N050.04.38.079 E019.46.49.884 Color_252ACI
N050.04.38.079 E019.46.49.884 N050.04.38.032 E019.46.49.810 Color_252ACI
N050.04.38.032 E019.46.49.810 N050.04.37.976 E019.46.49.793 Color_252ACI
N050.04.37.976 E019.46.49.793 N050.04.37.913 E019.46.49.836 Color_252ACI
N050.04.37.913 E019.46.49.836 N050.04.37.882 E019.46.49.920 Color_252ACI
N050.04.37.882 E019.46.49.920 N050.04.37.888 E019.46.50.022 Color_252ACI
N050.04.37.888 E019.46.50.022 N050.04.37.928 E019.46.50.094 Color_252ACI
N050.04.37.928 E019.46.50.094 N050.04.37.992 E019.46.50.120 Color_252ACI
N050.04.37.992 E019.46.50.120 N050.04.38.042 E019.46.50.094 Color_252ACI
N050.04.38.042 E019.46.50.094 N050.04.38.078 E019.46.50.031 Color_252ACI
N050.04.38.078 E019.46.50.031 N050.04.38.089 E019.46.49.974 Color_252ACI
N050.04.37.886 E019.46.48.485 N050.04.37.875 E019.46.48.395 Color_252ACI
N050.04.37.875 E019.46.48.395 N050.04.37.829 E019.46.48.322 Color_252ACI
N050.04.37.829 E019.46.48.322 N050.04.37.772 E019.46.48.305 Color_252ACI
N050.04.37.772 E019.46.48.305 N050.04.37.710 E019.46.48.347 Color_252ACI
N050.04.37.710 E019.46.48.347 N050.04.37.678 E019.46.48.431 Color_252ACI
N050.04.37.678 E019.46.48.431 N050.04.37.684 E019.46.48.533 Color_252ACI
N050.04.37.684 E019.46.48.533 N050.04.37.724 E019.46.48.606 Color_252ACI
N050.04.37.724 E019.46.48.606 N050.04.37.788 E019.46.48.632 Color_252ACI
N050.04.37.788 E019.46.48.632 N050.04.37.839 E019.46.48.605 Color_252ACI
N050.04.37.839 E019.46.48.605 N050.04.37.875 E019.46.48.542 Color_252ACI
N050.04.37.875 E019.46.48.542 N050.04.37.886 E019.46.48.485 Color_252ACI
N050.04.37.479 E019.46.45.509 N050.04.37.468 E019.46.45.418 Color_252ACI
N050.04.37.468 E019.46.45.418 N050.04.37.422 E019.46.45.345 Color_252ACI
N050.04.37.422 E019.46.45.345 N050.04.37.365 E019.46.45.328 Color_252ACI
N050.04.37.365 E019.46.45.328 N050.04.37.303 E019.46.45.370 Color_252ACI
N050.04.37.303 E019.46.45.370 N050.04.37.271 E019.46.45.455 Color_252ACI
N050.04.37.271 E019.46.45.455 N050.04.37.277 E019.46.45.556 Color_252ACI
N050.04.37.277 E019.46.45.556 N050.04.37.317 E019.46.45.629 Color_252ACI
N050.04.37.317 E019.46.45.629 N050.04.37.381 E019.46.45.655 Color_252ACI
N050.04.37.381 E019.46.45.655 N050.04.37.432 E019.46.45.628 Color_252ACI
N050.04.37.432 E019.46.45.628 N050.04.37.468 E019.46.45.565 Color_252ACI
N050.04.37.468 E019.46.45.565 N050.04.37.479 E019.46.45.509 Color_252ACI
N050.04.37.071 E019.46.42.532 N050.04.37.061 E019.46.42.441 Color_252ACI
N050.04.37.061 E019.46.42.441 N050.04.37.015 E019.46.42.368 Color_252ACI
N050.04.37.015 E019.46.42.368 N050.04.36.958 E019.46.42.351 Color_252ACI
N050.04.36.958 E019.46.42.351 N050.04.36.896 E019.46.42.393 Color_252ACI
N050.04.36.896 E019.46.42.393 N050.04.36.864 E019.46.42.478 Color_252ACI
N050.04.36.864 E019.46.42.478 N050.04.36.870 E019.46.42.580 Color_252ACI
N050.04.36.870 E019.46.42.580 N050.04.36.910 E019.46.42.652 Color_252ACI
N050.04.36.910 E019.46.42.652 N050.04.36.974 E019.46.42.678 Color_252ACI
N050.04.36.974 E019.46.42.678 N050.04.37.025 E019.46.42.651 Color_252ACI
N050.04.37.025 E019.46.42.651 N050.04.37.061 E019.46.42.588 Color_252ACI
N050.04.37.061 E019.46.42.588 N050.04.37.071 E019.46.42.532 Color_252ACI
N050.04.36.664 E019.46.39.555 N050.04.36.654 E019.46.39.464 Color_252ACI
N050.04.36.654 E019.46.39.464 N050.04.36.608 E019.46.39.391 Color_252ACI
N050.04.36.608 E019.46.39.391 N050.04.36.551 E019.46.39.374 Color_252ACI
N050.04.36.551 E019.46.39.374 N050.04.36.489 E019.46.39.417 Color_252ACI
N050.04.36.489 E019.46.39.417 N050.04.36.457 E019.46.39.501 Color_252ACI
N050.04.36.457 E019.46.39.501 N050.04.36.463 E019.46.39.603 Color_252ACI
N050.04.36.463 E019.46.39.603 N050.04.36.503 E019.46.39.675 Color_252ACI
N050.04.36.503 E019.46.39.675 N050.04.36.567 E019.46.39.701 Color_252ACI
N050.04.36.567 E019.46.39.701 N050.04.36.618 E019.46.39.674 Color_252ACI
N050.04.36.618 E019.46.39.674 N050.04.36.654 E019.46.39.611 Color_252ACI
N050.04.36.654 E019.46.39.611 N050.04.36.664 E019.46.39.555 Color_252ACI
N050.04.36.257 E019.46.36.578 N050.04.36.247 E019.46.36.487 Color_252ACI
N050.04.36.247 E019.46.36.487 N050.04.36.201 E019.46.36.414 Color_252ACI
N050.04.36.201 E019.46.36.414 N050.04.36.144 E019.46.36.397 Color_252ACI
N050.04.36.144 E019.46.36.397 N050.04.36.082 E019.46.36.440 Color_252ACI
N050.04.36.082 E019.46.36.440 N050.04.36.050 E019.46.36.524 Color_252ACI
N050.04.36.050 E019.46.36.524 N050.04.36.056 E019.46.36.626 Color_252ACI
N050.04.36.056 E019.46.36.626 N050.04.36.096 E019.46.36.698 Color_252ACI
N050.04.36.096 E019.46.36.698 N050.04.36.160 E019.46.36.724 Color_252ACI
N050.04.36.160 E019.46.36.724 N050.04.36.211 E019.46.36.697 Color_252ACI
N050.04.36.211 E019.46.36.697 N050.04.36.247 E019.46.36.634 Color_252ACI
N050.04.36.247 E019.46.36.634 N050.04.36.257 E019.46.36.578 Color_252ACI
N050.04.35.850 E019.46.33.601 N050.04.35.840 E019.46.33.510 Color_252ACI
N050.04.35.840 E019.46.33.510 N050.04.35.794 E019.46.33.437 Color_252ACI
N050.04.35.794 E019.46.33.437 N050.04.35.737 E019.46.33.420 Color_252ACI
N050.04.35.737 E019.46.33.420 N050.04.35.674 E019.46.33.463 Color_252ACI
N050.04.35.674 E019.46.33.463 N050.04.35.643 E019.46.33.547 Color_252ACI
N050.04.35.643 E019.46.33.547 N050.04.35.649 E019.46.33.649 Color_252ACI
N050.04.35.649 E019.46.33.649 N050.04.35.689 E019.46.33.721 Color_252ACI
N050.04.35.689 E019.46.33.721 N050.04.35.753 E019.46.33.747 Color_252ACI
N050.04.35.753 E019.46.33.747 N050.04.35.803 E019.46.33.720 Color_252ACI
N050.04.35.803 E019.46.33.720 N050.04.35.840 E019.46.33.657 Color_252ACI
N050.04.35.840 E019.46.33.657 N050.04.35.850 E019.46.33.601 Color_252ACI
N050.04.35.443 E019.46.30.624 N050.04.35.433 E019.46.30.534 Color_252ACI
N050.04.35.433 E019.46.30.534 N050.04.35.386 E019.46.30.460 Color_252ACI
N050.04.35.386 E019.46.30.460 N050.04.35.330 E019.46.30.443 Color_252ACI
N050.04.35.330 E019.46.30.443 N050.04.35.267 E019.46.30.486 Color_252ACI
N050.04.35.267 E019.46.30.486 N050.04.35.236 E019.46.30.570 Color_252ACI
N050.04.35.236 E019.46.30.570 N050.04.35.242 E019.46.30.672 Color_252ACI
N050.04.35.242 E019.46.30.672 N050.04.35.282 E019.46.30.744 Color_252ACI
N050.04.35.282 E019.46.30.744 N050.04.35.346 E019.46.30.770 Color_252ACI
N050.04.35.346 E019.46.30.770 N050.04.35.396 E019.46.30.744 Color_252ACI
N050.04.35.396 E019.46.30.744 N050.04.35.433 E019.46.30.681 Color_252ACI
N050.04.35.433 E019.46.30.681 N050.04.35.443 E019.46.30.624 Color_252ACI
N050.04.35.036 E019.46.27.647 N050.04.35.026 E019.46.27.557 Color_252ACI
N050.04.35.026 E019.46.27.557 N050.04.34.979 E019.46.27.484 Color_252ACI
N050.04.34.979 E019.46.27.484 N050.04.34.923 E019.46.27.466 Color_252ACI
N050.04.34.923 E019.46.27.466 N050.04.34.860 E019.46.27.509 Color_252ACI
N050.04.34.860 E019.46.27.509 N050.04.34.829 E019.46.27.593 Color_252ACI
N050.04.34.829 E019.46.27.593 N050.04.34.835 E019.46.27.695 Color_252ACI
N050.04.34.835 E019.46.27.695 N050.04.34.875 E019.46.27.768 Color_252ACI
N050.04.34.875 E019.46.27.768 N050.04.34.939 E019.46.27.793 Color_252ACI
N050.04.34.939 E019.46.27.793 N050.04.34.989 E019.46.27.767 Color_252ACI
N050.04.34.989 E019.46.27.767 N050.04.35.025 E019.46.27.704 Color_252ACI
N050.04.35.025 E019.46.27.704 N050.04.35.036 E019.46.27.647 Color_252ACI
N050.04.34.629 E019.46.24.670 N050.04.34.619 E019.46.24.580 Color_252ACI
N050.04.34.619 E019.46.24.580 N050.04.34.572 E019.46.24.507 Color_252ACI
N050.04.34.572 E019.46.24.507 N050.04.34.516 E019.46.24.489 Color_252ACI
N050.04.34.516 E019.46.24.489 N050.04.34.453 E019.46.24.532 Color_252ACI
N050.04.34.453 E019.46.24.532 N050.04.34.422 E019.46.24.616 Color_252ACI
N050.04.34.422 E019.46.24.616 N050.04.34.428 E019.46.24.718 Color_252ACI
N050.04.34.428 E019.46.24.718 N050.04.34.468 E019.46.24.791 Color_252ACI
N050.04.34.468 E019.46.24.791 N050.04.34.532 E019.46.24.816 Color_252ACI
N050.04.34.532 E019.46.24.816 N050.04.34.582 E019.46.24.790 Color_252ACI
N050.04.34.582 E019.46.24.790 N050.04.34.618 E019.46.24.727 Color_252ACI
N050.04.34.618 E019.46.24.727 N050.04.34.629 E019.46.24.670 Color_252ACI
N050.04.34.222 E019.46.21.693 N050.04.34.212 E019.46.21.603 Color_252ACI
N050.04.34.212 E019.46.21.603 N050.04.34.165 E019.46.21.530 Color_252ACI
N050.04.34.165 E019.46.21.530 N050.04.34.109 E019.46.21.512 Color_252ACI
N050.04.34.109 E019.46.21.512 N050.04.34.046 E019.46.21.555 Color_252ACI
N050.04.34.046 E019.46.21.555 N050.04.34.015 E019.46.21.639 Color_252ACI
N050.04.34.015 E019.46.21.639 N050.04.34.021 E019.46.21.741 Color_252ACI
N050.04.34.021 E019.46.21.741 N050.04.34.061 E019.46.21.814 Color_252ACI
N050.04.34.061 E019.46.21.814 N050.04.34.125 E019.46.21.839 Color_252ACI
N050.04.34.125 E019.46.21.839 N050.04.34.175 E019.46.21.813 Color_252ACI
N050.04.34.175 E019.46.21.813 N050.04.34.211 E019.46.21.750 Color_252ACI
N050.04.34.211 E019.46.21.750 N050.04.34.222 E019.46.21.693 Color_252ACI
;drogi N000.00.00.000 E000.00.00.000 N000.00.00.000 E000.00.00.000
N050.04.05.815 E019.48.01.300 N050.04.06.372 E019.48.02.651 Color_251ACI
N050.04.30.586 E019.47.53.138 N050.04.30.939 E019.47.54.317 Color_251ACI
N050.04.30.939 E019.47.54.317 N050.04.31.303 E019.47.55.454 Color_251ACI
N050.04.27.573 E019.47.43.595 N050.04.28.235 E019.47.45.636 Color_251ACI
N050.04.28.235 E019.47.45.636 N050.04.28.842 E019.47.47.403 Color_251ACI
N050.04.28.842 E019.47.47.403 N050.04.29.353 E019.47.49.063 Color_251ACI
N050.04.29.353 E019.47.49.063 N050.04.29.869 E019.47.50.823 Color_251ACI
N050.04.29.869 E019.47.50.823 N050.04.30.477 E019.47.52.831 Color_251ACI
N050.04.31.233 E019.48.09.764 N050.04.30.771 E019.48.09.386 Color_251ACI
N050.04.30.771 E019.48.09.386 N050.04.30.702 E019.48.09.537 Color_251ACI
N050.04.30.702 E019.48.09.537 N050.04.30.783 E019.48.09.586 Color_251ACI
N050.04.30.783 E019.48.09.586 N050.04.30.799 E019.48.09.644 Color_251ACI
N050.04.30.799 E019.48.09.644 N050.04.30.832 E019.48.09.760 Color_251ACI
N050.04.30.832 E019.48.09.760 N050.04.30.848 E019.48.09.819 Color_251ACI
N050.04.30.848 E019.48.09.819 N050.04.30.806 E019.48.09.986 Color_251ACI
N050.04.30.806 E019.48.09.986 N050.04.30.812 E019.48.10.086 Color_251ACI
N050.04.30.812 E019.48.10.086 N050.04.30.743 E019.48.10.236 Color_251ACI
N050.04.31.227 E019.48.09.664 N050.04.30.873 E019.48.09.352 Color_251ACI
N050.04.30.873 E019.48.09.352 N050.04.30.894 E019.48.09.268 Color_251ACI
N050.04.31.667 E019.48.12.341 N050.04.31.528 E019.48.09.944 Color_251ACI
N050.04.31.528 E019.48.09.944 N050.04.31.377 E019.48.09.804 Color_251ACI
N050.04.31.775 E019.48.06.867 N050.04.31.810 E019.48.06.359 Color_251ACI
N050.04.31.810 E019.48.06.359 N050.04.32.190 E019.48.06.446 Color_251ACI
N050.04.32.190 E019.48.06.446 N050.04.32.511 E019.48.03.319 Color_251ACI
N050.04.32.511 E019.48.03.319 N050.04.32.505 E019.48.03.219 Color_251ACI
N050.04.32.505 E019.48.03.219 N050.04.32.500 E019.48.03.119 Color_251ACI
N050.04.32.500 E019.48.03.119 N050.04.32.494 E019.48.03.019 Color_251ACI
N050.04.32.494 E019.48.03.019 N050.04.32.467 E019.48.03.003 Color_251ACI
N050.04.32.467 E019.48.03.003 N050.04.32.451 E019.48.02.945 Color_251ACI
N050.04.32.793 E019.48.03.057 N050.04.32.766 E019.48.03.041 Color_251ACI
N050.04.32.766 E019.48.03.041 N050.04.32.729 E019.48.03.066 Color_251ACI
N050.04.32.729 E019.48.03.066 N050.04.32.692 E019.48.03.092 Color_251ACI
N050.04.32.692 E019.48.03.092 N050.04.32.681 E019.48.03.134 Color_251ACI
N050.04.32.681 E019.48.03.134 N050.04.32.634 E019.48.03.201 Color_251ACI
N050.04.32.634 E019.48.03.201 N050.04.32.578 E019.48.03.793 Color_251ACI
N050.04.32.578 E019.48.03.793 N050.04.32.435 E019.48.05.344 Color_251ACI
N050.04.32.435 E019.48.05.344 N050.04.32.468 E019.48.05.460 Color_251ACI
N050.04.32.468 E019.48.05.460 N050.04.32.362 E019.48.06.744 Color_251ACI
N050.04.32.362 E019.48.06.744 N050.04.32.325 E019.48.06.769 Color_251ACI
N050.04.32.325 E019.48.06.769 N050.04.32.314 E019.48.06.811 Color_251ACI
N050.04.32.314 E019.48.06.811 N050.04.32.283 E019.48.06.936 Color_251ACI
N050.04.32.283 E019.48.06.936 N050.04.32.289 E019.48.07.036 Color_251ACI
N050.04.32.289 E019.48.07.036 N050.04.32.278 E019.48.07.078 Color_251ACI
N050.04.32.278 E019.48.07.078 N050.04.32.332 E019.48.07.111 Color_251ACI
N050.04.32.332 E019.48.07.111 N050.04.32.364 E019.48.07.227 Color_251ACI
N050.04.32.364 E019.48.07.227 N050.04.32.445 E019.48.07.276 Color_251ACI
N050.04.32.445 E019.48.07.276 N050.04.32.653 E019.48.07.307 Color_251ACI
N050.04.32.653 E019.48.07.307 N050.04.32.628 E019.48.07.532 Color_251ACI
N050.04.32.628 E019.48.07.532 N050.04.32.130 E019.48.07.421 Color_251ACI
N050.04.32.130 E019.48.07.421 N050.04.32.139 E019.48.07.138 Color_251ACI
N050.04.32.139 E019.48.07.138 N050.04.31.749 E019.48.07.093 Color_251ACI
N050.04.26.068 E019.47.37.524 N050.04.26.393 E019.47.38.445 Color_251ACI
N050.04.26.393 E019.47.38.445 N050.04.27.269 E019.47.41.483 Color_251ACI
N050.04.27.269 E019.47.41.483 N050.04.28.382 E019.47.45.051 Color_251ACI
N050.04.28.382 E019.47.45.051 N050.04.29.066 E019.47.47.251 Color_251ACI
N050.04.29.066 E019.47.47.251 N050.04.29.576 E019.47.48.910 Color_251ACI
N050.04.29.576 E019.47.48.910 N050.04.30.093 E019.47.50.670 Color_251ACI
N050.04.30.093 E019.47.50.670 N050.04.31.163 E019.47.54.164 Color_251ACI
N050.04.31.163 E019.47.54.164 N050.04.31.667 E019.47.55.724 Color_251ACI
N050.04.31.667 E019.47.55.724 N050.04.31.961 E019.47.56.770 Color_251ACI
N050.04.31.961 E019.47.56.770 N050.04.32.016 E019.47.57.044 Color_251ACI
N050.04.32.016 E019.47.57.044 N050.04.32.069 E019.47.57.077 Color_251ACI
N050.04.31.493 E019.47.56.051 N050.04.31.613 E019.47.56.558 Color_251ACI
N050.04.31.613 E019.47.56.558 N050.04.31.737 E019.47.56.923 Color_251ACI
N050.04.31.737 E019.47.56.923 N050.04.31.786 E019.47.57.097 Color_251ACI
N050.04.31.786 E019.47.57.097 N050.04.31.792 E019.47.57.197 Color_251ACI
N050.04.31.792 E019.47.57.197 N050.04.31.798 E019.47.57.297 Color_251ACI
N050.04.23.348 E019.46.51.362 N050.04.23.136 E019.46.51.714 Color_251ACI
N050.04.23.136 E019.46.51.714 N050.04.18.996 E019.46.52.321 Color_251ACI
N050.04.18.996 E019.46.52.321 N050.04.18.775 E019.46.51.848 Color_251ACI
N050.04.18.775 E019.46.51.848 N050.04.19.577 E019.46.25.510 Color_251ACI
N050.04.19.577 E019.46.25.510 N050.04.23.423 E019.46.25.831 Color_251ACI
N050.04.23.423 E019.46.25.831 N050.04.23.927 E019.46.26.284 Color_251ACI
N050.04.23.927 E019.46.26.284 N050.04.24.145 E019.46.27.139 Color_251ACI
N050.04.24.296 E019.46.23.955 N050.04.23.964 E019.46.24.909 Color_251ACI
N050.04.23.964 E019.46.24.909 N050.04.23.388 E019.46.25.232 Color_251ACI
N050.04.23.388 E019.46.25.232 N050.04.20.307 E019.46.24.943 Color_251ACI
N050.04.30.547 E019.48.13.970 N050.04.30.306 E019.48.13.823 Color_251ACI
N050.04.30.306 E019.48.13.823 N050.04.30.129 E019.48.13.667 Color_251ACI
N050.04.30.129 E019.48.13.667 N050.04.29.989 E019.48.13.485 Color_251ACI
N050.04.29.989 E019.48.13.485 N050.04.29.705 E019.48.13.264 Color_251ACI
N050.04.29.705 E019.48.13.264 N050.04.29.528 E019.48.13.107 Color_251ACI
N050.04.29.528 E019.48.13.107 N050.04.29.324 E019.48.12.935 Color_251ACI
N050.04.29.324 E019.48.12.935 N050.04.29.237 E019.48.12.786 Color_251ACI
N050.04.29.237 E019.48.12.786 N050.04.29.183 E019.48.12.512 Color_251ACI
N050.04.29.183 E019.48.12.512 N050.04.29.181 E019.48.12.270 Color_251ACI
N050.04.29.181 E019.48.12.270 N050.04.29.234 E019.48.12.061 Color_251ACI
N050.04.29.234 E019.48.12.061 N050.04.29.324 E019.48.11.827 Color_251ACI
N050.04.29.324 E019.48.11.827 N050.04.29.430 E019.48.11.651 Color_251ACI
N050.04.27.147 E019.45.51.304 N050.04.26.982 E019.45.51.348 Color_251ACI
N050.04.26.982 E019.45.51.348 N050.04.26.459 E019.45.51.462 Color_251ACI
N050.04.26.459 E019.45.51.462 N050.04.25.935 E019.45.51.577 Color_251ACI
N050.04.40.025 E019.45.49.138 N050.04.39.177 E019.45.49.439 Color_251ACI
N050.04.39.177 E019.45.49.439 N050.04.38.301 E019.45.49.724 Color_251ACI
N050.04.38.301 E019.45.49.724 N050.04.37.687 E019.45.49.831 Color_251ACI
N050.04.37.687 E019.45.49.831 N050.04.37.110 E019.45.49.913 Color_251ACI
N050.04.37.110 E019.45.49.913 N050.04.36.378 E019.45.49.997 Color_251ACI
N050.04.36.378 E019.45.49.997 N050.04.35.663 E019.45.50.138 Color_251ACI
N050.04.35.663 E019.45.50.138 N050.04.34.557 E019.45.50.235 Color_251ACI
N050.04.34.557 E019.45.50.235 N050.04.33.477 E019.45.50.347 Color_251ACI
N050.04.33.477 E019.45.50.347 N050.04.32.815 E019.45.50.522 Color_251ACI
N050.04.32.815 E019.45.50.522 N050.04.32.143 E019.45.50.738 Color_251ACI
N050.04.32.143 E019.45.50.738 N050.04.31.684 E019.45.50.843 Color_251ACI
N050.04.31.684 E019.45.50.843 N050.04.31.235 E019.45.50.907 Color_251ACI
N050.04.31.235 E019.45.50.907 N050.04.30.470 E019.45.50.874 Color_251ACI
N050.04.30.470 E019.45.50.874 N050.04.29.716 E019.45.50.800 Color_251ACI
N050.04.29.716 E019.45.50.800 N050.04.28.935 E019.45.50.709 Color_251ACI
N050.04.28.935 E019.45.50.709 N050.04.28.177 E019.45.50.776 Color_251ACI
N050.04.28.177 E019.45.50.776 N050.04.27.552 E019.45.50.925 Color_251ACI
N050.04.27.552 E019.45.50.925 N050.04.26.954 E019.45.51.090 Color_251ACI
N050.04.26.954 E019.45.51.090 N050.04.26.431 E019.45.51.205 Color_251ACI
N050.04.26.431 E019.45.51.205 N050.04.25.945 E019.45.51.294 Color_251ACI
N050.04.20.088 E019.46.24.954 N050.04.19.607 E019.46.24.902 Color_251ACI
N050.04.25.949 E019.45.52.260 N050.04.25.858 E019.45.52.252 Color_251ACI
N050.04.25.858 E019.45.52.252 N050.04.25.778 E019.45.52.203 Color_251ACI
N050.04.25.778 E019.45.52.203 N050.04.25.698 E019.45.52.154 Color_251ACI
N050.04.25.698 E019.45.52.154 N050.04.25.580 E019.45.52.131 Color_251ACI
N050.04.25.580 E019.45.52.131 N050.04.25.489 E019.45.52.124 Color_251ACI
N050.04.25.489 E019.45.52.124 N050.04.25.408 E019.45.52.075 Color_251ACI
N050.04.25.408 E019.45.52.075 N050.04.25.291 E019.45.52.051 Color_251ACI
N050.04.25.291 E019.45.52.051 N050.04.25.200 E019.45.52.044 Color_251ACI
N050.04.26.557 E019.45.52.919 N050.04.25.903 E019.45.52.568 Color_251ACI
N050.04.26.657 E019.45.52.643 N050.04.25.949 E019.45.52.260 Color_251ACI
N050.04.27.273 E019.45.53.019 N050.04.27.199 E019.45.53.070 Color_251ACI
N050.04.27.199 E019.45.53.070 N050.04.27.108 E019.45.53.062 Color_251ACI
N050.04.27.108 E019.45.53.062 N050.04.27.017 E019.45.53.055 Color_251ACI
N050.04.27.017 E019.45.53.055 N050.04.26.926 E019.45.53.048 Color_251ACI
N050.04.26.926 E019.45.53.048 N050.04.26.835 E019.45.53.041 Color_251ACI
N050.04.26.835 E019.45.53.041 N050.04.26.744 E019.45.53.033 Color_251ACI
N050.04.26.744 E019.45.53.033 N050.04.26.557 E019.45.52.919 Color_251ACI
N050.04.27.283 E019.45.52.736 N050.04.27.219 E019.45.52.745 Color_251ACI
N050.04.27.219 E019.45.52.745 N050.04.27.128 E019.45.52.737 Color_251ACI
N050.04.27.128 E019.45.52.737 N050.04.27.026 E019.45.52.772 Color_251ACI
N050.04.27.026 E019.45.52.772 N050.04.26.973 E019.45.52.739 Color_251ACI
N050.04.26.973 E019.45.52.739 N050.04.26.882 E019.45.52.732 Color_251ACI
N050.04.26.882 E019.45.52.732 N050.04.26.801 E019.45.52.683 Color_251ACI
N050.04.26.801 E019.45.52.683 N050.04.26.710 E019.45.52.676 Color_251ACI
N050.04.26.710 E019.45.52.676 N050.04.26.657 E019.45.52.643 Color_251ACI
N050.04.27.284 E019.45.52.977 N050.04.27.311 E019.45.52.993 Color_251ACI
N050.04.27.311 E019.45.52.993 N050.04.27.364 E019.45.53.026 Color_251ACI
N050.04.27.364 E019.45.53.026 N050.04.27.402 E019.45.53.001 Color_251ACI
N050.04.27.402 E019.45.53.001 N050.04.27.418 E019.45.53.059 Color_251ACI
N050.04.27.418 E019.45.53.059 N050.04.27.445 E019.45.53.075 Color_251ACI
N050.04.27.445 E019.45.53.075 N050.04.27.498 E019.45.53.108 Color_251ACI
N050.04.27.498 E019.45.53.108 N050.04.27.515 E019.45.53.166 Color_251ACI
N050.04.27.515 E019.45.53.166 N050.04.27.531 E019.45.53.224 Color_251ACI
N050.04.27.272 E019.45.52.777 N050.04.27.320 E019.45.52.710 Color_251ACI
N050.04.27.320 E019.45.52.710 N050.04.27.357 E019.45.52.685 Color_251ACI
N050.04.27.357 E019.45.52.685 N050.04.27.368 E019.45.52.643 Color_251ACI
N050.04.27.368 E019.45.52.643 N050.04.27.405 E019.45.52.617 Color_251ACI
N050.04.27.405 E019.45.52.617 N050.04.27.447 E019.45.52.450 Color_251ACI
N050.04.27.447 E019.45.52.450 N050.04.27.441 E019.45.52.351 Color_251ACI
N050.04.27.701 E019.45.53.039 N050.04.27.719 E019.45.53.338 Color_251ACI
N050.04.27.719 E019.45.53.338 N050.04.27.960 E019.45.53.486 Color_251ACI
N050.04.27.960 E019.45.53.486 N050.04.28.061 E019.45.53.451 Color_251ACI
N050.04.28.061 E019.45.53.451 N050.04.28.089 E019.45.53.709 Color_251ACI
N050.04.28.089 E019.45.53.709 N050.04.28.025 E019.45.53.718 Color_251ACI
N050.04.28.025 E019.45.53.718 N050.04.27.914 E019.45.54.036 Color_251ACI
N050.04.27.914 E019.45.54.036 N050.04.27.872 E019.45.54.203 Color_251ACI
N050.04.27.872 E019.45.54.203 N050.04.27.890 E019.45.54.503 Color_251ACI
N050.04.27.890 E019.45.54.503 N050.04.29.146 E019.46.05.624 Color_251ACI
N050.04.29.146 E019.46.05.624 N050.04.29.303 E019.46.05.864 Color_251ACI
N050.04.27.589 E019.45.52.007 N050.04.27.613 E019.45.52.407 Color_251ACI
N050.04.27.701 E019.45.53.039 N050.04.27.738 E019.45.53.013 Color_251ACI
N050.04.27.738 E019.45.53.013 N050.04.27.749 E019.45.52.972 Color_251ACI
N050.04.27.749 E019.45.52.972 N050.04.27.759 E019.45.52.930 Color_251ACI
N050.04.27.759 E019.45.52.930 N050.04.27.786 E019.45.52.946 Color_251ACI
N050.04.27.786 E019.45.52.946 N050.04.27.797 E019.45.52.904 Color_251ACI
N050.04.27.797 E019.45.52.904 N050.04.27.834 E019.45.52.879 Color_251ACI
N050.04.27.834 E019.45.52.879 N050.04.27.844 E019.45.52.837 Color_251ACI
N050.04.27.844 E019.45.52.837 N050.04.27.871 E019.45.52.854 Color_251ACI
N050.04.27.639 E019.45.52.423 N050.04.27.666 E019.45.52.440 Color_251ACI
N050.04.27.666 E019.45.52.440 N050.04.27.682 E019.45.52.498 Color_251ACI
N050.04.27.682 E019.45.52.498 N050.04.27.709 E019.45.52.514 Color_251ACI
N050.04.27.709 E019.45.52.514 N050.04.27.736 E019.45.52.530 Color_251ACI
N050.04.27.736 E019.45.52.530 N050.04.27.763 E019.45.52.547 Color_251ACI
N050.04.27.763 E019.45.52.547 N050.04.27.843 E019.45.52.596 Color_251ACI
N050.04.27.843 E019.45.52.596 N050.04.27.881 E019.45.52.570 Color_251ACI
N050.05.05.226 E019.48.27.265 N050.05.05.413 E019.48.27.138 Color_251ACI
N050.05.05.413 E019.48.27.138 N050.05.05.636 E019.48.26.985 Color_251ACI
N050.05.05.636 E019.48.26.985 N050.05.05.817 E019.48.26.758 Color_251ACI
N050.05.05.817 E019.48.26.758 N050.05.05.965 E019.48.26.415 Color_251ACI
N050.05.05.965 E019.48.26.415 N050.05.05.950 E019.48.25.490 Color_251ACI
N050.05.05.950 E019.48.25.490 N050.05.05.962 E019.48.24.582 Color_251ACI
N050.05.05.962 E019.48.24.582 N050.05.05.939 E019.48.22.209 Color_251ACI
N050.05.05.939 E019.48.22.209 N050.05.05.954 E019.48.19.810 Color_251ACI
N050.05.05.954 E019.48.19.810 N050.05.05.946 E019.48.19.227 Color_251ACI
N050.05.05.946 E019.48.19.227 N050.05.05.938 E019.48.18.644 Color_251ACI
N050.05.05.913 E019.48.17.761 N050.05.05.882 E019.48.17.020 Color_251ACI
N050.05.05.882 E019.48.17.020 N050.05.05.852 E019.48.16.279 Color_251ACI
N050.05.05.852 E019.48.16.279 N050.05.05.717 E019.48.14.848 Color_251ACI
N050.05.05.717 E019.48.14.848 N050.05.05.453 E019.48.13.435 Color_251ACI
N050.05.05.453 E019.48.13.435 N050.05.04.918 E019.48.11.134 Color_251ACI
N050.05.04.918 E019.48.11.134 N050.05.04.373 E019.48.08.875 Color_251ACI
N050.05.04.373 E019.48.08.875 N050.05.03.703 E019.48.06.251 Color_251ACI
N050.05.03.703 E019.48.06.251 N050.05.03.017 E019.48.03.569 Color_251ACI
N050.05.03.017 E019.48.03.569 N050.05.02.798 E019.48.02.472 Color_251ACI
N050.05.02.798 E019.48.02.472 N050.05.02.610 E019.48.01.250 Color_251ACI
N050.05.02.610 E019.48.01.250 N050.05.02.481 E019.47.59.919 Color_251ACI
N050.05.02.481 E019.47.59.919 N050.05.02.442 E019.47.58.595 Color_251ACI
N050.05.02.442 E019.47.58.595 N050.05.02.471 E019.47.57.986 Color_251ACI
N050.05.02.471 E019.47.57.986 N050.05.02.538 E019.47.57.352 Color_251ACI
N050.05.02.538 E019.47.57.352 N050.05.02.673 E019.47.56.568 Color_251ACI
N050.05.02.673 E019.47.56.568 N050.05.02.824 E019.47.55.842 Color_251ACI
N050.05.02.824 E019.47.55.842 N050.05.03.107 E019.47.54.714 Color_251ACI
N050.05.03.107 E019.47.54.714 N050.05.03.434 E019.47.53.660 Color_251ACI
N050.05.05.702 E019.48.18.355 N050.05.05.766 E019.48.18.346 Color_251ACI
N050.05.05.766 E019.48.18.346 N050.05.05.846 E019.48.18.395 Color_251ACI
N050.05.05.846 E019.48.18.395 N050.05.05.862 E019.48.18.453 Color_251ACI
N050.05.05.862 E019.48.18.453 N050.05.05.889 E019.48.18.469 Color_251ACI
N050.05.05.889 E019.48.18.469 N050.05.05.906 E019.48.18.528 Color_251ACI
N050.05.05.906 E019.48.18.528 N050.05.05.922 E019.48.18.586 Color_251ACI
N050.05.05.922 E019.48.18.586 N050.05.05.938 E019.48.18.644 Color_251ACI
N050.05.05.711 E019.48.18.072 N050.05.05.748 E019.48.18.046 Color_251ACI
N050.05.05.748 E019.48.18.046 N050.05.05.785 E019.48.18.021 Color_251ACI
N050.05.05.785 E019.48.18.021 N050.05.05.796 E019.48.17.979 Color_251ACI
N050.05.05.796 E019.48.17.979 N050.05.05.833 E019.48.17.954 Color_251ACI
N050.05.05.833 E019.48.17.954 N050.05.05.881 E019.48.17.887 Color_251ACI
N050.05.05.881 E019.48.17.887 N050.05.05.892 E019.48.17.845 Color_251ACI
N050.05.05.892 E019.48.17.845 N050.05.05.913 E019.48.17.761 Color_251ACI
N050.05.04.441 E019.48.18.453 N050.05.05.702 E019.48.18.355 Color_251ACI
N050.05.04.376 E019.48.18.221 N050.05.05.711 E019.48.18.072 Color_251ACI
N050.05.05.708 E019.48.29.533 N050.05.04.892 E019.48.29.951 Color_251ACI
N050.05.04.892 E019.48.29.951 N050.05.04.060 E019.48.30.310 Color_251ACI
N050.05.04.060 E019.48.30.310 N050.05.03.185 E019.48.30.595 Color_251ACI
N050.05.03.185 E019.48.30.595 N050.05.02.298 E019.48.30.681 Color_251ACI
N050.05.02.298 E019.48.30.681 N050.04.59.620 E019.48.30.637 Color_251ACI
N050.04.59.620 E019.48.30.637 N050.04.56.899 E019.48.30.519 Color_251ACI
N050.04.56.899 E019.48.30.519 N050.04.55.023 E019.48.30.483 Color_251ACI
N050.04.55.023 E019.48.30.483 N050.04.53.109 E019.48.30.472 Color_251ACI
N050.04.53.109 E019.48.30.472 N050.04.51.394 E019.48.30.534 Color_251ACI
N050.04.51.394 E019.48.30.534 N050.04.49.663 E019.48.30.779 Color_251ACI
N050.04.49.663 E019.48.30.779 N050.04.48.216 E019.48.31.004 Color_251ACI
N050.04.48.216 E019.48.31.004 N050.04.46.774 E019.48.31.329 Color_251ACI
N050.04.46.774 E019.48.31.329 N050.04.44.590 E019.48.31.780 Color_251ACI
N050.04.44.590 E019.48.31.780 N050.04.42.412 E019.48.32.330 Color_251ACI
N050.04.42.412 E019.48.32.330 N050.04.40.656 E019.48.32.801 Color_251ACI
N050.04.40.656 E019.48.32.801 N050.04.38.937 E019.48.33.246 Color_251ACI
N050.04.38.937 E019.48.33.246 N050.04.36.380 E019.48.33.950 Color_251ACI
N050.04.36.380 E019.48.33.950 N050.04.33.860 E019.48.34.629 Color_251ACI
N050.04.33.860 E019.48.34.629 N050.04.33.759 E019.48.34.664 Color_251ACI
N050.05.07.028 E019.48.30.675 N050.05.07.979 E019.48.33.904 Color_251ACI
N050.05.07.979 E019.48.33.904 N050.05.08.054 E019.48.34.095 Color_251ACI
N050.05.08.054 E019.48.34.095 N050.05.08.157 E019.48.34.302 Color_251ACI
N050.05.08.157 E019.48.34.302 N050.05.08.318 E019.48.34.400 Color_251ACI
N050.05.08.318 E019.48.34.400 N050.05.08.435 E019.48.34.423 Color_251ACI
N050.05.08.435 E019.48.34.423 N050.05.10.552 E019.48.34.365 Color_251ACI
N050.05.10.552 E019.48.34.365 N050.05.12.250 E019.48.34.245 Color_251ACI
N050.05.12.250 E019.48.34.245 N050.05.13.292 E019.48.34.158 Color_251ACI
N050.04.26.746 E019.47.40.731 N050.04.27.573 E019.47.43.595 Color_251ACI
N050.04.27.573 E019.47.43.595 N050.04.26.975 E019.47.43.760 Color_251ACI
N050.04.25.136 E019.47.37.052 N050.04.25.509 E019.47.36.797 Color_251ACI
N050.04.25.509 E019.47.36.797 N050.04.25.616 E019.47.36.863 Color_251ACI
N050.04.25.616 E019.47.36.863 N050.04.26.475 E019.47.39.843 Color_251ACI
N050.04.05.905 E019.47.42.475 N050.04.06.067 E019.47.27.305 Color_251ACI
N050.04.06.431 E019.47.27.334 N050.04.06.172 E019.47.42.397 Color_251ACI
N050.04.06.581 E019.47.25.259 N050.04.06.465 E019.47.25.477 Color_251ACI
N050.04.06.465 E019.47.25.477 N050.04.06.348 E019.47.25.694 Color_251ACI
N050.04.06.348 E019.47.25.694 N050.04.06.258 E019.47.25.929 Color_251ACI
N050.04.06.258 E019.47.25.929 N050.04.06.122 E019.47.26.472 Color_251ACI
N050.04.06.122 E019.47.26.472 N050.04.06.113 E019.47.26.755 Color_251ACI
N050.04.06.113 E019.47.26.755 N050.04.06.077 E019.47.27.022 Color_251ACI
N050.04.06.077 E019.47.27.022 N050.04.06.067 E019.47.27.305 Color_251ACI
N050.04.06.807 E019.47.25.589 N050.04.06.728 E019.47.25.782 Color_251ACI
N050.04.06.728 E019.47.25.782 N050.04.06.649 E019.47.25.974 Color_251ACI
N050.04.06.649 E019.47.25.974 N050.04.06.570 E019.47.26.167 Color_251ACI
N050.04.06.570 E019.47.26.167 N050.04.06.517 E019.47.26.375 Color_251ACI
N050.04.06.517 E019.47.26.375 N050.04.06.481 E019.47.26.642 Color_251ACI
N050.04.06.481 E019.47.26.642 N050.04.06.455 E019.47.26.868 Color_251ACI
N050.04.06.455 E019.47.26.868 N050.04.06.430 E019.47.27.093 Color_251ACI
N050.04.06.430 E019.47.27.093 N050.04.06.431 E019.47.27.334 Color_251ACI
N050.05.14.210 E019.48.08.468 N050.05.14.330 E019.48.08.975 Color_251ACI
N050.05.14.330 E019.48.08.975 N050.05.14.440 E019.48.09.523 Color_251ACI
N050.05.14.440 E019.48.09.523 N050.05.14.490 E019.48.09.939 Color_251ACI
N050.05.14.490 E019.48.09.939 N050.05.14.577 E019.48.10.330 Color_251ACI
N050.05.14.577 E019.48.10.330 N050.05.14.656 E019.48.11.245 Color_251ACI
N050.05.14.656 E019.48.11.245 N050.05.14.719 E019.48.12.102 Color_251ACI
N050.05.14.719 E019.48.12.102 N050.05.14.745 E019.48.12.985 Color_251ACI
N050.05.14.745 E019.48.12.985 N050.05.14.744 E019.48.13.851 Color_251ACI
N050.05.14.744 E019.48.13.851 N050.05.14.660 E019.48.15.293 Color_251ACI
N050.05.14.660 E019.48.15.293 N050.05.14.448 E019.48.16.753 Color_251ACI
N050.05.14.448 E019.48.16.753 N050.05.14.323 E019.48.17.496 Color_251ACI
N050.05.14.323 E019.48.17.496 N050.05.14.161 E019.48.18.264 Color_251ACI
N050.05.04.613 E019.47.51.056 N050.05.05.076 E019.47.52.783 Color_251ACI
N050.05.05.076 E019.47.52.783 N050.05.05.522 E019.47.54.452 Color_251ACI
N050.05.05.522 E019.47.54.452 N050.05.05.906 E019.47.55.505 Color_251ACI
N050.05.05.906 E019.47.55.505 N050.05.06.376 E019.47.56.466 Color_251ACI
N050.05.06.376 E019.47.56.466 N050.05.06.597 E019.47.56.938 Color_251ACI
N050.05.06.597 E019.47.56.938 N050.05.06.803 E019.47.57.352 Color_251ACI
N050.05.06.803 E019.47.57.352 N050.05.06.965 E019.47.57.692 Color_251ACI
N050.05.06.965 E019.47.57.692 N050.05.07.174 E019.47.57.964 Color_251ACI
N050.05.07.174 E019.47.57.964 N050.05.07.374 E019.47.58.279 Color_251ACI
N050.05.07.374 E019.47.58.279 N050.05.07.589 E019.47.58.651 Color_251ACI
N050.05.07.589 E019.47.58.651 N050.05.08.164 E019.47.59.194 Color_251ACI
N050.05.08.164 E019.47.59.194 N050.05.08.690 E019.47.59.804 Color_251ACI
N050.05.08.690 E019.47.59.804 N050.05.09.646 E019.48.00.676 Color_251ACI
N050.05.09.646 E019.48.00.676 N050.05.10.585 E019.48.01.489 Color_251ACI
N050.05.10.585 E019.48.01.489 N050.05.10.956 E019.48.01.860 Color_251ACI
N050.05.10.956 E019.48.01.860 N050.05.11.326 E019.48.02.230 Color_251ACI
N050.05.11.326 E019.48.02.230 N050.05.11.740 E019.48.02.675 Color_251ACI
N050.05.11.740 E019.48.02.675 N050.05.12.137 E019.48.03.062 Color_251ACI
N050.05.12.137 E019.48.03.062 N050.05.12.740 E019.48.03.863 Color_251ACI
N050.05.12.740 E019.48.03.863 N050.05.13.257 E019.48.04.756 Color_251ACI
N050.05.13.257 E019.48.04.756 N050.05.13.872 E019.48.05.998 Color_251ACI
N050.05.13.872 E019.48.05.998 N050.05.14.365 E019.48.07.359 Color_251ACI
N050.05.14.365 E019.48.07.359 N050.05.14.719 E019.48.08.779 Color_251ACI
N050.05.14.719 E019.48.08.779 N050.05.14.962 E019.48.10.275 Color_251ACI
N050.05.14.962 E019.48.10.275 N050.05.15.091 E019.48.11.606 Color_251ACI
N050.05.15.091 E019.48.11.606 N050.05.15.130 E019.48.12.930 Color_251ACI
N050.05.15.130 E019.48.12.930 N050.05.15.098 E019.48.14.163 Color_251ACI
N050.05.15.098 E019.48.14.163 N050.05.14.976 E019.48.15.389 Color_251ACI
N050.05.14.976 E019.48.15.389 N050.05.14.806 E019.48.16.682 Color_251ACI
N050.05.14.806 E019.48.16.682 N050.05.14.582 E019.48.17.943 Color_251ACI
N050.05.14.582 E019.48.17.943 N050.05.14.504 E019.48.18.377 Color_251ACI
N050.05.14.504 E019.48.18.377 N050.05.14.389 E019.48.18.836 Color_251ACI
N050.05.05.713 E019.47.56.399 N050.05.05.902 E019.47.56.755 Color_251ACI
N050.05.05.902 E019.47.56.755 N050.05.06.091 E019.47.57.111 Color_251ACI
N050.05.06.091 E019.47.57.111 N050.05.06.253 E019.47.57.450 Color_251ACI
N050.05.06.253 E019.47.57.450 N050.05.06.415 E019.47.57.790 Color_251ACI
N050.05.06.415 E019.47.57.790 N050.05.06.657 E019.47.58.179 Color_251ACI
N050.05.06.657 E019.47.58.179 N050.05.06.883 E019.47.58.509 Color_251ACI
N050.05.06.883 E019.47.58.509 N050.05.07.335 E019.47.59.170 Color_251ACI
N050.05.07.335 E019.47.59.170 N050.05.07.846 E019.47.59.722 Color_251ACI
N050.05.07.846 E019.47.59.722 N050.05.09.155 E019.48.00.906 Color_251ACI
N050.05.09.155 E019.48.00.906 N050.05.10.438 E019.48.02.074 Color_251ACI
N050.05.10.438 E019.48.02.074 N050.05.11.039 E019.48.02.633 Color_251ACI
N050.05.11.039 E019.48.02.633 N050.05.11.630 E019.48.03.234 Color_251ACI
N050.05.11.630 E019.48.03.234 N050.05.12.254 E019.48.03.952 Color_251ACI
N050.05.12.254 E019.48.03.952 N050.05.12.782 E019.48.04.804 Color_251ACI
N050.05.12.782 E019.48.04.804 N050.05.13.354 E019.48.05.971 Color_251ACI
N050.05.13.354 E019.48.05.971 N050.05.13.814 E019.48.07.215 Color_251ACI
N050.05.13.814 E019.48.07.215 N050.05.14.009 E019.48.07.671 Color_251ACI
N050.05.14.009 E019.48.07.671 N050.05.14.129 E019.48.08.178 Color_251ACI
N050.05.14.129 E019.48.08.178 N050.05.14.210 E019.48.08.468 Color_251ACI
N050.05.05.084 E019.47.50.043 N050.05.04.939 E019.47.50.003 Color_251ACI
N050.05.04.939 E019.47.50.003 N050.05.04.113 E019.47.52.678 Color_251ACI
N050.05.04.113 E019.47.52.678 N050.05.03.971 E019.47.53.121 Color_251ACI
N050.05.03.971 E019.47.53.121 N050.05.03.860 E019.47.53.439 Color_251ACI
N050.05.03.860 E019.47.53.439 N050.05.03.639 E019.47.54.074 Color_251ACI
N050.05.03.639 E019.47.54.074 N050.05.03.678 E019.47.54.532 Color_251ACI
N050.05.04.715 E019.47.49.048 N050.05.04.776 E019.47.49.422 Color_251ACI
N050.05.04.776 E019.47.49.422 N050.05.04.059 E019.47.51.537 Color_251ACI
N050.05.04.059 E019.47.51.537 N050.05.03.854 E019.47.52.231 Color_251ACI
N050.05.03.854 E019.47.52.231 N050.05.03.664 E019.47.52.741 Color_251ACI
N050.05.03.664 E019.47.52.741 N050.05.03.522 E019.47.53.185 Color_251ACI
N050.05.03.522 E019.47.53.185 N050.05.03.422 E019.47.53.461 Color_251ACI
N050.05.03.422 E019.47.53.461 N050.05.03.236 E019.47.53.588 Color_251ACI
N050.05.04.797 E019.47.49.338 N050.05.04.929 E019.47.48.937 Color_251ACI
N050.05.04.929 E019.47.48.937 N050.05.05.071 E019.47.48.494 Color_251ACI
N050.05.05.071 E019.47.48.494 N050.05.05.360 E019.47.47.466 Color_251ACI
N050.05.05.360 E019.47.47.466 N050.05.05.579 E019.47.46.347 Color_251ACI
N050.05.05.579 E019.47.46.347 N050.05.05.688 E019.47.45.788 Color_251ACI
N050.05.05.688 E019.47.45.788 N050.05.05.782 E019.47.45.170 Color_251ACI
N050.05.05.782 E019.47.45.170 N050.05.05.887 E019.47.43.645 Color_251ACI
N050.05.05.887 E019.47.43.645 N050.05.05.917 E019.47.42.170 Color_251ACI
N050.05.05.917 E019.47.42.170 N050.05.05.874 E019.47.40.988 Color_251ACI
N050.05.05.874 E019.47.40.988 N050.05.05.713 E019.47.39.782 Color_251ACI
N050.05.05.713 E019.47.39.782 N050.05.05.521 E019.47.38.702 Color_251ACI
N050.05.05.521 E019.47.38.702 N050.05.05.264 E019.47.37.630 Color_251ACI
N050.05.05.264 E019.47.37.630 N050.05.04.976 E019.47.36.684 Color_251ACI
N050.05.04.976 E019.47.36.684 N050.05.04.641 E019.47.35.805 Color_251ACI
N050.05.04.641 E019.47.35.805 N050.05.04.463 E019.47.35.407 Color_251ACI
N050.05.04.463 E019.47.35.407 N050.05.04.284 E019.47.35.010 Color_251ACI
N050.05.04.284 E019.47.35.010 N050.05.03.987 E019.47.34.347 Color_251ACI
N050.05.03.987 E019.47.34.347 N050.05.03.690 E019.47.33.684 Color_251ACI
N050.05.03.690 E019.47.33.684 N050.05.03.420 E019.47.33.037 Color_251ACI
N050.05.03.420 E019.47.33.037 N050.05.03.122 E019.47.32.374 Color_251ACI
N050.05.04.971 E019.47.49.878 N050.05.05.207 E019.47.49.058 Color_251ACI
N050.05.05.207 E019.47.49.058 N050.05.05.471 E019.47.48.256 Color_251ACI
N050.05.05.471 E019.47.48.256 N050.05.05.722 E019.47.47.253 Color_251ACI
N050.05.05.722 E019.47.47.253 N050.05.05.947 E019.47.46.235 Color_251ACI
N050.05.05.947 E019.47.46.235 N050.05.06.082 E019.47.45.450 Color_251ACI
N050.05.06.082 E019.47.45.450 N050.05.06.174 E019.47.44.591 Color_251ACI
N050.05.06.174 E019.47.44.591 N050.05.06.229 E019.47.43.757 Color_251ACI
N050.05.06.229 E019.47.43.757 N050.05.06.257 E019.47.42.907 Color_251ACI
N050.05.06.257 E019.47.42.907 N050.05.06.238 E019.47.41.259 Color_251ACI
N050.05.06.238 E019.47.41.259 N050.05.06.081 E019.47.39.669 Color_251ACI
N050.05.06.081 E019.47.39.669 N050.05.06.015 E019.47.39.195 Color_251ACI
N050.05.06.015 E019.47.39.195 N050.05.05.911 E019.47.38.747 Color_251ACI
N050.05.05.911 E019.47.38.747 N050.05.05.243 E019.47.36.606 Color_251ACI
N050.05.05.243 E019.47.36.606 N050.05.04.443 E019.47.34.624 Color_251ACI
N050.05.04.443 E019.47.34.624 N050.05.04.215 E019.47.34.052 Color_251ACI
N050.05.04.215 E019.47.34.052 N050.05.03.951 E019.47.33.506 Color_251ACI
N050.05.03.951 E019.47.33.506 N050.05.03.562 E019.47.32.594 Color_251ACI
N050.05.03.562 E019.47.32.594 N050.05.03.172 E019.47.31.683 Color_251ACI
N050.05.03.172 E019.47.31.683 N050.05.02.901 E019.47.30.794 Color_251ACI
N050.05.02.901 E019.47.30.794 N050.05.02.667 E019.47.29.881 Color_251ACI
N050.05.02.667 E019.47.29.881 N050.05.02.307 E019.47.28.361 Color_251ACI
N050.05.02.307 E019.47.28.361 N050.05.02.075 E019.47.26.823 Color_251ACI
N050.05.02.075 E019.47.26.823 N050.05.02.057 E019.47.26.523 Color_251ACI
N050.05.02.057 E019.47.26.523 N050.05.02.088 E019.47.26.156 Color_251ACI
N050.05.02.088 E019.47.26.156 N050.05.02.135 E019.47.24.981 Color_251ACI
N050.05.02.135 E019.47.24.981 N050.05.02.220 E019.47.23.781 Color_251ACI
N050.04.25.428 E019.47.34.533 N050.04.25.856 E019.47.36.768 Color_251ACI
N050.04.25.856 E019.47.36.768 N050.04.25.856 E019.47.36.768 Color_251ACI
N050.04.25.856 E019.47.36.768 N050.04.25.872 E019.47.36.826 Color_251ACI
N050.04.25.872 E019.47.36.826 N050.04.25.926 E019.47.36.859 Color_251ACI
N050.04.25.926 E019.47.36.859 N050.04.25.926 E019.47.36.859 Color_251ACI
N050.04.25.926 E019.47.36.859 N050.04.25.953 E019.47.36.875 Color_251ACI
N050.04.25.953 E019.47.36.875 N050.04.25.979 E019.47.36.892 Color_251ACI
N050.04.25.979 E019.47.36.892 N050.04.26.006 E019.47.36.908 Color_251ACI
N050.04.26.006 E019.47.36.908 N050.04.26.044 E019.47.36.883 Color_251ACI
N050.04.26.044 E019.47.36.883 N050.04.26.044 E019.47.36.883 Color_251ACI
N050.04.26.044 E019.47.36.883 N050.04.26.081 E019.47.36.857 Color_251ACI
N050.04.26.081 E019.47.36.857 N050.04.26.108 E019.47.36.874 Color_251ACI
N050.04.25.518 E019.47.34.298 N050.04.25.795 E019.47.34.179 Color_251ACI
N050.04.25.518 E019.47.34.298 N050.04.25.491 E019.47.34.282 Color_251ACI
N050.04.25.491 E019.47.34.282 N050.04.25.481 E019.47.34.324 Color_251ACI
N050.04.25.481 E019.47.34.324 N050.04.25.481 E019.47.34.324 Color_251ACI
N050.04.25.481 E019.47.34.324 N050.04.25.460 E019.47.34.407 Color_251ACI
N050.04.25.460 E019.47.34.407 N050.04.25.433 E019.47.34.391 Color_251ACI
N050.04.25.433 E019.47.34.391 N050.04.25.401 E019.47.34.516 Color_251ACI
N050.04.25.401 E019.47.34.516 N050.04.25.428 E019.47.34.533 Color_251ACI
N050.04.25.428 E019.47.34.533 N050.04.25.428 E019.47.34.533 Color_251ACI
N050.04.25.517 E019.47.34.057 N050.04.25.831 E019.47.33.912 Color_251ACI
N050.04.25.831 E019.47.33.912 N050.04.25.985 E019.47.33.668 Color_251ACI
N050.04.25.275 E019.47.33.910 N050.04.25.302 E019.47.33.926 Color_251ACI
N050.04.25.302 E019.47.33.926 N050.04.25.292 E019.47.33.968 Color_251ACI
N050.04.25.292 E019.47.33.968 N050.04.25.319 E019.47.33.984 Color_251ACI
N050.04.25.319 E019.47.33.984 N050.04.25.335 E019.47.34.042 Color_251ACI
N050.04.25.335 E019.47.34.042 N050.04.25.442 E019.47.34.108 Color_251ACI
N050.04.25.442 E019.47.34.108 N050.04.25.479 E019.47.34.082 Color_251ACI
N050.04.25.479 E019.47.34.082 N050.04.25.506 E019.47.34.099 Color_251ACI
N050.04.25.506 E019.47.34.099 N050.04.25.517 E019.47.34.057 Color_251ACI
N050.04.24.828 E019.47.33.107 N050.04.25.616 E019.47.36.863 Color_251ACI
N050.04.24.159 E019.47.29.617 N050.04.24.828 E019.47.33.107 Color_251ACI
N050.04.23.604 E019.47.26.533 N050.04.23.972 E019.47.28.636 Color_251ACI
N050.04.18.097 E019.47.25.198 N050.04.21.347 E019.47.25.302 Color_251ACI
N050.04.21.347 E019.47.25.302 N050.04.22.166 E019.47.25.367 Color_251ACI
N050.04.22.166 E019.47.25.367 N050.04.23.096 E019.47.25.356 Color_251ACI
N050.04.23.096 E019.47.25.356 N050.04.23.149 E019.47.25.389 Color_251ACI
N050.04.23.149 E019.47.25.389 N050.04.23.257 E019.47.25.454 Color_251ACI
N050.04.23.257 E019.47.25.454 N050.04.23.310 E019.47.25.487 Color_251ACI
N050.04.23.310 E019.47.25.487 N050.04.23.380 E019.47.25.578 Color_251ACI
N050.04.23.380 E019.47.25.578 N050.04.23.396 E019.47.25.636 Color_251ACI
N050.04.23.396 E019.47.25.636 N050.04.23.440 E019.47.25.710 Color_251ACI
N050.04.23.440 E019.47.25.710 N050.04.23.456 E019.47.25.769 Color_251ACI
N050.04.24.113 E019.47.27.951 N050.04.24.628 E019.47.30.577 Color_251ACI
N050.04.24.628 E019.47.30.577 N050.04.24.645 E019.47.30.636 Color_251ACI
N050.04.17.845 E019.47.27.309 N050.04.17.858 E019.47.25.534 Color_251ACI
N050.04.18.086 E019.47.25.240 N050.04.18.032 E019.47.25.207 Color_251ACI
N050.04.18.032 E019.47.25.207 N050.04.17.995 E019.47.25.233 Color_251ACI
N050.04.17.995 E019.47.25.233 N050.04.17.931 E019.47.25.242 Color_251ACI
N050.04.17.931 E019.47.25.242 N050.04.17.921 E019.47.25.284 Color_251ACI
N050.04.17.921 E019.47.25.284 N050.04.17.873 E019.47.25.351 Color_251ACI
N050.04.17.873 E019.47.25.351 N050.04.17.841 E019.47.25.476 Color_251ACI
N050.04.17.841 E019.47.25.476 N050.04.17.858 E019.47.25.534 Color_251ACI
N050.04.17.879 E019.47.24.343 N050.04.17.858 E019.47.24.427 Color_251ACI
N050.04.17.858 E019.47.24.427 N050.04.17.901 E019.47.24.501 Color_251ACI
N050.04.17.901 E019.47.24.501 N050.04.17.907 E019.47.24.601 Color_251ACI
N050.04.17.907 E019.47.24.601 N050.04.17.923 E019.47.24.659 Color_251ACI
N050.04.17.923 E019.47.24.659 N050.04.17.976 E019.47.24.692 Color_251ACI
N050.04.17.976 E019.47.24.692 N050.04.17.993 E019.47.24.750 Color_251ACI
N050.04.17.993 E019.47.24.750 N050.04.18.046 E019.47.24.783 Color_251ACI
N050.04.18.046 E019.47.24.783 N050.04.18.111 E019.47.24.773 Color_251ACI
N050.04.17.868 E019.47.24.385 N050.04.17.918 E019.47.22.585 Color_251ACI
N050.04.23.039 E019.47.22.383 N050.04.23.293 E019.47.24.080 Color_251ACI
N050.04.23.293 E019.47.24.080 N050.04.23.343 E019.47.24.495 Color_251ACI
N050.04.23.343 E019.47.24.495 N050.04.23.290 E019.47.24.704 Color_251ACI
N050.04.23.290 E019.47.24.704 N050.04.23.205 E019.47.24.797 Color_251ACI
N050.04.23.205 E019.47.24.797 N050.04.23.093 E019.47.24.873 Color_251ACI
N050.04.23.093 E019.47.24.873 N050.04.22.618 E019.47.24.920 Color_251ACI
N050.04.22.618 E019.47.24.920 N050.04.18.848 E019.47.24.790 Color_251ACI
N050.04.18.848 E019.47.24.790 N050.04.18.292 E019.47.24.788 Color_251ACI
N050.04.18.292 E019.47.24.788 N050.04.18.111 E019.47.24.773 Color_251ACI
N050.04.17.736 E019.47.22.571 N050.04.17.718 E019.47.24.245 Color_251ACI
N050.04.17.373 E019.47.24.757 N050.04.17.464 E019.47.24.764 Color_251ACI
N050.04.17.464 E019.47.24.764 N050.04.17.501 E019.47.24.739 Color_251ACI
N050.04.17.501 E019.47.24.739 N050.04.17.576 E019.47.24.688 Color_251ACI
N050.04.17.576 E019.47.24.688 N050.04.17.623 E019.47.24.621 Color_251ACI
N050.04.17.623 E019.47.24.621 N050.04.17.644 E019.47.24.537 Color_251ACI
N050.04.17.644 E019.47.24.537 N050.04.17.686 E019.47.24.370 Color_251ACI
N050.04.17.686 E019.47.24.370 N050.04.17.691 E019.47.24.229 Color_251ACI
N050.04.17.400 E019.47.24.773 N050.04.07.806 E019.47.24.320 Color_251ACI
N050.04.17.612 E019.47.25.529 N050.04.17.562 E019.47.27.329 Color_251ACI
N050.04.17.450 E019.47.25.189 N050.04.17.487 E019.47.25.164 Color_251ACI
N050.04.17.487 E019.47.25.164 N050.04.17.541 E019.47.25.197 Color_251ACI
N050.04.17.541 E019.47.25.197 N050.04.17.557 E019.47.25.255 Color_251ACI
N050.04.17.557 E019.47.25.255 N050.04.17.610 E019.47.25.287 Color_251ACI
N050.04.17.610 E019.47.25.287 N050.04.17.627 E019.47.25.346 Color_251ACI
N050.04.17.627 E019.47.25.346 N050.04.17.606 E019.47.25.429 Color_251ACI
N050.04.17.606 E019.47.25.429 N050.04.17.622 E019.47.25.487 Color_251ACI
N050.04.17.622 E019.47.25.487 N050.04.17.638 E019.47.25.545 Color_251ACI
N050.04.08.022 E019.47.24.692 N050.04.17.450 E019.47.25.189 Color_251ACI
N050.04.06.818 E019.47.25.547 N050.04.06.924 E019.47.25.371 Color_251ACI
N050.04.06.924 E019.47.25.371 N050.04.07.057 E019.47.25.211 Color_251ACI
N050.04.07.057 E019.47.25.211 N050.04.07.190 E019.47.25.052 Color_251ACI
N050.04.07.190 E019.47.25.052 N050.04.07.349 E019.47.24.908 Color_251ACI
N050.04.07.349 E019.47.24.908 N050.04.07.525 E019.47.24.823 Color_251ACI
N050.04.07.525 E019.47.24.823 N050.04.07.675 E019.47.24.721 Color_251ACI
N050.04.07.675 E019.47.24.721 N050.04.07.856 E019.47.24.736 Color_251ACI
N050.04.07.856 E019.47.24.736 N050.04.08.022 E019.47.24.692 Color_251ACI
N050.04.06.581 E019.47.25.259 N050.04.06.698 E019.47.25.041 Color_251ACI
N050.04.06.698 E019.47.25.041 N050.04.06.831 E019.47.24.881 Color_251ACI
N050.04.06.831 E019.47.24.881 N050.04.06.990 E019.47.24.737 Color_251ACI
N050.04.06.990 E019.47.24.737 N050.04.07.150 E019.47.24.594 Color_251ACI
N050.04.07.150 E019.47.24.594 N050.04.07.299 E019.47.24.492 Color_251ACI
N050.04.07.299 E019.47.24.492 N050.04.07.475 E019.47.24.407 Color_251ACI
N050.04.07.475 E019.47.24.407 N050.04.07.641 E019.47.24.363 Color_251ACI
N050.04.07.641 E019.47.24.363 N050.04.07.806 E019.47.24.320 Color_251ACI
N050.05.00.568 E019.47.39.101 N050.05.01.081 E019.47.41.244 Color_251ACI
N050.05.01.081 E019.47.41.244 N050.05.01.583 E019.47.43.429 Color_251ACI
N050.05.01.583 E019.47.43.429 N050.05.01.894 E019.47.44.774 Color_251ACI
N050.05.01.894 E019.47.44.774 N050.05.02.232 E019.47.46.137 Color_251ACI
N050.05.02.401 E019.47.46.818 N050.05.02.631 E019.47.47.873 Color_251ACI
N050.05.02.631 E019.47.47.873 N050.05.02.860 E019.47.48.928 Color_251ACI
N050.05.02.860 E019.47.48.928 N050.05.03.265 E019.47.50.764 Color_251ACI
N050.05.03.265 E019.47.50.764 N050.05.03.706 E019.47.52.574 Color_251ACI
N050.05.00.238 E019.47.39.430 N050.05.00.301 E019.47.39.179 Color_251ACI
N050.05.00.301 E019.47.39.179 N050.05.00.333 E019.47.39.054 Color_251ACI
N050.05.00.333 E019.47.39.054 N050.05.00.364 E019.47.38.929 Color_251ACI
N050.05.00.364 E019.47.38.929 N050.05.00.369 E019.47.38.787 Color_251ACI
N050.05.00.369 E019.47.38.787 N050.05.00.374 E019.47.38.645 Color_251ACI
N050.05.00.374 E019.47.38.645 N050.05.00.378 E019.47.38.504 Color_251ACI
N050.05.00.378 E019.47.38.504 N050.05.00.410 E019.47.38.378 Color_251ACI
N050.04.47.075 E019.45.49.005 N050.04.47.087 E019.45.50.554 Color_251ACI
N050.04.47.087 E019.45.50.554 N050.04.47.138 E019.45.52.078 Color_251ACI
N050.04.47.138 E019.45.52.078 N050.04.47.280 E019.45.56.066 Color_251ACI
N050.04.47.280 E019.45.56.066 N050.04.47.550 E019.46.00.036 Color_251ACI
N050.04.47.550 E019.46.00.036 N050.04.47.701 E019.46.02.391 Color_251ACI
N050.04.47.701 E019.46.02.391 N050.04.47.905 E019.46.04.779 Color_251ACI
N050.04.47.905 E019.46.04.779 N050.04.48.231 E019.46.08.157 Color_251ACI
N050.04.48.231 E019.46.08.157 N050.04.48.595 E019.46.11.509 Color_251ACI
N050.04.48.595 E019.46.11.509 N050.04.48.945 E019.46.14.421 Color_251ACI
N050.04.48.945 E019.46.14.421 N050.04.49.312 E019.46.17.390 Color_251ACI
N050.04.49.312 E019.46.17.390 N050.04.49.956 E019.46.22.213 Color_251ACI
N050.04.49.956 E019.46.22.213 N050.04.50.626 E019.46.27.053 Color_251ACI
N050.04.50.626 E019.46.27.053 N050.04.51.413 E019.46.32.783 Color_251ACI
N050.04.51.413 E019.46.32.783 N050.04.52.216 E019.46.38.570 Color_251ACI
N050.04.52.216 E019.46.38.570 N050.04.53.057 E019.46.44.574 Color_251ACI
N050.04.53.057 E019.46.44.574 N050.04.53.872 E019.46.50.562 Color_251ACI
N050.04.53.872 E019.46.50.562 N050.04.54.641 E019.46.55.992 Color_251ACI
N050.04.54.641 E019.46.55.992 N050.04.55.404 E019.47.01.322 Color_251ACI
N050.04.55.404 E019.47.01.322 N050.04.56.223 E019.47.07.168 Color_251ACI
N050.04.56.223 E019.47.07.168 N050.04.56.979 E019.47.13.023 Color_251ACI
N050.04.56.979 E019.47.13.023 N050.04.57.335 E019.47.16.034 Color_251ACI
N050.04.57.335 E019.47.16.034 N050.04.57.667 E019.47.20.619 Color_251ACI
N050.04.57.667 E019.47.20.619 N050.04.58.091 E019.47.25.212 Color_251ACI
N050.04.58.091 E019.47.25.212 N050.04.58.371 E019.47.28.032 Color_251ACI
N050.04.58.371 E019.47.28.032 N050.04.58.791 E019.47.30.793 Color_251ACI
N050.04.58.791 E019.47.30.793 N050.04.59.094 E019.47.32.663 Color_251ACI
N050.04.59.094 E019.47.32.663 N050.04.59.498 E019.47.34.499 Color_251ACI
N050.04.59.498 E019.47.34.499 N050.04.59.935 E019.47.36.452 Color_251ACI
N050.04.59.935 E019.47.36.452 N050.05.00.410 E019.47.38.378 Color_251ACI
N050.05.00.076 E019.47.40.198 N050.05.00.071 E019.47.40.098 Color_251ACI
N050.05.00.071 E019.47.40.098 N050.05.00.102 E019.47.39.973 Color_251ACI
N050.05.00.102 E019.47.39.973 N050.05.00.123 E019.47.39.889 Color_251ACI
N050.05.00.123 E019.47.39.889 N050.05.00.117 E019.47.39.789 Color_251ACI
N050.05.00.117 E019.47.39.789 N050.05.00.170 E019.47.39.581 Color_251ACI
N050.05.00.170 E019.47.39.581 N050.05.00.217 E019.47.39.513 Color_251ACI
N050.05.00.217 E019.47.39.513 N050.05.00.238 E019.47.39.430 Color_251ACI
N050.05.00.305 E019.47.42.119 N050.05.00.106 E019.47.40.697 Color_251ACI
N050.05.00.106 E019.47.40.697 N050.05.00.076 E019.47.40.198 Color_251ACI
N050.05.00.584 E019.47.42.483 N050.05.00.976 E019.47.42.770 Color_251ACI
N050.05.00.976 E019.47.42.770 N050.05.00.332 E019.47.39.920 Color_251ACI
N050.05.00.332 E019.47.39.920 N050.05.00.291 E019.47.40.329 Color_251ACI
N050.05.00.291 E019.47.40.329 N050.05.00.508 E019.47.42.050 Color_251ACI
N050.05.00.508 E019.47.42.050 N050.05.00.584 E019.47.42.483 Color_251ACI
N050.05.01.097 E019.47.44.626 N050.05.01.757 E019.47.45.076 Color_251ACI
N050.05.01.757 E019.47.45.076 N050.05.01.888 E019.47.45.782 Color_251ACI
N050.05.01.888 E019.47.45.782 N050.05.01.222 E019.47.44.991 Color_251ACI
N050.05.01.222 E019.47.44.991 N050.05.01.097 E019.47.44.626 Color_251ACI
N050.05.01.262 E019.47.45.448 N050.05.02.401 E019.47.46.818 Color_251ACI
N050.05.00.807 E019.47.44.304 N050.05.00.856 E019.47.44.478 Color_251ACI
N050.05.00.856 E019.47.44.478 N050.05.00.878 E019.47.44.636 Color_251ACI
N050.05.00.878 E019.47.44.636 N050.05.00.927 E019.47.44.811 Color_251ACI
N050.05.00.927 E019.47.44.811 N050.05.00.987 E019.47.44.943 Color_251ACI
N050.05.00.987 E019.47.44.943 N050.05.01.046 E019.47.45.076 Color_251ACI
N050.05.01.046 E019.47.45.076 N050.05.01.105 E019.47.45.209 Color_251ACI
N050.05.01.105 E019.47.45.209 N050.05.01.192 E019.47.45.357 Color_251ACI
N050.05.01.192 E019.47.45.357 N050.05.01.262 E019.47.45.448 Color_251ACI
N050.05.00.305 E019.47.42.119 N050.05.00.797 E019.47.44.346 Color_251ACI
N050.04.22.635 E019.47.21.897 N050.04.22.662 E019.47.21.913 Color_251ACI
N050.04.22.662 E019.47.21.913 N050.04.22.796 E019.47.21.995 Color_251ACI
N050.04.22.796 E019.47.21.995 N050.04.22.877 E019.47.22.044 Color_251ACI
N050.04.22.877 E019.47.22.044 N050.04.22.920 E019.47.22.118 Color_251ACI
N050.04.22.920 E019.47.22.118 N050.04.22.963 E019.47.22.193 Color_251ACI
N050.04.22.963 E019.47.22.193 N050.04.23.006 E019.47.22.267 Color_251ACI
N050.04.23.006 E019.47.22.267 N050.04.23.039 E019.47.22.383 Color_251ACI
N050.04.22.498 E019.47.18.875 N050.04.22.845 E019.47.21.061 Color_251ACI
N050.04.22.575 E019.47.21.523 N050.04.22.649 E019.47.21.472 Color_251ACI
N050.04.22.649 E019.47.21.472 N050.04.22.687 E019.47.21.446 Color_251ACI
N050.04.22.687 E019.47.21.446 N050.04.22.724 E019.47.21.421 Color_251ACI
N050.04.22.724 E019.47.21.421 N050.04.22.772 E019.47.21.354 Color_251ACI
N050.04.22.772 E019.47.21.354 N050.04.22.793 E019.47.21.270 Color_251ACI
N050.04.22.793 E019.47.21.270 N050.04.22.845 E019.47.21.061 Color_251ACI
N050.04.22.705 E019.47.18.664 N050.04.22.784 E019.47.18.472 Color_251ACI
N050.04.22.784 E019.47.18.472 N050.04.22.896 E019.47.18.395 Color_251ACI
N050.04.22.896 E019.47.18.395 N050.04.23.041 E019.47.18.435 Color_251ACI
N050.04.23.255 E019.47.17.458 N050.04.23.674 E019.47.17.762 Color_251ACI
N050.04.23.674 E019.47.17.762 N050.04.24.459 E019.47.17.711 Color_251ACI
N050.04.22.557 E019.47.17.900 N050.04.22.573 E019.47.17.958 Color_251ACI
N050.04.22.573 E019.47.17.958 N050.04.22.579 E019.47.18.058 Color_251ACI
N050.04.22.579 E019.47.18.058 N050.04.22.596 E019.47.18.116 Color_251ACI
N050.04.22.596 E019.47.18.116 N050.04.22.649 E019.47.18.148 Color_251ACI
N050.04.22.649 E019.47.18.148 N050.04.22.687 E019.47.18.123 Color_251ACI
N050.04.22.687 E019.47.18.123 N050.04.22.751 E019.47.18.114 Color_251ACI
N050.04.22.751 E019.47.18.114 N050.04.22.761 E019.47.18.072 Color_251ACI
N050.04.22.761 E019.47.18.072 N050.04.22.809 E019.47.18.005 Color_251ACI
N050.04.23.352 E019.47.17.565 N050.04.23.204 E019.47.17.909 Color_251ACI
N050.04.23.204 E019.47.17.909 N050.04.22.964 E019.47.18.003 Color_251ACI
N050.04.22.964 E019.47.18.003 N050.04.23.154 E019.47.17.493 Color_251ACI
N050.04.25.132 E019.47.21.926 N050.04.25.447 E019.47.23.996 Color_251ACI
N050.04.25.447 E019.47.23.996 N050.04.25.701 E019.47.25.692 Color_251ACI
N050.04.25.701 E019.47.25.692 N050.04.25.599 E019.47.25.727 Color_251ACI
N050.04.24.487 E019.47.17.969 N050.04.25.132 E019.47.21.926 Color_251ACI
N050.04.23.507 E019.47.15.348 N050.04.23.326 E019.47.13.359 Color_251ACI
N050.04.23.291 E019.47.17.191 N050.04.24.584 E019.47.16.968 Color_251ACI
N050.04.22.809 E019.47.18.005 N050.04.23.057 E019.47.17.386 Color_251ACI
N050.04.23.057 E019.47.17.386 N050.04.22.670 E019.47.16.957 Color_251ACI
N050.04.23.561 E019.47.16.488 N050.04.23.291 E019.47.17.191 Color_251ACI
N050.04.24.065 E019.47.15.833 N050.04.23.964 E019.47.15.867 Color_251ACI
N050.04.23.964 E019.47.15.867 N050.04.23.906 E019.47.15.976 Color_251ACI
N050.04.23.906 E019.47.15.976 N050.04.23.831 E019.47.16.027 Color_251ACI
N050.04.23.831 E019.47.16.027 N050.04.23.783 E019.47.16.094 Color_251ACI
N050.04.23.783 E019.47.16.094 N050.04.23.725 E019.47.16.203 Color_251ACI
N050.04.23.725 E019.47.16.203 N050.04.23.677 E019.47.16.271 Color_251ACI
N050.04.23.677 E019.47.16.271 N050.04.23.619 E019.47.16.380 Color_251ACI
N050.04.23.619 E019.47.16.380 N050.04.23.561 E019.47.16.488 Color_251ACI
N050.04.23.641 E019.47.15.430 N050.04.23.695 E019.47.15.462 Color_251ACI
N050.04.23.695 E019.47.15.462 N050.04.23.856 E019.47.15.560 Color_251ACI
N050.04.23.856 E019.47.15.560 N050.04.23.882 E019.47.15.577 Color_251ACI
N050.04.23.882 E019.47.15.577 N050.04.23.920 E019.47.15.551 Color_251ACI
N050.04.23.920 E019.47.15.551 N050.04.23.946 E019.47.15.568 Color_251ACI
N050.04.23.498 E019.47.13.416 N050.04.23.641 E019.47.15.430 Color_251ACI
N050.04.23.634 E019.47.12.873 N050.04.23.613 E019.47.12.956 Color_251ACI
N050.04.23.613 E019.47.12.956 N050.04.23.576 E019.47.12.982 Color_251ACI
N050.04.23.576 E019.47.12.982 N050.04.23.555 E019.47.13.065 Color_251ACI
N050.04.23.555 E019.47.13.065 N050.04.23.502 E019.47.13.274 Color_251ACI
N050.04.23.502 E019.47.13.274 N050.04.23.492 E019.47.13.316 Color_251ACI
N050.04.23.492 E019.47.13.316 N050.04.23.498 E019.47.13.416 Color_251ACI
N050.04.23.622 E019.47.12.673 N050.04.23.548 E019.47.12.724 Color_251ACI
N050.04.23.548 E019.47.12.724 N050.04.23.511 E019.47.12.749 Color_251ACI
N050.04.23.511 E019.47.12.749 N050.04.23.452 E019.47.12.858 Color_251ACI
N050.04.23.452 E019.47.12.858 N050.04.23.404 E019.47.12.925 Color_251ACI
N050.04.23.404 E019.47.12.925 N050.04.23.352 E019.47.13.134 Color_251ACI
N050.04.23.352 E019.47.13.134 N050.04.23.358 E019.47.13.234 Color_251ACI
N050.04.23.358 E019.47.13.234 N050.04.23.337 E019.47.13.318 Color_251ACI
N050.04.24.284 E019.47.12.499 N050.04.24.349 E019.47.12.489 Color_251ACI
N050.04.24.349 E019.47.12.489 N050.04.24.375 E019.47.12.506 Color_251ACI
N050.04.24.375 E019.47.12.506 N050.04.24.509 E019.47.12.588 Color_251ACI
N050.04.24.509 E019.47.12.588 N050.04.24.536 E019.47.12.604 Color_251ACI
N050.04.24.536 E019.47.12.604 N050.04.24.579 E019.47.12.678 Color_251ACI
N050.04.24.579 E019.47.12.678 N050.04.24.569 E019.47.12.720 Color_251ACI
N050.04.23.622 E019.47.12.673 N050.04.24.284 E019.47.12.499 Color_251ACI
N050.04.24.450 E019.47.14.671 N050.04.24.530 E019.47.14.720 Color_251ACI
N050.04.24.530 E019.47.14.720 N050.04.24.547 E019.47.14.778 Color_251ACI
N050.04.24.547 E019.47.14.778 N050.04.24.590 E019.47.14.852 Color_251ACI
N050.04.24.590 E019.47.14.852 N050.04.24.596 E019.47.14.952 Color_251ACI
N050.04.24.596 E019.47.14.952 N050.04.24.602 E019.47.15.052 Color_251ACI
N050.04.24.602 E019.47.15.052 N050.04.24.581 E019.47.15.135 Color_251ACI
N050.04.24.581 E019.47.15.135 N050.04.24.533 E019.47.15.203 Color_251ACI
N050.04.24.533 E019.47.15.203 N050.04.24.522 E019.47.15.244 Color_251ACI
N050.04.24.809 E019.47.14.841 N050.04.24.804 E019.47.14.983 Color_251ACI
N050.04.24.804 E019.47.14.983 N050.04.24.800 E019.47.15.125 Color_251ACI
N050.04.24.800 E019.47.15.125 N050.04.24.768 E019.47.15.250 Color_251ACI
N050.04.24.768 E019.47.15.250 N050.04.24.710 E019.47.15.359 Color_251ACI
N050.04.24.710 E019.47.15.359 N050.04.24.652 E019.47.15.468 Color_251ACI
N050.04.24.652 E019.47.15.468 N050.04.24.604 E019.47.15.535 Color_251ACI
N050.04.24.604 E019.47.15.535 N050.04.24.519 E019.47.15.628 Color_251ACI
N050.04.24.519 E019.47.15.628 N050.04.24.428 E019.47.15.620 Color_251ACI
N050.04.24.569 E019.47.12.720 N050.04.24.809 E019.47.14.841 Color_251ACI
N050.04.23.480 E019.47.15.332 N050.04.23.513 E019.47.15.448 Color_251ACI
N050.04.23.513 E019.47.15.448 N050.04.23.508 E019.47.15.590 Color_251ACI
N050.04.23.508 E019.47.15.590 N050.04.23.504 E019.47.15.731 Color_251ACI
N050.04.23.504 E019.47.15.731 N050.04.23.509 E019.47.15.831 Color_251ACI
N050.04.23.509 E019.47.15.831 N050.04.23.488 E019.47.15.915 Color_251ACI
N050.04.23.488 E019.47.15.915 N050.04.23.484 E019.47.16.056 Color_251ACI
N050.04.23.484 E019.47.16.056 N050.04.23.452 E019.47.16.182 Color_251ACI
N050.04.23.452 E019.47.16.182 N050.04.23.421 E019.47.16.307 Color_251ACI
N050.04.22.910 E019.47.16.863 N050.04.23.168 E019.47.17.068 Color_251ACI
N050.04.23.168 E019.47.17.068 N050.04.23.421 E019.47.16.307 Color_251ACI
N050.04.22.251 E019.47.13.089 N050.04.22.814 E019.47.16.755 Color_251ACI
N050.04.22.244 E019.47.12.747 N050.04.22.233 E019.47.12.789 Color_251ACI
N050.04.22.233 E019.47.12.789 N050.04.22.223 E019.47.12.831 Color_251ACI
N050.04.22.223 E019.47.12.831 N050.04.22.212 E019.47.12.873 Color_251ACI
N050.04.22.212 E019.47.12.873 N050.04.22.228 E019.47.12.931 Color_251ACI
N050.04.22.228 E019.47.12.931 N050.04.22.218 E019.47.12.973 Color_251ACI
N050.04.22.218 E019.47.12.973 N050.04.22.218 E019.47.12.973 Color_251ACI
N050.04.22.218 E019.47.12.973 N050.04.22.224 E019.47.13.072 Color_251ACI
N050.04.22.224 E019.47.13.072 N050.04.22.251 E019.47.13.089 Color_251ACI
N050.04.22.331 E019.47.12.030 N050.04.22.233 E019.47.12.789 Color_251ACI
N050.04.22.230 E019.47.12.065 N050.04.22.310 E019.47.12.114 Color_251ACI
N050.04.22.310 E019.47.12.114 N050.04.22.353 E019.47.12.188 Color_251ACI
N050.04.22.353 E019.47.12.188 N050.04.22.434 E019.47.12.237 Color_251ACI
N050.04.22.434 E019.47.12.237 N050.04.22.498 E019.47.12.228 Color_251ACI
N050.04.22.498 E019.47.12.228 N050.04.22.578 E019.47.12.277 Color_251ACI
N050.04.22.578 E019.47.12.277 N050.04.22.669 E019.47.12.284 Color_251ACI
N050.04.22.669 E019.47.12.284 N050.04.22.733 E019.47.12.275 Color_251ACI
N050.04.22.733 E019.47.12.275 N050.04.22.797 E019.47.12.266 Color_251ACI
N050.04.21.996 E019.47.11.393 N050.04.22.002 E019.47.11.493 Color_251ACI
N050.04.22.002 E019.47.11.493 N050.04.22.019 E019.47.11.551 Color_251ACI
N050.04.22.019 E019.47.11.551 N050.04.22.035 E019.47.11.609 Color_251ACI
N050.04.22.035 E019.47.11.609 N050.04.22.051 E019.47.11.667 Color_251ACI
N050.04.22.051 E019.47.11.667 N050.04.22.094 E019.47.11.741 Color_251ACI
N050.04.22.094 E019.47.11.741 N050.04.22.100 E019.47.11.841 Color_251ACI
N050.04.22.100 E019.47.11.841 N050.04.22.143 E019.47.11.916 Color_251ACI
N050.04.22.143 E019.47.11.916 N050.04.22.197 E019.47.11.948 Color_251ACI
N050.04.22.079 E019.47.13.033 N050.04.22.186 E019.47.11.990 Color_251ACI
N050.04.21.554 E019.47.12.664 N050.04.22.012 E019.47.15.640 Color_251ACI
N050.04.22.012 E019.47.15.640 N050.04.22.337 E019.47.17.669 Color_251ACI
N050.04.22.192 E019.47.18.737 N050.04.22.230 E019.47.18.711 Color_251ACI
N050.04.22.230 E019.47.18.711 N050.04.22.256 E019.47.18.728 Color_251ACI
N050.04.22.256 E019.47.18.728 N050.04.22.321 E019.47.18.719 Color_251ACI
N050.04.22.321 E019.47.18.719 N050.04.22.358 E019.47.18.693 Color_251ACI
N050.04.22.358 E019.47.18.693 N050.04.22.438 E019.47.18.742 Color_251ACI
N050.04.22.438 E019.47.18.742 N050.04.22.481 E019.47.18.817 Color_251ACI
N050.04.22.481 E019.47.18.817 N050.04.22.498 E019.47.18.875 Color_251ACI
N050.04.22.072 E019.47.18.230 N050.04.22.136 E019.47.18.221 Color_251ACI
N050.04.22.136 E019.47.18.221 N050.04.22.184 E019.47.18.154 Color_251ACI
N050.04.22.184 E019.47.18.154 N050.04.22.221 E019.47.18.128 Color_251ACI
N050.04.22.221 E019.47.18.128 N050.04.22.280 E019.47.18.019 Color_251ACI
N050.04.22.280 E019.47.18.019 N050.04.22.311 E019.47.17.894 Color_251ACI
N050.04.22.311 E019.47.17.894 N050.04.22.316 E019.47.17.752 Color_251ACI
N050.04.22.316 E019.47.17.752 N050.04.22.337 E019.47.17.669 Color_251ACI
N050.04.17.914 E019.46.53.058 N050.04.18.421 E019.46.52.885 Color_251ACI
N050.04.18.421 E019.46.52.885 N050.04.18.609 E019.46.53.000 Color_251ACI
N050.04.18.609 E019.46.53.000 N050.04.20.015 E019.47.02.912 Color_251ACI
N050.04.20.015 E019.47.02.912 N050.04.21.144 E019.47.09.862 Color_251ACI
N050.04.21.144 E019.47.09.862 N050.04.21.465 E019.47.12.032 Color_251ACI
N050.04.21.557 E019.47.11.173 N050.04.21.578 E019.47.11.089 Color_251ACI
N050.04.21.578 E019.47.11.089 N050.04.21.599 E019.47.11.006 Color_251ACI
N050.04.21.599 E019.47.11.006 N050.04.21.599 E019.47.11.006 Color_251ACI
N050.04.21.599 E019.47.11.006 N050.04.21.636 E019.47.10.980 Color_251ACI
N050.04.21.636 E019.47.10.980 N050.04.21.674 E019.47.10.955 Color_251ACI
N050.04.21.674 E019.47.10.955 N050.04.21.711 E019.47.10.930 Color_251ACI
N050.04.21.711 E019.47.10.930 N050.04.21.738 E019.47.10.946 Color_251ACI
N050.04.21.355 E019.47.12.591 N050.04.21.382 E019.47.12.608 Color_251ACI
N050.04.21.382 E019.47.12.608 N050.04.21.393 E019.47.12.566 Color_251ACI
N050.04.21.393 E019.47.12.566 N050.04.21.446 E019.47.12.599 Color_251ACI
N050.04.21.446 E019.47.12.599 N050.04.21.446 E019.47.12.599 Color_251ACI
N050.04.21.446 E019.47.12.599 N050.04.21.527 E019.47.12.648 Color_251ACI
N050.04.21.527 E019.47.12.648 N050.04.21.527 E019.47.12.648 Color_251ACI
N050.04.21.527 E019.47.12.648 N050.04.21.554 E019.47.12.664 Color_251ACI
N050.04.21.317 E019.47.12.375 N050.04.21.354 E019.47.12.350 Color_251ACI
N050.04.21.354 E019.47.12.350 N050.04.21.365 E019.47.12.308 Color_251ACI
N050.04.21.365 E019.47.12.308 N050.04.21.402 E019.47.12.283 Color_251ACI
N050.04.21.402 E019.47.12.283 N050.04.21.439 E019.47.12.257 Color_251ACI
N050.04.21.439 E019.47.12.257 N050.04.21.481 E019.47.12.090 Color_251ACI
N050.04.21.481 E019.47.12.090 N050.04.21.465 E019.47.12.032 Color_251ACI
N050.05.02.828 E019.47.32.195 N050.05.02.892 E019.47.32.186 Color_251ACI
N050.05.02.892 E019.47.32.186 N050.05.02.918 E019.47.32.202 Color_251ACI
N050.05.02.918 E019.47.32.202 N050.05.02.956 E019.47.32.176 Color_251ACI
N050.05.02.956 E019.47.32.176 N050.05.03.036 E019.47.32.226 Color_251ACI
N050.05.03.036 E019.47.32.226 N050.05.03.079 E019.47.32.300 Color_251ACI
N050.05.03.079 E019.47.32.300 N050.05.03.096 E019.47.32.358 Color_251ACI
N050.05.03.096 E019.47.32.358 N050.05.03.122 E019.47.32.374 Color_251ACI
N050.05.02.321 E019.47.32.367 N050.05.02.828 E019.47.32.195 Color_251ACI
N050.05.02.210 E019.47.32.685 N050.05.02.194 E019.47.32.627 Color_251ACI
N050.05.02.194 E019.47.32.627 N050.05.02.177 E019.47.32.569 Color_251ACI
N050.05.02.177 E019.47.32.569 N050.05.02.209 E019.47.32.443 Color_251ACI
N050.05.02.209 E019.47.32.443 N050.05.02.246 E019.47.32.418 Color_251ACI
N050.05.02.246 E019.47.32.418 N050.05.02.283 E019.47.32.393 Color_251ACI
N050.05.02.283 E019.47.32.393 N050.05.02.294 E019.47.32.351 Color_251ACI
N050.05.02.294 E019.47.32.351 N050.05.02.321 E019.47.32.367 Color_251ACI
N050.05.02.071 E019.47.32.745 N050.05.02.398 E019.47.35.015 Color_251ACI
N050.05.02.398 E019.47.35.015 N050.05.02.553 E019.47.35.013 Color_251ACI
N050.05.02.553 E019.47.35.013 N050.05.02.210 E019.47.32.685 Color_251ACI
N050.05.01.793 E019.47.32.623 N050.05.01.830 E019.47.32.598 Color_251ACI
N050.05.01.830 E019.47.32.598 N050.05.01.867 E019.47.32.572 Color_251ACI
N050.05.01.867 E019.47.32.572 N050.05.01.894 E019.47.32.589 Color_251ACI
N050.05.01.894 E019.47.32.589 N050.05.01.958 E019.47.32.580 Color_251ACI
N050.05.01.958 E019.47.32.580 N050.05.01.985 E019.47.32.596 Color_251ACI
N050.05.01.985 E019.47.32.596 N050.05.02.028 E019.47.32.670 Color_251ACI
N050.05.02.028 E019.47.32.670 N050.05.02.045 E019.47.32.729 Color_251ACI
N050.05.02.045 E019.47.32.729 N050.05.02.071 E019.47.32.745 Color_251ACI
N050.05.01.628 E019.47.32.908 N050.05.01.639 E019.47.32.867 Color_251ACI
N050.05.01.639 E019.47.32.867 N050.05.01.660 E019.47.32.783 Color_251ACI
N050.05.01.660 E019.47.32.783 N050.05.01.681 E019.47.32.700 Color_251ACI
N050.05.01.681 E019.47.32.700 N050.05.01.718 E019.47.32.674 Color_251ACI
N050.05.01.718 E019.47.32.674 N050.05.01.745 E019.47.32.690 Color_251ACI
N050.05.01.745 E019.47.32.690 N050.05.01.766 E019.47.32.607 Color_251ACI
N050.05.01.766 E019.47.32.607 N050.05.01.793 E019.47.32.623 Color_251ACI
N050.04.59.928 E019.47.22.817 N050.05.00.126 E019.47.23.997 Color_251ACI
N050.05.00.126 E019.47.23.997 N050.05.00.324 E019.47.25.177 Color_251ACI
N050.05.00.324 E019.47.25.177 N050.05.00.440 E019.47.25.826 Color_251ACI
N050.05.00.440 E019.47.25.826 N050.05.00.555 E019.47.26.474 Color_251ACI
N050.04.52.699 E019.46.33.567 N050.04.53.048 E019.46.35.995 Color_251ACI
N050.04.53.048 E019.46.35.995 N050.04.53.386 E019.46.38.465 Color_251ACI
N050.04.53.386 E019.46.38.465 N050.04.54.403 E019.46.45.491 Color_251ACI
N050.04.54.403 E019.46.45.491 N050.04.55.373 E019.46.52.585 Color_251ACI
N050.04.55.373 E019.46.52.585 N050.04.56.507 E019.47.00.501 Color_251ACI
N050.04.56.507 E019.47.00.501 N050.04.57.566 E019.47.08.468 Color_251ACI
N050.04.57.566 E019.47.08.468 N050.04.58.522 E019.47.14.879 Color_251ACI
N050.04.58.522 E019.47.14.879 N050.04.59.515 E019.47.21.264 Color_251ACI
N050.04.59.515 E019.47.21.264 N050.04.59.591 E019.47.21.696 Color_251ACI
N050.04.59.591 E019.47.21.696 N050.04.59.679 E019.47.22.087 Color_251ACI
N050.05.01.181 E019.47.25.459 N050.05.01.469 E019.47.25.297 Color_251ACI
N050.05.01.469 E019.47.25.297 N050.05.00.747 E019.47.22.016 Color_251ACI
N050.05.00.747 E019.47.22.016 N050.05.00.294 E019.47.22.221 Color_251ACI
N050.05.00.294 E019.47.22.221 N050.05.00.365 E019.47.22.553 Color_251ACI
N050.05.00.365 E019.47.22.553 N050.05.00.200 E019.47.22.597 Color_251ACI
N050.05.00.200 E019.47.22.597 N050.04.59.679 E019.47.22.087 Color_251ACI
N050.05.01.468 E019.47.26.164 N050.05.01.435 E019.47.26.047 Color_251ACI
N050.05.01.435 E019.47.26.047 N050.05.01.392 E019.47.25.973 Color_251ACI
N050.05.01.392 E019.47.25.973 N050.05.01.349 E019.47.25.898 Color_251ACI
N050.05.01.349 E019.47.25.898 N050.05.01.343 E019.47.25.799 Color_251ACI
N050.05.01.343 E019.47.25.799 N050.05.01.300 E019.47.25.724 Color_251ACI
N050.05.01.300 E019.47.25.724 N050.05.01.257 E019.47.25.650 Color_251ACI
N050.05.01.257 E019.47.25.650 N050.05.01.214 E019.47.25.575 Color_251ACI
N050.05.01.214 E019.47.25.575 N050.05.01.181 E019.47.25.459 Color_251ACI
N050.05.00.751 E019.47.27.171 N050.05.00.971 E019.47.28.510 Color_251ACI
N050.05.00.971 E019.47.28.510 N050.05.01.181 E019.47.29.890 Color_251ACI
N050.05.01.181 E019.47.29.890 N050.05.01.346 E019.47.30.954 Color_251ACI
N050.05.01.346 E019.47.30.954 N050.05.01.485 E019.47.32.002 Color_251ACI
N050.05.00.798 E019.47.26.863 N050.05.00.787 E019.47.26.905 Color_251ACI
N050.05.00.787 E019.47.26.905 N050.05.00.777 E019.47.26.946 Color_251ACI
N050.05.00.777 E019.47.26.946 N050.05.00.756 E019.47.27.030 Color_251ACI
N050.05.00.756 E019.47.27.030 N050.05.00.772 E019.47.27.088 Color_251ACI
N050.05.00.772 E019.47.27.088 N050.05.00.751 E019.47.27.171 Color_251ACI
N050.05.00.971 E019.47.26.294 N050.05.00.798 E019.47.26.863 Color_251ACI
N050.05.01.158 E019.47.26.167 N050.05.01.131 E019.47.26.151 Color_251ACI
N050.05.01.131 E019.47.26.151 N050.05.01.094 E019.47.26.176 Color_251ACI
N050.05.01.094 E019.47.26.176 N050.05.01.083 E019.47.26.218 Color_251ACI
N050.05.01.083 E019.47.26.218 N050.05.01.056 E019.47.26.202 Color_251ACI
N050.05.01.056 E019.47.26.202 N050.05.01.046 E019.47.26.243 Color_251ACI
N050.05.01.046 E019.47.26.243 N050.05.01.019 E019.47.26.227 Color_251ACI
N050.05.01.019 E019.47.26.227 N050.05.00.998 E019.47.26.311 Color_251ACI
N050.05.01.384 E019.47.26.498 N050.05.01.367 E019.47.26.440 Color_251ACI
N050.05.01.367 E019.47.26.440 N050.05.01.324 E019.47.26.365 Color_251ACI
N050.05.01.324 E019.47.26.365 N050.05.01.308 E019.47.26.307 Color_251ACI
N050.05.01.308 E019.47.26.307 N050.05.01.292 E019.47.26.249 Color_251ACI
N050.05.01.292 E019.47.26.249 N050.05.01.265 E019.47.26.233 Color_251ACI
N050.05.01.265 E019.47.26.233 N050.05.01.184 E019.47.26.184 Color_251ACI
N050.05.01.184 E019.47.26.184 N050.05.01.131 E019.47.26.151 Color_251ACI
N050.05.01.863 E019.47.31.606 N050.05.01.546 E019.47.31.268 Color_251ACI
N050.05.01.546 E019.47.31.268 N050.05.01.231 E019.47.29.198 Color_251ACI
N050.05.01.231 E019.47.29.198 N050.05.01.526 E019.47.29.378 Color_251ACI
N050.05.01.526 E019.47.29.378 N050.05.01.793 E019.47.29.300 Color_251ACI
N050.05.01.793 E019.47.29.300 N050.05.01.384 E019.47.26.498 Color_251ACI
N050.05.02.103 E019.47.31.512 N050.05.02.272 E019.47.31.085 Color_251ACI
N050.05.02.272 E019.47.31.085 N050.05.01.468 E019.47.26.164 Color_251ACI
N050.05.02.500 E019.47.31.899 N050.05.02.521 E019.47.31.815 Color_251ACI
N050.05.02.521 E019.47.31.815 N050.05.02.569 E019.47.31.748 Color_251ACI
N050.05.02.569 E019.47.31.748 N050.05.02.617 E019.47.31.681 Color_251ACI
N050.05.02.617 E019.47.31.681 N050.05.02.680 E019.47.31.430 Color_251ACI
N050.05.02.680 E019.47.31.430 N050.05.02.684 E019.47.31.288 Color_251ACI
N050.05.02.684 E019.47.31.288 N050.05.02.668 E019.47.31.230 Color_251ACI
N050.05.02.103 E019.47.31.512 N050.05.02.109 E019.47.31.612 Color_251ACI
N050.05.02.109 E019.47.31.612 N050.05.02.141 E019.47.31.728 Color_251ACI
N050.05.02.141 E019.47.31.728 N050.05.02.184 E019.47.31.802 Color_251ACI
N050.05.02.184 E019.47.31.802 N050.05.02.238 E019.47.31.835 Color_251ACI
N050.05.02.238 E019.47.31.835 N050.05.02.372 E019.47.31.917 Color_251ACI
N050.05.02.372 E019.47.31.917 N050.05.02.436 E019.47.31.908 Color_251ACI
N050.05.02.436 E019.47.31.908 N050.05.02.511 E019.47.31.857 Color_251ACI
N050.05.01.485 E019.47.32.002 N050.05.01.555 E019.47.32.093 Color_251ACI
N050.05.01.555 E019.47.32.093 N050.05.01.619 E019.47.32.084 Color_251ACI
N050.05.01.619 E019.47.32.084 N050.05.01.710 E019.47.32.091 Color_251ACI
N050.05.01.710 E019.47.32.091 N050.05.01.758 E019.47.32.024 Color_251ACI
N050.05.01.758 E019.47.32.024 N050.05.01.832 E019.47.31.973 Color_251ACI
N050.05.01.832 E019.47.31.973 N050.05.01.853 E019.47.31.890 Color_251ACI
N050.05.01.853 E019.47.31.890 N050.05.01.885 E019.47.31.764 Color_251ACI
N050.05.01.885 E019.47.31.764 N050.05.01.863 E019.47.31.606 Color_251ACI
N050.05.01.628 E019.47.32.908 N050.05.01.933 E019.47.35.020 Color_251ACI
N050.05.01.933 E019.47.35.020 N050.05.02.247 E019.47.37.091 Color_251ACI
N050.05.02.247 E019.47.37.091 N050.05.02.656 E019.47.39.893 Color_251ACI
N050.05.02.656 E019.47.39.893 N050.05.03.039 E019.47.42.679 Color_251ACI
N050.05.03.039 E019.47.42.679 N050.05.03.297 E019.47.44.233 Color_251ACI
N050.05.03.297 E019.47.44.233 N050.05.03.556 E019.47.45.788 Color_251ACI
N050.05.03.556 E019.47.45.788 N050.05.03.720 E019.47.46.610 Color_251ACI
N050.05.03.720 E019.47.46.610 N050.05.03.885 E019.47.47.433 Color_251ACI
N050.05.03.885 E019.47.47.433 N050.05.04.185 E019.47.48.821 Color_251ACI
N050.05.04.185 E019.47.48.821 N050.05.04.486 E019.47.50.208 Color_251ACI
N050.05.02.695 E019.47.31.247 N050.05.02.406 E019.47.30.059 Color_251ACI
N050.05.02.406 E019.47.30.059 N050.05.02.170 E019.47.28.904 Color_251ACI
N050.05.02.170 E019.47.28.904 N050.05.01.952 E019.47.28.049 Color_251ACI
N050.05.01.952 E019.47.28.049 N050.05.01.809 E019.47.27.142 Color_251ACI
N050.05.01.809 E019.47.27.142 N050.05.01.786 E019.47.25.635 Color_251ACI
N050.05.01.786 E019.47.25.635 N050.05.01.907 E019.47.24.168 Color_251ACI
N050.05.01.907 E019.47.24.168 N050.05.01.987 E019.47.23.109 Color_251ACI
N050.05.01.987 E019.47.23.109 N050.05.02.041 E019.47.22.034 Color_251ACI
N050.05.02.041 E019.47.22.034 N050.05.02.097 E019.47.21.442 Color_251ACI
N050.05.02.097 E019.47.21.442 N050.05.02.153 E019.47.20.850 Color_251ACI
N050.05.02.153 E019.47.20.850 N050.05.02.254 E019.47.19.707 Color_251ACI
N050.05.02.254 E019.47.19.707 N050.05.02.265 E019.47.18.558 Color_251ACI
N050.05.02.265 E019.47.18.558 N050.05.02.097 E019.47.15.903 Color_251ACI
N050.05.02.097 E019.47.15.903 N050.05.01.945 E019.47.13.306 Color_251ACI
N050.04.24.211 E019.47.08.360 N050.04.24.216 E019.47.08.218 Color_251ACI
N050.04.24.216 E019.47.08.218 N050.04.24.194 E019.47.08.060 Color_251ACI
N050.04.24.194 E019.47.08.060 N050.04.24.188 E019.47.07.960 Color_251ACI
N050.04.24.188 E019.47.07.960 N050.04.24.139 E019.47.07.786 Color_251ACI
N050.04.24.139 E019.47.07.786 N050.04.24.096 E019.47.07.711 Color_251ACI
N050.04.24.096 E019.47.07.711 N050.04.24.036 E019.47.07.579 Color_251ACI
N050.04.24.036 E019.47.07.579 N050.04.23.966 E019.47.07.488 Color_251ACI
N050.04.23.966 E019.47.07.488 N050.04.23.896 E019.47.07.397 Color_251ACI
N050.04.23.835 E019.47.08.997 N050.04.23.882 E019.47.08.930 Color_251ACI
N050.04.23.882 E019.47.08.930 N050.04.23.946 E019.47.08.921 Color_251ACI
N050.04.23.946 E019.47.08.921 N050.04.24.021 E019.47.08.870 Color_251ACI
N050.04.24.021 E019.47.08.870 N050.04.24.079 E019.47.08.761 Color_251ACI
N050.04.24.079 E019.47.08.761 N050.04.24.127 E019.47.08.694 Color_251ACI
N050.04.24.127 E019.47.08.694 N050.04.24.180 E019.47.08.485 Color_251ACI
N050.04.24.180 E019.47.08.485 N050.04.24.184 E019.47.08.343 Color_251ACI
N050.04.23.533 E019.47.07.368 N050.04.23.597 E019.47.07.359 Color_251ACI
N050.04.23.597 E019.47.07.359 N050.04.23.634 E019.47.07.334 Color_251ACI
N050.04.23.634 E019.47.07.334 N050.04.23.688 E019.47.07.366 Color_251ACI
N050.04.23.688 E019.47.07.366 N050.04.23.725 E019.47.07.341 Color_251ACI
N050.04.23.725 E019.47.07.341 N050.04.23.779 E019.47.07.374 Color_251ACI
N050.04.23.779 E019.47.07.374 N050.04.23.886 E019.47.07.439 Color_251ACI
N050.04.23.474 E019.47.07.477 N050.04.23.495 E019.47.07.394 Color_251ACI
N050.04.23.495 E019.47.07.394 N050.04.23.533 E019.47.07.368 Color_251ACI
N050.04.23.533 E019.47.07.368 N050.04.23.533 E019.47.07.368 Color_251ACI
N050.04.23.533 E019.47.07.368 N050.04.23.533 E019.47.07.368 Color_251ACI
N050.04.22.920 E019.47.07.717 N050.04.22.942 E019.47.07.875 Color_251ACI
N050.04.22.942 E019.47.07.875 N050.04.23.497 E019.47.07.635 Color_251ACI
N050.04.23.497 E019.47.07.635 N050.04.23.474 E019.47.07.477 Color_251ACI
N050.04.22.444 E019.47.07.764 N050.04.22.850 E019.47.07.626 Color_251ACI
N050.04.22.365 E019.47.07.957 N050.04.22.365 E019.47.07.957 Color_251ACI
N050.04.22.365 E019.47.07.957 N050.04.22.348 E019.47.07.899 Color_251ACI
N050.04.22.348 E019.47.07.899 N050.04.22.359 E019.47.07.857 Color_251ACI
N050.04.22.359 E019.47.07.857 N050.04.22.396 E019.47.07.831 Color_251ACI
N050.04.22.396 E019.47.07.831 N050.04.22.396 E019.47.07.831 Color_251ACI
N050.04.22.396 E019.47.07.831 N050.04.22.407 E019.47.07.790 Color_251ACI
N050.04.22.407 E019.47.07.790 N050.04.22.417 E019.47.07.748 Color_251ACI
N050.04.22.417 E019.47.07.748 N050.04.22.444 E019.47.07.764 Color_251ACI
N050.04.22.461 E019.47.08.064 N050.04.22.435 E019.47.08.047 Color_251ACI
N050.04.22.435 E019.47.08.047 N050.04.22.408 E019.47.08.031 Color_251ACI
N050.04.22.408 E019.47.08.031 N050.04.22.381 E019.47.08.015 Color_251ACI
N050.04.22.381 E019.47.08.015 N050.04.22.365 E019.47.07.957 Color_251ACI
N050.04.22.365 E019.47.07.957 N050.04.22.365 E019.47.07.957 Color_251ACI
N050.04.22.618 E019.47.09.411 N050.04.22.922 E019.47.09.308 Color_251ACI
N050.04.22.606 E019.47.09.212 N050.04.22.569 E019.47.09.237 Color_251ACI
N050.04.22.569 E019.47.09.237 N050.04.22.569 E019.47.09.237 Color_251ACI
N050.04.22.569 E019.47.09.237 N050.04.22.558 E019.47.09.279 Color_251ACI
N050.04.22.558 E019.47.09.279 N050.04.22.548 E019.47.09.321 Color_251ACI
N050.04.22.548 E019.47.09.321 N050.04.22.564 E019.47.09.379 Color_251ACI
N050.04.22.564 E019.47.09.379 N050.04.22.564 E019.47.09.379 Color_251ACI
N050.04.22.564 E019.47.09.379 N050.04.22.618 E019.47.09.411 Color_251ACI
N050.04.22.618 E019.47.09.411 N050.04.22.618 E019.47.09.411 Color_251ACI
N050.04.22.707 E019.47.09.177 N050.04.22.606 E019.47.09.212 Color_251ACI
N050.04.22.461 E019.47.08.064 N050.04.22.526 E019.47.08.055 Color_251ACI
N050.04.22.526 E019.47.08.055 N050.04.22.707 E019.47.09.177 Color_251ACI
N050.04.21.688 E019.47.10.530 N050.04.21.698 E019.47.10.488 Color_251ACI
N050.04.21.698 E019.47.10.488 N050.04.21.735 E019.47.10.463 Color_251ACI
N050.04.21.735 E019.47.10.463 N050.04.21.746 E019.47.10.421 Color_251ACI
N050.04.21.746 E019.47.10.421 N050.04.21.783 E019.47.10.396 Color_251ACI
N050.04.21.783 E019.47.10.396 N050.04.21.825 E019.47.10.229 Color_251ACI
N050.04.21.825 E019.47.10.229 N050.04.21.819 E019.47.10.129 Color_251ACI
N050.04.21.446 E019.47.10.383 N050.04.21.463 E019.47.10.441 Color_251ACI
N050.04.21.463 E019.47.10.441 N050.04.21.489 E019.47.10.457 Color_251ACI
N050.04.21.489 E019.47.10.457 N050.04.21.506 E019.47.10.516 Color_251ACI
N050.04.21.506 E019.47.10.516 N050.04.21.586 E019.47.10.565 Color_251ACI
N050.04.21.586 E019.47.10.565 N050.04.21.623 E019.47.10.539 Color_251ACI
N050.04.21.623 E019.47.10.539 N050.04.21.650 E019.47.10.555 Color_251ACI
N050.04.21.650 E019.47.10.555 N050.04.21.688 E019.47.10.530 Color_251ACI
N050.04.21.581 E019.47.08.491 N050.04.21.819 E019.47.10.129 Color_251ACI
N050.04.21.911 E019.47.08.162 N050.04.21.949 E019.47.08.136 Color_251ACI
N050.04.21.949 E019.47.08.136 N050.04.21.949 E019.47.08.136 Color_251ACI
N050.04.21.949 E019.47.08.136 N050.04.21.970 E019.47.08.053 Color_251ACI
N050.04.21.970 E019.47.08.053 N050.04.21.970 E019.47.08.053 Color_251ACI
N050.04.21.970 E019.47.08.053 N050.04.22.007 E019.47.08.027 Color_251ACI
N050.04.22.007 E019.47.08.027 N050.04.22.044 E019.47.08.002 Color_251ACI
N050.04.22.044 E019.47.08.002 N050.04.22.055 E019.47.07.960 Color_251ACI
N050.04.22.055 E019.47.07.960 N050.04.22.082 E019.47.07.977 Color_251ACI
N050.04.21.833 E019.47.08.596 N050.04.21.817 E019.47.08.538 Color_251ACI
N050.04.21.817 E019.47.08.538 N050.04.21.827 E019.47.08.496 Color_251ACI
N050.04.21.827 E019.47.08.496 N050.04.21.848 E019.47.08.413 Color_251ACI
N050.04.21.848 E019.47.08.413 N050.04.21.880 E019.47.08.287 Color_251ACI
N050.04.21.880 E019.47.08.287 N050.04.21.890 E019.47.08.245 Color_251ACI
N050.04.21.890 E019.47.08.245 N050.04.21.911 E019.47.08.162 Color_251ACI
N050.04.21.986 E019.47.09.219 N050.04.21.943 E019.47.09.144 Color_251ACI
N050.04.21.943 E019.47.09.144 N050.04.21.916 E019.47.09.128 Color_251ACI
N050.04.21.916 E019.47.09.128 N050.04.21.883 E019.47.09.012 Color_251ACI
N050.04.21.883 E019.47.09.012 N050.04.21.867 E019.47.08.954 Color_251ACI
N050.04.21.867 E019.47.08.954 N050.04.21.834 E019.47.08.837 Color_251ACI
N050.04.21.834 E019.47.08.837 N050.04.21.845 E019.47.08.796 Color_251ACI
N050.04.21.845 E019.47.08.796 N050.04.21.812 E019.47.08.679 Color_251ACI
N050.04.21.812 E019.47.08.679 N050.04.21.833 E019.47.08.596 Color_251ACI
N050.04.22.334 E019.47.09.431 N050.04.22.297 E019.47.09.457 Color_251ACI
N050.04.22.297 E019.47.09.457 N050.04.22.233 E019.47.09.466 Color_251ACI
N050.04.22.233 E019.47.09.466 N050.04.22.072 E019.47.09.368 Color_251ACI
N050.04.22.072 E019.47.09.368 N050.04.22.029 E019.47.09.293 Color_251ACI
N050.04.22.029 E019.47.09.293 N050.04.21.986 E019.47.09.219 Color_251ACI
N050.04.22.312 E019.47.09.273 N050.04.22.339 E019.47.09.290 Color_251ACI
N050.04.22.339 E019.47.09.290 N050.04.22.393 E019.47.09.322 Color_251ACI
N050.04.22.393 E019.47.09.322 N050.04.22.393 E019.47.09.322 Color_251ACI
N050.04.22.393 E019.47.09.322 N050.04.22.361 E019.47.09.448 Color_251ACI
N050.04.22.361 E019.47.09.448 N050.04.22.361 E019.47.09.448 Color_251ACI
N050.04.22.130 E019.47.08.151 N050.04.22.029 E019.47.08.185 Color_251ACI
N050.04.22.029 E019.47.08.185 N050.04.22.211 E019.47.09.308 Color_251ACI
N050.04.22.211 E019.47.09.308 N050.04.22.312 E019.47.09.273 Color_251ACI
N050.04.22.092 E019.47.07.935 N050.04.22.119 E019.47.07.951 Color_251ACI
N050.04.22.119 E019.47.07.951 N050.04.22.172 E019.47.07.984 Color_251ACI
N050.04.22.172 E019.47.07.984 N050.04.22.216 E019.47.08.058 Color_251ACI
N050.04.22.216 E019.47.08.058 N050.04.22.195 E019.47.08.142 Color_251ACI
N050.04.22.195 E019.47.08.142 N050.04.22.157 E019.47.08.167 Color_251ACI
N050.04.22.157 E019.47.08.167 N050.04.22.130 E019.47.08.151 Color_251ACI
N050.04.21.351 E019.47.08.302 N050.04.21.388 E019.47.08.276 Color_251ACI
N050.04.21.388 E019.47.08.276 N050.04.21.415 E019.47.08.293 Color_251ACI
N050.04.21.415 E019.47.08.293 N050.04.21.442 E019.47.08.309 Color_251ACI
N050.04.21.442 E019.47.08.309 N050.04.21.495 E019.47.08.342 Color_251ACI
N050.04.21.495 E019.47.08.342 N050.04.21.522 E019.47.08.358 Color_251ACI
N050.04.21.522 E019.47.08.358 N050.04.21.565 E019.47.08.432 Color_251ACI
N050.04.21.565 E019.47.08.432 N050.04.21.581 E019.47.08.491 Color_251ACI
N050.04.21.160 E019.47.08.571 N050.04.21.170 E019.47.08.529 Color_251ACI
N050.04.21.170 E019.47.08.529 N050.04.21.207 E019.47.08.503 Color_251ACI
N050.04.21.207 E019.47.08.503 N050.04.21.218 E019.47.08.462 Color_251ACI
N050.04.21.218 E019.47.08.462 N050.04.21.228 E019.47.08.420 Color_251ACI
N050.04.21.228 E019.47.08.420 N050.04.21.276 E019.47.08.353 Color_251ACI
N050.04.21.276 E019.47.08.353 N050.04.21.303 E019.47.08.369 Color_251ACI
N050.04.21.303 E019.47.08.369 N050.04.21.340 E019.47.08.344 Color_251ACI
N050.04.21.340 E019.47.08.344 N050.04.21.351 E019.47.08.302 Color_251ACI
N050.04.25.353 E019.47.05.781 N050.04.25.349 E019.47.05.923 Color_251ACI
N050.04.25.349 E019.47.05.923 N050.04.25.259 E019.47.06.157 Color_251ACI
N050.04.25.259 E019.47.06.157 N050.04.25.126 E019.47.06.317 Color_251ACI
N050.04.25.126 E019.47.06.317 N050.04.24.204 E019.47.06.911 Color_251ACI
N050.04.24.204 E019.47.06.911 N050.04.24.055 E019.47.07.012 Color_251ACI
N050.04.23.819 E019.47.06.965 N050.04.23.862 E019.47.07.040 Color_251ACI
N050.04.23.862 E019.47.07.040 N050.04.23.889 E019.47.07.056 Color_251ACI
N050.04.23.889 E019.47.07.056 N050.04.23.953 E019.47.07.047 Color_251ACI
N050.04.23.953 E019.47.07.047 N050.04.23.980 E019.47.07.063 Color_251ACI
N050.04.23.980 E019.47.07.063 N050.04.23.980 E019.47.07.063 Color_251ACI
N050.04.23.980 E019.47.07.063 N050.04.24.044 E019.47.07.054 Color_251ACI
N050.04.24.044 E019.47.07.054 N050.04.24.055 E019.47.07.012 Color_251ACI
N050.04.23.695 E019.47.06.600 N050.04.23.684 E019.47.06.642 Color_251ACI
N050.04.23.684 E019.47.06.642 N050.04.23.690 E019.47.06.742 Color_251ACI
N050.04.23.690 E019.47.06.742 N050.04.23.717 E019.47.06.758 Color_251ACI
N050.04.23.717 E019.47.06.758 N050.04.23.733 E019.47.06.816 Color_251ACI
N050.04.23.733 E019.47.06.816 N050.04.23.749 E019.47.06.874 Color_251ACI
N050.04.23.749 E019.47.06.874 N050.04.23.766 E019.47.06.932 Color_251ACI
N050.04.23.766 E019.47.06.932 N050.04.23.793 E019.47.06.949 Color_251ACI
N050.04.23.793 E019.47.06.949 N050.04.23.809 E019.47.07.007 Color_251ACI
N050.04.23.172 E019.47.05.848 N050.04.23.117 E019.47.05.332 Color_251ACI
N050.04.23.117 E019.47.05.332 N050.04.23.218 E019.47.05.298 Color_251ACI
N050.04.23.218 E019.47.05.298 N050.04.23.311 E019.47.05.788 Color_251ACI
N050.04.23.311 E019.47.05.788 N050.04.23.551 E019.47.05.694 Color_251ACI
N050.04.23.551 E019.47.05.694 N050.04.23.695 E019.47.06.600 Color_251ACI
N050.04.23.566 E019.47.06.618 N050.04.23.512 E019.47.06.344 Color_251ACI
N050.04.23.512 E019.47.06.344 N050.04.23.282 E019.47.06.397 Color_251ACI
N050.04.23.376 E019.47.07.129 N050.04.23.424 E019.47.07.061 Color_251ACI
N050.04.23.424 E019.47.07.061 N050.04.23.488 E019.47.07.052 Color_251ACI
N050.04.23.488 E019.47.07.052 N050.04.23.509 E019.47.06.969 Color_251ACI
N050.04.23.509 E019.47.06.969 N050.04.23.562 E019.47.06.760 Color_251ACI
N050.04.23.562 E019.47.06.760 N050.04.23.572 E019.47.06.718 Color_251ACI
N050.04.23.572 E019.47.06.718 N050.04.23.566 E019.47.06.618 Color_251ACI
N050.04.21.301 E019.47.07.886 N050.04.21.541 E019.47.07.791 Color_251ACI
N050.04.21.541 E019.47.07.791 N050.04.22.453 E019.47.07.481 Color_251ACI
N050.04.22.453 E019.47.07.481 N050.04.23.072 E019.47.07.232 Color_251ACI
N050.04.23.072 E019.47.07.232 N050.04.23.403 E019.47.07.145 Color_251ACI
N050.05.03.313 E019.47.23.243 N050.05.03.763 E019.47.23.421 Color_251ACI
N050.05.02.807 E019.47.23.416 N050.05.03.706 E019.47.23.772 Color_251ACI
N050.05.02.220 E019.47.23.781 N050.05.02.279 E019.47.23.672 Color_251ACI
N050.05.02.279 E019.47.23.672 N050.05.02.337 E019.47.23.563 Color_251ACI
N050.05.02.337 E019.47.23.563 N050.05.02.411 E019.47.23.512 Color_251ACI
N050.05.02.411 E019.47.23.512 N050.05.02.486 E019.47.23.461 Color_251ACI
N050.05.02.486 E019.47.23.461 N050.05.02.561 E019.47.23.410 Color_251ACI
N050.05.02.561 E019.47.23.410 N050.05.02.625 E019.47.23.401 Color_251ACI
N050.05.02.625 E019.47.23.401 N050.05.02.726 E019.47.23.367 Color_251ACI
N050.05.02.726 E019.47.23.367 N050.05.02.780 E019.47.23.399 Color_251ACI
N050.05.02.925 E019.47.22.573 N050.05.02.931 E019.47.22.673 Color_251ACI
N050.05.02.931 E019.47.22.673 N050.05.02.964 E019.47.22.789 Color_251ACI
N050.05.02.964 E019.47.22.789 N050.05.02.996 E019.47.22.906 Color_251ACI
N050.05.02.996 E019.47.22.906 N050.05.03.040 E019.47.22.980 Color_251ACI
N050.05.03.040 E019.47.22.980 N050.05.03.083 E019.47.23.054 Color_251ACI
N050.05.03.083 E019.47.23.054 N050.05.03.153 E019.47.23.145 Color_251ACI
N050.05.03.153 E019.47.23.145 N050.05.03.233 E019.47.23.194 Color_251ACI
N050.05.03.233 E019.47.23.194 N050.05.03.313 E019.47.23.243 Color_251ACI
N050.05.02.661 E019.47.19.811 N050.05.02.825 E019.47.21.741 Color_251ACI
N050.05.02.825 E019.47.21.741 N050.05.02.925 E019.47.22.573 Color_251ACI
N050.05.02.332 E019.47.22.597 N050.05.02.338 E019.47.22.697 Color_251ACI
N050.05.02.338 E019.47.22.697 N050.05.02.371 E019.47.22.813 Color_251ACI
N050.05.02.371 E019.47.22.813 N050.05.02.397 E019.47.22.829 Color_251ACI
N050.05.02.397 E019.47.22.829 N050.05.02.478 E019.47.22.878 Color_251ACI
N050.05.02.478 E019.47.22.878 N050.05.02.532 E019.47.22.911 Color_251ACI
N050.05.02.532 E019.47.22.911 N050.05.02.579 E019.47.22.844 Color_251ACI
N050.05.02.579 E019.47.22.844 N050.05.02.654 E019.47.22.793 Color_251ACI
N050.05.02.654 E019.47.22.793 N050.05.02.675 E019.47.22.709 Color_251ACI
N050.05.02.450 E019.47.20.405 N050.05.02.570 E019.47.22.019 Color_251ACI
N050.05.02.570 E019.47.22.019 N050.05.02.675 E019.47.22.709 Color_251ACI
N050.05.02.332 E019.47.22.597 N050.05.02.396 E019.47.21.480 Color_251ACI
N050.05.02.396 E019.47.21.480 N050.05.02.460 E019.47.20.363 Color_251ACI
N050.04.22.973 E019.46.59.995 N050.04.23.139 E019.46.59.951 Color_251ACI
N050.04.23.139 E019.46.59.951 N050.04.23.188 E019.47.00.126 Color_251ACI
N050.04.23.188 E019.47.00.126 N050.04.23.693 E019.46.59.712 Color_251ACI
N050.04.23.169 E019.47.00.692 N050.04.23.318 E019.47.00.591 Color_251ACI
N050.04.23.318 E019.47.00.591 N050.04.23.253 E019.47.00.358 Color_251ACI
N050.04.23.253 E019.47.00.358 N050.04.23.775 E019.47.00.002 Color_251ACI
N050.04.20.750 E019.46.52.475 N050.04.20.771 E019.46.52.391 Color_251ACI
N050.04.20.771 E019.46.52.391 N050.04.20.873 E019.46.52.357 Color_251ACI
N050.04.20.873 E019.46.52.357 N050.04.20.980 E019.46.52.422 Color_251ACI
N050.04.20.980 E019.46.52.422 N050.04.21.039 E019.46.52.555 Color_251ACI
N050.04.21.039 E019.46.52.555 N050.04.21.051 E019.46.52.754 Color_251ACI
N050.04.21.051 E019.46.52.754 N050.04.20.999 E019.46.52.963 Color_251ACI
N050.04.20.999 E019.46.52.963 N050.04.20.940 E019.46.53.072 Color_251ACI
N050.04.20.940 E019.46.53.072 N050.04.20.876 E019.46.53.081 Color_251ACI
N050.04.21.081 E019.46.54.603 N050.04.21.072 E019.46.53.779 Color_251ACI
N050.04.21.072 E019.46.53.779 N050.04.21.050 E019.46.53.621 Color_251ACI
N050.04.21.050 E019.46.53.621 N050.04.20.980 E019.46.53.530 Color_251ACI
N050.04.20.980 E019.46.53.530 N050.04.20.889 E019.46.53.523 Color_251ACI
N050.04.20.889 E019.46.53.523 N050.04.20.876 E019.46.53.081 Color_251ACI
N050.04.19.280 E019.46.52.542 N050.04.19.884 E019.46.52.477 Color_251ACI
N050.04.19.884 E019.46.52.477 N050.04.19.938 E019.46.52.509 Color_251ACI
N050.04.19.938 E019.46.52.509 N050.04.19.966 E019.46.52.767 Color_251ACI
N050.04.19.966 E019.46.52.767 N050.04.20.735 E019.46.52.658 Color_251ACI
N050.04.20.735 E019.46.52.658 N050.04.20.750 E019.46.52.475 Color_251ACI
N050.04.18.828 E019.46.52.989 N050.04.18.949 E019.46.52.629 Color_251ACI
N050.04.18.949 E019.46.52.629 N050.04.19.088 E019.46.52.569 Color_251ACI
N050.04.17.833 E019.46.52.767 N050.04.18.431 E019.46.52.602 Color_251ACI
N050.04.18.431 E019.46.52.602 N050.04.18.574 E019.46.52.400 Color_251ACI
N050.04.18.574 E019.46.52.400 N050.04.18.561 E019.46.51.959 Color_251ACI
N050.04.18.561 E019.46.51.959 N050.04.19.369 E019.46.25.479 Color_251ACI
N050.04.19.369 E019.46.25.479 N050.04.18.396 E019.46.25.416 Color_251ACI
N050.05.02.558 E019.47.18.496 N050.05.02.380 E019.47.15.883 Color_251ACI
N050.05.02.380 E019.47.15.883 N050.05.02.212 E019.47.13.228 Color_251ACI
N050.05.03.086 E019.47.19.348 N050.05.03.006 E019.47.19.299 Color_251ACI
N050.05.03.006 E019.47.19.299 N050.05.02.958 E019.47.19.366 Color_251ACI
N050.05.02.958 E019.47.19.366 N050.05.02.894 E019.47.19.375 Color_251ACI
N050.05.02.894 E019.47.19.375 N050.05.02.809 E019.47.19.468 Color_251ACI
N050.05.02.809 E019.47.19.468 N050.05.02.772 E019.47.19.493 Color_251ACI
N050.05.02.772 E019.47.19.493 N050.05.02.713 E019.47.19.602 Color_251ACI
N050.05.02.713 E019.47.19.602 N050.05.02.661 E019.47.19.811 Color_251ACI
N050.05.02.558 E019.47.18.496 N050.05.02.591 E019.47.18.612 Color_251ACI
N050.05.02.591 E019.47.18.612 N050.05.02.634 E019.47.18.687 Color_251ACI
N050.05.02.634 E019.47.18.687 N050.05.02.677 E019.47.18.761 Color_251ACI
N050.05.02.677 E019.47.18.761 N050.05.02.747 E019.47.18.852 Color_251ACI
N050.05.02.747 E019.47.18.852 N050.05.02.801 E019.47.18.885 Color_251ACI
N050.05.02.801 E019.47.18.885 N050.05.02.881 E019.47.18.934 Color_251ACI
N050.05.02.881 E019.47.18.934 N050.05.02.961 E019.47.18.983 Color_251ACI
N050.05.02.961 E019.47.18.983 N050.05.03.036 E019.47.18.932 Color_251ACI
N050.04.53.067 E019.46.31.239 N050.04.52.804 E019.46.32.042 Color_251ACI
N050.04.52.804 E019.46.32.042 N050.04.52.710 E019.46.32.418 Color_251ACI
N050.04.52.710 E019.46.32.418 N050.04.52.684 E019.46.32.643 Color_251ACI
N050.04.52.684 E019.46.32.643 N050.04.52.664 E019.46.32.968 Color_251ACI
N050.04.52.664 E019.46.32.968 N050.04.52.682 E019.46.33.268 Color_251ACI
N050.04.52.682 E019.46.33.268 N050.04.52.699 E019.46.33.567 Color_251ACI
N050.04.52.847 E019.46.31.008 N050.04.52.494 E019.46.32.045 Color_251ACI
N050.04.49.866 E019.46.12.477 N050.04.50.543 E019.46.17.659 Color_251ACI
N050.04.50.543 E019.46.17.659 N050.04.51.204 E019.46.22.782 Color_251ACI
N050.04.51.204 E019.46.22.782 N050.04.51.862 E019.46.27.422 Color_251ACI
N050.04.51.862 E019.46.27.422 N050.04.52.494 E019.46.32.045 Color_251ACI
N050.04.28.860 E019.46.06.027 N050.04.28.997 E019.46.05.726 Color_251ACI
N050.04.28.997 E019.46.05.726 N050.04.28.433 E019.46.00.710 Color_251ACI
N050.04.28.433 E019.46.00.710 N050.04.28.314 E019.46.00.445 Color_251ACI
N050.04.28.314 E019.46.00.445 N050.04.28.208 E019.45.59.513 Color_251ACI
N050.04.28.208 E019.45.59.513 N050.04.28.282 E019.45.59.221 Color_251ACI
N050.04.28.282 E019.45.59.221 N050.04.27.785 E019.45.54.920 Color_251ACI
N050.04.27.785 E019.45.54.920 N050.04.27.645 E019.45.54.739 Color_251ACI
N050.04.27.645 E019.45.54.739 N050.04.27.583 E019.45.54.123 Color_251ACI
N050.04.27.583 E019.45.54.123 N050.04.27.385 E019.45.54.050 Color_251ACI
N050.04.27.385 E019.45.54.050 N050.04.26.963 E019.45.54.130 Color_251ACI
N050.04.26.963 E019.45.54.130 N050.04.26.935 E019.45.53.872 Color_251ACI
N050.04.26.935 E019.45.53.872 N050.04.27.341 E019.45.53.734 Color_251ACI
N050.04.27.341 E019.45.53.734 N050.04.27.607 E019.45.53.415 Color_251ACI
N050.04.27.607 E019.45.53.415 N050.04.27.424 E019.45.52.051 Color_251ACI
N050.04.49.770 E019.46.11.504 N050.04.49.809 E019.46.11.720 Color_251ACI
N050.04.49.809 E019.46.11.720 N050.04.49.901 E019.46.11.969 Color_251ACI
N050.04.49.901 E019.46.11.969 N050.04.50.003 E019.46.12.176 Color_251ACI
N050.04.50.003 E019.46.12.176 N050.04.50.273 E019.46.12.581 Color_251ACI
N050.04.50.273 E019.46.12.581 N050.04.50.396 E019.46.12.704 Color_251ACI
N050.04.49.893 E019.46.12.494 N050.04.50.248 E019.46.13.048 Color_251ACI
N050.04.50.248 E019.46.13.048 N050.04.50.410 E019.46.13.387 Color_251ACI
N050.04.48.170 E019.45.48.950 N050.04.48.196 E019.45.49.833 Color_251ACI
N050.04.48.196 E019.45.49.833 N050.04.48.221 E019.45.50.716 Color_251ACI
N050.04.48.221 E019.45.50.716 N050.04.48.234 E019.45.51.157 Color_251ACI
N050.04.48.234 E019.45.51.157 N050.04.48.247 E019.45.51.598 Color_251ACI
N050.04.48.247 E019.45.51.598 N050.04.48.273 E019.45.52.481 Color_251ACI
N050.04.48.273 E019.45.52.481 N050.04.48.325 E019.45.53.380 Color_251ACI
N050.04.48.325 E019.45.53.380 N050.04.48.367 E019.45.54.320 Color_251ACI
N050.04.48.367 E019.45.54.320 N050.04.48.409 E019.45.55.261 Color_251ACI
N050.04.48.409 E019.45.55.261 N050.04.48.593 E019.45.57.974 Color_251ACI
N050.04.48.593 E019.45.57.974 N050.04.48.767 E019.46.00.729 Color_251ACI
N050.04.48.767 E019.46.00.729 N050.04.49.133 E019.46.05.673 Color_251ACI
N050.04.49.133 E019.46.05.673 N050.04.49.638 E019.46.10.556 Color_251ACI
N050.04.49.638 E019.46.10.556 N050.04.49.704 E019.46.11.030 Color_251ACI
N050.04.49.704 E019.46.11.030 N050.04.49.770 E019.46.11.504 Color_251ACI
N050.04.05.788 E019.47.57.960 N050.04.05.783 E019.47.58.102 Color_251ACI
N050.04.05.783 E019.47.58.102 N050.04.05.805 E019.47.58.260 Color_251ACI
N050.04.05.805 E019.47.58.260 N050.04.05.817 E019.47.58.460 Color_251ACI
N050.04.05.817 E019.47.58.460 N050.04.05.839 E019.47.58.618 Color_251ACI
N050.04.05.839 E019.47.58.618 N050.04.05.861 E019.47.58.776 Color_251ACI
N050.04.05.861 E019.47.58.776 N050.04.05.910 E019.47.58.950 Color_251ACI
N050.04.05.910 E019.47.58.950 N050.04.05.943 E019.47.59.066 Color_251ACI
N050.04.05.943 E019.47.59.066 N050.04.05.992 E019.47.59.241 Color_251ACI
N050.04.05.987 E019.48.00.490 N050.04.06.035 E019.48.00.423 Color_251ACI
N050.04.06.035 E019.48.00.423 N050.04.05.795 E019.47.59.410 Color_251ACI
N050.04.05.992 E019.47.59.241 N050.04.06.275 E019.48.00.328 Color_251ACI
N050.04.05.542 E019.47.57.955 N050.04.05.564 E019.47.58.113 Color_251ACI
N050.04.05.564 E019.47.58.113 N050.04.05.576 E019.47.58.313 Color_251ACI
N050.04.05.576 E019.47.58.313 N050.04.05.587 E019.47.58.512 Color_251ACI
N050.04.05.587 E019.47.58.512 N050.04.05.599 E019.47.58.712 Color_251ACI
N050.04.05.599 E019.47.58.712 N050.04.05.648 E019.47.58.887 Color_251ACI
N050.04.05.648 E019.47.58.887 N050.04.05.697 E019.47.59.061 Color_251ACI
N050.04.05.697 E019.47.59.061 N050.04.05.746 E019.47.59.235 Color_251ACI
N050.04.05.746 E019.47.59.235 N050.04.05.795 E019.47.59.410 Color_251ACI
N050.04.06.172 E019.47.42.397 N050.04.05.895 E019.47.54.702 Color_251ACI
N050.04.05.895 E019.47.54.702 N050.04.05.788 E019.47.57.960 Color_251ACI
N050.04.05.905 E019.47.42.475 N050.04.05.643 E019.47.54.597 Color_251ACI
N050.04.05.643 E019.47.54.597 N050.04.05.542 E019.47.57.955 Color_251ACI
N050.04.06.582 E019.48.00.708 N050.04.06.565 E019.48.00.650 Color_251ACI
N050.04.06.565 E019.48.00.650 N050.04.06.522 E019.48.00.575 Color_251ACI
N050.04.06.522 E019.48.00.575 N050.04.06.468 E019.48.00.543 Color_251ACI
N050.04.06.468 E019.48.00.543 N050.04.06.452 E019.48.00.485 Color_251ACI
N050.04.06.452 E019.48.00.485 N050.04.06.409 E019.48.00.410 Color_251ACI
N050.04.06.409 E019.48.00.410 N050.04.06.275 E019.48.00.328 Color_251ACI
N050.04.07.648 E019.48.03.477 N050.04.07.286 E019.48.02.582 Color_251ACI
N050.04.07.286 E019.48.02.582 N050.04.07.075 E019.48.02.068 Color_251ACI
N050.04.07.075 E019.48.02.068 N050.04.06.896 E019.48.01.670 Color_251ACI
N050.04.06.896 E019.48.01.670 N050.04.06.647 E019.48.00.940 Color_251ACI
N050.04.06.647 E019.48.00.940 N050.04.06.582 E019.48.00.708 Color_251ACI
N050.04.07.648 E019.48.03.477 N050.04.07.648 E019.48.03.477 Color_251ACI
N050.04.07.648 E019.48.03.477 N050.04.07.755 E019.48.03.543 Color_251ACI
N050.04.07.755 E019.48.03.543 N050.04.07.809 E019.48.03.576 Color_251ACI
N050.04.07.809 E019.48.03.576 N050.04.07.809 E019.48.03.576 Color_251ACI
N050.04.07.809 E019.48.03.576 N050.04.07.846 E019.48.03.550 Color_251ACI
N050.04.07.213 E019.48.03.116 N050.04.07.295 E019.48.03.407 Color_251ACI
N050.04.07.014 E019.48.03.910 N050.04.05.846 E019.48.04.498 Color_251ACI
N050.04.07.284 E019.48.03.448 N050.04.07.290 E019.48.03.548 Color_251ACI
N050.04.07.290 E019.48.03.548 N050.04.07.269 E019.48.03.632 Color_251ACI
N050.04.07.269 E019.48.03.632 N050.04.07.259 E019.48.03.674 Color_251ACI
N050.04.07.259 E019.48.03.674 N050.04.07.227 E019.48.03.799 Color_251ACI
N050.04.07.227 E019.48.03.799 N050.04.07.180 E019.48.03.866 Color_251ACI
N050.04.07.180 E019.48.03.866 N050.04.07.142 E019.48.03.892 Color_251ACI
N050.04.07.142 E019.48.03.892 N050.04.07.068 E019.48.03.942 Color_251ACI
N050.04.07.068 E019.48.03.942 N050.04.07.030 E019.48.03.968 Color_251ACI
N050.04.06.493 E019.48.02.292 N050.04.06.081 E019.48.01.222 Color_251ACI
N050.04.06.326 E019.48.00.986 N050.04.06.690 E019.48.02.123 Color_251ACI
N050.04.06.690 E019.48.02.123 N050.04.06.706 E019.48.02.181 Color_251ACI
N050.04.06.706 E019.48.02.181 N050.04.06.685 E019.48.02.264 Color_251ACI
N050.04.06.685 E019.48.02.264 N050.04.06.675 E019.48.02.306 Color_251ACI
N050.04.06.675 E019.48.02.306 N050.04.06.638 E019.48.02.332 Color_251ACI
N050.04.06.638 E019.48.02.332 N050.04.06.600 E019.48.02.357 Color_251ACI
N050.04.06.600 E019.48.02.357 N050.04.06.563 E019.48.02.382 Color_251ACI
N050.04.06.563 E019.48.02.382 N050.04.06.509 E019.48.02.350 Color_251ACI
N050.04.06.509 E019.48.02.350 N050.04.06.493 E019.48.02.292 Color_251ACI
N050.04.06.081 E019.48.01.222 N050.04.06.038 E019.48.01.147 Color_251ACI
N050.04.06.038 E019.48.01.147 N050.04.06.059 E019.48.01.064 Color_251ACI
N050.04.06.059 E019.48.01.064 N050.04.06.091 E019.48.00.939 Color_251ACI
N050.04.06.091 E019.48.00.939 N050.04.06.128 E019.48.00.913 Color_251ACI
N050.04.06.128 E019.48.00.913 N050.04.06.203 E019.48.00.862 Color_251ACI
N050.04.06.203 E019.48.00.862 N050.04.06.256 E019.48.00.895 Color_251ACI
N050.04.06.256 E019.48.00.895 N050.04.06.310 E019.48.00.928 Color_251ACI
N050.04.06.310 E019.48.00.928 N050.04.06.353 E019.48.01.002 Color_251ACI
N050.04.05.815 E019.48.01.300 N050.04.05.809 E019.48.01.200 Color_251ACI
N050.04.05.809 E019.48.01.200 N050.04.05.803 E019.48.01.100 Color_251ACI
N050.04.05.803 E019.48.01.100 N050.04.05.797 E019.48.01.000 Color_251ACI
N050.04.05.797 E019.48.01.000 N050.04.05.829 E019.48.00.875 Color_251ACI
N050.04.05.829 E019.48.00.875 N050.04.05.881 E019.48.00.666 Color_251ACI
N050.04.05.881 E019.48.00.666 N050.04.05.939 E019.48.00.557 Color_251ACI
N050.04.05.939 E019.48.00.557 N050.04.05.987 E019.48.00.490 Color_251ACI
N050.04.06.613 E019.48.02.798 N050.04.06.559 E019.48.02.766 Color_251ACI
N050.04.06.559 E019.48.02.766 N050.04.06.533 E019.48.02.749 Color_251ACI
N050.04.06.533 E019.48.02.749 N050.04.06.495 E019.48.02.775 Color_251ACI
N050.04.06.495 E019.48.02.775 N050.04.06.469 E019.48.02.758 Color_251ACI
N050.04.06.469 E019.48.02.758 N050.04.06.452 E019.48.02.700 Color_251ACI
N050.04.06.452 E019.48.02.700 N050.04.06.399 E019.48.02.668 Color_251ACI
N050.04.06.399 E019.48.02.668 N050.04.06.372 E019.48.02.651 Color_251ACI
N050.04.06.950 E019.48.02.811 N050.04.06.613 E019.48.02.798 Color_251ACI
N050.04.07.187 E019.48.03.100 N050.04.07.197 E019.48.03.058 Color_251ACI
N050.04.07.197 E019.48.03.058 N050.04.07.154 E019.48.02.983 Color_251ACI
N050.04.07.154 E019.48.02.983 N050.04.07.138 E019.48.02.925 Color_251ACI
N050.04.07.138 E019.48.02.925 N050.04.07.094 E019.48.02.851 Color_251ACI
N050.04.07.094 E019.48.02.851 N050.04.06.987 E019.48.02.786 Color_251ACI
N050.04.06.987 E019.48.02.786 N050.04.06.950 E019.48.02.811 Color_251ACI
N050.04.10.613 E019.48.09.523 N050.04.10.812 E019.48.09.837 Color_251ACI
N050.04.10.812 E019.48.09.837 N050.04.12.078 E019.48.11.813 Color_251ACI
N050.04.12.078 E019.48.11.813 N050.04.13.306 E019.48.13.814 Color_251ACI
N050.04.05.923 E019.48.04.930 N050.04.06.441 E019.48.04.716 Color_251ACI
N050.04.06.441 E019.48.04.716 N050.04.06.969 E019.48.04.460 Color_251ACI
N050.04.06.969 E019.48.04.460 N050.04.07.188 E019.48.04.449 Color_251ACI
N050.04.07.188 E019.48.04.449 N050.04.07.423 E019.48.04.496 Color_251ACI
N050.04.07.423 E019.48.04.496 N050.04.07.638 E019.48.04.627 Color_251ACI
N050.04.07.638 E019.48.04.627 N050.04.07.697 E019.48.04.760 Color_251ACI
N050.04.07.697 E019.48.04.760 N050.04.07.827 E019.48.04.983 Color_251ACI
N050.04.07.827 E019.48.04.983 N050.04.07.983 E019.48.05.223 Color_251ACI
N050.04.07.983 E019.48.05.223 N050.04.08.112 E019.48.05.446 Color_251ACI
N050.04.08.112 E019.48.05.446 N050.04.08.242 E019.48.05.669 Color_251ACI
N050.04.08.242 E019.48.05.669 N050.04.08.404 E019.48.06.009 Color_251ACI
N050.04.08.404 E019.48.06.009 N050.04.08.549 E019.48.06.290 Color_251ACI
N050.04.08.549 E019.48.06.290 N050.04.08.775 E019.48.06.621 Color_251ACI
N050.04.08.775 E019.48.06.621 N050.04.08.991 E019.48.06.993 Color_251ACI
N050.04.08.991 E019.48.06.993 N050.04.09.443 E019.48.07.654 Color_251ACI
N050.04.09.443 E019.48.07.654 N050.04.09.885 E019.48.08.357 Color_251ACI
N050.04.09.885 E019.48.08.357 N050.04.10.128 E019.48.08.746 Color_251ACI
N050.04.10.128 E019.48.08.746 N050.04.10.343 E019.48.09.118 Color_251ACI
N050.04.13.818 E019.48.14.608 N050.04.13.592 E019.48.14.277 Color_251ACI
N050.04.13.592 E019.48.14.277 N050.04.13.518 E019.48.14.570 Color_251ACI
N050.04.13.306 E019.48.13.814 N050.04.13.064 E019.48.14.533 Color_251ACI
N050.04.13.818 E019.48.14.608 N050.04.14.190 E019.48.15.220 Color_251ACI
N050.04.14.190 E019.48.15.220 N050.04.14.562 E019.48.15.832 Color_251ACI
N050.04.14.562 E019.48.15.832 N050.04.15.030 E019.48.16.551 Color_251ACI
N050.04.15.030 E019.48.16.551 N050.04.15.488 E019.48.17.312 Color_251ACI
N050.04.15.715 E019.48.17.643 N050.04.16.081 E019.48.18.155 Color_251ACI
N050.04.16.081 E019.48.18.155 N050.04.16.436 E019.48.18.709 Color_251ACI
N050.04.18.342 E019.48.00.412 N050.04.17.065 E019.48.00.693 Color_251ACI
N050.04.17.065 E019.48.00.693 N050.04.16.959 E019.48.00.869 Color_251ACI
N050.04.16.959 E019.48.00.869 N050.04.16.821 E019.48.00.929 Color_251ACI
N050.04.16.821 E019.48.00.929 N050.04.16.633 E019.48.00.815 Color_251ACI
N050.04.16.633 E019.48.00.815 N050.04.12.191 E019.48.02.008 Color_251ACI
N050.04.12.191 E019.48.02.008 N050.04.11.336 E019.48.02.210 Color_251ACI
N050.04.11.336 E019.48.02.210 N050.04.10.082 E019.48.02.649 Color_251ACI
N050.04.10.082 E019.48.02.649 N050.04.09.484 E019.48.02.815 Color_251ACI
N050.04.09.484 E019.48.02.815 N050.04.09.068 E019.48.02.994 Color_251ACI
N050.04.09.068 E019.48.02.994 N050.04.08.652 E019.48.03.174 Color_251ACI
N050.04.08.652 E019.48.03.174 N050.04.08.252 E019.48.03.412 Color_251ACI
N050.04.08.252 E019.48.03.412 N050.04.07.846 E019.48.03.550 Color_251ACI
N050.04.15.372 E019.48.02.021 N050.04.15.382 E019.48.01.979 Color_251ACI
N050.04.15.382 E019.48.01.979 N050.04.15.366 E019.48.01.921 Color_251ACI
N050.04.15.366 E019.48.01.921 N050.04.15.366 E019.48.01.921 Color_251ACI
N050.04.15.366 E019.48.01.921 N050.04.15.387 E019.48.01.837 Color_251ACI
N050.04.15.387 E019.48.01.837 N050.04.15.333 E019.48.01.805 Color_251ACI
N050.04.15.333 E019.48.01.805 N050.04.15.344 E019.48.01.763 Color_251ACI
N050.04.15.344 E019.48.01.763 N050.04.15.317 E019.48.01.747 Color_251ACI
N050.04.15.317 E019.48.01.747 N050.04.15.301 E019.48.01.688 Color_251ACI
N050.04.15.301 E019.48.01.688 N050.04.15.167 E019.48.01.607 Color_251ACI
N050.04.15.167 E019.48.01.607 N050.04.15.156 E019.48.01.649 Color_251ACI
N050.04.15.156 E019.48.01.649 N050.04.15.102 E019.48.01.616 Color_251ACI
N050.04.15.686 E019.48.01.876 N050.04.15.660 E019.48.01.859 Color_251ACI
N050.04.15.660 E019.48.01.859 N050.04.15.670 E019.48.01.817 Color_251ACI
N050.04.15.670 E019.48.01.817 N050.04.15.681 E019.48.01.776 Color_251ACI
N050.04.15.681 E019.48.01.776 N050.04.15.664 E019.48.01.718 Color_251ACI
N050.04.15.664 E019.48.01.718 N050.04.15.696 E019.48.01.592 Color_251ACI
N050.04.15.696 E019.48.01.592 N050.04.15.733 E019.48.01.567 Color_251ACI
N050.04.15.733 E019.48.01.567 N050.04.15.744 E019.48.01.525 Color_251ACI
N050.04.15.744 E019.48.01.525 N050.04.15.754 E019.48.01.483 Color_251ACI
N050.04.15.754 E019.48.01.483 N050.04.15.791 E019.48.01.458 Color_251ACI
N050.04.15.791 E019.48.01.458 N050.04.15.791 E019.48.01.458 Color_251ACI
N050.04.15.791 E019.48.01.458 N050.04.15.818 E019.48.01.474 Color_251ACI
N050.04.15.818 E019.48.01.474 N050.04.15.855 E019.48.01.449 Color_251ACI
N050.04.15.102 E019.48.01.616 N050.04.14.478 E019.48.01.765 Color_251ACI
N050.04.14.478 E019.48.01.765 N050.04.13.468 E019.48.01.968 Color_251ACI
N050.04.13.468 E019.48.01.968 N050.04.13.148 E019.48.02.014 Color_251ACI
N050.04.13.148 E019.48.02.014 N050.04.12.347 E019.48.02.248 Color_251ACI
N050.04.12.347 E019.48.02.248 N050.04.11.354 E019.48.02.509 Color_251ACI
N050.04.11.354 E019.48.02.509 N050.04.11.279 E019.48.02.560 Color_251ACI
N050.04.16.582 E019.48.01.265 N050.04.15.855 E019.48.01.449 Color_251ACI
N050.04.16.609 E019.48.19.006 N050.04.17.114 E019.48.19.700 Color_251ACI
N050.04.17.114 E019.48.19.700 N050.04.17.583 E019.48.20.419 Color_251ACI
N050.04.17.583 E019.48.20.419 N050.04.17.809 E019.48.20.750 Color_251ACI
N050.04.18.148 E019.48.21.246 N050.04.18.449 E019.48.21.525 Color_251ACI
N050.04.18.449 E019.48.21.525 N050.04.18.739 E019.48.21.847 Color_251ACI
N050.04.18.739 E019.48.21.847 N050.04.19.351 E019.48.22.364 Color_251ACI
N050.04.19.351 E019.48.22.364 N050.04.19.974 E019.48.22.840 Color_251ACI
N050.04.19.974 E019.48.22.840 N050.04.20.215 E019.48.22.987 Color_251ACI
N050.04.20.215 E019.48.22.987 N050.04.20.429 E019.48.23.118 Color_251ACI
N050.04.20.429 E019.48.23.118 N050.04.20.559 E019.48.23.341 Color_251ACI
N050.04.20.559 E019.48.23.341 N050.04.20.667 E019.48.23.648 Color_251ACI
N050.04.20.667 E019.48.23.648 N050.04.20.813 E019.48.23.930 Color_251ACI
N050.04.20.813 E019.48.23.930 N050.04.20.857 E019.48.24.246 Color_251ACI
N050.04.20.857 E019.48.24.246 N050.04.20.811 E019.48.24.554 Color_251ACI
N050.04.20.811 E019.48.24.554 N050.04.20.744 E019.48.25.188 Color_251ACI
N050.04.20.744 E019.48.25.188 N050.04.20.635 E019.48.25.747 Color_251ACI
N050.04.19.173 E019.48.16.427 N050.04.19.434 E019.48.18.465 Color_251ACI
N050.04.19.434 E019.48.18.465 N050.04.19.506 E019.48.19.039 Color_251ACI
N050.04.19.659 E019.48.19.662 N050.04.19.970 E019.48.21.008 Color_251ACI
N050.04.19.835 E019.48.19.577 N050.04.19.510 E019.48.19.764 Color_251ACI
N050.04.19.682 E019.48.18.954 N050.04.19.341 E019.48.19.083 Color_251ACI
N050.04.19.540 E019.48.16.073 N050.04.19.562 E019.48.16.231 Color_251ACI
N050.04.16.669 E019.48.14.949 N050.04.16.739 E019.48.15.040 Color_251ACI
N050.04.16.739 E019.48.15.040 N050.04.16.772 E019.48.15.156 Color_251ACI
N050.04.16.772 E019.48.15.156 N050.04.16.724 E019.48.15.223 Color_251ACI
N050.04.16.724 E019.48.15.223 N050.04.16.435 E019.48.15.144 Color_251ACI
N050.04.16.435 E019.48.15.144 N050.04.16.275 E019.48.16.395 Color_251ACI
N050.04.16.275 E019.48.16.395 N050.04.16.217 E019.48.16.504 Color_251ACI
N050.04.16.217 E019.48.16.504 N050.04.16.116 E019.48.16.538 Color_251ACI
N050.04.16.116 E019.48.16.538 N050.04.15.981 E019.48.16.457 Color_251ACI
N050.04.15.981 E019.48.16.457 N050.04.15.770 E019.48.15.943 Color_251ACI
N050.04.15.770 E019.48.15.943 N050.04.15.858 E019.48.15.225 Color_251ACI
N050.04.15.858 E019.48.15.225 N050.04.15.740 E019.48.15.202 Color_251ACI
N050.04.15.740 E019.48.15.202 N050.04.15.428 E019.48.15.830 Color_251ACI
N050.04.15.428 E019.48.15.830 N050.04.16.047 E019.48.16.689 Color_251ACI
N050.04.16.047 E019.48.16.689 N050.04.16.477 E019.48.17.192 Color_251ACI
N050.04.16.477 E019.48.17.192 N050.04.16.387 E019.48.17.426 Color_251ACI
N050.04.16.387 E019.48.17.426 N050.04.17.281 E019.48.18.790 Color_251ACI
N050.04.17.281 E019.48.18.790 N050.04.18.288 E019.48.20.319 Color_251ACI
N050.04.18.288 E019.48.20.319 N050.04.18.552 E019.48.20.624 Color_251ACI
N050.04.18.552 E019.48.20.624 N050.04.19.530 E019.48.21.654 Color_251ACI
N050.04.19.530 E019.48.21.654 N050.04.19.793 E019.48.21.959 Color_251ACI
N050.04.19.793 E019.48.21.959 N050.04.19.927 E019.48.22.041 Color_251ACI
N050.04.19.927 E019.48.22.041 N050.04.20.045 E019.48.22.064 Color_251ACI
N050.04.20.045 E019.48.22.064 N050.04.20.136 E019.48.22.072 Color_251ACI
N050.04.20.136 E019.48.22.072 N050.04.20.248 E019.48.21.995 Color_251ACI
N050.04.20.248 E019.48.21.995 N050.04.20.322 E019.48.21.945 Color_251ACI
N050.04.20.322 E019.48.21.945 N050.04.20.418 E019.48.21.810 Color_251ACI
N050.04.20.418 E019.48.21.810 N050.04.20.487 E019.48.21.660 Color_251ACI
N050.04.20.487 E019.48.21.660 N050.04.20.560 E019.48.21.367 Color_251ACI
N050.04.20.560 E019.48.21.367 N050.04.20.548 E019.48.21.167 Color_251ACI
N050.04.20.548 E019.48.21.167 N050.04.20.499 E019.48.20.993 Color_251ACI
N050.04.20.499 E019.48.20.993 N050.04.20.238 E019.48.20.063 Color_251ACI
N050.04.20.238 E019.48.20.063 N050.04.20.086 E019.48.19.440 Color_251ACI
N050.04.17.836 E019.48.14.119 N050.04.18.032 E019.48.15.924 Color_251ACI
N050.04.17.513 E019.48.11.466 N050.04.17.769 E019.48.13.645 Color_251ACI
N050.04.17.962 E019.48.13.618 N050.04.18.001 E019.48.14.076 Color_251ACI
N050.04.17.962 E019.48.13.618 N050.04.17.604 E019.48.13.689 Color_251ACI
N050.04.17.604 E019.48.13.689 N050.04.17.670 E019.48.14.163 Color_251ACI
N050.04.17.670 E019.48.14.163 N050.04.18.001 E019.48.14.076 Color_251ACI
N050.04.18.359 E019.48.14.005 N050.04.18.576 E019.48.15.726 Color_251ACI
N050.04.18.019 E019.48.11.052 N050.04.18.293 E019.48.13.531 Color_251ACI
N050.04.18.552 E019.48.13.978 N050.04.18.496 E019.48.13.462 Color_251ACI
N050.04.18.496 E019.48.13.462 N050.04.18.127 E019.48.13.574 Color_251ACI
N050.04.18.127 E019.48.13.574 N050.04.18.194 E019.48.14.048 Color_251ACI
N050.04.18.194 E019.48.14.048 N050.04.18.552 E019.48.13.978 Color_251ACI
N050.04.18.883 E019.48.13.890 N050.04.19.073 E019.48.15.596 Color_251ACI
N050.04.18.547 E019.48.10.796 N050.04.18.815 E019.48.13.175 Color_251ACI
N050.04.18.815 E019.48.13.175 N050.04.18.991 E019.48.13.090 Color_251ACI
N050.04.18.991 E019.48.13.090 N050.04.19.085 E019.48.13.821 Color_251ACI
N050.04.19.085 E019.48.13.821 N050.04.18.754 E019.48.13.909 Color_251ACI
N050.04.18.754 E019.48.13.909 N050.04.18.648 E019.48.12.977 Color_251ACI
N050.04.18.648 E019.48.12.977 N050.04.18.787 E019.48.12.917 Color_251ACI
N050.04.19.419 E019.48.13.110 N050.04.19.216 E019.48.13.179 Color_251ACI
N050.04.19.216 E019.48.13.179 N050.04.19.267 E019.48.13.836 Color_251ACI
N050.04.19.267 E019.48.13.836 N050.04.19.481 E019.48.13.725 Color_251ACI
N050.04.19.506 E019.48.15.716 N050.04.19.474 E019.48.15.599 Color_251ACI
N050.04.19.474 E019.48.15.599 N050.04.19.435 E019.48.15.383 Color_251ACI
N050.04.19.435 E019.48.15.383 N050.04.19.665 E019.48.15.331 Color_251ACI
N050.04.19.061 E019.48.09.857 N050.04.19.029 E019.48.09.982 Color_251ACI
N050.04.19.029 E019.48.09.982 N050.04.19.003 E019.48.09.966 Color_251ACI
N050.04.19.003 E019.48.09.966 N050.04.18.982 E019.48.10.049 Color_251ACI
N050.04.18.982 E019.48.10.049 N050.04.18.928 E019.48.10.017 Color_251ACI
N050.04.18.928 E019.48.10.017 N050.04.18.891 E019.48.10.042 Color_251ACI
N050.04.18.891 E019.48.10.042 N050.04.18.837 E019.48.10.010 Color_251ACI
N050.04.18.922 E019.48.08.809 N050.04.18.837 E019.48.08.902 Color_251ACI
N050.04.18.837 E019.48.08.902 N050.04.18.937 E019.48.09.734 Color_251ACI
N050.04.18.937 E019.48.09.734 N050.04.18.799 E019.48.09.793 Color_251ACI
N050.04.18.799 E019.48.09.793 N050.04.18.837 E019.48.10.010 Color_251ACI
N050.04.18.867 E019.48.08.535 N050.04.18.782 E019.48.08.628 Color_251ACI
N050.04.18.782 E019.48.08.628 N050.04.18.759 E019.48.08.228 Color_251ACI
N050.04.18.759 E019.48.08.228 N050.04.18.593 E019.48.08.272 Color_251ACI
N050.04.18.593 E019.48.08.272 N050.04.18.566 E019.48.08.014 Color_251ACI
N050.04.18.823 E019.48.08.219 N050.04.18.867 E019.48.08.535 Color_251ACI
N050.04.18.930 E019.48.10.500 N050.04.18.975 E019.48.10.816 Color_251ACI
N050.04.18.975 E019.48.10.816 N050.04.19.167 E019.48.10.789 Color_251ACI
N050.04.18.922 E019.48.08.809 N050.04.19.061 E019.48.09.857 Color_251ACI
N050.04.18.566 E019.48.08.014 N050.04.18.576 E019.48.07.972 Color_251ACI
N050.04.18.576 E019.48.07.972 N050.04.18.613 E019.48.07.947 Color_251ACI
N050.04.18.613 E019.48.07.947 N050.04.18.667 E019.48.07.979 Color_251ACI
N050.04.18.667 E019.48.07.979 N050.04.18.747 E019.48.08.028 Color_251ACI
N050.04.18.747 E019.48.08.028 N050.04.18.774 E019.48.08.045 Color_251ACI
N050.04.18.774 E019.48.08.045 N050.04.18.817 E019.48.08.119 Color_251ACI
N050.04.18.817 E019.48.08.119 N050.04.18.834 E019.48.08.177 Color_251ACI
N050.04.18.262 E019.48.08.359 N050.04.18.236 E019.48.08.342 Color_251ACI
N050.04.18.236 E019.48.08.342 N050.04.18.219 E019.48.08.284 Color_251ACI
N050.04.18.219 E019.48.08.284 N050.04.18.085 E019.48.08.203 Color_251ACI
N050.04.18.085 E019.48.08.203 N050.04.18.048 E019.48.08.228 Color_251ACI
N050.04.18.751 E019.48.07.645 N050.04.18.697 E019.48.07.612 Color_251ACI
N050.04.18.697 E019.48.07.612 N050.04.18.633 E019.48.07.621 Color_251ACI
N050.04.18.633 E019.48.07.621 N050.04.18.526 E019.48.07.556 Color_251ACI
N050.04.18.526 E019.48.07.556 N050.04.18.510 E019.48.07.498 Color_251ACI
N050.04.18.510 E019.48.07.498 N050.04.18.466 E019.48.07.423 Color_251ACI
N050.04.18.466 E019.48.07.423 N050.04.18.450 E019.48.07.365 Color_251ACI
N050.04.18.450 E019.48.07.365 N050.04.18.471 E019.48.07.282 Color_251ACI
N050.04.17.823 E019.48.02.600 N050.04.17.873 E019.48.03.016 Color_251ACI
N050.04.17.873 E019.48.03.016 N050.04.18.039 E019.48.02.972 Color_251ACI
N050.04.18.039 E019.48.02.972 N050.04.18.205 E019.48.04.278 Color_251ACI
N050.04.18.205 E019.48.04.278 N050.04.18.040 E019.48.04.322 Color_251ACI
N050.04.18.040 E019.48.04.322 N050.04.18.111 E019.48.04.654 Color_251ACI
N050.04.18.111 E019.48.04.654 N050.04.18.250 E019.48.04.594 Color_251ACI
N050.04.18.250 E019.48.04.594 N050.04.18.610 E019.48.07.222 Color_251ACI
N050.04.18.610 E019.48.07.222 N050.04.18.471 E019.48.07.282 Color_251ACI
N050.04.18.035 E019.48.02.248 N050.04.18.008 E019.48.02.231 Color_251ACI
N050.04.18.008 E019.48.02.231 N050.04.17.971 E019.48.02.257 Color_251ACI
N050.04.17.971 E019.48.02.257 N050.04.17.923 E019.48.02.324 Color_251ACI
N050.04.17.923 E019.48.02.324 N050.04.17.886 E019.48.02.349 Color_251ACI
N050.04.17.886 E019.48.02.349 N050.04.17.865 E019.48.02.433 Color_251ACI
N050.04.17.865 E019.48.02.433 N050.04.17.854 E019.48.02.475 Color_251ACI
N050.04.17.854 E019.48.02.475 N050.04.17.817 E019.48.02.500 Color_251ACI
N050.04.17.817 E019.48.02.500 N050.04.17.823 E019.48.02.600 Color_251ACI
N050.04.18.062 E019.48.02.264 N050.04.18.735 E019.48.07.587 Color_251ACI
N050.04.16.788 E019.48.08.568 N050.04.18.048 E019.48.08.228 Color_251ACI
N050.04.16.203 E019.48.08.066 N050.04.16.325 E019.48.09.056 Color_251ACI
N050.04.16.325 E019.48.09.056 N050.04.16.667 E019.48.08.927 Color_251ACI
N050.04.16.667 E019.48.08.927 N050.04.16.667 E019.48.08.927 Color_251ACI
N050.04.16.667 E019.48.08.927 N050.04.16.661 E019.48.08.827 Color_251ACI
N050.04.16.661 E019.48.08.827 N050.04.16.703 E019.48.08.660 Color_251ACI
N050.04.16.703 E019.48.08.660 N050.04.16.740 E019.48.08.635 Color_251ACI
N050.04.16.740 E019.48.08.635 N050.04.16.777 E019.48.08.609 Color_251ACI
N050.04.16.777 E019.48.08.609 N050.04.16.788 E019.48.08.568 Color_251ACI
N050.04.16.744 E019.48.08.252 N050.04.16.690 E019.48.08.219 Color_251ACI
N050.04.16.690 E019.48.08.219 N050.04.16.653 E019.48.08.244 Color_251ACI
N050.04.16.653 E019.48.08.244 N050.04.16.626 E019.48.08.228 Color_251ACI
N050.04.16.626 E019.48.08.228 N050.04.16.610 E019.48.08.170 Color_251ACI
N050.04.16.610 E019.48.08.170 N050.04.16.583 E019.48.08.154 Color_251ACI
N050.04.16.583 E019.48.08.154 N050.04.16.540 E019.48.08.079 Color_251ACI
N050.04.16.540 E019.48.08.079 N050.04.16.550 E019.48.08.037 Color_251ACI
N050.04.16.550 E019.48.08.037 N050.04.16.534 E019.48.07.979 Color_251ACI
N050.04.17.709 E019.48.02.193 N050.04.17.442 E019.48.02.271 Color_251ACI
N050.04.17.442 E019.48.02.271 N050.04.17.736 E019.48.04.425 Color_251ACI
N050.04.17.736 E019.48.04.425 N050.04.17.901 E019.48.04.382 Color_251ACI
N050.04.17.901 E019.48.04.382 N050.04.17.945 E019.48.04.698 Color_251ACI
N050.04.17.945 E019.48.04.698 N050.04.17.780 E019.48.04.741 Color_251ACI
N050.04.17.780 E019.48.04.741 N050.04.18.124 E019.48.07.311 Color_251ACI
N050.04.18.124 E019.48.07.311 N050.04.18.289 E019.48.07.267 Color_251ACI
N050.04.18.289 E019.48.07.267 N050.04.18.366 E019.48.07.700 Color_251ACI
N050.04.18.366 E019.48.07.700 N050.04.16.744 E019.48.08.252 Color_251ACI
N050.04.17.914 E019.48.01.500 N050.04.17.947 E019.48.01.616 Color_251ACI
N050.04.17.947 E019.48.01.616 N050.04.17.952 E019.48.01.716 Color_251ACI
N050.04.17.952 E019.48.01.716 N050.04.17.879 E019.48.02.008 Color_251ACI
N050.04.17.879 E019.48.02.008 N050.04.17.831 E019.48.02.075 Color_251ACI
N050.04.17.831 E019.48.02.075 N050.04.17.757 E019.48.02.126 Color_251ACI
N050.04.17.757 E019.48.02.126 N050.04.17.709 E019.48.02.193 Color_251ACI
N050.04.17.537 E019.48.01.029 N050.04.17.602 E019.48.01.020 Color_251ACI
N050.04.17.602 E019.48.01.020 N050.04.17.655 E019.48.01.053 Color_251ACI
N050.04.17.655 E019.48.01.053 N050.04.17.736 E019.48.01.102 Color_251ACI
N050.04.17.736 E019.48.01.102 N050.04.17.789 E019.48.01.135 Color_251ACI
N050.04.17.789 E019.48.01.135 N050.04.17.859 E019.48.01.225 Color_251ACI
N050.04.17.859 E019.48.01.225 N050.04.17.865 E019.48.01.325 Color_251ACI
N050.04.17.865 E019.48.01.325 N050.04.17.908 E019.48.01.400 Color_251ACI
N050.04.17.908 E019.48.01.400 N050.04.17.914 E019.48.01.500 Color_251ACI
N050.04.26.233 E019.48.24.874 N050.04.26.142 E019.48.24.867 Color_251ACI
N050.04.26.142 E019.48.24.867 N050.04.26.067 E019.48.24.917 Color_251ACI
N050.04.26.067 E019.48.24.917 N050.04.25.982 E019.48.25.010 Color_251ACI
N050.04.25.982 E019.48.25.010 N050.04.25.961 E019.48.25.094 Color_251ACI
N050.04.25.961 E019.48.25.094 N050.04.25.930 E019.48.25.219 Color_251ACI
N050.04.25.930 E019.48.25.219 N050.04.25.925 E019.48.25.361 Color_251ACI
N050.04.25.925 E019.48.25.361 N050.04.25.958 E019.48.25.477 Color_251ACI
N050.04.25.958 E019.48.25.477 N050.04.25.990 E019.48.25.593 Color_251ACI
N050.04.27.985 E019.48.25.653 N050.04.26.206 E019.48.24.857 Color_251ACI
N050.05.15.119 E019.48.28.481 N050.05.14.894 E019.48.28.392 Color_251ACI
N050.05.14.894 E019.48.28.392 N050.05.14.680 E019.48.28.261 Color_251ACI
N050.05.14.680 E019.48.28.261 N050.05.14.439 E019.48.28.114 Color_251ACI
N050.05.14.439 E019.48.28.114 N050.05.14.214 E019.48.28.025 Color_251ACI
N050.05.14.214 E019.48.28.025 N050.05.13.599 E019.48.27.891 Color_251ACI
N050.05.13.599 E019.48.27.891 N050.05.12.962 E019.48.27.840 Color_251ACI
N050.05.12.962 E019.48.27.840 N050.05.12.444 E019.48.27.813 Color_251ACI
N050.05.12.444 E019.48.27.813 N050.05.11.942 E019.48.27.844 Color_251ACI
N050.05.11.942 E019.48.27.844 N050.05.11.408 E019.48.28.000 Color_251ACI
N050.05.11.408 E019.48.28.000 N050.05.10.826 E019.48.28.223 Color_251ACI
N050.05.10.826 E019.48.28.223 N050.05.10.245 E019.48.28.447 Color_251ACI
N050.05.10.245 E019.48.28.447 N050.05.09.680 E019.48.28.728 Color_251ACI
N050.05.09.680 E019.48.28.728 N050.05.08.881 E019.48.29.204 Color_251ACI
N050.05.08.881 E019.48.29.204 N050.05.08.124 E019.48.29.754 Color_251ACI
N050.05.08.124 E019.48.29.754 N050.05.07.890 E019.48.29.949 Color_251ACI
N050.05.07.890 E019.48.29.949 N050.05.07.666 E019.48.30.101 Color_251ACI
N050.04.29.248 E019.48.27.146 N050.04.25.964 E019.48.25.577 Color_251ACI
N050.04.25.444 E019.48.25.308 N050.04.25.508 E019.48.25.299 Color_251ACI
N050.04.25.508 E019.48.25.299 N050.04.25.572 E019.48.25.290 Color_251ACI
N050.04.25.572 E019.48.25.290 N050.04.25.620 E019.48.25.222 Color_251ACI
N050.04.25.620 E019.48.25.222 N050.04.25.662 E019.48.25.055 Color_251ACI
N050.04.25.444 E019.48.25.308 N050.04.23.944 E019.48.24.634 Color_251ACI
N050.04.21.081 E019.46.54.603 N050.04.21.210 E019.46.54.585 Color_251ACI
N050.04.21.210 E019.46.54.585 N050.04.21.189 E019.46.52.453 Color_251ACI
N050.04.21.189 E019.46.52.453 N050.04.21.332 E019.46.52.251 Color_251ACI
N050.04.19.956 E019.48.38.049 N050.04.19.777 E019.48.37.410 Color_251ACI
N050.04.19.777 E019.48.37.410 N050.04.19.608 E019.48.36.729 Color_251ACI
N050.04.19.608 E019.48.36.729 N050.04.19.433 E019.48.35.948 Color_251ACI
N050.04.19.433 E019.48.35.948 N050.04.19.322 E019.48.35.158 Color_251ACI
N050.04.19.322 E019.48.35.158 N050.04.19.259 E019.48.34.301 Color_251ACI
N050.04.19.259 E019.48.34.301 N050.04.19.325 E019.48.33.426 Color_251ACI
N050.04.19.325 E019.48.33.426 N050.04.19.464 E019.48.32.500 Color_251ACI
N050.04.19.464 E019.48.32.500 N050.04.19.642 E019.48.31.548 Color_251ACI
N050.04.19.642 E019.48.31.548 N050.04.19.967 E019.48.30.253 Color_251ACI
N050.04.19.967 E019.48.30.253 N050.04.20.319 E019.48.28.975 Color_251ACI
N050.04.20.403 E019.48.28.640 N050.04.20.523 E019.48.28.039 Color_251ACI
N050.04.20.523 E019.48.28.039 N050.04.20.670 E019.48.27.455 Color_251ACI
N050.04.20.670 E019.48.27.455 N050.04.20.963 E019.48.26.285 Color_251ACI
N050.04.20.963 E019.48.26.285 N050.04.21.241 E019.48.25.057 Color_251ACI
N050.04.20.292 E019.48.28.958 N050.04.20.453 E019.48.29.056 Color_251ACI
N050.04.20.376 E019.48.28.624 N050.04.20.526 E019.48.28.764 Color_251ACI
N050.04.16.582 E019.48.01.265 N050.04.17.537 E019.48.01.029 Color_251ACI
N050.04.17.239 E019.48.08.987 N050.04.17.476 E019.48.10.384 Color_251ACI
N050.04.17.476 E019.48.10.384 N050.04.17.614 E019.48.10.324 Color_251ACI
N050.04.17.614 E019.48.10.324 N050.04.17.631 E019.48.10.382 Color_251ACI
N050.04.17.631 E019.48.10.382 N050.04.17.589 E019.48.10.549 Color_251ACI
N050.04.17.589 E019.48.10.549 N050.04.17.541 E019.48.10.616 Color_251ACI
N050.04.17.541 E019.48.10.616 N050.04.17.477 E019.48.10.625 Color_251ACI
N050.04.17.477 E019.48.10.625 N050.04.17.194 E019.48.10.645 Color_251ACI
N050.04.17.194 E019.48.10.645 N050.04.17.112 E019.48.11.462 Color_251ACI
N050.04.17.112 E019.48.11.462 N050.04.17.097 E019.48.11.646 Color_251ACI
N050.04.17.097 E019.48.11.646 N050.04.17.119 E019.48.11.804 Color_251ACI
N050.04.17.119 E019.48.11.804 N050.04.17.163 E019.48.12.120 Color_251ACI
N050.04.17.163 E019.48.12.120 N050.04.17.230 E019.48.12.594 Color_251ACI
N050.04.17.230 E019.48.12.594 N050.04.17.069 E019.48.12.496 Color_251ACI
N050.04.17.069 E019.48.12.496 N050.04.16.861 E019.48.13.814 Color_251ACI
N050.04.16.861 E019.48.13.814 N050.04.16.747 E019.48.14.515 Color_251ACI
N050.04.14.918 E019.48.15.520 N050.04.16.184 E019.48.17.495 Color_251ACI
N050.04.16.184 E019.48.17.495 N050.04.17.466 E019.48.19.529 Color_251ACI
N050.04.17.466 E019.48.19.529 N050.04.18.064 E019.48.20.472 Color_251ACI
N050.04.18.064 E019.48.20.472 N050.04.18.694 E019.48.21.289 Color_251ACI
N050.04.18.694 E019.48.21.289 N050.04.18.968 E019.48.21.552 Color_251ACI
N050.04.11.354 E019.48.02.509 N050.04.10.911 E019.48.02.673 Color_251ACI
N050.04.10.911 E019.48.02.673 N050.04.10.489 E019.48.02.753 Color_251ACI
N050.04.10.489 E019.48.02.753 N050.04.10.276 E019.48.02.864 Color_251ACI
N050.04.10.276 E019.48.02.864 N050.04.10.073 E019.48.02.933 Color_251ACI
N050.04.10.073 E019.48.02.933 N050.04.09.352 E019.48.03.216 Color_251ACI
N050.04.09.352 E019.48.03.216 N050.04.08.659 E019.48.03.516 Color_251ACI
N050.04.08.659 E019.48.03.516 N050.04.08.392 E019.48.03.594 Color_251ACI
N050.04.08.392 E019.48.03.594 N050.04.08.179 E019.48.03.704 Color_251ACI
N050.04.08.179 E019.48.03.704 N050.04.08.056 E019.48.03.822 Color_251ACI
N050.04.08.056 E019.48.03.822 N050.04.07.987 E019.48.03.973 Color_251ACI
N050.04.07.987 E019.48.03.973 N050.04.07.956 E019.48.04.099 Color_251ACI
N050.04.07.956 E019.48.04.099 N050.04.07.984 E019.48.04.356 Color_251ACI
N050.04.07.984 E019.48.04.356 N050.04.08.130 E019.48.04.638 Color_251ACI
N050.04.08.130 E019.48.04.638 N050.04.08.275 E019.48.04.919 Color_251ACI
N050.04.08.275 E019.48.04.919 N050.04.08.577 E019.48.05.441 Color_251ACI
N050.04.08.577 E019.48.05.441 N050.04.08.879 E019.48.05.962 Color_251ACI
N050.04.08.879 E019.48.05.962 N050.04.09.078 E019.48.06.276 Color_251ACI
N050.04.09.078 E019.48.06.276 N050.04.09.294 E019.48.06.648 Color_251ACI
N050.04.09.294 E019.48.06.648 N050.04.09.504 E019.48.06.921 Color_251ACI
N050.04.09.504 E019.48.06.921 N050.04.09.676 E019.48.07.218 Color_251ACI
N050.04.09.676 E019.48.07.218 N050.04.09.849 E019.48.07.516 Color_251ACI
N050.04.09.849 E019.48.07.516 N050.04.10.032 E019.48.07.772 Color_251ACI
N050.04.10.032 E019.48.07.772 N050.04.10.571 E019.48.08.582 Color_251ACI
N050.04.10.571 E019.48.08.582 N050.04.11.072 E019.48.09.418 Color_251ACI
N050.04.11.072 E019.48.09.418 N050.04.12.736 E019.48.12.022 Color_251ACI
N050.04.12.736 E019.48.12.022 N050.04.14.390 E019.48.14.668 Color_251ACI
N050.04.14.390 E019.48.14.668 N050.04.14.578 E019.48.14.782 Color_251ACI
N050.04.14.578 E019.48.14.782 N050.04.14.632 E019.48.14.815 Color_251ACI
N050.04.14.632 E019.48.14.815 N050.04.14.696 E019.48.14.806 Color_251ACI
N050.04.14.696 E019.48.14.806 N050.04.14.749 E019.48.14.839 Color_251ACI
N050.04.14.749 E019.48.14.839 N050.04.14.813 E019.48.14.829 Color_251ACI
N050.04.16.747 E019.48.14.515 N050.04.14.787 E019.48.14.813 Color_251ACI
N050.04.14.981 E019.48.15.269 N050.04.16.669 E019.48.14.949 Color_251ACI
N050.04.18.968 E019.48.21.552 N050.04.19.145 E019.48.21.709 Color_251ACI
N050.04.19.145 E019.48.21.709 N050.04.19.376 E019.48.21.897 Color_251ACI
N050.04.19.376 E019.48.21.897 N050.04.19.644 E019.48.22.061 Color_251ACI
N050.04.19.644 E019.48.22.061 N050.04.19.939 E019.48.22.241 Color_251ACI
N050.04.19.939 E019.48.22.241 N050.04.20.083 E019.48.22.281 Color_251ACI
N050.04.20.083 E019.48.22.281 N050.04.20.238 E019.48.22.279 Color_251ACI
N050.04.20.238 E019.48.22.279 N050.04.20.462 E019.48.22.126 Color_251ACI
N050.04.20.462 E019.48.22.126 N050.04.20.589 E019.48.21.867 Color_251ACI
N050.04.20.589 E019.48.21.867 N050.04.20.673 E019.48.21.532 Color_251ACI
N050.04.20.673 E019.48.21.532 N050.04.20.671 E019.48.21.049 Color_251ACI
N050.04.20.671 E019.48.21.049 N050.04.20.453 E019.48.20.194 Color_251ACI
N050.04.20.453 E019.48.20.194 N050.04.20.208 E019.48.19.322 Color_251ACI
N050.04.20.086 E019.48.19.440 N050.04.20.086 E019.48.19.440 Color_251ACI
N050.04.20.086 E019.48.19.440 N050.04.20.117 E019.48.19.315 Color_251ACI
N050.04.20.117 E019.48.19.315 N050.04.20.128 E019.48.19.273 Color_251ACI
N050.04.20.128 E019.48.19.273 N050.04.20.208 E019.48.19.322 Color_251ACI
N050.04.20.115 E019.48.18.832 N050.04.20.038 E019.48.18.400 Color_251ACI
N050.04.20.038 E019.48.18.400 N050.04.19.971 E019.48.17.926 Color_251ACI
N050.04.19.971 E019.48.17.926 N050.04.19.915 E019.48.17.410 Color_251ACI
N050.04.19.915 E019.48.17.410 N050.04.19.843 E019.48.16.836 Color_251ACI
N050.04.19.843 E019.48.16.836 N050.04.19.787 E019.48.16.320 Color_251ACI
N050.04.19.787 E019.48.16.320 N050.04.19.754 E019.48.16.204 Color_251ACI
N050.04.19.754 E019.48.16.204 N050.04.19.685 E019.48.16.113 Color_251ACI
N050.04.19.685 E019.48.16.113 N050.04.19.658 E019.48.16.097 Color_251ACI
N050.04.19.658 E019.48.16.097 N050.04.19.594 E019.48.16.106 Color_251ACI
N050.04.19.594 E019.48.16.106 N050.04.19.540 E019.48.16.073 Color_251ACI
N050.04.19.976 E019.48.18.892 N050.04.19.949 E019.48.18.876 Color_251ACI
N050.04.19.949 E019.48.18.876 N050.04.19.893 E019.48.18.360 Color_251ACI
N050.04.19.893 E019.48.18.360 N050.04.19.821 E019.48.17.786 Color_251ACI
N050.04.19.821 E019.48.17.786 N050.04.19.704 E019.48.16.896 Color_251ACI
N050.04.19.704 E019.48.16.896 N050.04.19.648 E019.48.16.380 Color_251ACI
N050.04.19.648 E019.48.16.380 N050.04.19.653 E019.48.16.239 Color_251ACI
N050.04.23.041 E019.47.18.435 N050.04.23.321 E019.47.19.906 Color_251ACI
N050.04.23.321 E019.47.19.906 N050.04.23.780 E019.47.19.801 Color_251ACI
N050.04.23.780 E019.47.19.801 N050.04.24.077 E019.47.21.572 Color_251ACI
N050.04.24.077 E019.47.21.572 N050.04.25.011 E019.47.21.177 Color_251ACI
N050.04.22.705 E019.47.18.664 N050.04.23.589 E019.47.24.501 Color_251ACI
N050.04.24.980 E019.47.10.466 N050.04.26.030 E019.47.09.854 Color_251ACI
N050.04.24.898 E019.47.08.826 N050.04.26.175 E019.47.08.787 Color_251ACI
N050.04.24.684 E019.47.11.153 N050.04.24.726 E019.47.10.986 Color_251ACI
N050.04.24.726 E019.47.10.986 N050.04.24.747 E019.47.10.902 Color_251ACI
N050.04.24.747 E019.47.10.902 N050.04.24.779 E019.47.10.777 Color_251ACI
N050.04.24.980 E019.47.10.466 N050.04.24.933 E019.47.10.534 Color_251ACI
N050.04.24.933 E019.47.10.534 N050.04.24.933 E019.47.10.534 Color_251ACI
N050.04.24.933 E019.47.10.534 N050.04.24.895 E019.47.10.559 Color_251ACI
N050.04.24.895 E019.47.10.559 N050.04.24.847 E019.47.10.626 Color_251ACI
N050.04.24.847 E019.47.10.626 N050.04.24.837 E019.47.10.668 Color_251ACI
N050.04.24.837 E019.47.10.668 N050.04.24.800 E019.47.10.693 Color_251ACI
N050.04.24.800 E019.47.10.693 N050.04.24.789 E019.47.10.735 Color_251ACI
N050.04.24.789 E019.47.10.735 N050.04.24.779 E019.47.10.777 Color_251ACI
N050.04.24.180 E019.47.11.808 N050.04.24.281 E019.47.11.774 Color_251ACI
N050.04.24.281 E019.47.11.774 N050.04.24.345 E019.47.11.765 Color_251ACI
N050.04.24.345 E019.47.11.765 N050.04.24.430 E019.47.11.672 Color_251ACI
N050.04.24.430 E019.47.11.672 N050.04.24.505 E019.47.11.621 Color_251ACI
N050.04.24.505 E019.47.11.621 N050.04.24.563 E019.47.11.512 Color_251ACI
N050.04.24.563 E019.47.11.512 N050.04.24.621 E019.47.11.403 Color_251ACI
N050.04.24.621 E019.47.11.403 N050.04.24.653 E019.47.11.278 Color_251ACI
N050.04.24.653 E019.47.11.278 N050.04.24.684 E019.47.11.153 Color_251ACI
N050.04.22.824 E019.47.12.282 N050.04.24.180 E019.47.11.808 Color_251ACI
N050.04.21.968 E019.47.11.135 N050.04.21.996 E019.47.11.393 Color_251ACI
N050.04.21.765 E019.47.10.962 N050.04.21.775 E019.47.10.920 Color_251ACI
N050.04.21.775 E019.47.10.920 N050.04.21.802 E019.47.10.937 Color_251ACI
N050.04.21.802 E019.47.10.937 N050.04.21.909 E019.47.11.002 Color_251ACI
N050.04.21.909 E019.47.11.002 N050.04.21.936 E019.47.11.019 Color_251ACI
N050.04.21.936 E019.47.11.019 N050.04.21.952 E019.47.11.077 Color_251ACI
N050.04.21.952 E019.47.11.077 N050.04.21.968 E019.47.11.135 Color_251ACI
N050.04.24.397 E019.47.08.233 N050.04.24.430 E019.47.08.349 Color_251ACI
N050.04.24.430 E019.47.08.349 N050.04.24.463 E019.47.08.465 Color_251ACI
N050.04.24.463 E019.47.08.465 N050.04.24.533 E019.47.08.556 Color_251ACI
N050.04.24.533 E019.47.08.556 N050.04.24.603 E019.47.08.647 Color_251ACI
N050.04.24.603 E019.47.08.647 N050.04.24.673 E019.47.08.738 Color_251ACI
N050.04.24.673 E019.47.08.738 N050.04.24.807 E019.47.08.819 Color_251ACI
N050.04.24.807 E019.47.08.819 N050.04.24.898 E019.47.08.826 Color_251ACI
N050.04.24.253 E019.47.07.085 N050.04.24.397 E019.47.08.233 Color_251ACI
N050.04.21.568 E019.47.11.131 N050.04.22.252 E019.47.15.546 Color_251ACI
N050.04.22.252 E019.47.15.546 N050.04.22.584 E019.47.17.916 Color_251ACI
N050.04.22.474 E019.47.11.828 N050.04.23.221 E019.47.11.562 Color_251ACI
N050.04.22.561 E019.47.11.977 N050.04.22.534 E019.47.11.961 Color_251ACI
N050.04.22.534 E019.47.11.961 N050.04.22.534 E019.47.11.961 Color_251ACI
N050.04.22.534 E019.47.11.961 N050.04.22.507 E019.47.11.945 Color_251ACI
N050.04.22.507 E019.47.11.945 N050.04.22.480 E019.47.11.928 Color_251ACI
N050.04.22.480 E019.47.11.928 N050.04.22.491 E019.47.11.887 Color_251ACI
N050.04.22.491 E019.47.11.887 N050.04.22.464 E019.47.11.870 Color_251ACI
N050.04.22.464 E019.47.11.870 N050.04.22.474 E019.47.11.828 Color_251ACI
N050.04.22.474 E019.47.11.828 N050.04.22.448 E019.47.11.812 Color_251ACI
N050.04.22.753 E019.47.11.950 N050.04.22.742 E019.47.11.992 Color_251ACI
N050.04.22.742 E019.47.11.992 N050.04.22.716 E019.47.11.976 Color_251ACI
N050.04.22.716 E019.47.11.976 N050.04.22.689 E019.47.11.959 Color_251ACI
N050.04.22.689 E019.47.11.959 N050.04.22.652 E019.47.11.985 Color_251ACI
N050.04.22.652 E019.47.11.985 N050.04.22.625 E019.47.11.968 Color_251ACI
N050.04.22.625 E019.47.11.968 N050.04.22.587 E019.47.11.994 Color_251ACI
N050.04.22.587 E019.47.11.994 N050.04.22.561 E019.47.11.977 Color_251ACI
N050.04.24.135 E019.47.11.492 N050.04.22.780 E019.47.11.967 Color_251ACI
N050.04.24.543 E019.47.10.730 N050.04.24.539 E019.47.10.871 Color_251ACI
N050.04.24.539 E019.47.10.871 N050.04.24.476 E019.47.11.122 Color_251ACI
N050.04.24.476 E019.47.11.122 N050.04.24.417 E019.47.11.231 Color_251ACI
N050.04.24.417 E019.47.11.231 N050.04.24.359 E019.47.11.340 Color_251ACI
N050.04.24.359 E019.47.11.340 N050.04.24.311 E019.47.11.407 Color_251ACI
N050.04.24.311 E019.47.11.407 N050.04.24.237 E019.47.11.458 Color_251ACI
N050.04.24.237 E019.47.11.458 N050.04.24.135 E019.47.11.492 Color_251ACI
N050.04.24.239 E019.47.10.833 N050.04.24.543 E019.47.10.730 Color_251ACI
N050.04.24.273 E019.47.11.191 N050.04.24.239 E019.47.10.833 Color_251ACI
N050.04.24.107 E019.47.11.235 N050.04.24.273 E019.47.11.191 Color_251ACI
N050.04.21.160 E019.47.08.571 N050.04.21.436 E019.47.10.425 Color_251ACI
N050.04.24.253 E019.47.07.085 N050.04.25.223 E019.47.06.424 Color_251ACI
N050.04.25.223 E019.47.06.424 N050.04.25.351 E019.47.06.406 Color_251ACI
N050.04.25.351 E019.47.06.406 N050.04.25.469 E019.47.06.429 Color_251ACI
N050.04.25.469 E019.47.06.429 N050.04.25.576 E019.47.06.495 Color_251ACI
N050.04.21.027 E019.48.20.737 N050.04.20.811 E019.48.20.123 Color_251ACI
N050.04.20.811 E019.48.20.123 N050.04.20.631 E019.48.19.484 Color_251ACI
N050.04.20.631 E019.48.19.484 N050.04.20.549 E019.48.19.193 Color_251ACI
N050.04.20.549 E019.48.19.193 N050.04.20.468 E019.48.18.903 Color_251ACI
N050.04.20.468 E019.48.18.903 N050.04.20.347 E019.48.18.155 Color_251ACI
N050.04.20.347 E019.48.18.155 N050.04.20.252 E019.48.17.423 Color_251ACI
N050.04.20.252 E019.48.17.423 N050.04.20.186 E019.48.16.949 Color_251ACI
N050.04.20.186 E019.48.16.949 N050.04.20.136 E019.48.16.533 Color_251ACI
N050.04.20.136 E019.48.16.533 N050.04.20.145 E019.48.16.249 Color_251ACI
N050.04.20.145 E019.48.16.249 N050.04.20.224 E019.48.16.057 Color_251ACI
N050.04.20.224 E019.48.16.057 N050.04.20.330 E019.48.15.881 Color_251ACI
N050.04.20.330 E019.48.15.881 N050.04.20.736 E019.48.15.743 Color_251ACI
N050.04.20.736 E019.48.15.743 N050.04.21.168 E019.48.15.621 Color_251ACI
N050.04.21.168 E019.48.15.621 N050.04.21.398 E019.48.15.568 Color_251ACI
N050.04.21.398 E019.48.15.568 N050.04.21.505 E019.48.15.634 Color_251ACI
N050.04.21.505 E019.48.15.634 N050.04.21.548 E019.48.15.708 Color_251ACI
N050.04.21.548 E019.48.15.708 N050.04.21.554 E019.48.15.808 Color_251ACI
N050.04.21.554 E019.48.15.808 N050.04.21.544 E019.48.15.850 Color_251ACI
N050.04.21.544 E019.48.15.850 N050.04.21.512 E019.48.15.975 Color_251ACI
N050.04.21.512 E019.48.15.975 N050.04.21.464 E019.48.16.042 Color_251ACI
N050.04.21.464 E019.48.16.042 N050.04.21.411 E019.48.16.010 Color_251ACI
N050.04.22.013 E019.48.23.457 N050.04.21.890 E019.48.23.334 Color_251ACI
N050.04.21.890 E019.48.23.334 N050.04.21.777 E019.48.23.169 Color_251ACI
N050.04.21.777 E019.48.23.169 N050.04.21.707 E019.48.23.078 Color_251ACI
N050.04.21.707 E019.48.23.078 N050.04.21.695 E019.48.22.878 Color_251ACI
N050.04.21.695 E019.48.22.878 N050.04.21.646 E019.48.22.704 Color_251ACI
N050.04.21.646 E019.48.22.704 N050.04.21.544 E019.48.22.497 Color_251ACI
N050.04.21.544 E019.48.22.497 N050.04.21.414 E019.48.22.273 Color_251ACI
N050.04.21.414 E019.48.22.273 N050.04.21.344 E019.48.22.183 Color_251ACI
N050.04.21.344 E019.48.22.183 N050.04.21.279 E019.48.21.950 Color_251ACI
N050.04.21.279 E019.48.21.950 N050.04.21.202 E019.48.21.518 Color_251ACI
N050.04.21.202 E019.48.21.518 N050.04.21.121 E019.48.21.227 Color_251ACI
N050.04.21.121 E019.48.21.227 N050.04.21.076 E019.48.20.911 Color_251ACI
N050.04.21.076 E019.48.20.911 N050.04.20.974 E019.48.20.704 Color_251ACI
N050.04.22.426 E019.48.22.553 N050.04.22.158 E019.48.22.390 Color_251ACI
N050.04.22.158 E019.48.22.390 N050.04.21.964 E019.48.22.175 Color_251ACI
N050.04.21.964 E019.48.22.175 N050.04.21.830 E019.48.22.094 Color_251ACI
N050.04.21.830 E019.48.22.094 N050.04.21.717 E019.48.21.928 Color_251ACI
N050.04.21.717 E019.48.21.928 N050.04.21.524 E019.48.21.714 Color_251ACI
N050.04.21.524 E019.48.21.714 N050.04.21.362 E019.48.21.374 Color_251ACI
N050.04.21.362 E019.48.21.374 N050.04.21.173 E019.48.21.018 Color_251ACI
N050.04.21.173 E019.48.21.018 N050.04.21.108 E019.48.20.786 Color_251ACI
N050.04.21.108 E019.48.20.786 N050.04.21.048 E019.48.20.653 Color_251ACI
N050.04.21.048 E019.48.20.653 N050.04.20.974 E019.48.20.704 Color_251ACI
N050.04.23.461 E019.48.24.340 N050.04.23.589 E019.48.24.322 Color_251ACI
N050.04.23.589 E019.48.24.322 N050.04.23.685 E019.48.24.187 Color_251ACI
N050.04.23.685 E019.48.24.187 N050.04.23.727 E019.48.24.020 Color_251ACI
N050.04.23.727 E019.48.24.020 N050.04.23.752 E019.48.23.795 Color_251ACI
N050.04.23.752 E019.48.23.795 N050.04.23.736 E019.48.23.737 Color_251ACI
N050.04.23.736 E019.48.23.737 N050.04.23.693 E019.48.23.663 Color_251ACI
N050.04.23.693 E019.48.23.663 N050.04.23.623 E019.48.23.572 Color_251ACI
N050.04.23.623 E019.48.23.572 N050.04.22.348 E019.48.22.987 Color_251ACI
N050.04.22.348 E019.48.22.987 N050.04.22.426 E019.48.22.553 Color_251ACI
N050.04.31.992 E019.48.36.284 N050.04.30.833 E019.48.36.589 Color_251ACI
N050.04.30.833 E019.48.36.589 N050.04.29.648 E019.48.36.878 Color_251ACI
N050.04.29.648 E019.48.36.878 N050.04.28.665 E019.48.37.098 Color_251ACI
N050.04.28.665 E019.48.37.098 N050.04.27.646 E019.48.37.343 Color_251ACI
N050.04.27.646 E019.48.37.343 N050.04.27.507 E019.48.37.403 Color_251ACI
N050.04.27.507 E019.48.37.403 N050.04.27.496 E019.48.37.445 Color_251ACI
N050.04.47.648 E019.48.13.078 N050.04.47.457 E019.48.13.347 Color_251ACI
N050.04.47.457 E019.48.13.347 N050.04.47.475 E019.48.13.646 Color_251ACI
N050.04.47.475 E019.48.13.646 N050.04.48.389 E019.48.20.466 Color_251ACI
N050.04.48.389 E019.48.20.466 N050.04.48.916 E019.48.24.399 Color_251ACI
N050.04.48.916 E019.48.24.399 N050.04.49.116 E019.48.25.821 Color_251ACI
N050.04.49.116 E019.48.25.821 N050.04.49.470 E019.48.28.349 Color_251ACI
N050.04.49.470 E019.48.28.349 N050.04.49.932 E019.48.28.968 Color_251ACI
N050.04.49.051 E019.48.29.154 N050.04.49.152 E019.48.28.878 Color_251ACI
N050.04.49.152 E019.48.28.878 N050.04.49.241 E019.48.28.643 Color_251ACI
N050.04.49.241 E019.48.28.643 N050.04.49.294 E019.48.28.435 Color_251ACI
N050.04.49.294 E019.48.28.435 N050.04.48.219 E019.48.20.651 Color_251ACI
N050.04.48.219 E019.48.20.651 N050.04.47.998 E019.48.19.071 Color_251ACI
N050.04.47.998 E019.48.19.071 N050.04.47.272 E019.48.13.715 Color_251ACI
N050.04.47.272 E019.48.13.715 N050.04.47.217 E019.48.13.441 Color_251ACI
N050.04.47.217 E019.48.13.441 N050.04.46.976 E019.48.13.294 Color_251ACI
N050.04.25.846 E019.48.36.631 N050.04.25.835 E019.48.36.673 Color_251ACI
N050.04.25.835 E019.48.36.673 N050.04.25.072 E019.48.36.882 Color_251ACI
N050.04.25.072 E019.48.36.882 N050.04.24.271 E019.48.37.116 Color_251ACI
N050.04.24.271 E019.48.37.116 N050.04.22.995 E019.48.37.397 Color_251ACI
N050.04.22.995 E019.48.37.397 N050.04.21.681 E019.48.37.704 Color_251ACI
N050.04.21.681 E019.48.37.704 N050.04.21.030 E019.48.37.837 Color_251ACI
N050.04.21.030 E019.48.37.837 N050.04.20.378 E019.48.37.970 Color_251ACI
N050.04.28.010 E019.48.28.751 N050.04.27.749 E019.48.30.037 Color_251ACI
N050.04.27.749 E019.48.30.037 N050.04.27.478 E019.48.31.364 Color_251ACI
N050.04.27.478 E019.48.31.364 N050.04.27.317 E019.48.32.374 Color_251ACI
N050.04.27.317 E019.48.32.374 N050.04.27.156 E019.48.33.384 Color_251ACI
N050.04.27.156 E019.48.33.384 N050.04.27.021 E019.48.34.168 Color_251ACI
N050.04.27.021 E019.48.34.168 N050.04.26.842 E019.48.34.878 Color_251ACI
N050.04.26.842 E019.48.34.878 N050.04.26.759 E019.48.35.213 Color_251ACI
N050.04.26.759 E019.48.35.213 N050.04.26.611 E019.48.35.556 Color_251ACI
N050.04.26.611 E019.48.35.556 N050.04.26.452 E019.48.35.941 Color_251ACI
N050.04.26.452 E019.48.35.941 N050.04.26.240 E019.48.36.293 Color_251ACI
N050.04.26.240 E019.48.36.293 N050.04.26.070 E019.48.36.478 Color_251ACI
N050.04.26.070 E019.48.36.478 N050.04.25.846 E019.48.36.631 Color_251ACI
N050.04.33.759 E019.48.34.664 N050.04.33.320 E019.48.34.686 Color_251ACI
N050.04.33.320 E019.48.34.686 N050.04.32.882 E019.48.34.708 Color_251ACI
N050.04.32.882 E019.48.34.708 N050.04.32.010 E019.48.34.610 Color_251ACI
N050.04.32.010 E019.48.34.610 N050.04.31.143 E019.48.34.370 Color_251ACI
N050.04.31.143 E019.48.34.370 N050.04.30.227 E019.48.33.956 Color_251ACI
N050.04.30.227 E019.48.33.956 N050.04.29.299 E019.48.33.342 Color_251ACI
N050.04.29.299 E019.48.33.342 N050.04.28.891 E019.48.32.997 Color_251ACI
N050.04.28.891 E019.48.32.997 N050.04.28.478 E019.48.32.552 Color_251ACI
N050.04.28.478 E019.48.32.552 N050.04.28.235 E019.48.32.163 Color_251ACI
N050.04.28.235 E019.48.32.163 N050.04.28.067 E019.48.31.724 Color_251ACI
N050.04.28.067 E019.48.31.724 N050.04.27.967 E019.48.30.892 Color_251ACI
N050.04.27.967 E019.48.30.892 N050.04.28.022 E019.48.30.059 Color_251ACI
N050.04.28.022 E019.48.30.059 N050.04.28.115 E019.48.29.441 Color_251ACI
N050.04.28.115 E019.48.29.441 N050.04.28.208 E019.48.28.824 Color_251ACI
N050.04.29.611 E019.48.35.795 N050.04.30.577 E019.48.35.518 Color_251ACI
N050.04.30.577 E019.48.35.518 N050.04.31.543 E019.48.35.240 Color_251ACI
N050.04.31.543 E019.48.35.240 N050.04.31.708 E019.48.35.196 Color_251ACI
N050.04.31.708 E019.48.35.196 N050.04.31.874 E019.48.35.153 Color_251ACI
N050.04.31.874 E019.48.35.153 N050.04.31.965 E019.48.35.160 Color_251ACI
N050.04.31.965 E019.48.35.160 N050.04.32.039 E019.48.35.109 Color_251ACI
N050.04.32.039 E019.48.35.109 N050.04.32.077 E019.48.35.084 Color_251ACI
N050.04.32.077 E019.48.35.084 N050.04.31.953 E019.48.34.960 Color_251ACI
N050.04.31.953 E019.48.34.960 N050.04.31.611 E019.48.34.847 Color_251ACI
N050.04.31.611 E019.48.34.847 N050.04.31.257 E019.48.34.777 Color_251ACI
N050.04.31.257 E019.48.34.777 N050.04.30.411 E019.48.34.453 Color_251ACI
N050.04.30.411 E019.48.34.453 N050.04.29.586 E019.48.34.047 Color_251ACI
N050.04.29.586 E019.48.34.047 N050.04.29.168 E019.48.33.743 Color_251ACI
N050.04.29.168 E019.48.33.743 N050.04.28.797 E019.48.33.373 Color_251ACI
N050.04.28.797 E019.48.33.373 N050.04.28.470 E019.48.33.077 Color_251ACI
N050.04.28.470 E019.48.33.077 N050.04.28.163 E019.48.32.697 Color_251ACI
N050.04.28.163 E019.48.32.697 N050.04.28.007 E019.48.32.458 Color_251ACI
N050.04.28.007 E019.48.32.458 N050.04.27.915 E019.48.32.209 Color_251ACI
N050.04.27.915 E019.48.32.209 N050.04.27.790 E019.48.31.844 Color_251ACI
N050.04.27.790 E019.48.31.844 N050.04.27.757 E019.48.31.728 Color_251ACI
N050.04.27.757 E019.48.31.728 N050.04.27.731 E019.48.31.711 Color_251ACI
N050.04.27.731 E019.48.31.711 N050.04.27.720 E019.48.31.753 Color_251ACI
N050.04.27.720 E019.48.31.753 N050.04.27.668 E019.48.31.962 Color_251ACI
N050.04.27.668 E019.48.31.962 N050.04.27.590 E019.48.32.396 Color_251ACI
N050.04.27.590 E019.48.32.396 N050.04.27.501 E019.48.32.872 Color_251ACI
N050.04.27.501 E019.48.32.872 N050.04.27.397 E019.48.33.531 Color_251ACI
N050.04.27.397 E019.48.33.531 N050.04.27.267 E019.48.34.174 Color_251ACI
N050.04.27.267 E019.48.34.174 N050.04.27.168 E019.48.34.691 Color_251ACI
N050.04.27.168 E019.48.34.691 N050.04.26.989 E019.48.35.401 Color_251ACI
N050.04.26.989 E019.48.35.401 N050.04.26.862 E019.48.35.661 Color_251ACI
N050.04.26.862 E019.48.35.661 N050.04.26.773 E019.48.35.895 Color_251ACI
N050.04.26.773 E019.48.35.895 N050.04.26.587 E019.48.36.264 Color_251ACI
N050.04.26.587 E019.48.36.264 N050.04.26.566 E019.48.36.348 Color_251ACI
N050.04.26.566 E019.48.36.348 N050.04.26.566 E019.48.36.348 Color_251ACI
N050.04.26.566 E019.48.36.348 N050.04.26.620 E019.48.36.380 Color_251ACI
N050.04.26.620 E019.48.36.380 N050.04.26.684 E019.48.36.371 Color_251ACI
N050.04.26.673 E019.48.36.413 N050.04.27.159 E019.48.36.324 Color_251ACI
N050.04.27.159 E019.48.36.324 N050.04.27.635 E019.48.36.277 Color_251ACI
N050.04.27.635 E019.48.36.277 N050.04.28.377 E019.48.36.151 Color_251ACI
N050.04.28.377 E019.48.36.151 N050.04.29.104 E019.48.35.968 Color_251ACI
N050.04.29.104 E019.48.35.968 N050.04.29.370 E019.48.35.890 Color_251ACI
N050.04.29.370 E019.48.35.890 N050.04.29.611 E019.48.35.795 Color_251ACI
N050.04.33.877 E019.48.36.037 N050.04.33.285 E019.48.36.302 Color_251ACI
N050.04.33.285 E019.48.36.302 N050.04.32.699 E019.48.36.667 Color_251ACI
N050.04.32.699 E019.48.36.667 N050.04.32.081 E019.48.37.157 Color_251ACI
N050.04.32.081 E019.48.37.157 N050.04.31.507 E019.48.37.722 Color_251ACI
N050.04.31.507 E019.48.37.722 N050.04.30.959 E019.48.38.303 Color_251ACI
N050.04.30.959 E019.48.38.303 N050.04.30.481 E019.48.38.975 Color_251ACI
N050.04.30.481 E019.48.38.975 N050.04.29.972 E019.48.39.773 Color_251ACI
N050.04.29.972 E019.48.39.773 N050.04.29.436 E019.48.40.554 Color_251ACI
N050.04.29.436 E019.48.40.554 N050.04.29.080 E019.48.41.107 Color_251ACI
N050.04.29.080 E019.48.41.107 N050.04.28.677 E019.48.41.729 Color_251ACI
N050.04.28.677 E019.48.41.729 N050.04.28.374 E019.48.42.074 Color_251ACI
N050.04.28.374 E019.48.42.074 N050.04.28.071 E019.48.42.419 Color_251ACI
N050.04.28.071 E019.48.42.419 N050.04.27.773 E019.48.42.622 Color_251ACI
N050.04.27.773 E019.48.42.622 N050.04.27.458 E019.48.42.767 Color_251ACI
N050.04.27.458 E019.48.42.767 N050.04.26.721 E019.48.42.993 Color_251ACI
N050.04.26.721 E019.48.42.993 N050.04.25.974 E019.48.43.260 Color_251ACI
N050.04.25.974 E019.48.43.260 N050.04.24.944 E019.48.43.547 Color_251ACI
N050.04.24.944 E019.48.43.547 N050.04.23.860 E019.48.43.801 Color_251ACI
N050.04.23.860 E019.48.43.801 N050.04.23.577 E019.48.43.821 Color_251ACI
N050.04.23.577 E019.48.43.821 N050.04.23.283 E019.48.43.883 Color_251ACI
N050.04.23.283 E019.48.43.883 N050.04.23.010 E019.48.43.861 Color_251ACI
N050.04.23.010 E019.48.43.861 N050.04.22.785 E019.48.43.772 Color_251ACI
N050.04.22.785 E019.48.43.772 N050.04.22.255 E019.48.43.545 Color_251ACI
N050.04.22.255 E019.48.43.545 N050.04.21.767 E019.48.43.151 Color_251ACI
N050.04.21.767 E019.48.43.151 N050.04.21.369 E019.48.42.764 Color_251ACI
N050.04.21.369 E019.48.42.764 N050.04.21.003 E019.48.42.252 Color_251ACI
N050.04.21.003 E019.48.42.252 N050.04.20.658 E019.48.41.656 Color_251ACI
N050.04.20.658 E019.48.41.656 N050.04.20.398 E019.48.40.968 Color_251ACI
N050.04.20.398 E019.48.40.968 N050.04.20.202 E019.48.40.270 Color_251ACI
N050.04.20.202 E019.48.40.270 N050.04.19.980 E019.48.39.557 Color_251ACI
N050.05.06.094 E019.48.31.069 N050.05.05.577 E019.48.31.284 Color_251ACI
N050.05.05.577 E019.48.31.284 N050.05.05.060 E019.48.31.498 Color_251ACI
N050.05.05.060 E019.48.31.498 N050.05.04.590 E019.48.31.645 Color_251ACI
N050.05.04.590 E019.48.31.645 N050.05.04.094 E019.48.31.776 Color_251ACI
N050.05.04.094 E019.48.31.776 N050.05.02.764 E019.48.32.025 Color_251ACI
N050.05.02.764 E019.48.32.025 N050.05.01.423 E019.48.32.074 Color_251ACI
N050.05.01.423 E019.48.32.074 N050.05.00.391 E019.48.32.119 Color_251ACI
N050.05.00.391 E019.48.32.119 N050.04.59.381 E019.48.32.081 Color_251ACI
N050.04.59.381 E019.48.32.081 N050.04.57.879 E019.48.32.032 Color_251ACI
N050.04.57.879 E019.48.32.032 N050.04.56.377 E019.48.31.983 Color_251ACI
N050.04.56.377 E019.48.31.983 N050.04.54.046 E019.48.31.910 Color_251ACI
N050.04.54.046 E019.48.31.910 N050.04.51.711 E019.48.31.979 Color_251ACI
N050.04.51.711 E019.48.31.979 N050.04.50.952 E019.48.32.047 Color_251ACI
N050.04.50.952 E019.48.32.047 N050.04.50.210 E019.48.32.172 Color_251ACI
N050.04.50.210 E019.48.32.172 N050.04.48.810 E019.48.32.330 Color_251ACI
N050.04.48.810 E019.48.32.330 N050.04.47.390 E019.48.32.572 Color_251ACI
N050.04.47.390 E019.48.32.572 N050.04.46.178 E019.48.32.844 Color_251ACI
N050.04.46.178 E019.48.32.844 N050.04.44.955 E019.48.33.158 Color_251ACI
N050.04.44.955 E019.48.33.158 N050.04.42.446 E019.48.33.796 Color_251ACI
N050.04.42.446 E019.48.33.796 N050.04.39.964 E019.48.34.450 Color_251ACI
N050.04.39.964 E019.48.34.450 N050.04.36.995 E019.48.35.192 Color_251ACI
N050.04.36.995 E019.48.35.192 N050.04.34.070 E019.48.36.010 Color_251ACI
N050.04.34.070 E019.48.36.010 N050.04.33.877 E019.48.36.037 Color_251ACI
N050.04.32.734 E019.48.36.159 N050.04.32.697 E019.48.36.184 Color_251ACI
N050.04.32.697 E019.48.36.184 N050.04.32.542 E019.48.36.186 Color_251ACI
N050.04.32.542 E019.48.36.186 N050.04.32.285 E019.48.36.222 Color_251ACI
N050.04.32.285 E019.48.36.222 N050.04.31.992 E019.48.36.284 Color_251ACI
N050.04.27.496 E019.48.37.445 N050.04.27.502 E019.48.37.544 Color_251ACI
N050.04.27.502 E019.48.37.544 N050.04.27.615 E019.48.37.710 Color_251ACI
N050.04.27.615 E019.48.37.710 N050.04.27.819 E019.48.37.882 Color_251ACI
N050.04.27.819 E019.48.37.882 N050.04.27.996 E019.48.38.038 Color_251ACI
N050.04.27.996 E019.48.38.038 N050.04.28.206 E019.48.38.311 Color_251ACI
N050.04.28.206 E019.48.38.311 N050.04.28.352 E019.48.38.592 Color_251ACI
N050.04.28.352 E019.48.38.592 N050.04.28.530 E019.48.38.990 Color_251ACI
N050.04.28.530 E019.48.38.990 N050.04.28.607 E019.48.39.422 Color_251ACI
N050.04.28.607 E019.48.39.422 N050.04.28.668 E019.48.39.796 Color_251ACI
N050.04.28.668 E019.48.39.796 N050.04.28.675 E019.48.40.138 Color_251ACI
N050.04.28.675 E019.48.40.138 N050.04.28.639 E019.48.40.405 Color_251ACI
N050.04.28.639 E019.48.40.405 N050.04.28.640 E019.48.40.646 Color_251ACI
N050.04.28.640 E019.48.40.646 N050.04.28.566 E019.48.40.939 Color_251ACI
N050.04.28.566 E019.48.40.939 N050.04.28.530 E019.48.41.206 Color_251ACI
N050.04.28.530 E019.48.41.206 N050.04.28.472 E019.48.41.314 Color_251ACI
N050.04.28.472 E019.48.41.314 N050.04.28.488 E019.48.41.373 Color_251ACI
N050.04.28.488 E019.48.41.373 N050.04.28.488 E019.48.41.373 Color_251ACI
N050.04.28.488 E019.48.41.373 N050.04.28.675 E019.48.41.245 Color_251ACI
N050.04.28.675 E019.48.41.245 N050.04.28.818 E019.48.41.044 Color_251ACI
N050.04.28.818 E019.48.41.044 N050.04.29.253 E019.48.40.297 Color_251ACI
N050.04.29.253 E019.48.40.297 N050.04.29.677 E019.48.39.593 Color_251ACI
N050.04.29.677 E019.48.39.593 N050.04.30.261 E019.48.38.745 Color_251ACI
N050.04.30.261 E019.48.38.745 N050.04.30.882 E019.48.37.871 Color_251ACI
N050.04.30.882 E019.48.37.871 N050.04.31.318 E019.48.37.366 Color_251ACI
N050.04.31.318 E019.48.37.366 N050.04.31.824 E019.48.36.952 Color_251ACI
N050.04.31.824 E019.48.36.952 N050.04.32.245 E019.48.36.631 Color_251ACI
N050.04.32.245 E019.48.36.631 N050.04.32.692 E019.48.36.326 Color_251ACI
N050.04.32.692 E019.48.36.326 N050.04.32.740 E019.48.36.259 Color_251ACI
N050.04.32.740 E019.48.36.259 N050.04.32.740 E019.48.36.259 Color_251ACI
N050.04.32.740 E019.48.36.259 N050.04.32.734 E019.48.36.159 Color_251ACI
N050.04.32.734 E019.48.36.159 N050.04.32.734 E019.48.36.159 Color_251ACI
N050.04.26.600 E019.48.37.813 N050.04.26.873 E019.48.37.835 Color_251ACI
N050.04.26.873 E019.48.37.835 N050.04.27.098 E019.48.37.924 Color_251ACI
N050.04.27.098 E019.48.37.924 N050.04.27.403 E019.48.38.062 Color_251ACI
N050.04.27.403 E019.48.38.062 N050.04.27.677 E019.48.38.325 Color_251ACI
N050.04.27.677 E019.48.38.325 N050.04.27.914 E019.48.38.614 Color_251ACI
N050.04.27.914 E019.48.38.614 N050.04.28.092 E019.48.39.012 Color_251ACI
N050.04.28.092 E019.48.39.012 N050.04.28.211 E019.48.39.277 Color_251ACI
N050.04.28.211 E019.48.39.277 N050.04.28.282 E019.48.39.609 Color_251ACI
N050.04.28.282 E019.48.39.609 N050.04.28.299 E019.48.39.909 Color_251ACI
N050.04.28.299 E019.48.39.909 N050.04.28.327 E019.48.40.167 Color_251ACI
N050.04.28.327 E019.48.40.167 N050.04.28.318 E019.48.40.450 Color_251ACI
N050.04.28.318 E019.48.40.450 N050.04.28.271 E019.48.40.759 Color_251ACI
N050.04.28.271 E019.48.40.759 N050.04.28.209 E019.48.41.009 Color_251ACI
N050.04.28.209 E019.48.41.009 N050.04.28.146 E019.48.41.260 Color_251ACI
N050.04.28.146 E019.48.41.260 N050.04.28.019 E019.48.41.520 Color_251ACI
N050.04.28.019 E019.48.41.520 N050.04.27.902 E019.48.41.738 Color_251ACI
N050.04.27.902 E019.48.41.738 N050.04.27.721 E019.48.41.965 Color_251ACI
N050.04.27.721 E019.48.41.965 N050.04.27.541 E019.48.42.192 Color_251ACI
N050.04.27.541 E019.48.42.192 N050.04.27.269 E019.48.42.411 Color_251ACI
N050.04.27.269 E019.48.42.411 N050.04.27.029 E019.48.42.506 Color_251ACI
N050.04.27.029 E019.48.42.506 N050.04.26.266 E019.48.42.715 Color_251ACI
N050.04.26.266 E019.48.42.715 N050.04.25.475 E019.48.42.907 Color_251ACI
N050.04.25.475 E019.48.42.907 N050.04.24.813 E019.48.43.082 Color_251ACI
N050.04.24.813 E019.48.43.082 N050.04.24.114 E019.48.43.281 Color_251ACI
N050.04.24.114 E019.48.43.281 N050.04.23.793 E019.48.43.327 Color_251ACI
N050.04.23.793 E019.48.43.327 N050.04.23.446 E019.48.43.356 Color_251ACI
N050.04.23.446 E019.48.43.356 N050.04.23.173 E019.48.43.334 Color_251ACI
N050.04.23.173 E019.48.43.334 N050.04.22.965 E019.48.43.303 Color_251ACI
N050.04.22.965 E019.48.43.303 N050.04.22.729 E019.48.43.256 Color_251ACI
N050.04.22.729 E019.48.43.256 N050.04.22.542 E019.48.43.142 Color_251ACI
N050.04.22.542 E019.48.43.142 N050.04.22.209 E019.48.42.987 Color_251ACI
N050.04.22.209 E019.48.42.987 N050.04.21.925 E019.48.42.766 Color_251ACI
N050.04.21.925 E019.48.42.766 N050.04.21.688 E019.48.42.477 Color_251ACI
N050.04.21.688 E019.48.42.477 N050.04.21.452 E019.48.42.188 Color_251ACI
N050.04.21.452 E019.48.42.188 N050.04.21.215 E019.48.41.899 Color_251ACI
N050.04.21.215 E019.48.41.899 N050.04.21.000 E019.48.41.527 Color_251ACI
N050.04.21.000 E019.48.41.527 N050.04.20.821 E019.48.41.129 Color_251ACI
N050.04.20.821 E019.48.41.129 N050.04.20.670 E019.48.40.748 Color_251ACI
N050.04.20.670 E019.48.40.748 N050.04.20.480 E019.48.40.151 Color_251ACI
N050.04.20.480 E019.48.40.151 N050.04.20.300 E019.48.39.511 Color_251ACI
N050.04.20.551 E019.48.39.375 N050.04.21.405 E019.48.39.174 Color_251ACI
N050.04.21.405 E019.48.39.174 N050.04.22.260 E019.48.38.972 Color_251ACI
N050.04.22.260 E019.48.38.972 N050.04.23.178 E019.48.38.761 Color_251ACI
N050.04.23.178 E019.48.38.761 N050.04.24.080 E019.48.38.492 Color_251ACI
N050.04.24.080 E019.48.38.492 N050.04.25.276 E019.48.38.162 Color_251ACI
N050.04.25.276 E019.48.38.162 N050.04.26.472 E019.48.37.831 Color_251ACI
N050.04.26.472 E019.48.37.831 N050.04.26.600 E019.48.37.813 Color_251ACI
N050.05.09.769 E019.48.09.662 N050.05.09.740 E019.48.09.162 Color_251ACI
N050.05.09.740 E019.48.09.162 N050.05.09.743 E019.48.08.537 Color_251ACI
N050.05.09.743 E019.48.08.537 N050.05.09.846 E019.48.07.878 Color_251ACI
N050.05.09.846 E019.48.07.878 N050.05.09.956 E019.48.07.319 Color_251ACI
N050.05.09.956 E019.48.07.319 N050.05.10.162 E019.48.06.867 Color_251ACI
N050.05.10.162 E019.48.06.867 N050.05.10.517 E019.48.06.313 Color_251ACI
N050.05.10.517 E019.48.06.313 N050.05.10.932 E019.48.05.891 Color_251ACI
N050.05.10.932 E019.48.05.891 N050.05.11.278 E019.48.05.621 Color_251ACI
N050.05.11.278 E019.48.05.621 N050.05.11.620 E019.48.05.492 Color_251ACI
N050.05.11.620 E019.48.05.492 N050.05.11.903 E019.48.05.472 Color_251ACI
N050.05.11.903 E019.48.05.472 N050.05.12.165 E019.48.05.535 Color_251ACI
N050.05.12.165 E019.48.05.535 N050.05.12.551 E019.48.05.722 Color_251ACI
N050.05.12.551 E019.48.05.722 N050.05.12.916 E019.48.05.993 Color_251ACI
N050.05.12.916 E019.48.05.993 N050.05.13.276 E019.48.06.405 Color_251ACI
N050.05.13.276 E019.48.06.405 N050.05.13.577 E019.48.06.926 Color_251ACI
N050.05.13.577 E019.48.06.926 N050.05.13.777 E019.48.07.241 Color_251ACI
N050.05.13.777 E019.48.07.241 N050.05.13.955 E019.48.07.638 Color_251ACI
N050.05.13.955 E019.48.07.638 N050.05.14.085 E019.48.08.103 Color_251ACI
N050.05.14.085 E019.48.08.103 N050.05.14.210 E019.48.08.468 Color_251ACI
N050.05.09.769 E019.48.09.662 N050.05.09.400 E019.48.08.425 Color_251ACI
N050.05.09.400 E019.48.08.425 N050.05.09.020 E019.48.07.230 Color_251ACI
N050.05.09.020 E019.48.07.230 N050.05.08.375 E019.48.05.247 Color_251ACI
N050.05.08.375 E019.48.05.247 N050.05.07.729 E019.48.03.264 Color_251ACI
N050.05.07.729 E019.48.03.264 N050.05.06.947 E019.48.00.716 Color_251ACI
N050.05.06.947 E019.48.00.716 N050.05.06.202 E019.47.58.142 Color_251ACI
N050.05.06.202 E019.47.58.142 N050.05.05.958 E019.47.57.271 Color_251ACI
N050.05.05.958 E019.47.57.271 N050.05.05.713 E019.47.56.399 Color_251ACI
N050.04.47.112 E019.45.47.872 N050.04.46.930 E019.45.47.857 Color_251ACI
N050.04.46.930 E019.45.47.857 N050.04.46.502 E019.45.47.837 Color_251ACI
N050.04.46.502 E019.45.47.837 N050.04.46.075 E019.45.47.817 Color_251ACI
N050.04.46.075 E019.45.47.817 N050.04.45.039 E019.45.48.004 Color_251ACI
N050.04.45.039 E019.45.48.004 N050.04.44.019 E019.45.48.249 Color_251ACI
N050.04.44.019 E019.45.48.249 N050.04.42.834 E019.45.48.538 Color_251ACI
N050.04.42.834 E019.45.48.538 N050.04.41.632 E019.45.48.769 Color_251ACI
N050.04.41.632 E019.45.48.769 N050.04.41.136 E019.45.48.900 Color_251ACI
N050.04.41.136 E019.45.48.900 N050.04.40.650 E019.45.48.989 Color_251ACI
N050.04.40.650 E019.45.48.989 N050.04.40.521 E019.45.49.007 Color_251ACI
N050.04.40.521 E019.45.49.007 N050.04.40.392 E019.45.48.783 Color_251ACI
N050.04.40.392 E019.45.48.783 N050.04.40.396 E019.45.48.400 Color_251ACI
N050.04.40.396 E019.45.48.400 N050.04.40.441 E019.45.47.850 Color_251ACI
N050.04.40.441 E019.45.47.850 N050.04.40.503 E019.45.47.358 Color_251ACI
N050.04.40.503 E019.45.47.358 N050.04.40.687 E019.45.45.640 Color_251ACI
N050.04.40.687 E019.45.45.640 N050.04.40.834 E019.45.43.947 Color_251ACI
N050.04.40.834 E019.45.43.947 N050.04.40.895 E019.45.43.455 Color_251ACI
N050.04.40.895 E019.45.43.455 N050.04.40.920 E019.45.42.988 Color_251ACI
N050.04.47.119 E019.45.48.213 N050.04.46.910 E019.45.48.182 Color_251ACI
N050.04.46.910 E019.45.48.182 N050.04.46.371 E019.45.48.239 Color_251ACI
N050.04.46.371 E019.45.48.239 N050.04.45.842 E019.45.48.253 Color_251ACI
N050.04.45.842 E019.45.48.253 N050.04.44.640 E019.45.48.484 Color_251ACI
N050.04.44.640 E019.45.48.484 N050.04.43.455 E019.45.48.773 Color_251ACI
N050.04.43.455 E019.45.48.773 N050.04.42.051 E019.45.49.072 Color_251ACI
N050.04.42.051 E019.45.49.072 N050.04.40.636 E019.45.49.414 Color_251ACI
N050.04.40.636 E019.45.49.414 N050.04.40.406 E019.45.49.466 Color_251ACI
N050.04.40.406 E019.45.49.466 N050.04.40.176 E019.45.49.519 Color_251ACI
N050.04.40.176 E019.45.49.519 N050.04.39.957 E019.45.49.530 Color_251ACI
N050.04.48.160 E019.45.47.884 N050.04.48.379 E019.45.47.873 Color_251ACI
N050.04.48.379 E019.45.47.873 N050.04.48.587 E019.45.47.904 Color_251ACI
N050.04.48.587 E019.45.47.904 N050.04.48.823 E019.45.47.952 Color_251ACI
N050.04.48.823 E019.45.47.952 N050.04.49.021 E019.45.48.024 Color_251ACI
N050.04.49.021 E019.45.48.024 N050.04.49.246 E019.45.48.113 Color_251ACI
N050.04.49.246 E019.45.48.113 N050.04.49.567 E019.45.48.309 Color_251ACI
N050.04.49.567 E019.45.48.309 N050.04.49.728 E019.45.48.407 Color_251ACI
N050.04.48.167 E019.45.48.226 N050.04.48.375 E019.45.48.257 Color_251ACI
N050.04.48.375 E019.45.48.257 N050.04.48.557 E019.45.48.271 Color_251ACI
N050.04.48.557 E019.45.48.271 N050.04.48.766 E019.45.48.302 Color_251ACI
N050.04.48.766 E019.45.48.302 N050.04.48.991 E019.45.48.391 Color_251ACI
N050.04.48.991 E019.45.48.391 N050.04.49.172 E019.45.48.406 Color_251ACI
N050.04.49.172 E019.45.48.406 N050.04.49.494 E019.45.48.602 Color_251ACI
N050.04.49.494 E019.45.48.602 N050.04.49.644 E019.45.48.742 Color_251ACI
N050.04.27.820 E019.45.51.088 N050.04.27.698 E019.45.51.206 Color_251ACI
N050.04.27.698 E019.45.51.206 N050.04.27.581 E019.45.51.424 Color_251ACI
N050.04.27.581 E019.45.51.424 N050.04.27.561 E019.45.51.749 Color_251ACI
N050.04.27.561 E019.45.51.749 N050.04.27.589 E019.45.52.007 Color_251ACI
N050.04.27.147 E019.45.51.304 N050.04.27.314 E019.45.51.502 Color_251ACI
N050.04.27.314 E019.45.51.502 N050.04.27.412 E019.45.51.851 Color_251ACI
N050.04.27.412 E019.45.51.851 N050.04.27.424 E019.45.52.051 Color_251ACI
N050.04.39.984 E019.45.49.546 N050.04.38.991 E019.45.49.808 Color_251ACI
N050.04.38.991 E019.45.49.808 N050.04.37.998 E019.45.50.069 Color_251ACI
N050.04.37.998 E019.45.50.069 N050.04.37.752 E019.45.50.064 Color_251ACI
N050.04.37.752 E019.45.50.064 N050.04.37.496 E019.45.50.100 Color_251ACI
N050.04.37.496 E019.45.50.100 N050.04.36.818 E019.45.50.216 Color_251ACI
N050.04.36.818 E019.45.50.216 N050.04.36.166 E019.45.50.349 Color_251ACI
N050.04.36.166 E019.45.50.349 N050.04.34.841 E019.45.50.456 Color_251ACI
N050.04.34.841 E019.45.50.456 N050.04.33.505 E019.45.50.605 Color_251ACI
N050.04.33.505 E019.45.50.605 N050.04.32.806 E019.45.50.805 Color_251ACI
N050.04.32.806 E019.45.50.805 N050.04.32.107 E019.45.51.005 Color_251ACI
N050.04.32.107 E019.45.51.005 N050.04.31.610 E019.45.51.135 Color_251ACI
N050.04.31.610 E019.45.51.135 N050.04.31.071 E019.45.51.192 Color_251ACI
N050.04.31.071 E019.45.51.192 N050.04.30.343 E019.45.51.134 Color_251ACI
N050.04.30.343 E019.45.51.134 N050.04.29.600 E019.45.51.017 Color_251ACI
N050.04.29.600 E019.45.51.017 N050.04.28.899 E019.45.50.976 Color_251ACI
N050.04.28.899 E019.45.50.976 N050.04.28.205 E019.45.51.034 Color_251ACI
N050.04.28.205 E019.45.51.034 N050.04.28.012 E019.45.51.061 Color_251ACI
N050.04.28.012 E019.45.51.061 N050.04.27.820 E019.45.51.088 Color_251ACI
N050.04.40.025 E019.45.49.138 N050.04.40.147 E019.45.47.912 Color_251ACI
N050.04.40.147 E019.45.47.912 N050.04.40.270 E019.45.46.686 Color_251ACI
N050.04.40.270 E019.45.46.686 N050.04.40.458 E019.45.44.826 Color_251ACI
N050.04.40.458 E019.45.44.826 N050.04.40.658 E019.45.42.925 Color_251ACI
N050.04.47.629 E019.45.48.765 N050.04.47.670 E019.45.50.572 Color_251ACI
N050.04.47.670 E019.45.50.572 N050.04.47.711 E019.45.52.379 Color_251ACI
N050.04.47.711 E019.45.52.379 N050.04.47.793 E019.45.54.885 Color_251ACI
N050.04.47.793 E019.45.54.885 N050.04.47.938 E019.45.57.382 Color_251ACI
N050.04.47.938 E019.45.57.382 N050.04.48.171 E019.46.01.378 Color_251ACI
N050.04.48.171 E019.46.01.378 N050.04.48.506 E019.46.05.338 Color_251ACI
N050.04.48.506 E019.46.05.338 N050.04.49.011 E019.46.10.222 Color_251ACI
N050.04.49.011 E019.46.10.222 N050.04.49.606 E019.46.15.112 Color_251ACI
N050.04.49.606 E019.46.15.112 N050.04.50.350 E019.46.20.768 Color_251ACI
N050.04.50.350 E019.46.20.768 N050.04.51.093 E019.46.26.423 Color_251ACI
N050.04.51.093 E019.46.26.423 N050.04.51.508 E019.46.29.325 Color_251ACI
N050.04.51.508 E019.46.29.325 N050.04.51.896 E019.46.32.211 Color_251ACI
N050.04.51.896 E019.46.32.211 N050.04.53.374 E019.46.42.696 Color_251ACI
N050.04.53.374 E019.46.42.696 N050.04.54.835 E019.46.53.124 Color_251ACI
N050.04.54.835 E019.46.53.124 N050.04.56.099 E019.47.02.372 Color_251ACI
N050.04.56.099 E019.47.02.372 N050.04.57.399 E019.47.11.593 Color_251ACI
N050.04.57.399 E019.47.11.593 N050.04.58.840 E019.47.22.105 Color_251ACI
N050.04.58.840 E019.47.22.105 N050.05.00.301 E019.47.32.532 Color_251ACI
N050.05.00.301 E019.47.32.532 N050.05.00.924 E019.47.36.332 Color_251ACI
N050.05.00.924 E019.47.36.332 N050.05.01.583 E019.47.40.105 Color_251ACI
N050.05.01.583 E019.47.40.105 N050.05.01.907 E019.47.41.892 Color_251ACI
N050.05.01.907 E019.47.41.892 N050.05.02.279 E019.47.43.612 Color_251ACI
N050.05.02.279 E019.47.43.612 N050.05.02.674 E019.47.45.732 Color_251ACI
N050.05.02.674 E019.47.45.732 N050.05.03.160 E019.47.47.858 Color_251ACI
N050.05.03.160 E019.47.47.858 N050.05.03.618 E019.47.49.727 Color_251ACI
N050.05.03.618 E019.47.49.727 N050.05.04.059 E019.47.51.537 Color_251ACI
N050.04.47.005 E019.45.48.914 N050.04.47.121 E019.45.48.696 Color_251ACI
N050.04.47.121 E019.45.48.696 N050.04.47.070 E019.45.46.931 Color_251ACI
N050.04.48.309 E019.45.48.890 N050.04.48.158 E019.45.48.751 Color_251ACI
N050.04.48.158 E019.45.48.751 N050.04.48.151 E019.45.47.301 Color_251ACI
N050.04.25.662 E019.48.25.055 N050.04.25.714 E019.48.24.847 Color_251ACI
N050.04.25.714 E019.48.24.847 N050.04.25.708 E019.48.24.747 Color_251ACI
N050.04.25.708 E019.48.24.747 N050.04.25.659 E019.48.24.572 Color_251ACI
N050.04.25.659 E019.48.24.572 N050.04.25.606 E019.48.24.540 Color_251ACI
N050.04.25.606 E019.48.24.540 N050.04.24.223 E019.48.23.890 Color_251ACI
N050.04.24.223 E019.48.23.890 N050.04.24.143 E019.48.23.841 Color_251ACI
N050.04.24.143 E019.48.23.841 N050.04.24.079 E019.48.23.850 Color_251ACI
N050.04.24.079 E019.48.23.850 N050.04.24.031 E019.48.23.917 Color_251ACI
N050.04.24.031 E019.48.23.917 N050.04.23.983 E019.48.23.984 Color_251ACI
N050.04.23.983 E019.48.23.984 N050.04.23.952 E019.48.24.109 Color_251ACI
N050.04.23.952 E019.48.24.109 N050.04.23.947 E019.48.24.251 Color_251ACI
N050.04.23.947 E019.48.24.251 N050.04.23.932 E019.48.24.434 Color_251ACI
N050.04.23.932 E019.48.24.434 N050.04.23.954 E019.48.24.592 Color_251ACI
N050.04.23.954 E019.48.24.592 N050.04.23.944 E019.48.24.634 Color_251ACI
N050.04.24.683 E019.47.30.852 N050.04.25.313 E019.47.30.561 Color_251ACI
N050.04.25.313 E019.47.30.561 N050.04.26.897 E019.47.29.793 Color_251ACI
N050.04.25.338 E019.47.30.336 N050.04.25.135 E019.47.30.405 Color_251ACI
N050.04.25.135 E019.47.30.405 N050.04.24.645 E019.47.30.636 Color_251ACI
N050.04.24.683 E019.47.30.852 N050.04.24.947 E019.47.32.265 Color_251ACI
N050.04.24.947 E019.47.32.265 N050.04.25.275 E019.47.33.910 Color_251ACI
N050.04.22.861 E019.48.24.022 N050.04.22.834 E019.48.24.006 Color_251ACI
N050.04.22.834 E019.48.24.006 N050.04.22.013 E019.48.23.457 Color_251ACI
N050.04.19.653 E019.48.16.239 N050.04.19.648 E019.48.16.380 Color_251ACI
N050.04.19.648 E019.48.16.380 N050.04.19.558 E019.48.16.373 Color_251ACI
N050.04.19.558 E019.48.16.373 N050.04.19.562 E019.48.16.231 Color_251ACI
N050.04.19.562 E019.48.16.231 N050.04.19.653 E019.48.16.239 Color_251ACI
N050.04.19.261 E019.48.08.197 N050.04.19.187 E019.48.08.248 Color_251ACI
N050.04.19.187 E019.48.08.248 N050.04.19.096 E019.48.08.241 Color_251ACI
N050.04.19.096 E019.48.08.241 N050.04.19.036 E019.48.08.108 Color_251ACI
N050.04.19.036 E019.48.08.108 N050.04.18.997 E019.48.07.650 Color_251ACI
N050.04.18.997 E019.48.07.650 N050.04.18.957 E019.48.07.193 Color_251ACI
N050.04.18.957 E019.48.07.193 N050.04.18.945 E019.48.06.993 Color_251ACI
N050.04.18.945 E019.48.06.993 N050.04.18.987 E019.48.06.826 Color_251ACI
N050.04.18.987 E019.48.06.826 N050.04.18.954 E019.48.06.468 Color_251ACI
N050.04.18.954 E019.48.06.468 N050.04.18.883 E019.48.06.136 Color_251ACI
N050.04.18.883 E019.48.06.136 N050.04.18.754 E019.48.05.046 Color_251ACI
N050.04.18.754 E019.48.05.046 N050.04.18.599 E019.48.03.940 Color_251ACI
N050.04.18.599 E019.48.03.940 N050.04.18.472 E019.48.03.092 Color_251ACI
N050.04.18.472 E019.48.03.092 N050.04.18.356 E019.48.02.202 Color_251ACI
N050.04.18.356 E019.48.02.202 N050.04.18.295 E019.48.01.828 Color_251ACI
N050.04.18.295 E019.48.01.828 N050.04.18.283 E019.48.01.628 Color_251ACI
N050.04.18.283 E019.48.01.628 N050.04.18.240 E019.48.01.554 Color_251ACI
N050.04.18.240 E019.48.01.554 N050.04.18.154 E019.48.01.405 Color_251ACI
N050.04.18.154 E019.48.01.405 N050.04.18.138 E019.48.01.347 Color_251ACI
N050.04.18.138 E019.48.01.347 N050.04.18.201 E019.48.01.096 Color_251ACI
N050.04.18.201 E019.48.01.096 N050.04.18.222 E019.48.01.013 Color_251ACI
N050.04.18.222 E019.48.01.013 N050.04.18.286 E019.48.01.004 Color_251ACI
N050.04.18.286 E019.48.01.004 N050.04.18.302 E019.48.01.062 Color_251ACI
N050.04.18.302 E019.48.01.062 N050.04.18.372 E019.48.01.153 Color_251ACI
N050.04.18.372 E019.48.01.153 N050.04.18.415 E019.48.01.227 Color_251ACI
N050.04.18.415 E019.48.01.227 N050.04.18.427 E019.48.01.427 Color_251ACI
N050.04.18.427 E019.48.01.427 N050.04.18.787 E019.48.04.055 Color_251ACI
N050.04.18.787 E019.48.04.055 N050.04.19.110 E019.48.06.708 Color_251ACI
N050.04.19.110 E019.48.06.708 N050.04.19.181 E019.48.07.040 Color_251ACI
N050.04.19.181 E019.48.07.040 N050.04.19.225 E019.48.07.356 Color_251ACI
N050.04.19.225 E019.48.07.356 N050.04.19.258 E019.48.07.473 Color_251ACI
N050.04.19.258 E019.48.07.473 N050.04.19.334 E019.48.07.663 Color_251ACI
N050.04.19.334 E019.48.07.663 N050.04.19.409 E019.48.07.854 Color_251ACI
N050.04.19.409 E019.48.07.854 N050.04.19.421 E019.48.08.054 Color_251ACI
N050.04.19.421 E019.48.08.054 N050.04.19.400 E019.48.08.137 Color_251ACI
N050.04.19.400 E019.48.08.137 N050.04.19.363 E019.48.08.163 Color_251ACI
N050.04.19.363 E019.48.08.163 N050.04.19.261 E019.48.08.197 Color_251ACI
N050.04.28.291 E019.45.53.398 N050.04.28.061 E019.45.53.451 Color_251ACI
N050.04.28.061 E019.45.53.451 N050.04.28.089 E019.45.53.709 Color_251ACI
N050.04.28.089 E019.45.53.709 N050.04.28.319 E019.45.53.656 Color_251ACI
N050.04.28.319 E019.45.53.656 N050.04.28.291 E019.45.53.398 Color_251ACI
N050.04.31.493 E019.47.56.051 N050.04.31.342 E019.47.55.911 Color_251ACI
N050.04.31.342 E019.47.55.911 N050.04.30.589 E019.47.56.078 Color_251ACI
N050.04.30.589 E019.47.56.078 N050.04.30.578 E019.47.55.879 Color_251ACI
N050.04.30.578 E019.47.55.879 N050.04.31.266 E019.47.55.721 Color_251ACI
N050.04.31.266 E019.47.55.721 N050.04.31.303 E019.47.55.454 Color_251ACI
N050.04.17.454 E019.48.14.657 N050.04.17.103 E019.48.15.069 Color_251ACI
N050.04.17.800 E019.48.17.710 N050.04.17.476 E019.48.18.138 Color_251ACI
N050.04.17.257 E019.48.14.826 N050.04.17.656 E019.48.17.911 Color_251ACI
N050.04.18.594 E019.48.19.350 N050.04.18.263 E019.48.19.437 Color_251ACI
N050.04.18.308 E019.48.16.671 N050.04.17.977 E019.48.16.758 Color_251ACI
N050.04.18.842 E019.48.16.515 N050.04.18.511 E019.48.16.602 Color_251ACI
N050.04.19.384 E019.48.20.265 N050.04.19.096 E019.48.20.426 Color_251ACI
N050.04.20.146 E019.48.20.922 N050.04.19.821 E019.48.21.109 Color_251ACI
N050.04.19.338 E019.48.16.384 N050.04.19.034 E019.48.16.487 Color_251ACI
N050.04.18.142 E019.48.16.714 N050.04.18.428 E019.48.19.393 Color_251ACI
N050.04.18.676 E019.48.16.558 N050.04.18.894 E019.48.18.521 Color_251ACI
N050.04.18.894 E019.48.18.521 N050.04.18.912 E019.48.18.821 Color_251ACI
N050.04.18.912 E019.48.18.821 N050.04.18.950 E019.48.19.037 Color_251ACI
N050.04.18.950 E019.48.19.037 N050.04.19.245 E019.48.20.325 Color_251ACI
N050.04.18.208 E019.48.15.839 N050.04.17.866 E019.48.15.968 Color_251ACI
N050.04.17.679 E019.48.11.422 N050.04.17.348 E019.48.11.510 Color_251ACI
N050.04.18.195 E019.48.10.967 N050.04.17.880 E019.48.11.112 Color_251ACI
N050.04.18.715 E019.48.15.667 N050.04.18.411 E019.48.15.770 Color_251ACI
N050.04.19.238 E019.48.15.552 N050.04.18.907 E019.48.15.639 Color_251ACI
N050.04.18.712 E019.48.10.752 N050.04.18.408 E019.48.10.856 Color_251ACI
N050.04.19.506 E019.48.15.716 N050.04.19.554 E019.48.15.648 Color_251ACI
N050.04.19.554 E019.48.15.648 N050.04.19.629 E019.48.15.598 Color_251ACI
N050.04.19.629 E019.48.15.598 N050.04.19.676 E019.48.15.530 Color_251ACI
N050.04.19.676 E019.48.15.530 N050.04.19.671 E019.48.15.430 Color_251ACI
N050.04.19.671 E019.48.15.430 N050.04.19.648 E019.48.15.272 Color_251ACI
N050.04.19.648 E019.48.15.272 N050.04.19.435 E019.48.13.168 Color_251ACI
N050.04.19.435 E019.48.13.168 N050.04.19.184 E019.48.11.088 Color_251ACI
N050.04.19.184 E019.48.11.088 N050.04.19.145 E019.48.10.631 Color_251ACI
N050.04.19.145 E019.48.10.631 N050.04.19.129 E019.48.10.573 Color_251ACI
N050.04.19.129 E019.48.10.573 N050.04.19.048 E019.48.10.523 Color_251ACI
N050.04.19.048 E019.48.10.523 N050.04.18.994 E019.48.10.491 Color_251ACI
N050.04.18.994 E019.48.10.491 N050.04.18.930 E019.48.10.500 Color_251ACI
N050.04.30.167 E019.48.10.560 N050.04.28.841 E019.48.09.317 Color_251ACI
N050.04.28.841 E019.48.09.317 N050.04.28.762 E019.48.09.510 Color_251ACI
N050.04.30.167 E019.48.10.560 N050.04.30.302 E019.48.10.641 Color_251ACI
N050.04.30.302 E019.48.10.641 N050.04.30.409 E019.48.10.707 Color_251ACI
N050.04.30.409 E019.48.10.707 N050.04.30.537 E019.48.10.688 Color_251ACI
N050.04.30.537 E019.48.10.688 N050.04.30.622 E019.48.10.596 Color_251ACI
N050.04.30.622 E019.48.10.596 N050.04.30.743 E019.48.10.236 Color_251ACI
N050.04.30.860 E019.48.12.234 N050.04.30.967 E019.48.12.299 Color_251ACI
N050.04.30.967 E019.48.12.299 N050.04.31.112 E019.48.12.339 Color_251ACI
N050.04.31.112 E019.48.12.339 N050.04.31.271 E019.48.12.196 Color_251ACI
N050.04.31.271 E019.48.12.196 N050.04.31.377 E019.48.12.020 Color_251ACI
N050.04.31.377 E019.48.12.020 N050.04.31.391 E019.48.11.595 Color_251ACI
N050.04.31.391 E019.48.11.595 N050.04.31.352 E019.48.11.137 Color_251ACI
N050.04.31.352 E019.48.11.137 N050.04.31.339 E019.48.10.696 Color_251ACI
N050.04.30.860 E019.48.12.234 N050.04.30.425 E019.48.11.873 Color_251ACI
N050.04.30.425 E019.48.11.873 N050.04.29.974 E019.48.11.453 Color_251ACI
N050.04.29.974 E019.48.11.453 N050.04.29.877 E019.48.11.346 Color_251ACI
N050.04.29.877 E019.48.11.346 N050.04.29.727 E019.48.11.206 Color_251ACI
N050.04.29.727 E019.48.11.206 N050.04.29.688 E019.48.10.990 Color_251ACI
N050.04.29.688 E019.48.10.990 N050.04.29.704 E019.48.10.807 Color_251ACI
N050.04.29.704 E019.48.10.807 N050.04.29.884 E019.48.10.580 Color_251ACI
N050.04.29.884 E019.48.10.580 N050.04.29.948 E019.48.10.570 Color_251ACI
N050.04.29.948 E019.48.10.570 N050.04.30.056 E019.48.10.636 Color_251ACI
N050.04.30.056 E019.48.10.636 N050.04.30.206 E019.48.10.776 Color_251ACI
N050.04.30.206 E019.48.10.776 N050.04.30.367 E019.48.10.874 Color_251ACI
N050.04.30.367 E019.48.10.874 N050.04.30.559 E019.48.10.846 Color_251ACI
N050.04.30.559 E019.48.10.846 N050.04.30.681 E019.48.10.728 Color_251ACI
N050.04.30.681 E019.48.10.728 N050.04.30.819 E019.48.10.427 Color_251ACI
N050.04.30.819 E019.48.10.427 N050.04.30.930 E019.48.10.109 Color_251ACI
N050.04.30.930 E019.48.10.109 N050.04.31.042 E019.48.10.033 Color_251ACI
N050.04.31.042 E019.48.10.033 N050.04.31.170 E019.48.10.015 Color_251ACI
N050.04.31.170 E019.48.10.015 N050.04.31.240 E019.48.10.106 Color_251ACI
N050.04.31.240 E019.48.10.106 N050.04.31.299 E019.48.10.238 Color_251ACI
N050.04.31.299 E019.48.10.238 N050.04.31.339 E019.48.10.696 Color_251ACI
N050.04.29.846 E019.48.13.687 N050.04.29.829 E019.48.13.629 Color_251ACI
N050.04.29.829 E019.48.13.629 N050.04.29.663 E019.48.13.431 Color_251ACI
N050.04.29.663 E019.48.13.431 N050.04.29.459 E019.48.13.258 Color_251ACI
N050.04.29.459 E019.48.13.258 N050.04.29.244 E019.48.13.127 Color_251ACI
N050.04.29.244 E019.48.13.127 N050.04.29.115 E019.48.12.904 Color_251ACI
N050.04.29.115 E019.48.12.904 N050.04.29.044 E019.48.12.572 Color_251ACI
N050.04.29.044 E019.48.12.572 N050.04.29.053 E019.48.12.288 Color_251ACI
N050.04.29.053 E019.48.12.288 N050.04.29.100 E019.48.11.980 Color_251ACI
N050.04.29.100 E019.48.11.980 N050.04.29.237 E019.48.11.678 Color_251ACI
N050.04.29.237 E019.48.11.678 N050.04.29.375 E019.48.11.377 Color_251ACI
N050.04.29.375 E019.48.11.377 N050.04.29.475 E019.48.11.101 Color_251ACI
N050.04.29.475 E019.48.11.101 N050.04.29.565 E019.48.10.866 Color_251ACI
N050.04.29.565 E019.48.10.866 N050.04.29.574 E019.48.10.583 Color_251ACI
N050.04.29.574 E019.48.10.583 N050.04.29.579 E019.48.10.442 Color_251ACI
N050.04.29.579 E019.48.10.442 N050.04.29.557 E019.48.10.284 Color_251ACI
N050.04.29.557 E019.48.10.284 N050.04.29.470 E019.48.10.135 Color_251ACI
N050.04.29.470 E019.48.10.135 N050.04.29.116 E019.48.09.822 Color_251ACI
N050.04.29.116 E019.48.09.822 N050.04.28.762 E019.48.09.510 Color_251ACI
N050.04.21.132 E019.48.23.643 N050.04.21.234 E019.48.23.608 Color_251ACI
N050.04.21.234 E019.48.23.608 N050.04.21.346 E019.48.23.532 Color_251ACI
N050.04.21.346 E019.48.23.532 N050.04.21.404 E019.48.23.423 Color_251ACI
N050.04.21.404 E019.48.23.423 N050.04.21.446 E019.48.23.256 Color_251ACI
N050.04.21.446 E019.48.23.256 N050.04.21.477 E019.48.23.130 Color_251ACI
N050.04.21.477 E019.48.23.130 N050.04.21.455 E019.48.22.972 Color_251ACI
N050.04.21.455 E019.48.22.972 N050.04.21.406 E019.48.22.798 Color_251ACI
N050.04.21.406 E019.48.22.798 N050.04.21.336 E019.48.22.707 Color_251ACI
N050.04.21.336 E019.48.22.707 N050.04.21.240 E019.48.22.600 Color_251ACI
N050.04.21.240 E019.48.22.600 N050.04.21.149 E019.48.22.593 Color_251ACI
N050.04.21.149 E019.48.22.593 N050.04.21.047 E019.48.22.627 Color_251ACI
N050.04.21.047 E019.48.22.627 N050.04.20.935 E019.48.22.704 Color_251ACI
N050.04.20.935 E019.48.22.704 N050.04.20.877 E019.48.22.813 Color_251ACI
N050.04.20.877 E019.48.22.813 N050.04.20.846 E019.48.22.938 Color_251ACI
N050.04.20.846 E019.48.22.938 N050.04.20.804 E019.48.23.105 Color_251ACI
N050.04.20.804 E019.48.23.105 N050.04.20.826 E019.48.23.263 Color_251ACI
N050.04.20.826 E019.48.23.263 N050.04.20.885 E019.48.23.396 Color_251ACI
N050.04.20.885 E019.48.23.396 N050.04.20.945 E019.48.23.528 Color_251ACI
N050.04.20.945 E019.48.23.528 N050.04.21.052 E019.48.23.594 Color_251ACI
N050.04.21.052 E019.48.23.594 N050.04.21.132 E019.48.23.643 Color_251ACI
N050.04.18.317 E019.48.08.633 N050.04.17.239 E019.48.08.987 Color_251ACI
N050.04.18.121 E019.48.10.151 N050.04.17.790 E019.48.10.238 Color_251ACI
N050.04.17.783 E019.48.08.789 N050.04.17.956 E019.48.10.195 Color_251ACI
N050.04.18.639 E019.48.09.937 N050.04.18.308 E019.48.10.024 Color_251ACI
N050.04.18.262 E019.48.08.359 N050.04.18.473 E019.48.09.981 Color_251ACI
N050.04.20.387 E019.48.15.530 N050.04.20.303 E019.48.14.757 Color_251ACI
N050.04.20.303 E019.48.14.757 N050.04.20.111 E019.48.14.784 Color_251ACI
N050.04.20.111 E019.48.14.784 N050.04.19.933 E019.48.13.278 Color_251ACI
N050.04.19.450 E019.48.08.553 N050.04.19.425 E019.48.08.778 Color_251ACI
N050.04.19.425 E019.48.08.778 N050.04.19.442 E019.48.09.078 Color_251ACI
N050.04.19.442 E019.48.09.078 N050.04.19.416 E019.48.09.303 Color_251ACI
N050.04.19.416 E019.48.09.303 N050.04.19.412 E019.48.09.445 Color_251ACI
N050.04.19.412 E019.48.09.445 N050.04.19.374 E019.48.09.470 Color_251ACI
N050.04.19.374 E019.48.09.470 N050.04.19.348 E019.48.09.454 Color_251ACI
N050.04.19.348 E019.48.09.454 N050.04.19.277 E019.48.09.121 Color_251ACI
N050.04.19.277 E019.48.09.121 N050.04.19.222 E019.48.08.847 Color_251ACI
N050.04.19.222 E019.48.08.847 N050.04.19.183 E019.48.08.631 Color_251ACI
N050.04.19.183 E019.48.08.631 N050.04.19.194 E019.48.08.589 Color_251ACI
N050.04.19.194 E019.48.08.589 N050.04.19.295 E019.48.08.555 Color_251ACI
N050.04.19.295 E019.48.08.555 N050.04.19.423 E019.48.08.537 Color_251ACI
N050.04.20.387 E019.48.15.530 N050.04.20.227 E019.48.15.432 Color_251ACI
N050.04.20.227 E019.48.15.432 N050.04.20.033 E019.48.15.218 Color_251ACI
N050.04.20.033 E019.48.15.218 N050.04.19.956 E019.48.14.786 Color_251ACI
N050.04.19.956 E019.48.14.786 N050.04.19.894 E019.48.14.170 Color_251ACI
N050.04.19.894 E019.48.14.170 N050.04.19.816 E019.48.13.496 Color_251ACI
N050.04.19.816 E019.48.13.496 N050.04.19.678 E019.48.12.448 Color_251ACI
N050.04.19.678 E019.48.12.448 N050.04.19.566 E019.48.11.417 Color_251ACI
N050.04.19.566 E019.48.11.417 N050.04.19.526 E019.48.10.959 Color_251ACI
N050.04.19.526 E019.48.10.959 N050.04.19.601 E019.48.09.801 Color_251ACI
N050.04.19.601 E019.48.09.801 N050.04.19.622 E019.48.08.609 Color_251ACI
N050.04.18.828 E019.46.52.989 N050.04.20.255 E019.47.02.817 Color_251ACI
N050.04.20.255 E019.47.02.817 N050.04.21.000 E019.47.07.606 Color_251ACI
N050.04.19.607 E019.46.24.902 N050.04.19.755 E019.46.22.343 Color_251ACI
N050.04.18.697 E019.46.24.829 N050.04.19.398 E019.46.24.871 Color_251ACI
N050.04.19.398 E019.46.24.871 N050.04.19.535 E019.46.22.354 Color_251ACI
N050.05.05.043 E019.48.10.392 N050.05.04.825 E019.48.09.536 Color_251ACI
N050.05.04.825 E019.48.09.536 N050.05.04.634 E019.48.08.697 Color_251ACI
N050.05.04.634 E019.48.08.697 N050.05.03.964 E019.48.06.073 Color_251ACI
N050.05.03.964 E019.48.06.073 N050.05.03.294 E019.48.03.449 Color_251ACI
N050.05.03.294 E019.48.03.449 N050.05.03.048 E019.48.02.336 Color_251ACI
N050.05.03.048 E019.48.02.336 N050.05.02.877 E019.48.01.172 Color_251ACI
N050.05.02.877 E019.48.01.172 N050.05.02.764 E019.47.59.899 Color_251ACI
N050.05.02.764 E019.47.59.899 N050.05.02.742 E019.47.58.633 Color_251ACI
N050.05.02.742 E019.47.58.633 N050.05.02.810 E019.47.57.374 Color_251ACI
N050.05.02.810 E019.47.57.374 N050.05.03.013 E019.47.56.197 Color_251ACI
N050.05.03.013 E019.47.56.197 N050.05.03.302 E019.47.55.170 Color_251ACI
N050.05.03.302 E019.47.55.170 N050.05.03.581 E019.47.54.183 Color_251ACI
N050.05.14.102 E019.48.20.347 N050.05.14.546 E019.48.21.533 Color_251ACI
N050.05.14.546 E019.48.21.533 N050.05.14.979 E019.48.22.761 Color_251ACI
N050.05.14.979 E019.48.22.761 N050.05.15.413 E019.48.23.988 Color_251ACI
N050.05.15.413 E019.48.23.988 N050.05.15.921 E019.48.25.165 Color_251ACI
N050.05.15.921 E019.48.25.165 N050.05.16.045 E019.48.25.530 Color_251ACI
N050.05.13.892 E019.48.21.183 N050.05.14.125 E019.48.21.854 Color_251ACI
N050.05.14.125 E019.48.21.854 N050.05.14.358 E019.48.22.526 Color_251ACI
N050.05.14.358 E019.48.22.526 N050.05.15.094 E019.48.24.275 Color_251ACI
N050.05.15.094 E019.48.24.275 N050.05.15.829 E019.48.26.024 Color_251ACI
N050.05.13.553 E019.48.21.795 N050.05.13.780 E019.48.22.367 Color_251ACI
N050.05.13.780 E019.48.22.367 N050.05.14.008 E019.48.22.939 Color_251ACI
N050.05.14.008 E019.48.22.939 N050.05.14.850 E019.48.24.753 Color_251ACI
N050.05.14.850 E019.48.24.753 N050.05.15.719 E019.48.26.583 Color_251ACI
N050.05.09.331 E019.48.28.516 N050.05.09.555 E019.48.28.363 Color_251ACI
N050.05.09.555 E019.48.28.363 N050.05.09.742 E019.48.28.236 Color_251ACI
N050.05.09.742 E019.48.28.236 N050.05.10.104 E019.48.28.024 Color_251ACI
N050.05.10.104 E019.48.28.024 N050.05.10.483 E019.48.27.869 Color_251ACI
N050.05.10.483 E019.48.27.869 N050.05.10.990 E019.48.27.697 Color_251ACI
N050.05.10.990 E019.48.27.697 N050.05.11.496 E019.48.27.524 Color_251ACI
N050.05.11.496 E019.48.27.524 N050.05.11.918 E019.48.27.444 Color_251ACI
N050.05.11.918 E019.48.27.444 N050.05.12.330 E019.48.27.406 Color_251ACI
N050.05.12.330 E019.48.27.406 N050.05.12.976 E019.48.27.415 Color_251ACI
N050.05.12.976 E019.48.27.415 N050.05.13.613 E019.48.27.466 Color_251ACI
N050.05.13.613 E019.48.27.466 N050.05.14.046 E019.48.27.586 Color_251ACI
N050.05.14.046 E019.48.27.586 N050.05.14.442 E019.48.27.731 Color_251ACI
N050.05.14.442 E019.48.27.731 N050.05.14.855 E019.48.27.935 Color_251ACI
N050.05.14.855 E019.48.27.935 N050.05.15.203 E019.48.28.147 Color_251ACI
N050.05.12.840 E019.48.23.527 N050.05.12.422 E019.48.24.332 Color_251ACI
N050.05.12.422 E019.48.24.332 N050.05.11.966 E019.48.25.162 Color_251ACI
N050.05.11.966 E019.48.25.162 N050.05.11.096 E019.48.26.413 Color_251ACI
N050.05.11.096 E019.48.26.413 N050.05.10.182 E019.48.27.590 Color_251ACI
N050.05.10.182 E019.48.27.590 N050.05.09.757 E019.48.28.053 Color_251ACI
N050.05.09.757 E019.48.28.053 N050.05.09.331 E019.48.28.516 Color_251ACI
N050.04.50.456 E019.48.33.285 N050.04.49.761 E019.48.33.343 Color_251ACI
N050.04.49.761 E019.48.33.343 N050.04.48.746 E019.48.33.447 Color_251ACI
N050.04.48.746 E019.48.33.447 N050.04.46.744 E019.48.33.912 Color_251ACI
N050.04.46.744 E019.48.33.912 N050.04.45.671 E019.48.34.124 Color_251ACI
N050.04.45.671 E019.48.34.124 N050.04.45.505 E019.48.34.168 Color_251ACI
N050.04.50.910 E019.48.33.322 N050.04.50.889 E019.48.33.405 Color_251ACI
N050.04.50.889 E019.48.33.405 N050.04.50.911 E019.48.33.563 Color_251ACI
N050.04.50.911 E019.48.33.563 N050.04.51.332 E019.48.36.565 Color_251ACI
N050.04.51.332 E019.48.36.565 N050.04.52.252 E019.48.43.243 Color_251ACI
N050.04.52.252 E019.48.43.243 N050.04.52.789 E019.48.47.134 Color_251ACI
N050.04.52.789 E019.48.47.134 N050.04.53.454 E019.48.52.116 Color_251ACI
N050.04.53.454 E019.48.52.116 N050.04.53.503 E019.48.52.290 Color_251ACI
N050.04.53.503 E019.48.52.290 N050.04.53.600 E019.48.52.397 Color_251ACI
N050.04.53.600 E019.48.52.397 N050.04.53.815 E019.48.52.528 Color_251ACI
N050.04.53.815 E019.48.52.528 N050.04.54.478 E019.48.52.595 Color_251ACI
N050.04.54.478 E019.48.52.595 N050.04.54.534 E019.48.53.111 Color_251ACI
N050.04.54.534 E019.48.53.111 N050.04.54.599 E019.48.53.343 Color_251ACI
N050.04.54.599 E019.48.53.343 N050.04.54.631 E019.48.53.460 Color_251ACI
N050.04.54.631 E019.48.53.460 N050.04.54.648 E019.48.53.518 Color_251ACI
N050.04.54.648 E019.48.53.518 N050.04.54.715 E019.48.53.126 Color_251ACI
N050.04.54.715 E019.48.53.126 N050.04.54.726 E019.48.53.084 Color_251ACI
N050.04.54.726 E019.48.53.084 N050.04.54.693 E019.48.52.968 Color_251ACI
N050.04.54.693 E019.48.52.968 N050.04.54.683 E019.48.53.009 Color_251ACI
N050.04.54.683 E019.48.53.009 N050.04.54.627 E019.48.52.494 Color_251ACI
N050.04.54.627 E019.48.52.494 N050.04.54.830 E019.48.52.425 Color_251ACI
N050.04.54.830 E019.48.52.425 N050.04.54.885 E019.48.52.940 Color_251ACI
N050.04.54.885 E019.48.52.940 N050.04.54.885 E019.48.52.940 Color_251ACI
N050.04.54.885 E019.48.52.940 N050.04.54.875 E019.48.52.982 Color_251ACI
N050.04.54.875 E019.48.52.982 N050.04.54.887 E019.48.53.182 Color_251ACI
N050.04.54.887 E019.48.53.182 N050.04.54.851 E019.48.53.449 Color_251ACI
N050.04.54.851 E019.48.53.449 N050.04.54.809 E019.48.53.616 Color_251ACI
N050.04.54.809 E019.48.53.616 N050.04.54.809 E019.48.53.616 Color_251ACI
N050.04.54.809 E019.48.53.616 N050.04.55.032 E019.48.53.463 Color_251ACI
N050.04.55.032 E019.48.53.463 N050.04.55.099 E019.48.53.937 Color_251ACI
N050.04.55.099 E019.48.53.937 N050.04.54.848 E019.48.54.074 Color_251ACI
N050.04.54.848 E019.48.54.074 N050.04.54.925 E019.48.54.506 Color_251ACI
N050.04.54.925 E019.48.54.506 N050.04.55.037 E019.48.54.429 Color_251ACI
N050.04.55.037 E019.48.54.429 N050.04.55.081 E019.48.54.745 Color_251ACI
N050.04.55.081 E019.48.54.745 N050.04.54.729 E019.48.54.916 Color_251ACI
N050.04.54.729 E019.48.54.916 N050.04.54.740 E019.48.54.874 Color_251ACI
N050.04.54.740 E019.48.54.874 N050.04.54.601 E019.48.54.934 Color_251ACI
N050.04.54.601 E019.48.54.934 N050.04.54.579 E019.48.54.776 Color_251ACI
N050.04.54.579 E019.48.54.776 N050.04.54.525 E019.48.54.744 Color_251ACI
N050.04.54.525 E019.48.54.744 N050.04.54.327 E019.48.53.563 Color_251ACI
N050.04.54.327 E019.48.53.563 N050.04.54.295 E019.48.53.447 Color_251ACI
N050.04.54.295 E019.48.53.447 N050.04.54.256 E019.48.53.231 Color_251ACI
N050.04.54.256 E019.48.53.231 N050.04.54.170 E019.48.53.082 Color_251ACI
N050.04.54.170 E019.48.53.082 N050.04.54.046 E019.48.52.958 Color_251ACI
N050.04.54.046 E019.48.52.958 N050.04.53.929 E019.48.52.935 Color_251ACI
N050.04.53.929 E019.48.52.935 N050.04.53.613 E019.48.52.839 Color_251ACI
N050.04.53.613 E019.48.52.839 N050.04.53.313 E019.48.52.800 Color_251ACI
N050.04.53.313 E019.48.52.800 N050.04.53.268 E019.48.52.243 Color_251ACI
N050.04.53.268 E019.48.52.243 N050.04.52.735 E019.48.48.210 Color_251ACI
N050.04.52.735 E019.48.48.210 N050.04.51.776 E019.48.41.074 Color_251ACI
N050.04.51.776 E019.48.41.074 N050.04.50.740 E019.48.33.507 Color_251ACI
N050.04.50.740 E019.48.33.507 N050.04.50.697 E019.48.33.432 Color_251ACI
N050.04.50.697 E019.48.33.432 N050.04.50.627 E019.48.33.342 Color_251ACI
N050.04.50.627 E019.48.33.342 N050.04.50.456 E019.48.33.285 Color_251ACI
N050.04.23.461 E019.48.24.340 N050.04.22.834 E019.48.24.006 Color_251ACI
N050.04.22.834 E019.48.24.006 N050.04.22.013 E019.48.23.457 Color_251ACI
N050.04.29.248 E019.48.27.146 N050.04.30.271 E019.48.27.625 Color_251ACI
N050.04.30.271 E019.48.27.625 N050.04.31.321 E019.48.28.121 Color_251ACI
N050.04.31.321 E019.48.28.121 N050.04.32.801 E019.48.28.878 Color_251ACI
N050.04.32.801 E019.48.28.878 N050.04.34.306 E019.48.29.652 Color_251ACI
N050.04.34.306 E019.48.29.652 N050.04.35.266 E019.48.30.140 Color_251ACI
N050.04.35.266 E019.48.30.140 N050.04.36.262 E019.48.30.603 Color_251ACI
N050.04.36.262 E019.48.30.603 N050.04.36.883 E019.48.30.837 Color_251ACI
N050.04.36.883 E019.48.30.837 N050.04.37.521 E019.48.31.130 Color_251ACI
N050.04.37.521 E019.48.31.130 N050.04.37.971 E019.48.31.308 Color_251ACI
N050.04.37.971 E019.48.31.308 N050.04.38.404 E019.48.31.428 Color_251ACI
N050.04.38.404 E019.48.31.428 N050.04.39.003 E019.48.31.504 Color_251ACI
N050.04.39.003 E019.48.31.504 N050.04.39.602 E019.48.31.580 Color_251ACI
N050.04.39.602 E019.48.31.580 N050.04.40.340 E019.48.31.597 Color_251ACI
N050.04.40.340 E019.48.31.597 N050.04.41.082 E019.48.31.471 Color_251ACI
N050.04.41.082 E019.48.31.471 N050.04.43.143 E019.48.30.897 Color_251ACI
N050.04.43.143 E019.48.30.897 N050.04.45.187 E019.48.30.265 Color_251ACI
N050.04.45.187 E019.48.30.265 N050.04.46.559 E019.48.29.849 Color_251ACI
N050.04.46.559 E019.48.29.849 N050.04.47.920 E019.48.29.475 Color_251ACI
N050.04.47.920 E019.48.29.475 N050.04.48.961 E019.48.29.146 Color_251ACI
N050.04.48.961 E019.48.29.146 N050.04.50.023 E019.48.28.976 Color_251ACI
N050.04.50.023 E019.48.28.976 N050.04.50.755 E019.48.28.892 Color_251ACI
N050.04.50.755 E019.48.28.892 N050.04.51.503 E019.48.28.867 Color_251ACI
N050.04.51.503 E019.48.28.867 N050.04.52.652 E019.48.28.845 Color_251ACI
N050.04.52.652 E019.48.28.845 N050.04.53.828 E019.48.28.839 Color_251ACI
N050.04.53.828 E019.48.28.839 N050.04.55.298 E019.48.28.772 Color_251ACI
N050.04.55.298 E019.48.28.772 N050.04.56.778 E019.48.28.663 Color_251ACI
N050.04.56.778 E019.48.28.663 N050.04.58.365 E019.48.28.620 Color_251ACI
N050.04.58.365 E019.48.28.620 N050.04.59.942 E019.48.28.618 Color_251ACI
N050.04.59.942 E019.48.28.618 N050.05.00.919 E019.48.28.540 Color_251ACI
N050.05.00.919 E019.48.28.540 N050.05.01.891 E019.48.28.362 Color_251ACI
N050.05.01.891 E019.48.28.362 N050.05.03.188 E019.48.27.997 Color_251ACI
N050.05.03.188 E019.48.27.997 N050.05.04.479 E019.48.27.532 Color_251ACI
N050.05.04.479 E019.48.27.532 N050.05.04.885 E019.48.27.394 Color_251ACI
N050.05.04.885 E019.48.27.394 N050.05.05.226 E019.48.27.265 Color_251ACI
N050.04.28.208 E019.48.28.824 N050.04.28.271 E019.48.28.573 Color_251ACI
N050.04.28.271 E019.48.28.573 N050.04.28.318 E019.48.28.264 Color_251ACI
N050.04.28.318 E019.48.28.264 N050.04.28.450 E019.48.27.863 Color_251ACI
N050.04.28.450 E019.48.27.863 N050.04.28.593 E019.48.27.661 Color_251ACI
N050.04.28.593 E019.48.27.661 N050.04.28.742 E019.48.27.560 Color_251ACI
N050.04.28.742 E019.48.27.560 N050.04.29.009 E019.48.27.482 Color_251ACI
N050.04.29.009 E019.48.27.482 N050.04.30.123 E019.48.27.968 Color_251ACI
N050.04.30.123 E019.48.27.968 N050.04.31.227 E019.48.28.497 Color_251ACI
N050.04.31.227 E019.48.28.497 N050.04.32.722 E019.48.29.312 Color_251ACI
N050.04.32.722 E019.48.29.312 N050.04.34.201 E019.48.30.069 Color_251ACI
N050.04.34.201 E019.48.30.069 N050.04.35.198 E019.48.30.532 Color_251ACI
N050.04.35.198 E019.48.30.532 N050.04.36.194 E019.48.30.995 Color_251ACI
N050.04.36.194 E019.48.30.995 N050.04.36.661 E019.48.31.232 Color_251ACI
N050.04.36.661 E019.48.31.232 N050.04.37.175 E019.48.31.400 Color_251ACI
N050.04.37.175 E019.48.31.400 N050.04.37.517 E019.48.31.513 Color_251ACI
N050.04.37.517 E019.48.31.513 N050.04.37.876 E019.48.31.684 Color_251ACI
N050.04.37.876 E019.48.31.684 N050.04.38.727 E019.48.31.865 Color_251ACI
N050.04.38.727 E019.48.31.865 N050.04.39.588 E019.48.32.005 Color_251ACI
N050.04.39.588 E019.48.32.005 N050.04.40.363 E019.48.31.996 Color_251ACI
N050.04.40.363 E019.48.31.996 N050.04.41.095 E019.48.31.912 Color_251ACI
N050.04.41.095 E019.48.31.912 N050.04.43.166 E019.48.31.297 Color_251ACI
N050.04.43.166 E019.48.31.297 N050.04.45.237 E019.48.30.681 Color_251ACI
N050.04.45.237 E019.48.30.681 N050.04.46.582 E019.48.30.249 Color_251ACI
N050.04.46.582 E019.48.30.249 N050.04.47.943 E019.48.29.875 Color_251ACI
N050.04.47.943 E019.48.29.875 N050.04.48.936 E019.48.29.613 Color_251ACI
N050.04.48.936 E019.48.29.613 N050.04.49.945 E019.48.29.410 Color_251ACI
N050.04.49.945 E019.48.29.410 N050.04.50.667 E019.48.29.368 Color_251ACI
N050.04.50.667 E019.48.29.368 N050.04.51.351 E019.48.29.352 Color_251ACI
N050.04.51.351 E019.48.29.352 N050.04.52.601 E019.48.29.295 Color_251ACI
N050.04.52.601 E019.48.29.295 N050.04.53.841 E019.48.29.281 Color_251ACI
N050.04.53.841 E019.48.29.281 N050.04.55.294 E019.48.29.155 Color_251ACI
N050.04.55.294 E019.48.29.155 N050.04.56.764 E019.48.29.088 Color_251ACI
N050.04.56.764 E019.48.29.088 N050.04.58.223 E019.48.29.063 Color_251ACI
N050.04.58.223 E019.48.29.063 N050.04.59.692 E019.48.28.995 Color_251ACI
N050.04.59.692 E019.48.28.995 N050.05.00.595 E019.48.28.968 Color_251ACI
N050.05.00.595 E019.48.28.968 N050.05.01.493 E019.48.28.841 Color_251ACI
N050.05.01.493 E019.48.28.841 N050.05.03.019 E019.48.28.423 Color_251ACI
N050.05.03.019 E019.48.28.423 N050.05.04.556 E019.48.27.964 Color_251ACI
N050.05.04.556 E019.48.27.964 N050.05.04.962 E019.48.27.826 Color_251ACI
N050.05.04.962 E019.48.27.826 N050.05.05.351 E019.48.27.630 Color_251ACI
N050.05.05.351 E019.48.27.630 N050.05.05.516 E019.48.27.586 Color_251ACI
N050.05.05.516 E019.48.27.586 N050.05.05.698 E019.48.27.601 Color_251ACI
N050.05.05.698 E019.48.27.601 N050.05.05.913 E019.48.27.731 Color_251ACI
N050.05.05.913 E019.48.27.731 N050.05.06.052 E019.48.27.913 Color_251ACI
N050.05.06.052 E019.48.27.913 N050.05.06.144 E019.48.28.162 Color_251ACI
N050.05.06.144 E019.48.28.162 N050.05.06.221 E019.48.28.594 Color_251ACI
N050.05.06.221 E019.48.28.594 N050.05.06.346 E019.48.28.959 Color_251ACI
N050.04.19.663 E019.48.38.111 N050.04.19.499 E019.48.37.530 Color_251ACI
N050.04.19.499 E019.48.37.530 N050.04.19.320 E019.48.36.891 Color_251ACI
N050.04.19.320 E019.48.36.891 N050.04.19.156 E019.48.36.068 Color_251ACI
N050.04.19.156 E019.48.36.068 N050.04.19.055 E019.48.35.236 Color_251ACI
N050.04.19.055 E019.48.35.236 N050.04.18.976 E019.48.34.321 Color_251ACI
N050.04.18.976 E019.48.34.321 N050.04.19.025 E019.48.33.388 Color_251ACI
N050.04.19.025 E019.48.33.388 N050.04.19.213 E019.48.32.394 Color_251ACI
N050.04.19.213 E019.48.32.394 N050.04.19.400 E019.48.31.401 Color_251ACI
N050.04.19.400 E019.48.31.401 N050.04.19.783 E019.48.29.756 Color_251ACI
N050.04.19.783 E019.48.29.756 N050.04.20.159 E019.48.28.010 Color_251ACI
N050.04.20.159 E019.48.28.010 N050.04.20.415 E019.48.26.866 Color_251ACI
N050.04.20.415 E019.48.26.866 N050.04.20.635 E019.48.25.747 Color_251ACI
N050.04.28.010 E019.48.28.751 N050.04.28.062 E019.48.28.301 Color_251ACI
N050.04.28.062 E019.48.28.301 N050.04.28.166 E019.48.27.883 Color_251ACI
N050.04.28.166 E019.48.27.883 N050.04.28.192 E019.48.27.658 Color_251ACI
N050.04.28.192 E019.48.27.658 N050.04.28.164 E019.48.27.400 Color_251ACI
N050.04.28.164 E019.48.27.400 N050.04.27.992 E019.48.27.102 Color_251ACI
N050.04.27.992 E019.48.27.102 N050.04.27.643 E019.48.26.890 Color_251ACI
N050.04.27.643 E019.48.26.890 N050.04.27.300 E019.48.26.777 Color_251ACI
N050.04.27.300 E019.48.26.777 N050.04.26.690 E019.48.26.501 Color_251ACI
N050.04.26.690 E019.48.26.501 N050.04.26.095 E019.48.26.283 Color_251ACI
N050.04.26.095 E019.48.26.283 N050.04.25.903 E019.48.26.310 Color_251ACI
N050.04.25.903 E019.48.26.310 N050.04.25.733 E019.48.26.496 Color_251ACI
N050.04.25.733 E019.48.26.496 N050.04.25.579 E019.48.26.739 Color_251ACI
N050.04.25.579 E019.48.26.739 N050.04.25.367 E019.48.27.091 Color_251ACI
N050.04.25.367 E019.48.27.091 N050.04.25.198 E019.48.27.518 Color_251ACI
N050.04.25.198 E019.48.27.518 N050.04.25.087 E019.48.27.836 Color_251ACI
N050.04.25.087 E019.48.27.836 N050.04.25.003 E019.48.28.170 Color_251ACI
N050.04.21.241 E019.48.25.057 N050.04.21.346 E019.48.24.640 Color_251ACI
N050.04.21.346 E019.48.24.640 N050.04.21.510 E019.48.24.355 Color_251ACI
N050.04.21.510 E019.48.24.355 N050.04.21.777 E019.48.24.276 Color_251ACI
N050.04.21.777 E019.48.24.276 N050.04.22.093 E019.48.24.373 Color_251ACI
N050.04.22.093 E019.48.24.373 N050.04.22.409 E019.48.24.469 Color_251ACI
N050.04.22.409 E019.48.24.469 N050.04.23.496 E019.48.24.939 Color_251ACI
N050.04.23.496 E019.48.24.939 N050.04.24.573 E019.48.25.451 Color_251ACI
N050.04.24.573 E019.48.25.451 N050.04.24.916 E019.48.25.564 Color_251ACI
N050.04.24.916 E019.48.25.564 N050.04.25.248 E019.48.25.718 Color_251ACI
N050.04.25.248 E019.48.25.718 N050.04.25.345 E019.48.25.825 Color_251ACI
N050.04.25.345 E019.48.25.825 N050.04.25.346 E019.48.26.067 Color_251ACI
N050.04.25.346 E019.48.26.067 N050.04.24.888 E019.48.27.522 Color_251ACI
N050.04.24.888 E019.48.27.522 N050.04.24.457 E019.48.28.993 Color_251ACI
N050.05.07.044 E019.48.05.254 N050.05.06.919 E019.48.07.105 Color_251ACI
N050.05.06.919 E019.48.07.105 N050.05.06.832 E019.48.08.930 Color_251ACI
N050.05.06.832 E019.48.08.930 N050.05.06.797 E019.48.09.438 Color_251ACI
N050.05.06.797 E019.48.09.438 N050.05.06.762 E019.48.09.947 Color_251ACI
N050.05.06.762 E019.48.09.947 N050.05.06.705 E019.48.10.297 Color_251ACI
N050.05.06.705 E019.48.10.297 N050.05.06.621 E019.48.10.631 Color_251ACI
N050.05.06.621 E019.48.10.631 N050.05.06.558 E019.48.10.882 Color_251ACI
N050.05.06.558 E019.48.10.882 N050.05.06.462 E019.48.11.016 Color_251ACI
N050.05.06.462 E019.48.11.016 N050.05.06.191 E019.48.11.236 Color_251ACI
N050.05.06.191 E019.48.11.236 N050.05.05.919 E019.48.11.456 Color_251ACI
N050.05.05.919 E019.48.11.456 N050.05.05.712 E019.48.11.667 Color_251ACI
N050.05.05.712 E019.48.11.667 N050.05.05.628 E019.48.12.001 Color_251ACI
N050.05.05.628 E019.48.12.001 N050.05.05.586 E019.48.12.168 Color_251ACI
N050.05.05.586 E019.48.12.168 N050.05.05.625 E019.48.12.384 Color_251ACI
N050.05.05.625 E019.48.12.384 N050.05.05.669 E019.48.12.700 Color_251ACI
N050.05.05.669 E019.48.12.700 N050.05.05.713 E019.48.13.016 Color_251ACI
N050.05.06.807 E019.48.04.965 N050.05.06.695 E019.48.07.257 Color_251ACI
N050.05.06.695 E019.48.07.257 N050.05.06.584 E019.48.09.549 Color_251ACI
N050.05.06.584 E019.48.09.549 N050.05.06.558 E019.48.09.774 Color_251ACI
N050.05.06.558 E019.48.09.774 N050.05.06.549 E019.48.10.058 Color_251ACI
N050.05.06.549 E019.48.10.058 N050.05.06.486 E019.48.10.308 Color_251ACI
N050.05.06.486 E019.48.10.308 N050.05.06.402 E019.48.10.642 Color_251ACI
N050.05.06.402 E019.48.10.642 N050.05.06.221 E019.48.10.869 Color_251ACI
N050.05.06.221 E019.48.10.869 N050.05.05.987 E019.48.11.064 Color_251ACI
N050.05.05.987 E019.48.11.064 N050.05.05.726 E019.48.11.242 Color_251ACI
N050.05.05.726 E019.48.11.242 N050.05.05.577 E019.48.11.343 Color_251ACI
N050.05.05.577 E019.48.11.343 N050.05.05.385 E019.48.11.371 Color_251ACI
N050.05.05.385 E019.48.11.371 N050.05.05.245 E019.48.11.189 Color_251ACI
N050.05.05.245 E019.48.11.189 N050.05.05.157 E019.48.10.798 Color_251ACI
N050.05.05.157 E019.48.10.798 N050.05.05.043 E019.48.10.392 Color_251ACI
N050.05.06.591 E019.48.28.723 N050.05.06.520 E019.48.28.391 Color_251ACI
N050.05.06.520 E019.48.28.391 N050.05.06.475 E019.48.28.075 Color_251ACI
N050.05.06.475 E019.48.28.075 N050.05.06.421 E019.48.27.800 Color_251ACI
N050.05.06.421 E019.48.27.800 N050.05.06.366 E019.48.27.526 Color_251ACI
N050.05.06.366 E019.48.27.526 N050.05.06.348 E019.48.27.227 Color_251ACI
N050.05.06.348 E019.48.27.227 N050.05.06.325 E019.48.26.827 Color_251ACI
N050.05.06.325 E019.48.26.827 N050.05.06.302 E019.48.26.427 Color_251ACI
N050.05.06.302 E019.48.26.427 N050.05.06.313 E019.48.25.519 Color_251ACI
N050.05.06.313 E019.48.25.519 N050.05.06.325 E019.48.24.611 Color_251ACI
N050.05.06.325 E019.48.24.611 N050.05.06.313 E019.48.22.196 Color_251ACI
N050.05.06.313 E019.48.22.196 N050.05.06.302 E019.48.19.781 Color_251ACI
N050.05.06.302 E019.48.19.781 N050.05.06.261 E019.48.17.974 Color_251ACI
N050.05.06.261 E019.48.17.974 N050.05.06.210 E019.48.16.208 Color_251ACI
N050.05.06.210 E019.48.16.208 N050.05.06.058 E019.48.14.719 Color_251ACI
N050.05.06.058 E019.48.14.719 N050.05.05.768 E019.48.13.290 Color_251ACI
N050.05.05.768 E019.48.13.290 N050.05.05.713 E019.48.13.016 Color_251ACI
N050.05.10.041 E019.48.12.765 N050.05.10.366 E019.48.13.686 Color_251ACI
N050.05.10.366 E019.48.13.686 N050.05.10.664 E019.48.14.590 Color_251ACI
N050.05.10.664 E019.48.14.590 N050.05.11.526 E019.48.16.946 Color_251ACI
N050.05.11.526 E019.48.16.946 N050.05.12.434 E019.48.19.234 Color_251ACI
N050.05.12.434 E019.48.19.234 N050.05.12.721 E019.48.19.939 Color_251ACI
N050.05.12.721 E019.48.19.939 N050.05.13.008 E019.48.20.643 Color_251ACI
N050.05.04.245 E019.47.52.277 N050.05.04.310 E019.47.52.509 Color_251ACI
N050.05.04.310 E019.47.52.509 N050.05.04.375 E019.47.52.741 Color_251ACI
N050.05.04.375 E019.47.52.741 N050.05.05.105 E019.47.55.498 Color_251ACI
N050.05.05.105 E019.47.55.498 N050.05.05.834 E019.47.58.255 Color_251ACI
N050.05.05.834 E019.47.58.255 N050.05.07.177 E019.48.02.879 Color_251ACI
N050.05.07.177 E019.48.02.879 N050.05.08.647 E019.48.07.484 Color_251ACI
N050.05.08.647 E019.48.07.484 N050.05.09.303 E019.48.09.425 Color_251ACI
N050.05.09.303 E019.48.09.425 N050.05.09.959 E019.48.11.367 Color_251ACI
N050.05.09.959 E019.48.11.367 N050.05.10.739 E019.48.13.432 Color_251ACI
N050.05.10.739 E019.48.13.432 N050.05.11.529 E019.48.15.455 Color_251ACI
N050.05.11.529 E019.48.15.455 N050.05.12.395 E019.48.17.668 Color_251ACI
N050.05.12.395 E019.48.17.668 N050.05.13.261 E019.48.19.882 Color_251ACI
N050.05.13.555 E019.48.18.954 N050.05.12.782 E019.48.16.989 Color_251ACI
N050.05.12.782 E019.48.16.989 N050.05.12.018 E019.48.14.983 Color_251ACI
N050.05.12.018 E019.48.14.983 N050.05.11.337 E019.48.13.266 Color_251ACI
N050.05.11.337 E019.48.13.266 N050.05.10.666 E019.48.11.508 Color_251ACI
N050.05.10.666 E019.48.11.508 N050.05.10.476 E019.48.10.911 Color_251ACI
N050.05.10.476 E019.48.10.911 N050.05.10.286 E019.48.10.313 Color_251ACI
N050.05.10.286 E019.48.10.313 N050.05.10.171 E019.48.09.907 Color_251ACI
N050.05.10.171 E019.48.09.907 N050.05.10.121 E019.48.09.491 Color_251ACI
N050.05.10.121 E019.48.09.491 N050.05.10.114 E019.48.09.149 Color_251ACI
N050.05.10.114 E019.48.09.149 N050.05.10.123 E019.48.08.625 Color_251ACI
N050.05.10.123 E019.48.08.625 N050.05.10.205 E019.48.08.049 Color_251ACI
N050.05.10.205 E019.48.08.049 N050.05.10.310 E019.48.07.631 Color_251ACI
N050.05.10.310 E019.48.07.631 N050.05.10.452 E019.48.07.188 Color_251ACI
N050.05.10.452 E019.48.07.188 N050.05.10.749 E019.48.06.743 Color_251ACI
N050.05.10.749 E019.48.06.743 N050.05.11.090 E019.48.06.373 Color_251ACI
N050.05.11.090 E019.48.06.373 N050.05.11.361 E019.48.06.153 Color_251ACI
N050.05.11.361 E019.48.06.153 N050.05.11.665 E019.48.06.049 Color_251ACI
N050.05.11.665 E019.48.06.049 N050.05.11.884 E019.48.06.038 Color_251ACI
N050.05.11.884 E019.48.06.038 N050.05.12.082 E019.48.06.111 Color_251ACI
N050.05.12.082 E019.48.06.111 N050.05.12.415 E019.48.06.265 Color_251ACI
N050.05.12.415 E019.48.06.265 N050.05.12.736 E019.48.06.462 Color_251ACI
N050.05.12.736 E019.48.06.462 N050.05.13.032 E019.48.06.883 Color_251ACI
N050.05.13.032 E019.48.06.883 N050.05.13.328 E019.48.07.304 Color_251ACI
N050.05.13.328 E019.48.07.304 N050.05.13.501 E019.48.07.602 Color_251ACI
N050.05.13.501 E019.48.07.602 N050.05.13.636 E019.48.07.925 Color_251ACI
N050.05.13.636 E019.48.07.925 N050.05.13.923 E019.48.08.871 Color_251ACI
N050.05.13.923 E019.48.08.871 N050.05.14.137 E019.48.09.868 Color_251ACI
N050.05.14.137 E019.48.09.868 N050.05.14.258 E019.48.10.617 Color_251ACI
N050.05.14.258 E019.48.10.617 N050.05.14.352 E019.48.11.349 Color_251ACI
N050.05.14.352 E019.48.11.349 N050.05.14.402 E019.48.12.872 Color_251ACI
N050.05.14.402 E019.48.12.872 N050.05.14.399 E019.48.14.363 Color_251ACI
N050.05.14.399 E019.48.14.363 N050.05.14.334 E019.48.15.239 Color_251ACI
N050.05.14.334 E019.48.15.239 N050.05.14.231 E019.48.16.139 Color_251ACI
N050.05.14.231 E019.48.16.139 N050.05.14.065 E019.48.17.049 Color_251ACI
N050.05.14.065 E019.48.17.049 N050.05.13.871 E019.48.17.943 Color_251ACI
N050.05.11.933 E019.48.22.830 N050.05.12.136 E019.48.22.761 Color_251ACI
N050.05.12.136 E019.48.22.761 N050.05.12.411 E019.48.22.158 Color_251ACI
N050.05.12.411 E019.48.22.158 N050.05.12.659 E019.48.21.538 Color_251ACI
N050.05.12.659 E019.48.21.538 N050.05.12.839 E019.48.21.070 Color_251ACI
N050.05.12.839 E019.48.21.070 N050.05.13.039 E019.48.20.518 Color_251ACI
N050.05.13.039 E019.48.20.518 N050.05.13.282 E019.48.19.799 Color_251ACI
N050.05.13.282 E019.48.19.799 N050.05.13.434 E019.48.19.314 Color_251ACI
N050.05.13.434 E019.48.19.314 N050.05.13.566 E019.48.18.912 Color_251ACI
N050.05.13.566 E019.48.18.912 N050.05.13.698 E019.48.18.511 Color_251ACI
N050.05.13.698 E019.48.18.511 N050.05.13.823 E019.48.18.010 Color_251ACI
N050.05.13.823 E019.48.18.010 N050.05.13.763 E019.48.17.636 Color_251ACI
N050.05.14.634 E019.48.18.842 N050.05.14.437 E019.48.19.010 Color_251ACI
N050.05.14.437 E019.48.19.010 N050.05.14.238 E019.48.19.804 Color_251ACI
N050.05.14.238 E019.48.19.804 N050.05.14.138 E019.48.20.080 Color_251ACI
N050.05.14.138 E019.48.20.080 N050.05.14.054 E019.48.20.414 Color_251ACI
N050.05.14.054 E019.48.20.414 N050.05.13.906 E019.48.20.758 Color_251ACI
N050.05.13.906 E019.48.20.758 N050.05.13.764 E019.48.21.201 Color_251ACI
N050.05.13.764 E019.48.21.201 N050.05.13.606 E019.48.21.586 Color_251ACI
N050.05.13.606 E019.48.21.586 N050.05.13.495 E019.48.21.903 Color_251ACI
N050.05.13.495 E019.48.21.903 N050.05.13.305 E019.48.22.414 Color_251ACI
N050.05.13.305 E019.48.22.414 N050.05.13.099 E019.48.22.866 Color_251ACI
N050.05.13.099 E019.48.22.866 N050.05.12.951 E019.48.23.209 Color_251ACI
N050.05.12.951 E019.48.23.209 N050.05.12.889 E019.48.23.701 Color_251ACI
N050.05.12.411 E019.48.23.266 N050.05.12.051 E019.48.23.961 Color_251ACI
N050.05.12.051 E019.48.23.961 N050.05.11.681 E019.48.24.698 Color_251ACI
N050.05.11.681 E019.48.24.698 N050.05.11.103 E019.48.25.646 Color_251ACI
N050.05.11.103 E019.48.25.646 N050.05.10.131 E019.48.26.932 Color_251ACI
N050.05.10.131 E019.48.26.932 N050.05.09.100 E019.48.28.085 Color_251ACI
N050.05.09.100 E019.48.28.085 N050.05.08.307 E019.48.28.903 Color_251ACI
N050.05.08.307 E019.48.28.903 N050.05.07.418 E019.48.29.613 Color_251ACI
N050.05.03.939 E019.47.53.246 N050.05.04.174 E019.47.54.160 Color_251ACI
N050.05.04.174 E019.47.54.160 N050.05.04.381 E019.47.55.057 Color_251ACI
N050.05.04.381 E019.47.55.057 N050.05.05.753 E019.48.00.180 Color_251ACI
N050.05.05.753 E019.48.00.180 N050.05.07.247 E019.48.05.185 Color_251ACI
N050.05.07.247 E019.48.05.185 N050.05.08.006 E019.48.07.575 Color_251ACI
N050.05.08.006 E019.48.07.575 N050.05.08.803 E019.48.09.939 Color_251ACI
N050.05.08.803 E019.48.09.939 N050.05.09.292 E019.48.11.441 Color_251ACI
N050.05.09.292 E019.48.11.441 N050.05.09.823 E019.48.13.018 Color_251ACI
N050.05.09.823 E019.48.13.018 N050.05.10.090 E019.48.14.047 Color_251ACI
N050.05.10.090 E019.48.14.047 N050.05.10.272 E019.48.15.170 Color_251ACI
N050.05.10.272 E019.48.15.170 N050.05.10.428 E019.48.16.517 Color_251ACI
N050.05.10.428 E019.48.16.517 N050.05.10.509 E019.48.17.915 Color_251ACI
N050.05.10.509 E019.48.17.915 N050.05.10.523 E019.48.18.598 Color_251ACI
N050.05.10.523 E019.48.18.598 N050.05.10.473 E019.48.19.290 Color_251ACI
N050.05.10.473 E019.48.19.290 N050.05.10.357 E019.48.20.616 Color_251ACI
N050.05.10.357 E019.48.20.616 N050.05.10.149 E019.48.21.934 Color_251ACI
N050.05.10.149 E019.48.21.934 N050.05.09.803 E019.48.23.313 Color_251ACI
N050.05.09.803 E019.48.23.313 N050.05.09.361 E019.48.24.584 Color_251ACI
N050.05.09.361 E019.48.24.584 N050.05.09.133 E019.48.25.120 Color_251ACI
N050.05.09.133 E019.48.25.120 N050.05.08.879 E019.48.25.639 Color_251ACI
N050.05.08.879 E019.48.25.639 N050.05.08.015 E019.48.26.990 Color_251ACI
N050.05.08.015 E019.48.26.990 N050.05.07.161 E019.48.28.300 Color_251ACI
N050.05.12.121 E019.48.22.944 N050.05.11.904 E019.48.23.438 Color_251ACI
N050.05.11.904 E019.48.23.438 N050.05.11.623 E019.48.23.941 Color_251ACI
N050.05.11.623 E019.48.23.941 N050.05.10.621 E019.48.25.594 Color_251ACI
N050.05.10.621 E019.48.25.594 N050.05.09.469 E019.48.27.107 Color_251ACI
N050.05.09.469 E019.48.27.107 N050.05.08.703 E019.48.27.940 Color_251ACI
N050.05.08.703 E019.48.27.940 N050.05.07.884 E019.48.28.741 Color_251ACI
N050.05.07.884 E019.48.28.741 N050.05.07.783 E019.48.28.776 Color_251ACI
N050.05.07.783 E019.48.28.776 N050.05.07.661 E019.48.28.894 Color_251ACI
N050.05.07.661 E019.48.28.894 N050.05.07.495 E019.48.28.937 Color_251ACI
N050.05.07.495 E019.48.28.937 N050.05.07.319 E019.48.29.023 Color_251ACI
N050.05.07.319 E019.48.29.023 N050.05.07.265 E019.48.28.990 Color_251ACI
N050.05.07.265 E019.48.28.990 N050.05.07.233 E019.48.28.874 Color_251ACI
N050.05.07.233 E019.48.28.874 N050.05.07.254 E019.48.28.790 Color_251ACI
N050.05.07.254 E019.48.28.790 N050.05.07.424 E019.48.28.605 Color_251ACI
N050.05.07.424 E019.48.28.605 N050.05.08.056 E019.48.27.690 Color_251ACI
N050.05.08.056 E019.48.27.690 N050.05.08.698 E019.48.26.732 Color_251ACI
N050.05.08.698 E019.48.26.732 N050.05.09.084 E019.48.26.053 Color_251ACI
N050.05.09.084 E019.48.26.053 N050.05.09.418 E019.48.25.341 Color_251ACI
N050.05.09.418 E019.48.25.341 N050.05.09.745 E019.48.24.530 Color_251ACI
N050.05.09.745 E019.48.24.530 N050.05.10.029 E019.48.23.643 Color_251ACI
N050.05.10.029 E019.48.23.643 N050.05.10.287 E019.48.22.741 Color_251ACI
N050.05.10.287 E019.48.22.741 N050.05.10.480 E019.48.21.847 Color_251ACI
N050.05.10.480 E019.48.21.847 N050.05.10.626 E019.48.21.021 Color_251ACI
N050.05.10.626 E019.48.21.021 N050.05.10.708 E019.48.20.204 Color_251ACI
N050.05.10.708 E019.48.20.204 N050.05.10.789 E019.48.19.386 Color_251ACI
N050.05.10.789 E019.48.19.386 N050.05.10.807 E019.48.18.578 Color_251ACI
N050.05.10.807 E019.48.18.578 N050.05.10.779 E019.48.17.213 Color_251ACI
N050.05.10.779 E019.48.17.213 N050.05.10.687 E019.48.15.856 Color_251ACI
N050.05.10.687 E019.48.15.856 N050.05.10.646 E019.48.15.157 Color_251ACI
N050.05.10.646 E019.48.15.157 N050.05.10.530 E019.48.14.509 Color_251ACI
N050.05.10.530 E019.48.14.509 N050.05.10.286 E019.48.13.637 Color_251ACI
N050.05.10.286 E019.48.13.637 N050.05.10.041 E019.48.12.765 Color_251ACI
N050.05.10.363 E019.48.42.872 N050.05.08.299 E019.48.36.074 Color_251ACI
N050.05.10.624 E019.48.42.694 N050.05.08.636 E019.48.36.087 Color_251ACI
N050.05.08.636 E019.48.36.087 N050.05.08.528 E019.48.35.780 Color_251ACI
N050.05.08.528 E019.48.35.780 N050.05.08.456 E019.48.35.448 Color_251ACI
N050.05.08.456 E019.48.35.448 N050.05.08.461 E019.48.35.306 Color_251ACI
N050.05.08.461 E019.48.35.306 N050.05.08.567 E019.48.35.130 Color_251ACI
N050.05.08.567 E019.48.35.130 N050.05.08.727 E019.48.34.986 Color_251ACI
N050.05.08.727 E019.48.34.986 N050.05.08.882 E019.48.34.985 Color_251ACI
N050.05.08.882 E019.48.34.985 N050.05.09.047 E019.48.34.941 Color_251ACI
N050.05.09.010 E019.48.34.966 N050.05.10.078 E019.48.34.896 Color_251ACI
N050.05.10.078 E019.48.34.896 N050.05.12.499 E019.48.34.734 Color_251ACI
N050.05.12.499 E019.48.34.734 N050.05.13.257 E019.48.34.667 Color_251ACI
N050.05.07.680 E019.48.34.108 N050.05.07.729 E019.48.34.282 Color_251ACI
N050.05.07.729 E019.48.34.282 N050.05.07.741 E019.48.34.482 Color_251ACI
N050.05.07.741 E019.48.34.482 N050.05.07.710 E019.48.34.607 Color_251ACI
N050.05.07.710 E019.48.34.607 N050.05.07.662 E019.48.34.674 Color_251ACI
N050.05.07.662 E019.48.34.674 N050.05.07.550 E019.48.34.750 Color_251ACI
N050.05.07.550 E019.48.34.750 N050.05.05.299 E019.48.35.593 Color_251ACI
N050.05.05.299 E019.48.35.593 N050.05.04.231 E019.48.35.905 Color_251ACI
N050.05.04.231 E019.48.35.905 N050.05.03.836 E019.48.36.002 Color_251ACI
N050.05.03.836 E019.48.36.002 N050.05.03.580 E019.48.36.038 Color_251ACI
N050.05.03.580 E019.48.36.038 N050.05.03.398 E019.48.36.024 Color_251ACI
N050.05.03.398 E019.48.36.024 N050.05.03.088 E019.48.36.027 Color_251ACI
N050.05.03.088 E019.48.36.027 N050.05.02.772 E019.48.35.931 Color_251ACI
N050.05.02.772 E019.48.35.931 N050.05.02.510 E019.48.35.867 Color_251ACI
N050.05.02.510 E019.48.35.867 N050.05.02.215 E019.48.35.688 Color_251ACI
N050.05.02.215 E019.48.35.688 N050.05.01.716 E019.48.35.335 Color_251ACI
N050.05.01.716 E019.48.35.335 N050.05.01.335 E019.48.35.007 Color_251ACI
N050.05.01.335 E019.48.35.007 N050.05.01.045 E019.48.34.685 Color_251ACI
N050.05.01.045 E019.48.34.685 N050.05.00.615 E019.48.34.182 Color_251ACI
N050.05.00.615 E019.48.34.182 N050.05.00.315 E019.48.33.902 Color_251ACI
N050.05.00.315 E019.48.33.902 N050.04.59.917 E019.48.33.516 Color_251ACI
N050.04.59.917 E019.48.33.516 N050.04.59.606 E019.48.33.278 Color_251ACI
N050.04.59.606 E019.48.33.278 N050.04.59.134 E019.48.32.942 Color_251ACI
N050.04.59.134 E019.48.32.942 N050.04.58.792 E019.48.32.829 Color_251ACI
N050.04.58.792 E019.48.32.829 N050.04.58.422 E019.48.32.700 Color_251ACI
N050.04.58.422 E019.48.32.700 N050.04.57.796 E019.48.32.608 Color_251ACI
N050.04.57.796 E019.48.32.608 N050.04.56.443 E019.48.32.457 Color_251ACI
N050.04.56.443 E019.48.32.457 N050.04.54.712 E019.48.32.461 Color_251ACI
N050.04.54.712 E019.48.32.461 N050.04.54.081 E019.48.32.510 Color_251ACI
N050.04.54.081 E019.48.32.510 N050.04.53.413 E019.48.32.584 Color_251ACI
N050.04.53.413 E019.48.32.584 N050.04.52.516 E019.48.32.711 Color_251ACI
N050.04.52.516 E019.48.32.711 N050.04.52.030 E019.48.32.800 Color_251ACI
N050.04.52.030 E019.48.32.800 N050.04.50.988 E019.48.32.887 Color_251ACI
N050.04.50.988 E019.48.32.887 N050.04.48.350 E019.48.33.302 Color_251ACI
N050.04.48.350 E019.48.33.302 N050.04.46.342 E019.48.33.667 Color_251ACI
N050.04.46.342 E019.48.33.667 N050.04.45.552 E019.48.33.859 Color_251ACI
N050.05.08.299 E019.48.36.074 N050.05.08.218 E019.48.35.784 Color_251ACI
N050.05.08.218 E019.48.35.784 N050.05.08.109 E019.48.35.477 Color_251ACI
N050.05.08.109 E019.48.35.477 N050.05.08.023 E019.48.35.328 Color_251ACI
N050.05.08.023 E019.48.35.328 N050.05.07.889 E019.48.35.246 Color_251ACI
N050.05.07.889 E019.48.35.246 N050.05.07.744 E019.48.35.206 Color_251ACI
N050.05.07.744 E019.48.35.206 N050.05.07.643 E019.48.35.241 Color_251ACI
N050.05.07.643 E019.48.35.241 N050.05.05.365 E019.48.36.067 Color_251ACI
N050.05.05.365 E019.48.36.067 N050.05.04.298 E019.48.36.379 Color_251ACI
N050.05.04.298 E019.48.36.379 N050.05.03.903 E019.48.36.476 Color_251ACI
N050.05.03.903 E019.48.36.476 N050.05.03.609 E019.48.36.537 Color_251ACI
N050.05.03.609 E019.48.36.537 N050.05.03.390 E019.48.36.548 Color_251ACI
N050.05.03.390 E019.48.36.548 N050.05.03.053 E019.48.36.536 Color_251ACI
N050.05.03.053 E019.48.36.536 N050.05.02.710 E019.48.36.423 Color_251ACI
N050.05.02.710 E019.48.36.423 N050.05.02.421 E019.48.36.343 Color_251ACI
N050.05.02.421 E019.48.36.343 N050.05.02.100 E019.48.36.147 Color_251ACI
N050.05.02.100 E019.48.36.147 N050.05.01.574 E019.48.35.778 Color_251ACI
N050.05.01.574 E019.48.35.778 N050.05.01.150 E019.48.35.375 Color_251ACI
N050.05.01.150 E019.48.35.375 N050.05.00.860 E019.48.35.054 Color_251ACI
N050.05.00.860 E019.48.35.054 N050.05.00.446 E019.48.34.609 Color_251ACI
N050.05.00.446 E019.48.34.609 N050.05.00.146 E019.48.34.329 Color_251ACI
N050.05.00.146 E019.48.34.329 N050.04.59.748 E019.48.33.942 Color_251ACI
N050.04.59.748 E019.48.33.942 N050.04.59.437 E019.48.33.705 Color_251ACI
N050.04.59.437 E019.48.33.705 N050.04.59.046 E019.48.33.418 Color_251ACI
N050.04.59.046 E019.48.33.418 N050.04.58.730 E019.48.33.321 Color_251ACI
N050.04.58.730 E019.48.33.321 N050.04.58.360 E019.48.33.192 Color_251ACI
N050.04.58.360 E019.48.33.192 N050.04.57.761 E019.48.33.116 Color_251ACI
N050.04.57.761 E019.48.33.116 N050.04.56.446 E019.48.32.940 Color_251ACI
N050.04.56.446 E019.48.32.940 N050.04.54.708 E019.48.32.844 Color_251ACI
N050.04.54.708 E019.48.32.844 N050.04.54.051 E019.48.32.877 Color_251ACI
N050.04.54.051 E019.48.32.877 N050.04.53.282 E019.48.32.986 Color_251ACI
N050.04.53.282 E019.48.32.986 N050.04.52.641 E019.48.33.076 Color_251ACI
N050.04.52.641 E019.48.33.076 N050.04.52.064 E019.48.33.158 Color_251ACI
N050.04.52.064 E019.48.33.158 N050.04.51.028 E019.48.33.345 Color_251ACI
N050.04.51.028 E019.48.33.345 N050.04.50.910 E019.48.33.322 Color_251ACI
N050.05.06.729 E019.48.30.879 N050.05.07.680 E019.48.34.108 Color_251ACI
N050.05.08.042 E019.48.30.330 N050.05.07.662 E019.48.30.243 Color_251ACI
N050.05.07.662 E019.48.30.243 N050.05.07.252 E019.48.30.523 Color_251ACI
N050.05.07.252 E019.48.30.523 N050.05.06.841 E019.48.30.802 Color_251ACI
N050.05.06.841 E019.48.30.802 N050.05.06.425 E019.48.30.982 Color_251ACI
N050.05.06.425 E019.48.30.982 N050.05.06.175 E019.48.31.118 Color_251ACI
N050.05.06.175 E019.48.31.118 N050.05.06.016 E019.48.31.503 Color_251ACI
N050.05.07.100 E019.48.27.926 N050.05.07.022 E019.48.28.360 Color_251ACI
N050.05.07.022 E019.48.28.360 N050.05.06.777 E019.48.28.596 Color_251ACI
N050.05.06.777 E019.48.28.596 N050.05.06.458 E019.48.28.883 Color_251ACI
N050.05.06.458 E019.48.28.883 N050.05.06.075 E019.48.29.179 Color_251ACI
N050.05.06.075 E019.48.29.179 N050.05.05.814 E019.48.29.357 Color_251ACI
N050.05.05.814 E019.48.29.357 N050.05.05.525 E019.48.29.277 Color_251ACI
N050.05.05.803 E019.48.30.506 N050.05.05.462 E019.48.30.635 Color_251ACI
N050.05.05.462 E019.48.30.635 N050.05.05.083 E019.48.30.790 Color_251ACI
N050.05.05.083 E019.48.30.790 N050.05.04.282 E019.48.31.024 Color_251ACI
N050.05.04.282 E019.48.31.024 N050.05.03.530 E019.48.31.191 Color_251ACI
N050.05.03.530 E019.48.31.191 N050.05.02.814 E019.48.31.333 Color_251ACI
N050.05.02.814 E019.48.31.333 N050.05.02.146 E019.48.31.407 Color_251ACI
N050.05.02.146 E019.48.31.407 N050.05.00.842 E019.48.31.431 Color_251ACI
N050.05.00.842 E019.48.31.431 N050.04.59.522 E019.48.31.396 Color_251ACI
N050.04.59.522 E019.48.31.396 N050.04.56.882 E019.48.31.327 Color_251ACI
N050.04.56.882 E019.48.31.327 N050.04.54.214 E019.48.31.242 Color_251ACI
N050.04.54.214 E019.48.31.242 N050.04.52.600 E019.48.31.269 Color_251ACI
N050.04.52.600 E019.48.31.269 N050.04.51.002 E019.48.31.355 Color_251ACI
N050.04.51.002 E019.48.31.355 N050.04.50.233 E019.48.31.464 Color_251ACI
N050.04.50.233 E019.48.31.464 N050.04.49.437 E019.48.31.556 Color_251ACI
N050.04.49.437 E019.48.31.556 N050.04.46.906 E019.48.32.036 Color_251ACI
N050.04.46.906 E019.48.32.036 N050.04.44.381 E019.48.32.615 Color_251ACI
N050.04.44.381 E019.48.32.615 N050.04.41.797 E019.48.33.304 Color_251ACI
N050.04.41.797 E019.48.33.304 N050.04.39.186 E019.48.33.976 Color_251ACI
N050.04.39.186 E019.48.33.976 N050.04.36.180 E019.48.34.744 Color_251ACI
N050.04.36.180 E019.48.34.744 N050.04.33.175 E019.48.35.512 Color_251ACI
N050.04.33.175 E019.48.35.512 N050.04.30.473 E019.48.36.177 Color_251ACI
N050.04.30.473 E019.48.36.177 N050.04.27.771 E019.48.36.842 Color_251ACI
N050.04.27.771 E019.48.36.842 N050.04.24.077 E019.48.37.768 Color_251ACI
N050.04.24.077 E019.48.37.768 N050.04.20.371 E019.48.38.736 Color_251ACI
N050.04.20.376 E019.48.37.486 N050.04.20.186 E019.48.37.997 Color_251ACI
N050.04.20.186 E019.48.37.997 N050.04.17.185 E019.48.38.623 Color_251ACI
N050.04.17.185 E019.48.38.623 N050.04.17.061 E019.48.38.500 Color_251ACI
N050.04.20.649 E019.48.39.724 N050.04.20.428 E019.48.39.493 Color_251ACI
N050.04.20.428 E019.48.39.493 N050.04.17.555 E019.48.40.102 Color_251ACI
N050.04.17.555 E019.48.40.102 N050.04.17.370 E019.48.40.470 Color_251ACI
N050.04.17.397 E019.48.39.379 N050.04.16.745 E019.48.39.511 Color_251ACI
N050.04.16.745 E019.48.39.511 N050.04.16.104 E019.48.39.602 Color_251ACI
N050.04.16.104 E019.48.39.602 N050.04.14.667 E019.48.39.786 Color_251ACI
N050.04.14.667 E019.48.39.786 N050.04.13.240 E019.48.39.927 Color_251ACI
N050.04.13.240 E019.48.39.927 N050.04.12.802 E019.48.39.949 Color_251ACI
N050.04.12.802 E019.48.39.949 N050.04.12.390 E019.48.39.987 Color_251ACI
N050.04.12.390 E019.48.39.987 N050.04.11.295 E019.48.40.042 Color_251ACI
N050.04.11.295 E019.48.40.042 N050.04.10.226 E019.48.40.113 Color_251ACI
N050.04.17.496 E019.48.39.969 N050.04.16.855 E019.48.40.060 Color_251ACI
N050.04.16.855 E019.48.40.060 N050.04.16.240 E019.48.40.167 Color_251ACI
N050.04.16.240 E019.48.40.167 N050.04.15.022 E019.48.40.340 Color_251ACI
N050.04.15.022 E019.48.40.340 N050.04.13.842 E019.48.40.487 Color_251ACI
N050.04.13.842 E019.48.40.487 N050.04.12.372 E019.48.40.554 Color_251ACI
N050.04.12.372 E019.48.40.554 N050.04.10.939 E019.48.40.596 Color_251ACI
N050.04.10.939 E019.48.40.596 N050.04.10.501 E019.48.40.618 Color_251ACI
N050.04.10.501 E019.48.40.618 N050.04.10.100 E019.48.40.614 Color_251ACI
N050.04.17.324 E019.48.38.805 N050.04.17.132 E019.48.38.832 Color_251ACI
N050.04.17.132 E019.48.38.832 N050.04.16.545 E019.48.38.956 Color_251ACI
N050.04.16.545 E019.48.38.956 N050.04.15.968 E019.48.39.037 Color_251ACI
N050.04.15.968 E019.48.39.037 N050.04.14.466 E019.48.39.230 Color_251ACI
N050.04.14.466 E019.48.39.230 N050.04.12.965 E019.48.39.423 Color_251ACI
N050.04.12.965 E019.48.39.423 N050.04.12.132 E019.48.39.541 Color_251ACI
N050.04.12.132 E019.48.39.541 N050.04.11.292 E019.48.39.559 Color_251ACI
N050.04.11.292 E019.48.39.559 N050.04.10.672 E019.48.39.566 Color_251ACI
N050.04.10.672 E019.48.39.566 N050.04.10.079 E019.48.39.590 Color_251ACI
N050.04.25.735 E019.47.54.853 N050.04.25.723 E019.47.54.653 Color_251ACI
N050.04.25.723 E019.47.54.653 N050.04.27.740 E019.47.53.763 Color_251ACI
N050.04.27.740 E019.47.53.763 N050.04.29.572 E019.47.53.483 Color_251ACI
N050.04.29.572 E019.47.53.483 N050.04.30.223 E019.47.53.351 Color_251ACI
N050.04.30.223 E019.47.53.351 N050.04.30.586 E019.47.53.138 Color_251ACI
N050.04.24.692 E019.47.54.698 N050.04.27.706 E019.47.53.405 Color_251ACI
N050.04.27.706 E019.47.53.405 N050.04.29.538 E019.47.53.125 Color_251ACI
N050.04.29.538 E019.47.53.125 N050.04.30.152 E019.47.53.018 Color_251ACI
N050.04.30.152 E019.47.53.018 N050.04.30.477 E019.47.52.831 Color_251ACI
N050.04.31.233 E019.48.09.764 N050.04.31.229 E019.48.09.039 Color_251ACI
N050.04.31.229 E019.48.09.039 N050.04.31.424 E019.48.07.280 Color_251ACI
N050.04.31.595 E019.48.07.336 N050.04.31.401 E019.48.09.096 Color_251ACI
N050.04.31.401 E019.48.09.096 N050.04.31.373 E019.48.09.946 Color_251ACI
N050.04.31.775 E019.48.06.867 N050.04.31.684 E019.48.06.860 Color_251ACI
N050.04.31.684 E019.48.06.860 N050.04.31.646 E019.48.06.886 Color_251ACI
N050.04.31.646 E019.48.06.886 N050.04.31.582 E019.48.06.895 Color_251ACI
N050.04.31.582 E019.48.06.895 N050.04.31.535 E019.48.06.962 Color_251ACI
N050.04.31.535 E019.48.06.962 N050.04.31.514 E019.48.07.045 Color_251ACI
N050.04.31.514 E019.48.07.045 N050.04.31.466 E019.48.07.113 Color_251ACI
N050.04.31.466 E019.48.07.113 N050.04.31.418 E019.48.07.180 Color_251ACI
N050.04.31.418 E019.48.07.180 N050.04.31.424 E019.48.07.280 Color_251ACI
N050.04.31.749 E019.48.07.093 N050.04.31.712 E019.48.07.118 Color_251ACI
N050.04.31.712 E019.48.07.118 N050.04.31.712 E019.48.07.118 Color_251ACI
N050.04.31.712 E019.48.07.118 N050.04.31.674 E019.48.07.144 Color_251ACI
N050.04.31.674 E019.48.07.144 N050.04.31.664 E019.48.07.185 Color_251ACI
N050.04.31.664 E019.48.07.185 N050.04.31.627 E019.48.07.211 Color_251ACI
N050.04.31.627 E019.48.07.211 N050.04.31.595 E019.48.07.336 Color_251ACI
N050.04.23.604 E019.47.26.533 N050.04.23.445 E019.47.25.810 Color_251ACI
N050.04.24.292 E019.47.27.241 N050.04.24.244 E019.47.27.309 Color_251ACI
N050.04.24.244 E019.47.27.309 N050.04.24.186 E019.47.27.417 Color_251ACI
N050.04.24.186 E019.47.27.417 N050.04.24.148 E019.47.27.443 Color_251ACI
N050.04.24.148 E019.47.27.443 N050.04.24.096 E019.47.27.652 Color_251ACI
N050.04.24.096 E019.47.27.652 N050.04.24.102 E019.47.27.752 Color_251ACI
N050.04.24.102 E019.47.27.752 N050.04.24.107 E019.47.27.852 Color_251ACI
N050.04.24.107 E019.47.27.852 N050.04.24.086 E019.47.27.935 Color_251ACI
N050.04.23.589 E019.47.24.501 N050.04.23.877 E019.47.26.555 Color_251ACI
N050.04.24.584 E019.47.16.968 N050.04.24.738 E019.47.17.832 Color_251ACI
N050.04.24.738 E019.47.17.832 N050.04.24.691 E019.47.18.141 Color_251ACI
N050.04.24.691 E019.47.18.141 N050.04.25.954 E019.47.26.039 Color_251ACI
;rwy_edge_lights N000.00.00.000 E000.00.00.000 N000.00.00.000 E000.00.00.000
N050.04.35.360 E019.46.38.386 N050.04.35.306 E019.46.38.350 Color_253ACI
N050.04.35.306 E019.46.38.350 N050.04.35.242 E019.46.38.370 Color_253ACI
N050.04.35.242 E019.46.38.370 N050.04.35.201 E019.46.38.434 Color_253ACI
N050.04.35.201 E019.46.38.434 N050.04.35.190 E019.46.38.539 Color_253ACI
N050.04.35.190 E019.46.38.539 N050.04.35.218 E019.46.38.626 Color_253ACI
N050.04.35.218 E019.46.38.626 N050.04.35.275 E019.46.38.674 Color_253ACI
N050.04.35.275 E019.46.38.674 N050.04.35.336 E019.46.38.663 Color_253ACI
N050.04.35.336 E019.46.38.663 N050.04.35.385 E019.46.38.593 Color_253ACI
N050.04.35.385 E019.46.38.593 N050.04.35.399 E019.46.38.513 Color_253ACI
N050.04.35.399 E019.46.38.513 N050.04.35.385 E019.46.38.432 Color_253ACI
N050.04.35.385 E019.46.38.432 N050.04.35.360 E019.46.38.386 Color_253ACI
N050.04.35.754 E019.46.41.312 N050.04.35.700 E019.46.41.276 Color_253ACI
N050.04.35.700 E019.46.41.276 N050.04.35.635 E019.46.41.296 Color_253ACI
N050.04.35.635 E019.46.41.296 N050.04.35.595 E019.46.41.360 Color_253ACI
N050.04.35.595 E019.46.41.360 N050.04.35.583 E019.46.41.465 Color_253ACI
N050.04.35.583 E019.46.41.465 N050.04.35.611 E019.46.41.552 Color_253ACI
N050.04.35.611 E019.46.41.552 N050.04.35.669 E019.46.41.600 Color_253ACI
N050.04.35.669 E019.46.41.600 N050.04.35.730 E019.46.41.588 Color_253ACI
N050.04.35.730 E019.46.41.588 N050.04.35.779 E019.46.41.519 Color_253ACI
N050.04.35.779 E019.46.41.519 N050.04.35.792 E019.46.41.439 Color_253ACI
N050.04.35.792 E019.46.41.439 N050.04.35.778 E019.46.41.357 Color_253ACI
N050.04.35.778 E019.46.41.357 N050.04.35.754 E019.46.41.312 Color_253ACI
N050.04.36.175 E019.46.44.320 N050.04.36.121 E019.46.44.284 Color_253ACI
N050.04.36.121 E019.46.44.284 N050.04.36.056 E019.46.44.304 Color_253ACI
N050.04.36.056 E019.46.44.304 N050.04.36.016 E019.46.44.368 Color_253ACI
N050.04.36.016 E019.46.44.368 N050.04.36.004 E019.46.44.473 Color_253ACI
N050.04.36.004 E019.46.44.473 N050.04.36.032 E019.46.44.560 Color_253ACI
N050.04.36.032 E019.46.44.560 N050.04.36.090 E019.46.44.608 Color_253ACI
N050.04.36.090 E019.46.44.608 N050.04.36.151 E019.46.44.597 Color_253ACI
N050.04.36.151 E019.46.44.597 N050.04.36.200 E019.46.44.527 Color_253ACI
N050.04.36.200 E019.46.44.527 N050.04.36.214 E019.46.44.447 Color_253ACI
N050.04.36.214 E019.46.44.447 N050.04.36.200 E019.46.44.366 Color_253ACI
N050.04.36.200 E019.46.44.366 N050.04.36.175 E019.46.44.320 Color_253ACI
N050.04.36.578 E019.46.47.283 N050.04.36.524 E019.46.47.247 Color_253ACI
N050.04.36.524 E019.46.47.247 N050.04.36.459 E019.46.47.267 Color_253ACI
N050.04.36.459 E019.46.47.267 N050.04.36.419 E019.46.47.331 Color_253ACI
N050.04.36.419 E019.46.47.331 N050.04.36.407 E019.46.47.436 Color_253ACI
N050.04.36.407 E019.46.47.436 N050.04.36.435 E019.46.47.523 Color_253ACI
N050.04.36.435 E019.46.47.523 N050.04.36.493 E019.46.47.571 Color_253ACI
N050.04.36.493 E019.46.47.571 N050.04.36.554 E019.46.47.560 Color_253ACI
N050.04.36.554 E019.46.47.560 N050.04.36.603 E019.46.47.490 Color_253ACI
N050.04.36.603 E019.46.47.490 N050.04.36.616 E019.46.47.410 Color_253ACI
N050.04.36.616 E019.46.47.410 N050.04.36.602 E019.46.47.328 Color_253ACI
N050.04.36.602 E019.46.47.328 N050.04.36.578 E019.46.47.283 Color_253ACI
N050.04.37.797 E019.46.56.220 N050.04.37.742 E019.46.56.184 Color_253ACI
N050.04.37.742 E019.46.56.184 N050.04.37.678 E019.46.56.204 Color_253ACI
N050.04.37.678 E019.46.56.204 N050.04.37.637 E019.46.56.268 Color_253ACI
N050.04.37.637 E019.46.56.268 N050.04.37.626 E019.46.56.373 Color_253ACI
N050.04.37.626 E019.46.56.373 N050.04.37.654 E019.46.56.460 Color_253ACI
N050.04.37.654 E019.46.56.460 N050.04.37.712 E019.46.56.508 Color_253ACI
N050.04.37.712 E019.46.56.508 N050.04.37.772 E019.46.56.497 Color_253ACI
N050.04.37.772 E019.46.56.497 N050.04.37.821 E019.46.56.427 Color_253ACI
N050.04.37.821 E019.46.56.427 N050.04.37.835 E019.46.56.347 Color_253ACI
N050.04.37.835 E019.46.56.347 N050.04.37.821 E019.46.56.265 Color_253ACI
N050.04.37.821 E019.46.56.265 N050.04.37.797 E019.46.56.220 Color_253ACI
N050.04.38.216 E019.46.59.217 N050.04.38.162 E019.46.59.180 Color_253ACI
N050.04.38.162 E019.46.59.180 N050.04.38.097 E019.46.59.200 Color_253ACI
N050.04.38.097 E019.46.59.200 N050.04.38.057 E019.46.59.264 Color_253ACI
N050.04.38.057 E019.46.59.264 N050.04.38.045 E019.46.59.369 Color_253ACI
N050.04.38.045 E019.46.59.369 N050.04.38.073 E019.46.59.456 Color_253ACI
N050.04.38.073 E019.46.59.456 N050.04.38.131 E019.46.59.505 Color_253ACI
N050.04.38.131 E019.46.59.505 N050.04.38.192 E019.46.59.493 Color_253ACI
N050.04.38.192 E019.46.59.493 N050.04.38.241 E019.46.59.423 Color_253ACI
N050.04.38.241 E019.46.59.423 N050.04.38.254 E019.46.59.343 Color_253ACI
N050.04.38.254 E019.46.59.343 N050.04.38.241 E019.46.59.262 Color_253ACI
N050.04.38.241 E019.46.59.262 N050.04.38.216 E019.46.59.217 Color_253ACI
N050.04.38.610 E019.47.02.208 N050.04.38.556 E019.47.02.172 Color_253ACI
N050.04.38.556 E019.47.02.172 N050.04.38.491 E019.47.02.192 Color_253ACI
N050.04.38.491 E019.47.02.192 N050.04.38.451 E019.47.02.256 Color_253ACI
N050.04.38.451 E019.47.02.256 N050.04.38.439 E019.47.02.361 Color_253ACI
N050.04.38.439 E019.47.02.361 N050.04.38.467 E019.47.02.448 Color_253ACI
N050.04.38.467 E019.47.02.448 N050.04.38.525 E019.47.02.496 Color_253ACI
N050.04.38.525 E019.47.02.496 N050.04.38.586 E019.47.02.485 Color_253ACI
N050.04.38.586 E019.47.02.485 N050.04.38.635 E019.47.02.415 Color_253ACI
N050.04.38.635 E019.47.02.415 N050.04.38.648 E019.47.02.335 Color_253ACI
N050.04.38.648 E019.47.02.335 N050.04.38.635 E019.47.02.253 Color_253ACI
N050.04.38.635 E019.47.02.253 N050.04.38.610 E019.47.02.208 Color_253ACI
N050.04.39.024 E019.47.05.285 N050.04.38.970 E019.47.05.249 Color_253ACI
N050.04.38.970 E019.47.05.249 N050.04.38.905 E019.47.05.269 Color_253ACI
N050.04.38.905 E019.47.05.269 N050.04.38.865 E019.47.05.333 Color_253ACI
N050.04.38.865 E019.47.05.333 N050.04.38.853 E019.47.05.438 Color_253ACI
N050.04.38.853 E019.47.05.438 N050.04.38.881 E019.47.05.525 Color_253ACI
N050.04.38.881 E019.47.05.525 N050.04.38.939 E019.47.05.573 Color_253ACI
N050.04.38.939 E019.47.05.573 N050.04.39.000 E019.47.05.561 Color_253ACI
N050.04.39.000 E019.47.05.561 N050.04.39.049 E019.47.05.492 Color_253ACI
N050.04.39.049 E019.47.05.492 N050.04.39.062 E019.47.05.412 Color_253ACI
N050.04.39.062 E019.47.05.412 N050.04.39.048 E019.47.05.330 Color_253ACI
N050.04.39.048 E019.47.05.330 N050.04.39.024 E019.47.05.285 Color_253ACI
N050.04.39.443 E019.47.08.184 N050.04.39.389 E019.47.08.148 Color_253ACI
N050.04.39.389 E019.47.08.148 N050.04.39.324 E019.47.08.168 Color_253ACI
N050.04.39.324 E019.47.08.168 N050.04.39.284 E019.47.08.232 Color_253ACI
N050.04.39.284 E019.47.08.232 N050.04.39.272 E019.47.08.337 Color_253ACI
N050.04.39.272 E019.47.08.337 N050.04.39.300 E019.47.08.424 Color_253ACI
N050.04.39.300 E019.47.08.424 N050.04.39.358 E019.47.08.472 Color_253ACI
N050.04.39.358 E019.47.08.472 N050.04.39.419 E019.47.08.460 Color_253ACI
N050.04.39.419 E019.47.08.460 N050.04.39.468 E019.47.08.391 Color_253ACI
N050.04.39.468 E019.47.08.391 N050.04.39.481 E019.47.08.311 Color_253ACI
N050.04.39.481 E019.47.08.311 N050.04.39.468 E019.47.08.229 Color_253ACI
N050.04.39.468 E019.47.08.229 N050.04.39.443 E019.47.08.184 Color_253ACI
N050.04.39.853 E019.47.11.170 N050.04.39.799 E019.47.11.134 Color_253ACI
N050.04.39.799 E019.47.11.134 N050.04.39.734 E019.47.11.154 Color_253ACI
N050.04.39.734 E019.47.11.154 N050.04.39.694 E019.47.11.218 Color_253ACI
N050.04.39.694 E019.47.11.218 N050.04.39.682 E019.47.11.323 Color_253ACI
N050.04.39.682 E019.47.11.323 N050.04.39.710 E019.47.11.410 Color_253ACI
N050.04.39.710 E019.47.11.410 N050.04.39.768 E019.47.11.458 Color_253ACI
N050.04.39.768 E019.47.11.458 N050.04.39.829 E019.47.11.446 Color_253ACI
N050.04.39.829 E019.47.11.446 N050.04.39.878 E019.47.11.377 Color_253ACI
N050.04.39.878 E019.47.11.377 N050.04.39.891 E019.47.11.297 Color_253ACI
N050.04.39.891 E019.47.11.297 N050.04.39.877 E019.47.11.215 Color_253ACI
N050.04.39.877 E019.47.11.215 N050.04.39.853 E019.47.11.170 Color_253ACI
N050.04.40.260 E019.47.14.137 N050.04.40.206 E019.47.14.101 Color_253ACI
N050.04.40.206 E019.47.14.101 N050.04.40.142 E019.47.14.121 Color_253ACI
N050.04.40.142 E019.47.14.121 N050.04.40.101 E019.47.14.185 Color_253ACI
N050.04.40.101 E019.47.14.185 N050.04.40.090 E019.47.14.290 Color_253ACI
N050.04.40.090 E019.47.14.290 N050.04.40.118 E019.47.14.377 Color_253ACI
N050.04.40.118 E019.47.14.377 N050.04.40.176 E019.47.14.425 Color_253ACI
N050.04.40.176 E019.47.14.425 N050.04.40.236 E019.47.14.414 Color_253ACI
N050.04.40.236 E019.47.14.414 N050.04.40.285 E019.47.14.344 Color_253ACI
N050.04.40.285 E019.47.14.344 N050.04.40.299 E019.47.14.264 Color_253ACI
N050.04.40.299 E019.47.14.264 N050.04.40.285 E019.47.14.182 Color_253ACI
N050.04.40.285 E019.47.14.182 N050.04.40.260 E019.47.14.137 Color_253ACI
N050.04.40.662 E019.47.17.120 N050.04.40.607 E019.47.17.084 Color_253ACI
N050.04.40.607 E019.47.17.084 N050.04.40.543 E019.47.17.104 Color_253ACI
N050.04.40.543 E019.47.17.104 N050.04.40.502 E019.47.17.168 Color_253ACI
N050.04.40.502 E019.47.17.168 N050.04.40.491 E019.47.17.273 Color_253ACI
N050.04.40.491 E019.47.17.273 N050.04.40.519 E019.47.17.360 Color_253ACI
N050.04.40.519 E019.47.17.360 N050.04.40.577 E019.47.17.408 Color_253ACI
N050.04.40.577 E019.47.17.408 N050.04.40.637 E019.47.17.396 Color_253ACI
N050.04.40.637 E019.47.17.396 N050.04.40.686 E019.47.17.327 Color_253ACI
N050.04.40.686 E019.47.17.327 N050.04.40.700 E019.47.17.247 Color_253ACI
N050.04.40.700 E019.47.17.247 N050.04.40.686 E019.47.17.165 Color_253ACI
N050.04.40.686 E019.47.17.165 N050.04.40.662 E019.47.17.120 Color_253ACI
N050.04.41.080 E019.47.20.110 N050.04.41.026 E019.47.20.074 Color_253ACI
N050.04.41.026 E019.47.20.074 N050.04.40.962 E019.47.20.094 Color_253ACI
N050.04.40.962 E019.47.20.094 N050.04.40.921 E019.47.20.158 Color_253ACI
N050.04.40.921 E019.47.20.158 N050.04.40.910 E019.47.20.263 Color_253ACI
N050.04.40.910 E019.47.20.263 N050.04.40.937 E019.47.20.350 Color_253ACI
N050.04.40.937 E019.47.20.350 N050.04.40.995 E019.47.20.398 Color_253ACI
N050.04.40.995 E019.47.20.398 N050.04.41.056 E019.47.20.386 Color_253ACI
N050.04.41.056 E019.47.20.386 N050.04.41.105 E019.47.20.317 Color_253ACI
N050.04.41.105 E019.47.20.317 N050.04.41.119 E019.47.20.237 Color_253ACI
N050.04.41.119 E019.47.20.237 N050.04.41.105 E019.47.20.155 Color_253ACI
N050.04.41.105 E019.47.20.155 N050.04.41.080 E019.47.20.110 Color_253ACI
N050.04.41.485 E019.47.23.090 N050.04.41.431 E019.47.23.054 Color_253ACI
N050.04.41.431 E019.47.23.054 N050.04.41.367 E019.47.23.074 Color_253ACI
N050.04.41.367 E019.47.23.074 N050.04.41.326 E019.47.23.138 Color_253ACI
N050.04.41.326 E019.47.23.138 N050.04.41.315 E019.47.23.243 Color_253ACI
N050.04.41.315 E019.47.23.243 N050.04.41.342 E019.47.23.330 Color_253ACI
N050.04.41.342 E019.47.23.330 N050.04.41.400 E019.47.23.378 Color_253ACI
N050.04.41.400 E019.47.23.378 N050.04.41.461 E019.47.23.367 Color_253ACI
N050.04.41.461 E019.47.23.367 N050.04.41.510 E019.47.23.297 Color_253ACI
N050.04.41.510 E019.47.23.297 N050.04.41.524 E019.47.23.217 Color_253ACI
N050.04.41.524 E019.47.23.217 N050.04.41.510 E019.47.23.136 Color_253ACI
N050.04.41.510 E019.47.23.136 N050.04.41.485 E019.47.23.090 Color_253ACI
N050.04.42.692 E019.47.32.063 N050.04.42.638 E019.47.32.027 Color_253ACI
N050.04.42.638 E019.47.32.027 N050.04.42.573 E019.47.32.047 Color_253ACI
N050.04.42.573 E019.47.32.047 N050.04.42.533 E019.47.32.111 Color_253ACI
N050.04.42.533 E019.47.32.111 N050.04.42.521 E019.47.32.216 Color_253ACI
N050.04.42.521 E019.47.32.216 N050.04.42.549 E019.47.32.303 Color_253ACI
N050.04.42.549 E019.47.32.303 N050.04.42.607 E019.47.32.351 Color_253ACI
N050.04.42.607 E019.47.32.351 N050.04.42.668 E019.47.32.339 Color_253ACI
N050.04.42.668 E019.47.32.339 N050.04.42.717 E019.47.32.270 Color_253ACI
N050.04.42.717 E019.47.32.270 N050.04.42.730 E019.47.32.190 Color_253ACI
N050.04.42.730 E019.47.32.190 N050.04.42.716 E019.47.32.108 Color_253ACI
N050.04.42.716 E019.47.32.108 N050.04.42.692 E019.47.32.063 Color_253ACI
N050.04.43.115 E019.47.35.051 N050.04.43.061 E019.47.35.015 Color_253ACI
N050.04.43.061 E019.47.35.015 N050.04.42.996 E019.47.35.035 Color_253ACI
N050.04.42.996 E019.47.35.035 N050.04.42.956 E019.47.35.099 Color_253ACI
N050.04.42.956 E019.47.35.099 N050.04.42.944 E019.47.35.204 Color_253ACI
N050.04.42.944 E019.47.35.204 N050.04.42.972 E019.47.35.291 Color_253ACI
N050.04.42.972 E019.47.35.291 N050.04.43.030 E019.47.35.339 Color_253ACI
N050.04.43.030 E019.47.35.339 N050.04.43.090 E019.47.35.328 Color_253ACI
N050.04.43.090 E019.47.35.328 N050.04.43.139 E019.47.35.258 Color_253ACI
N050.04.43.139 E019.47.35.258 N050.04.43.153 E019.47.35.178 Color_253ACI
N050.04.43.153 E019.47.35.178 N050.04.43.139 E019.47.35.096 Color_253ACI
N050.04.43.139 E019.47.35.096 N050.04.43.115 E019.47.35.051 Color_253ACI
N050.04.43.508 E019.47.38.004 N050.04.43.454 E019.47.37.968 Color_253ACI
N050.04.43.454 E019.47.37.968 N050.04.43.389 E019.47.37.988 Color_253ACI
N050.04.43.389 E019.47.37.988 N050.04.43.348 E019.47.38.052 Color_253ACI
N050.04.43.348 E019.47.38.052 N050.04.43.337 E019.47.38.157 Color_253ACI
N050.04.43.337 E019.47.38.157 N050.04.43.365 E019.47.38.244 Color_253ACI
N050.04.43.365 E019.47.38.244 N050.04.43.423 E019.47.38.292 Color_253ACI
N050.04.43.423 E019.47.38.292 N050.04.43.483 E019.47.38.281 Color_253ACI
N050.04.43.483 E019.47.38.281 N050.04.43.532 E019.47.38.211 Color_253ACI
N050.04.43.532 E019.47.38.211 N050.04.43.546 E019.47.38.131 Color_253ACI
N050.04.43.546 E019.47.38.131 N050.04.43.532 E019.47.38.050 Color_253ACI
N050.04.43.532 E019.47.38.050 N050.04.43.508 E019.47.38.004 Color_253ACI
N050.04.43.927 E019.47.41.027 N050.04.43.873 E019.47.40.991 Color_253ACI
N050.04.43.873 E019.47.40.991 N050.04.43.808 E019.47.41.011 Color_253ACI
N050.04.43.808 E019.47.41.011 N050.04.43.767 E019.47.41.075 Color_253ACI
N050.04.43.767 E019.47.41.075 N050.04.43.756 E019.47.41.180 Color_253ACI
N050.04.43.756 E019.47.41.180 N050.04.43.784 E019.47.41.267 Color_253ACI
N050.04.43.784 E019.47.41.267 N050.04.43.842 E019.47.41.315 Color_253ACI
N050.04.43.842 E019.47.41.315 N050.04.43.902 E019.47.41.304 Color_253ACI
N050.04.43.902 E019.47.41.304 N050.04.43.951 E019.47.41.234 Color_253ACI
N050.04.43.951 E019.47.41.234 N050.04.43.965 E019.47.41.154 Color_253ACI
N050.04.43.965 E019.47.41.154 N050.04.43.951 E019.47.41.072 Color_253ACI
N050.04.43.951 E019.47.41.072 N050.04.43.927 E019.47.41.027 Color_253ACI
N050.04.44.328 E019.47.43.978 N050.04.44.274 E019.47.43.942 Color_253ACI
N050.04.44.274 E019.47.43.942 N050.04.44.209 E019.47.43.962 Color_253ACI
N050.04.44.209 E019.47.43.962 N050.04.44.168 E019.47.44.025 Color_253ACI
N050.04.44.168 E019.47.44.025 N050.04.44.157 E019.47.44.130 Color_253ACI
N050.04.44.157 E019.47.44.130 N050.04.44.185 E019.47.44.218 Color_253ACI
N050.04.44.185 E019.47.44.218 N050.04.44.243 E019.47.44.266 Color_253ACI
N050.04.44.243 E019.47.44.266 N050.04.44.303 E019.47.44.254 Color_253ACI
N050.04.44.303 E019.47.44.254 N050.04.44.352 E019.47.44.185 Color_253ACI
N050.04.44.352 E019.47.44.185 N050.04.44.366 E019.47.44.105 Color_253ACI
N050.04.44.366 E019.47.44.105 N050.04.44.352 E019.47.44.023 Color_253ACI
N050.04.44.352 E019.47.44.023 N050.04.44.328 E019.47.43.978 Color_253ACI
N050.04.44.742 E019.47.46.963 N050.04.44.687 E019.47.46.926 Color_253ACI
N050.04.44.687 E019.47.46.926 N050.04.44.623 E019.47.46.947 Color_253ACI
N050.04.44.623 E019.47.46.947 N050.04.44.582 E019.47.47.010 Color_253ACI
N050.04.44.582 E019.47.47.010 N050.04.44.571 E019.47.47.115 Color_253ACI
N050.04.44.571 E019.47.47.115 N050.04.44.599 E019.47.47.202 Color_253ACI
N050.04.44.599 E019.47.47.202 N050.04.44.657 E019.47.47.251 Color_253ACI
N050.04.44.657 E019.47.47.251 N050.04.44.717 E019.47.47.239 Color_253ACI
N050.04.44.717 E019.47.47.239 N050.04.44.766 E019.47.47.170 Color_253ACI
N050.04.44.766 E019.47.47.170 N050.04.44.780 E019.47.47.089 Color_253ACI
N050.04.44.780 E019.47.47.089 N050.04.44.766 E019.47.47.008 Color_253ACI
N050.04.44.766 E019.47.47.008 N050.04.44.742 E019.47.46.963 Color_253ACI
N050.04.45.147 E019.47.49.950 N050.04.45.093 E019.47.49.914 Color_253ACI
N050.04.45.093 E019.47.49.914 N050.04.45.029 E019.47.49.934 Color_253ACI
N050.04.45.029 E019.47.49.934 N050.04.44.988 E019.47.49.998 Color_253ACI
N050.04.44.988 E019.47.49.998 N050.04.44.977 E019.47.50.103 Color_253ACI
N050.04.44.977 E019.47.50.103 N050.04.45.005 E019.47.50.190 Color_253ACI
N050.04.45.005 E019.47.50.190 N050.04.45.062 E019.47.50.238 Color_253ACI
N050.04.45.062 E019.47.50.238 N050.04.45.123 E019.47.50.226 Color_253ACI
N050.04.45.123 E019.47.50.226 N050.04.45.172 E019.47.50.157 Color_253ACI
N050.04.45.172 E019.47.50.157 N050.04.45.186 E019.47.50.077 Color_253ACI
N050.04.45.186 E019.47.50.077 N050.04.45.172 E019.47.49.995 Color_253ACI
N050.04.45.172 E019.47.49.995 N050.04.45.147 E019.47.49.950 Color_253ACI
N050.04.45.563 E019.47.52.947 N050.04.45.509 E019.47.52.911 Color_253ACI
N050.04.45.509 E019.47.52.911 N050.04.45.444 E019.47.52.931 Color_253ACI
N050.04.45.444 E019.47.52.931 N050.04.45.404 E019.47.52.995 Color_253ACI
N050.04.45.404 E019.47.52.995 N050.04.45.392 E019.47.53.100 Color_253ACI
N050.04.45.392 E019.47.53.100 N050.04.45.420 E019.47.53.187 Color_253ACI
N050.04.45.420 E019.47.53.187 N050.04.45.478 E019.47.53.235 Color_253ACI
N050.04.45.478 E019.47.53.235 N050.04.45.539 E019.47.53.224 Color_253ACI
N050.04.45.539 E019.47.53.224 N050.04.45.588 E019.47.53.154 Color_253ACI
N050.04.45.588 E019.47.53.154 N050.04.45.601 E019.47.53.074 Color_253ACI
N050.04.45.601 E019.47.53.074 N050.04.45.587 E019.47.52.993 Color_253ACI
N050.04.45.587 E019.47.52.993 N050.04.45.563 E019.47.52.947 Color_253ACI
N050.04.45.975 E019.47.55.907 N050.04.45.921 E019.47.55.871 Color_253ACI
N050.04.45.921 E019.47.55.871 N050.04.45.856 E019.47.55.891 Color_253ACI
N050.04.45.856 E019.47.55.891 N050.04.45.816 E019.47.55.955 Color_253ACI
N050.04.45.816 E019.47.55.955 N050.04.45.804 E019.47.56.060 Color_253ACI
N050.04.45.804 E019.47.56.060 N050.04.45.832 E019.47.56.147 Color_253ACI
N050.04.45.832 E019.47.56.147 N050.04.45.890 E019.47.56.195 Color_253ACI
N050.04.45.890 E019.47.56.195 N050.04.45.951 E019.47.56.183 Color_253ACI
N050.04.45.951 E019.47.56.183 N050.04.46.000 E019.47.56.114 Color_253ACI
N050.04.46.000 E019.47.56.114 N050.04.46.013 E019.47.56.034 Color_253ACI
N050.04.46.013 E019.47.56.034 N050.04.45.999 E019.47.55.952 Color_253ACI
N050.04.45.999 E019.47.55.952 N050.04.45.975 E019.47.55.907 Color_253ACI
N050.04.46.368 E019.47.58.909 N050.04.46.314 E019.47.58.873 Color_253ACI
N050.04.46.314 E019.47.58.873 N050.04.46.250 E019.47.58.893 Color_253ACI
N050.04.46.250 E019.47.58.893 N050.04.46.209 E019.47.58.957 Color_253ACI
N050.04.46.209 E019.47.58.957 N050.04.46.198 E019.47.59.062 Color_253ACI
N050.04.46.198 E019.47.59.062 N050.04.46.225 E019.47.59.149 Color_253ACI
N050.04.46.225 E019.47.59.149 N050.04.46.283 E019.47.59.197 Color_253ACI
N050.04.46.283 E019.47.59.197 N050.04.46.344 E019.47.59.186 Color_253ACI
N050.04.46.344 E019.47.59.186 N050.04.46.393 E019.47.59.116 Color_253ACI
N050.04.46.393 E019.47.59.116 N050.04.46.407 E019.47.59.036 Color_253ACI
N050.04.46.407 E019.47.59.036 N050.04.46.393 E019.47.58.955 Color_253ACI
N050.04.46.393 E019.47.58.955 N050.04.46.368 E019.47.58.909 Color_253ACI
N050.04.46.780 E019.48.01.868 N050.04.46.726 E019.48.01.832 Color_253ACI
N050.04.46.726 E019.48.01.832 N050.04.46.661 E019.48.01.852 Color_253ACI
N050.04.46.661 E019.48.01.852 N050.04.46.621 E019.48.01.916 Color_253ACI
N050.04.46.621 E019.48.01.916 N050.04.46.609 E019.48.02.021 Color_253ACI
N050.04.46.609 E019.48.02.021 N050.04.46.637 E019.48.02.108 Color_253ACI
N050.04.46.637 E019.48.02.108 N050.04.46.695 E019.48.02.157 Color_253ACI
N050.04.46.695 E019.48.02.157 N050.04.46.756 E019.48.02.145 Color_253ACI
N050.04.46.756 E019.48.02.145 N050.04.46.805 E019.48.02.075 Color_253ACI
N050.04.46.805 E019.48.02.075 N050.04.46.818 E019.48.01.995 Color_253ACI
N050.04.46.818 E019.48.01.995 N050.04.46.804 E019.48.01.914 Color_253ACI
N050.04.46.804 E019.48.01.914 N050.04.46.780 E019.48.01.868 Color_253ACI
N050.04.47.193 E019.48.04.884 N050.04.47.139 E019.48.04.847 Color_253ACI
N050.04.47.139 E019.48.04.847 N050.04.47.074 E019.48.04.867 Color_253ACI
N050.04.47.074 E019.48.04.867 N050.04.47.034 E019.48.04.931 Color_253ACI
N050.04.47.034 E019.48.04.931 N050.04.47.022 E019.48.05.036 Color_253ACI
N050.04.47.022 E019.48.05.036 N050.04.47.050 E019.48.05.123 Color_253ACI
N050.04.47.050 E019.48.05.123 N050.04.47.108 E019.48.05.172 Color_253ACI
N050.04.47.108 E019.48.05.172 N050.04.47.169 E019.48.05.160 Color_253ACI
N050.04.47.169 E019.48.05.160 N050.04.47.218 E019.48.05.091 Color_253ACI
N050.04.47.218 E019.48.05.091 N050.04.47.231 E019.48.05.010 Color_253ACI
N050.04.47.231 E019.48.05.010 N050.04.47.218 E019.48.04.929 Color_253ACI
N050.04.47.218 E019.48.04.929 N050.04.47.193 E019.48.04.884 Color_253ACI
N050.04.47.603 E019.48.07.872 N050.04.47.549 E019.48.07.836 Color_253ACI
N050.04.47.549 E019.48.07.836 N050.04.47.484 E019.48.07.856 Color_253ACI
N050.04.47.484 E019.48.07.856 N050.04.47.444 E019.48.07.920 Color_253ACI
N050.04.47.444 E019.48.07.920 N050.04.47.432 E019.48.08.025 Color_253ACI
N050.04.47.432 E019.48.08.025 N050.04.47.460 E019.48.08.112 Color_253ACI
N050.04.47.460 E019.48.08.112 N050.04.47.518 E019.48.08.160 Color_253ACI
N050.04.47.518 E019.48.08.160 N050.04.47.579 E019.48.08.148 Color_253ACI
N050.04.47.579 E019.48.08.148 N050.04.47.628 E019.48.08.079 Color_253ACI
N050.04.47.628 E019.48.08.079 N050.04.47.641 E019.48.07.999 Color_253ACI
N050.04.47.641 E019.48.07.999 N050.04.47.627 E019.48.07.917 Color_253ACI
N050.04.47.627 E019.48.07.917 N050.04.47.603 E019.48.07.872 Color_253ACI
N050.04.50.168 E019.48.10.103 N050.04.50.113 E019.48.10.067 Color_253ACI
N050.04.50.113 E019.48.10.067 N050.04.50.049 E019.48.10.087 Color_253ACI
N050.04.50.049 E019.48.10.087 N050.04.50.008 E019.48.10.151 Color_253ACI
N050.04.50.008 E019.48.10.151 N050.04.49.997 E019.48.10.256 Color_253ACI
N050.04.49.997 E019.48.10.256 N050.04.50.025 E019.48.10.343 Color_253ACI
N050.04.50.025 E019.48.10.343 N050.04.50.083 E019.48.10.391 Color_253ACI
N050.04.50.083 E019.48.10.391 N050.04.50.143 E019.48.10.380 Color_253ACI
N050.04.50.143 E019.48.10.380 N050.04.50.192 E019.48.10.310 Color_253ACI
N050.04.50.192 E019.48.10.310 N050.04.50.206 E019.48.10.230 Color_253ACI
N050.04.50.206 E019.48.10.230 N050.04.50.192 E019.48.10.149 Color_253ACI
N050.04.50.192 E019.48.10.149 N050.04.50.168 E019.48.10.103 Color_253ACI
N050.04.49.741 E019.48.07.148 N050.04.49.687 E019.48.07.112 Color_253ACI
N050.04.49.687 E019.48.07.112 N050.04.49.622 E019.48.07.132 Color_253ACI
N050.04.49.622 E019.48.07.132 N050.04.49.582 E019.48.07.196 Color_253ACI
N050.04.49.582 E019.48.07.196 N050.04.49.570 E019.48.07.301 Color_253ACI
N050.04.49.570 E019.48.07.301 N050.04.49.598 E019.48.07.388 Color_253ACI
N050.04.49.598 E019.48.07.388 N050.04.49.656 E019.48.07.436 Color_253ACI
N050.04.49.656 E019.48.07.436 N050.04.49.717 E019.48.07.424 Color_253ACI
N050.04.49.717 E019.48.07.424 N050.04.49.766 E019.48.07.355 Color_253ACI
N050.04.49.766 E019.48.07.355 N050.04.49.779 E019.48.07.275 Color_253ACI
N050.04.49.779 E019.48.07.275 N050.04.49.765 E019.48.07.193 Color_253ACI
N050.04.49.765 E019.48.07.193 N050.04.49.741 E019.48.07.148 Color_253ACI
N050.04.49.338 E019.48.04.154 N050.04.49.284 E019.48.04.117 Color_253ACI
N050.04.49.284 E019.48.04.117 N050.04.49.219 E019.48.04.138 Color_253ACI
N050.04.49.219 E019.48.04.138 N050.04.49.179 E019.48.04.201 Color_253ACI
N050.04.49.179 E019.48.04.201 N050.04.49.167 E019.48.04.306 Color_253ACI
N050.04.49.167 E019.48.04.306 N050.04.49.195 E019.48.04.394 Color_253ACI
N050.04.49.195 E019.48.04.394 N050.04.49.253 E019.48.04.442 Color_253ACI
N050.04.49.253 E019.48.04.442 N050.04.49.314 E019.48.04.430 Color_253ACI
N050.04.49.314 E019.48.04.430 N050.04.49.363 E019.48.04.361 Color_253ACI
N050.04.49.363 E019.48.04.361 N050.04.49.376 E019.48.04.281 Color_253ACI
N050.04.49.376 E019.48.04.281 N050.04.49.362 E019.48.04.199 Color_253ACI
N050.04.49.362 E019.48.04.199 N050.04.49.338 E019.48.04.154 Color_253ACI
N050.04.48.947 E019.48.01.147 N050.04.48.893 E019.48.01.111 Color_253ACI
N050.04.48.893 E019.48.01.111 N050.04.48.828 E019.48.01.131 Color_253ACI
N050.04.48.828 E019.48.01.131 N050.04.48.788 E019.48.01.195 Color_253ACI
N050.04.48.788 E019.48.01.195 N050.04.48.776 E019.48.01.300 Color_253ACI
N050.04.48.776 E019.48.01.300 N050.04.48.804 E019.48.01.387 Color_253ACI
N050.04.48.804 E019.48.01.387 N050.04.48.862 E019.48.01.435 Color_253ACI
N050.04.48.862 E019.48.01.435 N050.04.48.923 E019.48.01.424 Color_253ACI
N050.04.48.923 E019.48.01.424 N050.04.48.972 E019.48.01.354 Color_253ACI
N050.04.48.972 E019.48.01.354 N050.04.48.986 E019.48.01.274 Color_253ACI
N050.04.48.986 E019.48.01.274 N050.04.48.972 E019.48.01.193 Color_253ACI
N050.04.48.972 E019.48.01.193 N050.04.48.947 E019.48.01.147 Color_253ACI
N050.04.48.515 E019.47.58.206 N050.04.48.461 E019.47.58.170 Color_253ACI
N050.04.48.461 E019.47.58.170 N050.04.48.396 E019.47.58.190 Color_253ACI
N050.04.48.396 E019.47.58.190 N050.04.48.356 E019.47.58.254 Color_253ACI
N050.04.48.356 E019.47.58.254 N050.04.48.344 E019.47.58.359 Color_253ACI
N050.04.48.344 E019.47.58.359 N050.04.48.372 E019.47.58.446 Color_253ACI
N050.04.48.372 E019.47.58.446 N050.04.48.430 E019.47.58.494 Color_253ACI
N050.04.48.430 E019.47.58.494 N050.04.48.491 E019.47.58.482 Color_253ACI
N050.04.48.491 E019.47.58.482 N050.04.48.540 E019.47.58.413 Color_253ACI
N050.04.48.540 E019.47.58.413 N050.04.48.553 E019.47.58.333 Color_253ACI
N050.04.48.553 E019.47.58.333 N050.04.48.539 E019.47.58.251 Color_253ACI
N050.04.48.539 E019.47.58.251 N050.04.48.515 E019.47.58.206 Color_253ACI
N050.04.48.128 E019.47.55.214 N050.04.48.074 E019.47.55.178 Color_253ACI
N050.04.48.074 E019.47.55.178 N050.04.48.009 E019.47.55.198 Color_253ACI
N050.04.48.009 E019.47.55.198 N050.04.47.969 E019.47.55.262 Color_253ACI
N050.04.47.969 E019.47.55.262 N050.04.47.957 E019.47.55.367 Color_253ACI
N050.04.47.957 E019.47.55.367 N050.04.47.985 E019.47.55.454 Color_253ACI
N050.04.47.985 E019.47.55.454 N050.04.48.043 E019.47.55.502 Color_253ACI
N050.04.48.043 E019.47.55.502 N050.04.48.104 E019.47.55.491 Color_253ACI
N050.04.48.104 E019.47.55.491 N050.04.48.153 E019.47.55.421 Color_253ACI
N050.04.48.153 E019.47.55.421 N050.04.48.166 E019.47.55.341 Color_253ACI
N050.04.48.166 E019.47.55.341 N050.04.48.153 E019.47.55.259 Color_253ACI
N050.04.48.153 E019.47.55.259 N050.04.48.128 E019.47.55.214 Color_253ACI
N050.04.47.710 E019.47.52.215 N050.04.47.656 E019.47.52.178 Color_253ACI
N050.04.47.656 E019.47.52.178 N050.04.47.591 E019.47.52.198 Color_253ACI
N050.04.47.591 E019.47.52.198 N050.04.47.551 E019.47.52.262 Color_253ACI
N050.04.47.551 E019.47.52.262 N050.04.47.539 E019.47.52.367 Color_253ACI
N050.04.47.539 E019.47.52.367 N050.04.47.567 E019.47.52.454 Color_253ACI
N050.04.47.567 E019.47.52.454 N050.04.47.625 E019.47.52.503 Color_253ACI
N050.04.47.625 E019.47.52.503 N050.04.47.686 E019.47.52.491 Color_253ACI
N050.04.47.686 E019.47.52.491 N050.04.47.735 E019.47.52.421 Color_253ACI
N050.04.47.735 E019.47.52.421 N050.04.47.748 E019.47.52.341 Color_253ACI
N050.04.47.748 E019.47.52.341 N050.04.47.734 E019.47.52.260 Color_253ACI
N050.04.47.734 E019.47.52.260 N050.04.47.710 E019.47.52.215 Color_253ACI
N050.04.47.296 E019.47.49.249 N050.04.47.242 E019.47.49.213 Color_253ACI
N050.04.47.242 E019.47.49.213 N050.04.47.178 E019.47.49.233 Color_253ACI
N050.04.47.178 E019.47.49.233 N050.04.47.137 E019.47.49.297 Color_253ACI
N050.04.47.137 E019.47.49.297 N050.04.47.126 E019.47.49.402 Color_253ACI
N050.04.47.126 E019.47.49.402 N050.04.47.153 E019.47.49.489 Color_253ACI
N050.04.47.153 E019.47.49.489 N050.04.47.211 E019.47.49.537 Color_253ACI
N050.04.47.211 E019.47.49.537 N050.04.47.272 E019.47.49.525 Color_253ACI
N050.04.47.272 E019.47.49.525 N050.04.47.321 E019.47.49.456 Color_253ACI
N050.04.47.321 E019.47.49.456 N050.04.47.335 E019.47.49.376 Color_253ACI
N050.04.47.335 E019.47.49.376 N050.04.47.321 E019.47.49.294 Color_253ACI
N050.04.47.321 E019.47.49.294 N050.04.47.296 E019.47.49.249 Color_253ACI
N050.04.46.898 E019.47.46.255 N050.04.46.844 E019.47.46.219 Color_253ACI
N050.04.46.844 E019.47.46.219 N050.04.46.779 E019.47.46.239 Color_253ACI
N050.04.46.779 E019.47.46.239 N050.04.46.739 E019.47.46.303 Color_253ACI
N050.04.46.739 E019.47.46.303 N050.04.46.727 E019.47.46.408 Color_253ACI
N050.04.46.727 E019.47.46.408 N050.04.46.755 E019.47.46.495 Color_253ACI
N050.04.46.755 E019.47.46.495 N050.04.46.813 E019.47.46.543 Color_253ACI
N050.04.46.813 E019.47.46.543 N050.04.46.874 E019.47.46.531 Color_253ACI
N050.04.46.874 E019.47.46.531 N050.04.46.923 E019.47.46.462 Color_253ACI
N050.04.46.923 E019.47.46.462 N050.04.46.936 E019.47.46.382 Color_253ACI
N050.04.46.936 E019.47.46.382 N050.04.46.922 E019.47.46.300 Color_253ACI
N050.04.46.922 E019.47.46.300 N050.04.46.898 E019.47.46.255 Color_253ACI
N050.04.46.483 E019.47.43.277 N050.04.46.429 E019.47.43.241 Color_253ACI
N050.04.46.429 E019.47.43.241 N050.04.46.364 E019.47.43.261 Color_253ACI
N050.04.46.364 E019.47.43.261 N050.04.46.324 E019.47.43.325 Color_253ACI
N050.04.46.324 E019.47.43.325 N050.04.46.312 E019.47.43.430 Color_253ACI
N050.04.46.312 E019.47.43.430 N050.04.46.340 E019.47.43.517 Color_253ACI
N050.04.46.340 E019.47.43.517 N050.04.46.398 E019.47.43.565 Color_253ACI
N050.04.46.398 E019.47.43.565 N050.04.46.459 E019.47.43.554 Color_253ACI
N050.04.46.459 E019.47.43.554 N050.04.46.508 E019.47.43.484 Color_253ACI
N050.04.46.508 E019.47.43.484 N050.04.46.521 E019.47.43.404 Color_253ACI
N050.04.46.521 E019.47.43.404 N050.04.46.507 E019.47.43.322 Color_253ACI
N050.04.46.507 E019.47.43.322 N050.04.46.483 E019.47.43.277 Color_253ACI
N050.04.46.079 E019.47.40.297 N050.04.46.024 E019.47.40.260 Color_253ACI
N050.04.46.024 E019.47.40.260 N050.04.45.960 E019.47.40.281 Color_253ACI
N050.04.45.960 E019.47.40.281 N050.04.45.919 E019.47.40.344 Color_253ACI
N050.04.45.919 E019.47.40.344 N050.04.45.908 E019.47.40.449 Color_253ACI
N050.04.45.908 E019.47.40.449 N050.04.45.936 E019.47.40.537 Color_253ACI
N050.04.45.936 E019.47.40.537 N050.04.45.994 E019.47.40.585 Color_253ACI
N050.04.45.994 E019.47.40.585 N050.04.46.054 E019.47.40.573 Color_253ACI
N050.04.46.054 E019.47.40.573 N050.04.46.103 E019.47.40.504 Color_253ACI
N050.04.46.103 E019.47.40.504 N050.04.46.117 E019.47.40.424 Color_253ACI
N050.04.46.117 E019.47.40.424 N050.04.46.103 E019.47.40.342 Color_253ACI
N050.04.46.103 E019.47.40.342 N050.04.46.079 E019.47.40.297 Color_253ACI
N050.04.45.664 E019.47.37.296 N050.04.45.610 E019.47.37.260 Color_253ACI
N050.04.45.610 E019.47.37.260 N050.04.45.545 E019.47.37.280 Color_253ACI
N050.04.45.545 E019.47.37.280 N050.04.45.505 E019.47.37.344 Color_253ACI
N050.04.45.505 E019.47.37.344 N050.04.45.493 E019.47.37.449 Color_253ACI
N050.04.45.493 E019.47.37.449 N050.04.45.521 E019.47.37.536 Color_253ACI
N050.04.45.521 E019.47.37.536 N050.04.45.579 E019.47.37.584 Color_253ACI
N050.04.45.579 E019.47.37.584 N050.04.45.640 E019.47.37.572 Color_253ACI
N050.04.45.640 E019.47.37.572 N050.04.45.689 E019.47.37.503 Color_253ACI
N050.04.45.689 E019.47.37.503 N050.04.45.702 E019.47.37.423 Color_253ACI
N050.04.45.702 E019.47.37.423 N050.04.45.689 E019.47.37.341 Color_253ACI
N050.04.45.689 E019.47.37.341 N050.04.45.664 E019.47.37.296 Color_253ACI
N050.04.45.258 E019.47.34.328 N050.04.45.204 E019.47.34.292 Color_253ACI
N050.04.45.204 E019.47.34.292 N050.04.45.139 E019.47.34.312 Color_253ACI
N050.04.45.139 E019.47.34.312 N050.04.45.099 E019.47.34.376 Color_253ACI
N050.04.45.099 E019.47.34.376 N050.04.45.087 E019.47.34.481 Color_253ACI
N050.04.45.087 E019.47.34.481 N050.04.45.115 E019.47.34.568 Color_253ACI
N050.04.45.115 E019.47.34.568 N050.04.45.173 E019.47.34.616 Color_253ACI
N050.04.45.173 E019.47.34.616 N050.04.45.234 E019.47.34.604 Color_253ACI
N050.04.45.234 E019.47.34.604 N050.04.45.283 E019.47.34.535 Color_253ACI
N050.04.45.283 E019.47.34.535 N050.04.45.296 E019.47.34.455 Color_253ACI
N050.04.45.296 E019.47.34.455 N050.04.45.282 E019.47.34.373 Color_253ACI
N050.04.45.282 E019.47.34.373 N050.04.45.258 E019.47.34.328 Color_253ACI
N050.04.44.842 E019.47.31.321 N050.04.44.788 E019.47.31.285 Color_253ACI
N050.04.44.788 E019.47.31.285 N050.04.44.724 E019.47.31.305 Color_253ACI
N050.04.44.724 E019.47.31.305 N050.04.44.683 E019.47.31.369 Color_253ACI
N050.04.44.683 E019.47.31.369 N050.04.44.672 E019.47.31.474 Color_253ACI
N050.04.44.672 E019.47.31.474 N050.04.44.700 E019.47.31.561 Color_253ACI
N050.04.44.700 E019.47.31.561 N050.04.44.757 E019.47.31.609 Color_253ACI
N050.04.44.757 E019.47.31.609 N050.04.44.818 E019.47.31.598 Color_253ACI
N050.04.44.818 E019.47.31.598 N050.04.44.867 E019.47.31.528 Color_253ACI
N050.04.44.867 E019.47.31.528 N050.04.44.881 E019.47.31.448 Color_253ACI
N050.04.44.881 E019.47.31.448 N050.04.44.867 E019.47.31.367 Color_253ACI
N050.04.44.867 E019.47.31.367 N050.04.44.842 E019.47.31.321 Color_253ACI
N050.04.44.445 E019.47.28.333 N050.04.44.391 E019.47.28.296 Color_253ACI
N050.04.44.391 E019.47.28.296 N050.04.44.326 E019.47.28.317 Color_253ACI
N050.04.44.326 E019.47.28.317 N050.04.44.286 E019.47.28.380 Color_253ACI
N050.04.44.286 E019.47.28.380 N050.04.44.274 E019.47.28.485 Color_253ACI
N050.04.44.274 E019.47.28.485 N050.04.44.302 E019.47.28.573 Color_253ACI
N050.04.44.302 E019.47.28.573 N050.04.44.360 E019.47.28.621 Color_253ACI
N050.04.44.360 E019.47.28.621 N050.04.44.420 E019.47.28.609 Color_253ACI
N050.04.44.420 E019.47.28.609 N050.04.44.470 E019.47.28.540 Color_253ACI
N050.04.44.470 E019.47.28.540 N050.04.44.483 E019.47.28.460 Color_253ACI
N050.04.44.483 E019.47.28.460 N050.04.44.469 E019.47.28.378 Color_253ACI
N050.04.44.469 E019.47.28.378 N050.04.44.445 E019.47.28.333 Color_253ACI
N050.04.44.045 E019.47.25.386 N050.04.43.991 E019.47.25.350 Color_253ACI
N050.04.43.991 E019.47.25.350 N050.04.43.926 E019.47.25.370 Color_253ACI
N050.04.43.926 E019.47.25.370 N050.04.43.886 E019.47.25.434 Color_253ACI
N050.04.43.886 E019.47.25.434 N050.04.43.874 E019.47.25.539 Color_253ACI
N050.04.43.874 E019.47.25.539 N050.04.43.902 E019.47.25.626 Color_253ACI
N050.04.43.902 E019.47.25.626 N050.04.43.960 E019.47.25.674 Color_253ACI
N050.04.43.960 E019.47.25.674 N050.04.44.021 E019.47.25.663 Color_253ACI
N050.04.44.021 E019.47.25.663 N050.04.44.070 E019.47.25.593 Color_253ACI
N050.04.44.070 E019.47.25.593 N050.04.44.083 E019.47.25.513 Color_253ACI
N050.04.44.083 E019.47.25.513 N050.04.44.070 E019.47.25.432 Color_253ACI
N050.04.44.070 E019.47.25.432 N050.04.44.045 E019.47.25.386 Color_253ACI
N050.04.43.627 E019.47.22.387 N050.04.43.573 E019.47.22.351 Color_253ACI
N050.04.43.573 E019.47.22.351 N050.04.43.508 E019.47.22.371 Color_253ACI
N050.04.43.508 E019.47.22.371 N050.04.43.468 E019.47.22.435 Color_253ACI
N050.04.43.468 E019.47.22.435 N050.04.43.456 E019.47.22.539 Color_253ACI
N050.04.43.456 E019.47.22.539 N050.04.43.484 E019.47.22.627 Color_253ACI
N050.04.43.484 E019.47.22.627 N050.04.43.542 E019.47.22.675 Color_253ACI
N050.04.43.542 E019.47.22.675 N050.04.43.603 E019.47.22.663 Color_253ACI
N050.04.43.603 E019.47.22.663 N050.04.43.652 E019.47.22.594 Color_253ACI
N050.04.43.652 E019.47.22.594 N050.04.43.665 E019.47.22.514 Color_253ACI
N050.04.43.665 E019.47.22.514 N050.04.43.651 E019.47.22.432 Color_253ACI
N050.04.43.651 E019.47.22.432 N050.04.43.627 E019.47.22.387 Color_253ACI
N050.04.43.227 E019.47.19.381 N050.04.43.173 E019.47.19.345 Color_253ACI
N050.04.43.173 E019.47.19.345 N050.04.43.108 E019.47.19.365 Color_253ACI
N050.04.43.108 E019.47.19.365 N050.04.43.068 E019.47.19.429 Color_253ACI
N050.04.43.068 E019.47.19.429 N050.04.43.056 E019.47.19.534 Color_253ACI
N050.04.43.056 E019.47.19.534 N050.04.43.084 E019.47.19.621 Color_253ACI
N050.04.43.084 E019.47.19.621 N050.04.43.142 E019.47.19.669 Color_253ACI
N050.04.43.142 E019.47.19.669 N050.04.43.203 E019.47.19.658 Color_253ACI
N050.04.43.203 E019.47.19.658 N050.04.43.252 E019.47.19.588 Color_253ACI
N050.04.43.252 E019.47.19.588 N050.04.43.265 E019.47.19.508 Color_253ACI
N050.04.43.265 E019.47.19.508 N050.04.43.251 E019.47.19.426 Color_253ACI
N050.04.43.251 E019.47.19.426 N050.04.43.227 E019.47.19.381 Color_253ACI
N050.04.42.811 E019.47.16.423 N050.04.42.756 E019.47.16.386 Color_253ACI
N050.04.42.756 E019.47.16.386 N050.04.42.692 E019.47.16.407 Color_253ACI
N050.04.42.692 E019.47.16.407 N050.04.42.651 E019.47.16.470 Color_253ACI
N050.04.42.651 E019.47.16.470 N050.04.42.640 E019.47.16.575 Color_253ACI
N050.04.42.640 E019.47.16.575 N050.04.42.668 E019.47.16.663 Color_253ACI
N050.04.42.668 E019.47.16.663 N050.04.42.726 E019.47.16.711 Color_253ACI
N050.04.42.726 E019.47.16.711 N050.04.42.786 E019.47.16.699 Color_253ACI
N050.04.42.786 E019.47.16.699 N050.04.42.835 E019.47.16.630 Color_253ACI
N050.04.42.835 E019.47.16.630 N050.04.42.849 E019.47.16.549 Color_253ACI
N050.04.42.849 E019.47.16.549 N050.04.42.835 E019.47.16.468 Color_253ACI
N050.04.42.835 E019.47.16.468 N050.04.42.811 E019.47.16.423 Color_253ACI
N050.04.42.397 E019.47.13.427 N050.04.42.343 E019.47.13.391 Color_253ACI
N050.04.42.343 E019.47.13.391 N050.04.42.278 E019.47.13.411 Color_253ACI
N050.04.42.278 E019.47.13.411 N050.04.42.238 E019.47.13.475 Color_253ACI
N050.04.42.238 E019.47.13.475 N050.04.42.226 E019.47.13.580 Color_253ACI
N050.04.42.226 E019.47.13.580 N050.04.42.254 E019.47.13.667 Color_253ACI
N050.04.42.254 E019.47.13.667 N050.04.42.312 E019.47.13.715 Color_253ACI
N050.04.42.312 E019.47.13.715 N050.04.42.372 E019.47.13.703 Color_253ACI
N050.04.42.372 E019.47.13.703 N050.04.42.422 E019.47.13.634 Color_253ACI
N050.04.42.422 E019.47.13.634 N050.04.42.435 E019.47.13.554 Color_253ACI
N050.04.42.435 E019.47.13.554 N050.04.42.421 E019.47.13.472 Color_253ACI
N050.04.42.421 E019.47.13.472 N050.04.42.397 E019.47.13.427 Color_253ACI
N050.04.41.995 E019.47.10.464 N050.04.41.941 E019.47.10.427 Color_253ACI
N050.04.41.941 E019.47.10.427 N050.04.41.876 E019.47.10.448 Color_253ACI
N050.04.41.876 E019.47.10.448 N050.04.41.836 E019.47.10.511 Color_253ACI
N050.04.41.836 E019.47.10.511 N050.04.41.824 E019.47.10.616 Color_253ACI
N050.04.41.824 E019.47.10.616 N050.04.41.852 E019.47.10.703 Color_253ACI
N050.04.41.852 E019.47.10.703 N050.04.41.910 E019.47.10.752 Color_253ACI
N050.04.41.910 E019.47.10.752 N050.04.41.971 E019.47.10.740 Color_253ACI
N050.04.41.971 E019.47.10.740 N050.04.42.020 E019.47.10.671 Color_253ACI
N050.04.42.020 E019.47.10.671 N050.04.42.033 E019.47.10.590 Color_253ACI
N050.04.42.033 E019.47.10.590 N050.04.42.019 E019.47.10.509 Color_253ACI
N050.04.42.019 E019.47.10.509 N050.04.41.995 E019.47.10.464 Color_253ACI
N050.04.41.586 E019.47.07.473 N050.04.41.531 E019.47.07.436 Color_253ACI
N050.04.41.531 E019.47.07.436 N050.04.41.467 E019.47.07.456 Color_253ACI
N050.04.41.467 E019.47.07.456 N050.04.41.426 E019.47.07.520 Color_253ACI
N050.04.41.426 E019.47.07.520 N050.04.41.415 E019.47.07.625 Color_253ACI
N050.04.41.415 E019.47.07.625 N050.04.41.443 E019.47.07.712 Color_253ACI
N050.04.41.443 E019.47.07.712 N050.04.41.501 E019.47.07.761 Color_253ACI
N050.04.41.501 E019.47.07.761 N050.04.41.561 E019.47.07.749 Color_253ACI
N050.04.41.561 E019.47.07.749 N050.04.41.610 E019.47.07.680 Color_253ACI
N050.04.41.610 E019.47.07.680 N050.04.41.624 E019.47.07.599 Color_253ACI
N050.04.41.624 E019.47.07.599 N050.04.41.610 E019.47.07.518 Color_253ACI
N050.04.41.610 E019.47.07.518 N050.04.41.586 E019.47.07.473 Color_253ACI
N050.04.41.181 E019.47.04.486 N050.04.41.126 E019.47.04.450 Color_253ACI
N050.04.41.126 E019.47.04.450 N050.04.41.062 E019.47.04.470 Color_253ACI
N050.04.41.062 E019.47.04.470 N050.04.41.021 E019.47.04.534 Color_253ACI
N050.04.41.021 E019.47.04.534 N050.04.41.010 E019.47.04.639 Color_253ACI
N050.04.41.010 E019.47.04.639 N050.04.41.038 E019.47.04.726 Color_253ACI
N050.04.41.038 E019.47.04.726 N050.04.41.096 E019.47.04.774 Color_253ACI
N050.04.41.096 E019.47.04.774 N050.04.41.156 E019.47.04.763 Color_253ACI
N050.04.41.156 E019.47.04.763 N050.04.41.205 E019.47.04.693 Color_253ACI
N050.04.41.205 E019.47.04.693 N050.04.41.219 E019.47.04.613 Color_253ACI
N050.04.41.219 E019.47.04.613 N050.04.41.205 E019.47.04.532 Color_253ACI
N050.04.41.205 E019.47.04.532 N050.04.41.181 E019.47.04.486 Color_253ACI
N050.04.40.770 E019.47.01.514 N050.04.40.716 E019.47.01.478 Color_253ACI
N050.04.40.716 E019.47.01.478 N050.04.40.651 E019.47.01.498 Color_253ACI
N050.04.40.651 E019.47.01.498 N050.04.40.611 E019.47.01.562 Color_253ACI
N050.04.40.611 E019.47.01.562 N050.04.40.599 E019.47.01.667 Color_253ACI
N050.04.40.599 E019.47.01.667 N050.04.40.627 E019.47.01.754 Color_253ACI
N050.04.40.627 E019.47.01.754 N050.04.40.685 E019.47.01.802 Color_253ACI
N050.04.40.685 E019.47.01.802 N050.04.40.745 E019.47.01.791 Color_253ACI
N050.04.40.745 E019.47.01.791 N050.04.40.795 E019.47.01.721 Color_253ACI
N050.04.40.795 E019.47.01.721 N050.04.40.808 E019.47.01.641 Color_253ACI
N050.04.40.808 E019.47.01.641 N050.04.40.794 E019.47.01.559 Color_253ACI
N050.04.40.794 E019.47.01.559 N050.04.40.770 E019.47.01.514 Color_253ACI
N050.04.40.366 E019.46.58.510 N050.04.40.312 E019.46.58.474 Color_253ACI
N050.04.40.312 E019.46.58.474 N050.04.40.247 E019.46.58.494 Color_253ACI
N050.04.40.247 E019.46.58.494 N050.04.40.207 E019.46.58.558 Color_253ACI
N050.04.40.207 E019.46.58.558 N050.04.40.195 E019.46.58.663 Color_253ACI
N050.04.40.195 E019.46.58.663 N050.04.40.223 E019.46.58.750 Color_253ACI
N050.04.40.223 E019.46.58.750 N050.04.40.281 E019.46.58.798 Color_253ACI
N050.04.40.281 E019.46.58.798 N050.04.40.342 E019.46.58.786 Color_253ACI
N050.04.40.342 E019.46.58.786 N050.04.40.391 E019.46.58.717 Color_253ACI
N050.04.40.391 E019.46.58.717 N050.04.40.404 E019.46.58.637 Color_253ACI
N050.04.40.404 E019.46.58.637 N050.04.40.391 E019.46.58.555 Color_253ACI
N050.04.40.391 E019.46.58.555 N050.04.40.366 E019.46.58.510 Color_253ACI
N050.04.39.969 E019.46.55.522 N050.04.39.914 E019.46.55.486 Color_253ACI
N050.04.39.914 E019.46.55.486 N050.04.39.850 E019.46.55.506 Color_253ACI
N050.04.39.850 E019.46.55.506 N050.04.39.809 E019.46.55.570 Color_253ACI
N050.04.39.809 E019.46.55.570 N050.04.39.798 E019.46.55.675 Color_253ACI
N050.04.39.798 E019.46.55.675 N050.04.39.826 E019.46.55.762 Color_253ACI
N050.04.39.826 E019.46.55.762 N050.04.39.884 E019.46.55.810 Color_253ACI
N050.04.39.884 E019.46.55.810 N050.04.39.944 E019.46.55.798 Color_253ACI
N050.04.39.944 E019.46.55.798 N050.04.39.993 E019.46.55.729 Color_253ACI
N050.04.39.993 E019.46.55.729 N050.04.40.007 E019.46.55.649 Color_253ACI
N050.04.40.007 E019.46.55.649 N050.04.39.993 E019.46.55.567 Color_253ACI
N050.04.39.993 E019.46.55.567 N050.04.39.969 E019.46.55.522 Color_253ACI
N050.04.39.550 E019.46.52.552 N050.04.39.496 E019.46.52.516 Color_253ACI
N050.04.39.496 E019.46.52.516 N050.04.39.432 E019.46.52.536 Color_253ACI
N050.04.39.432 E019.46.52.536 N050.04.39.391 E019.46.52.600 Color_253ACI
N050.04.39.391 E019.46.52.600 N050.04.39.380 E019.46.52.705 Color_253ACI
N050.04.39.380 E019.46.52.705 N050.04.39.408 E019.46.52.792 Color_253ACI
N050.04.39.408 E019.46.52.792 N050.04.39.466 E019.46.52.840 Color_253ACI
N050.04.39.466 E019.46.52.840 N050.04.39.526 E019.46.52.828 Color_253ACI
N050.04.39.526 E019.46.52.828 N050.04.39.575 E019.46.52.759 Color_253ACI
N050.04.39.575 E019.46.52.759 N050.04.39.589 E019.46.52.679 Color_253ACI
N050.04.39.589 E019.46.52.679 N050.04.39.575 E019.46.52.597 Color_253ACI
N050.04.39.575 E019.46.52.597 N050.04.39.550 E019.46.52.552 Color_253ACI
N050.04.39.144 E019.46.49.554 N050.04.39.090 E019.46.49.518 Color_253ACI
N050.04.39.090 E019.46.49.518 N050.04.39.025 E019.46.49.538 Color_253ACI
N050.04.39.025 E019.46.49.538 N050.04.38.985 E019.46.49.602 Color_253ACI
N050.04.38.985 E019.46.49.602 N050.04.38.973 E019.46.49.707 Color_253ACI
N050.04.38.973 E019.46.49.707 N050.04.39.001 E019.46.49.794 Color_253ACI
N050.04.39.001 E019.46.49.794 N050.04.39.059 E019.46.49.842 Color_253ACI
N050.04.39.059 E019.46.49.842 N050.04.39.120 E019.46.49.830 Color_253ACI
N050.04.39.120 E019.46.49.830 N050.04.39.169 E019.46.49.761 Color_253ACI
N050.04.39.169 E019.46.49.761 N050.04.39.182 E019.46.49.681 Color_253ACI
N050.04.39.182 E019.46.49.681 N050.04.39.168 E019.46.49.599 Color_253ACI
N050.04.39.168 E019.46.49.599 N050.04.39.144 E019.46.49.554 Color_253ACI
N050.04.38.731 E019.46.46.564 N050.04.38.677 E019.46.46.528 Color_253ACI
N050.04.38.677 E019.46.46.528 N050.04.38.612 E019.46.46.548 Color_253ACI
N050.04.38.612 E019.46.46.548 N050.04.38.572 E019.46.46.612 Color_253ACI
N050.04.38.572 E019.46.46.612 N050.04.38.560 E019.46.46.717 Color_253ACI
N050.04.38.560 E019.46.46.717 N050.04.38.588 E019.46.46.804 Color_253ACI
N050.04.38.588 E019.46.46.804 N050.04.38.646 E019.46.46.852 Color_253ACI
N050.04.38.646 E019.46.46.852 N050.04.38.707 E019.46.46.840 Color_253ACI
N050.04.38.707 E019.46.46.840 N050.04.38.756 E019.46.46.771 Color_253ACI
N050.04.38.756 E019.46.46.771 N050.04.38.769 E019.46.46.691 Color_253ACI
N050.04.38.769 E019.46.46.691 N050.04.38.755 E019.46.46.609 Color_253ACI
N050.04.38.755 E019.46.46.609 N050.04.38.731 E019.46.46.564 Color_253ACI
N050.04.38.318 E019.46.43.604 N050.04.38.264 E019.46.43.568 Color_253ACI
N050.04.38.264 E019.46.43.568 N050.04.38.199 E019.46.43.588 Color_253ACI
N050.04.38.199 E019.46.43.588 N050.04.38.159 E019.46.43.651 Color_253ACI
N050.04.38.159 E019.46.43.651 N050.04.38.147 E019.46.43.756 Color_253ACI
N050.04.38.147 E019.46.43.756 N050.04.38.175 E019.46.43.844 Color_253ACI
N050.04.38.175 E019.46.43.844 N050.04.38.233 E019.46.43.892 Color_253ACI
N050.04.38.233 E019.46.43.892 N050.04.38.294 E019.46.43.880 Color_253ACI
N050.04.38.294 E019.46.43.880 N050.04.38.343 E019.46.43.811 Color_253ACI
N050.04.38.343 E019.46.43.811 N050.04.38.356 E019.46.43.731 Color_253ACI
N050.04.38.356 E019.46.43.731 N050.04.38.342 E019.46.43.649 Color_253ACI
N050.04.38.342 E019.46.43.649 N050.04.38.318 E019.46.43.604 Color_253ACI
N050.04.37.917 E019.46.40.616 N050.04.37.863 E019.46.40.580 Color_253ACI
N050.04.37.863 E019.46.40.580 N050.04.37.798 E019.46.40.600 Color_253ACI
N050.04.37.798 E019.46.40.600 N050.04.37.758 E019.46.40.664 Color_253ACI
N050.04.37.758 E019.46.40.664 N050.04.37.746 E019.46.40.769 Color_253ACI
N050.04.37.746 E019.46.40.769 N050.04.37.774 E019.46.40.856 Color_253ACI
N050.04.37.774 E019.46.40.856 N050.04.37.832 E019.46.40.904 Color_253ACI
N050.04.37.832 E019.46.40.904 N050.04.37.893 E019.46.40.893 Color_253ACI
N050.04.37.893 E019.46.40.893 N050.04.37.942 E019.46.40.823 Color_253ACI
N050.04.37.942 E019.46.40.823 N050.04.37.955 E019.46.40.743 Color_253ACI
N050.04.37.955 E019.46.40.743 N050.04.37.941 E019.46.40.662 Color_253ACI
N050.04.37.941 E019.46.40.662 N050.04.37.917 E019.46.40.616 Color_253ACI
N050.04.37.506 E019.46.37.615 N050.04.37.452 E019.46.37.578 Color_253ACI
N050.04.37.452 E019.46.37.578 N050.04.37.387 E019.46.37.598 Color_253ACI
N050.04.37.387 E019.46.37.598 N050.04.37.347 E019.46.37.662 Color_253ACI
N050.04.37.347 E019.46.37.662 N050.04.37.335 E019.46.37.767 Color_253ACI
N050.04.37.335 E019.46.37.767 N050.04.37.363 E019.46.37.854 Color_253ACI
N050.04.37.363 E019.46.37.854 N050.04.37.421 E019.46.37.903 Color_253ACI
N050.04.37.421 E019.46.37.903 N050.04.37.482 E019.46.37.891 Color_253ACI
N050.04.37.482 E019.46.37.891 N050.04.37.531 E019.46.37.821 Color_253ACI
N050.04.37.531 E019.46.37.821 N050.04.37.544 E019.46.37.741 Color_253ACI
N050.04.37.544 E019.46.37.741 N050.04.37.531 E019.46.37.660 Color_253ACI
N050.04.37.531 E019.46.37.660 N050.04.37.506 E019.46.37.615 Color_253ACI
;rwy_ctr_lights_red N000.00.00.000 E000.00.00.000 N000.00.00.000 E000.00.00.000
N050.04.32.186 E019.46.06.817 N050.04.32.175 E019.46.06.726 Color_14ACI
N050.04.32.175 E019.46.06.726 N050.04.32.129 E019.46.06.653 Color_14ACI
N050.04.32.129 E019.46.06.653 N050.04.32.072 E019.46.06.636 Color_14ACI
N050.04.32.072 E019.46.06.636 N050.04.32.010 E019.46.06.678 Color_14ACI
N050.04.32.010 E019.46.06.678 N050.04.31.978 E019.46.06.763 Color_14ACI
N050.04.31.978 E019.46.06.763 N050.04.31.984 E019.46.06.864 Color_14ACI
N050.04.31.984 E019.46.06.864 N050.04.32.024 E019.46.06.937 Color_14ACI
N050.04.32.024 E019.46.06.937 N050.04.32.088 E019.46.06.963 Color_14ACI
N050.04.32.088 E019.46.06.963 N050.04.32.139 E019.46.06.936 Color_14ACI
N050.04.32.139 E019.46.06.936 N050.04.32.175 E019.46.06.873 Color_14ACI
N050.04.32.175 E019.46.06.873 N050.04.32.186 E019.46.06.817 Color_14ACI
N050.04.37.682 E019.46.46.997 N050.04.37.672 E019.46.46.907 Color_14ACI
N050.04.37.672 E019.46.46.907 N050.04.37.625 E019.46.46.834 Color_14ACI
N050.04.37.625 E019.46.46.834 N050.04.37.569 E019.46.46.816 Color_14ACI
N050.04.37.569 E019.46.46.816 N050.04.37.506 E019.46.46.859 Color_14ACI
N050.04.37.506 E019.46.46.859 N050.04.37.475 E019.46.46.943 Color_14ACI
N050.04.37.475 E019.46.46.943 N050.04.37.481 E019.46.47.045 Color_14ACI
N050.04.37.481 E019.46.47.045 N050.04.37.521 E019.46.47.118 Color_14ACI
N050.04.37.521 E019.46.47.118 N050.04.37.585 E019.46.47.143 Color_14ACI
N050.04.37.585 E019.46.47.143 N050.04.37.635 E019.46.47.117 Color_14ACI
N050.04.37.635 E019.46.47.117 N050.04.37.671 E019.46.47.054 Color_14ACI
N050.04.37.671 E019.46.47.054 N050.04.37.682 E019.46.46.997 Color_14ACI
N050.04.37.275 E019.46.44.020 N050.04.37.265 E019.46.43.930 Color_14ACI
N050.04.37.265 E019.46.43.930 N050.04.37.218 E019.46.43.857 Color_14ACI
N050.04.37.218 E019.46.43.857 N050.04.37.162 E019.46.43.839 Color_14ACI
N050.04.37.162 E019.46.43.839 N050.04.37.099 E019.46.43.882 Color_14ACI
N050.04.37.099 E019.46.43.882 N050.04.37.068 E019.46.43.966 Color_14ACI
N050.04.37.068 E019.46.43.966 N050.04.37.074 E019.46.44.068 Color_14ACI
N050.04.37.074 E019.46.44.068 N050.04.37.114 E019.46.44.141 Color_14ACI
N050.04.37.114 E019.46.44.141 N050.04.37.178 E019.46.44.166 Color_14ACI
N050.04.37.178 E019.46.44.166 N050.04.37.228 E019.46.44.140 Color_14ACI
N050.04.37.228 E019.46.44.140 N050.04.37.264 E019.46.44.077 Color_14ACI
N050.04.37.264 E019.46.44.077 N050.04.37.275 E019.46.44.020 Color_14ACI
N050.04.36.868 E019.46.41.043 N050.04.36.858 E019.46.40.953 Color_14ACI
N050.04.36.858 E019.46.40.953 N050.04.36.811 E019.46.40.880 Color_14ACI
N050.04.36.811 E019.46.40.880 N050.04.36.755 E019.46.40.862 Color_14ACI
N050.04.36.755 E019.46.40.862 N050.04.36.692 E019.46.40.905 Color_14ACI
N050.04.36.692 E019.46.40.905 N050.04.36.661 E019.46.40.989 Color_14ACI
N050.04.36.661 E019.46.40.989 N050.04.36.667 E019.46.41.091 Color_14ACI
N050.04.36.667 E019.46.41.091 N050.04.36.706 E019.46.41.164 Color_14ACI
N050.04.36.706 E019.46.41.164 N050.04.36.771 E019.46.41.189 Color_14ACI
N050.04.36.771 E019.46.41.189 N050.04.36.821 E019.46.41.163 Color_14ACI
N050.04.36.821 E019.46.41.163 N050.04.36.857 E019.46.41.100 Color_14ACI
N050.04.36.857 E019.46.41.100 N050.04.36.868 E019.46.41.043 Color_14ACI
N050.04.36.461 E019.46.38.066 N050.04.36.451 E019.46.37.976 Color_14ACI
N050.04.36.451 E019.46.37.976 N050.04.36.404 E019.46.37.903 Color_14ACI
N050.04.36.404 E019.46.37.903 N050.04.36.348 E019.46.37.885 Color_14ACI
N050.04.36.348 E019.46.37.885 N050.04.36.285 E019.46.37.928 Color_14ACI
N050.04.36.285 E019.46.37.928 N050.04.36.254 E019.46.38.012 Color_14ACI
N050.04.36.254 E019.46.38.012 N050.04.36.260 E019.46.38.114 Color_14ACI
N050.04.36.260 E019.46.38.114 N050.04.36.299 E019.46.38.187 Color_14ACI
N050.04.36.299 E019.46.38.187 N050.04.36.364 E019.46.38.212 Color_14ACI
N050.04.36.364 E019.46.38.212 N050.04.36.414 E019.46.38.186 Color_14ACI
N050.04.36.414 E019.46.38.186 N050.04.36.450 E019.46.38.123 Color_14ACI
N050.04.36.450 E019.46.38.123 N050.04.36.461 E019.46.38.066 Color_14ACI
N050.04.36.054 E019.46.35.089 N050.04.36.043 E019.46.34.999 Color_14ACI
N050.04.36.043 E019.46.34.999 N050.04.35.997 E019.46.34.926 Color_14ACI
N050.04.35.997 E019.46.34.926 N050.04.35.941 E019.46.34.908 Color_14ACI
N050.04.35.941 E019.46.34.908 N050.04.35.878 E019.46.34.951 Color_14ACI
N050.04.35.878 E019.46.34.951 N050.04.35.847 E019.46.35.035 Color_14ACI
N050.04.35.847 E019.46.35.035 N050.04.35.853 E019.46.35.137 Color_14ACI
N050.04.35.853 E019.46.35.137 N050.04.35.892 E019.46.35.210 Color_14ACI
N050.04.35.892 E019.46.35.210 N050.04.35.957 E019.46.35.235 Color_14ACI
N050.04.35.957 E019.46.35.235 N050.04.36.007 E019.46.35.209 Color_14ACI
N050.04.36.007 E019.46.35.209 N050.04.36.043 E019.46.35.146 Color_14ACI
N050.04.36.043 E019.46.35.146 N050.04.36.054 E019.46.35.089 Color_14ACI
N050.04.35.647 E019.46.32.112 N050.04.35.636 E019.46.32.022 Color_14ACI
N050.04.35.636 E019.46.32.022 N050.04.35.590 E019.46.31.949 Color_14ACI
N050.04.35.590 E019.46.31.949 N050.04.35.534 E019.46.31.932 Color_14ACI
N050.04.35.534 E019.46.31.932 N050.04.35.471 E019.46.31.974 Color_14ACI
N050.04.35.471 E019.46.31.974 N050.04.35.440 E019.46.32.058 Color_14ACI
N050.04.35.440 E019.46.32.058 N050.04.35.446 E019.46.32.160 Color_14ACI
N050.04.35.446 E019.46.32.160 N050.04.35.485 E019.46.32.233 Color_14ACI
N050.04.35.485 E019.46.32.233 N050.04.35.550 E019.46.32.258 Color_14ACI
N050.04.35.550 E019.46.32.258 N050.04.35.600 E019.46.32.232 Color_14ACI
N050.04.35.600 E019.46.32.232 N050.04.35.636 E019.46.32.169 Color_14ACI
N050.04.35.636 E019.46.32.169 N050.04.35.647 E019.46.32.112 Color_14ACI
N050.04.35.240 E019.46.29.135 N050.04.35.229 E019.46.29.045 Color_14ACI
N050.04.35.229 E019.46.29.045 N050.04.35.183 E019.46.28.972 Color_14ACI
N050.04.35.183 E019.46.28.972 N050.04.35.127 E019.46.28.955 Color_14ACI
N050.04.35.127 E019.46.28.955 N050.04.35.064 E019.46.28.997 Color_14ACI
N050.04.35.064 E019.46.28.997 N050.04.35.033 E019.46.29.081 Color_14ACI
N050.04.35.033 E019.46.29.081 N050.04.35.039 E019.46.29.183 Color_14ACI
N050.04.35.039 E019.46.29.183 N050.04.35.078 E019.46.29.256 Color_14ACI
N050.04.35.078 E019.46.29.256 N050.04.35.143 E019.46.29.282 Color_14ACI
N050.04.35.143 E019.46.29.282 N050.04.35.193 E019.46.29.255 Color_14ACI
N050.04.35.193 E019.46.29.255 N050.04.35.229 E019.46.29.192 Color_14ACI
N050.04.35.229 E019.46.29.192 N050.04.35.240 E019.46.29.135 Color_14ACI
N050.04.34.833 E019.46.26.159 N050.04.34.822 E019.46.26.068 Color_14ACI
N050.04.34.822 E019.46.26.068 N050.04.34.776 E019.46.25.995 Color_14ACI
N050.04.34.776 E019.46.25.995 N050.04.34.719 E019.46.25.978 Color_14ACI
N050.04.34.719 E019.46.25.978 N050.04.34.657 E019.46.26.020 Color_14ACI
N050.04.34.657 E019.46.26.020 N050.04.34.626 E019.46.26.105 Color_14ACI
N050.04.34.626 E019.46.26.105 N050.04.34.632 E019.46.26.206 Color_14ACI
N050.04.34.632 E019.46.26.206 N050.04.34.671 E019.46.26.279 Color_14ACI
N050.04.34.671 E019.46.26.279 N050.04.34.735 E019.46.26.305 Color_14ACI
N050.04.34.735 E019.46.26.305 N050.04.34.786 E019.46.26.278 Color_14ACI
N050.04.34.786 E019.46.26.278 N050.04.34.822 E019.46.26.215 Color_14ACI
N050.04.34.822 E019.46.26.215 N050.04.34.833 E019.46.26.159 Color_14ACI
N050.04.34.426 E019.46.23.182 N050.04.34.415 E019.46.23.091 Color_14ACI
N050.04.34.415 E019.46.23.091 N050.04.34.369 E019.46.23.018 Color_14ACI
N050.04.34.369 E019.46.23.018 N050.04.34.312 E019.46.23.001 Color_14ACI
N050.04.34.312 E019.46.23.001 N050.04.34.250 E019.46.23.043 Color_14ACI
N050.04.34.250 E019.46.23.043 N050.04.34.218 E019.46.23.128 Color_14ACI
N050.04.34.218 E019.46.23.128 N050.04.34.225 E019.46.23.230 Color_14ACI
N050.04.34.225 E019.46.23.230 N050.04.34.264 E019.46.23.302 Color_14ACI
N050.04.34.264 E019.46.23.302 N050.04.34.328 E019.46.23.328 Color_14ACI
N050.04.34.328 E019.46.23.328 N050.04.34.379 E019.46.23.301 Color_14ACI
N050.04.34.379 E019.46.23.301 N050.04.34.415 E019.46.23.238 Color_14ACI
N050.04.34.415 E019.46.23.238 N050.04.34.426 E019.46.23.182 Color_14ACI
N050.04.34.019 E019.46.20.205 N050.04.34.008 E019.46.20.114 Color_14ACI
N050.04.34.008 E019.46.20.114 N050.04.33.962 E019.46.20.041 Color_14ACI
N050.04.33.962 E019.46.20.041 N050.04.33.905 E019.46.20.024 Color_14ACI
N050.04.33.905 E019.46.20.024 N050.04.33.843 E019.46.20.067 Color_14ACI
N050.04.33.843 E019.46.20.067 N050.04.33.811 E019.46.20.151 Color_14ACI
N050.04.33.811 E019.46.20.151 N050.04.33.818 E019.46.20.253 Color_14ACI
N050.04.33.818 E019.46.20.253 N050.04.33.857 E019.46.20.325 Color_14ACI
N050.04.33.857 E019.46.20.325 N050.04.33.921 E019.46.20.351 Color_14ACI
N050.04.33.921 E019.46.20.351 N050.04.33.972 E019.46.20.324 Color_14ACI
N050.04.33.972 E019.46.20.324 N050.04.34.008 E019.46.20.261 Color_14ACI
N050.04.34.008 E019.46.20.261 N050.04.34.019 E019.46.20.205 Color_14ACI
N050.04.33.815 E019.46.18.716 N050.04.33.805 E019.46.18.626 Color_14ACI
N050.04.33.805 E019.46.18.626 N050.04.33.758 E019.46.18.553 Color_14ACI
N050.04.33.758 E019.46.18.553 N050.04.33.702 E019.46.18.535 Color_14ACI
N050.04.33.702 E019.46.18.535 N050.04.33.639 E019.46.18.578 Color_14ACI
N050.04.33.639 E019.46.18.578 N050.04.33.608 E019.46.18.662 Color_14ACI
N050.04.33.608 E019.46.18.662 N050.04.33.614 E019.46.18.764 Color_14ACI
N050.04.33.614 E019.46.18.764 N050.04.33.654 E019.46.18.837 Color_14ACI
N050.04.33.654 E019.46.18.837 N050.04.33.718 E019.46.18.862 Color_14ACI
N050.04.33.718 E019.46.18.862 N050.04.33.768 E019.46.18.836 Color_14ACI
N050.04.33.768 E019.46.18.836 N050.04.33.804 E019.46.18.773 Color_14ACI
N050.04.33.804 E019.46.18.773 N050.04.33.815 E019.46.18.716 Color_14ACI
N050.04.33.612 E019.46.17.228 N050.04.33.601 E019.46.17.137 Color_14ACI
N050.04.33.601 E019.46.17.137 N050.04.33.555 E019.46.17.064 Color_14ACI
N050.04.33.555 E019.46.17.064 N050.04.33.498 E019.46.17.047 Color_14ACI
N050.04.33.498 E019.46.17.047 N050.04.33.436 E019.46.17.090 Color_14ACI
N050.04.33.436 E019.46.17.090 N050.04.33.404 E019.46.17.174 Color_14ACI
N050.04.33.404 E019.46.17.174 N050.04.33.410 E019.46.17.276 Color_14ACI
N050.04.33.410 E019.46.17.276 N050.04.33.450 E019.46.17.348 Color_14ACI
N050.04.33.450 E019.46.17.348 N050.04.33.514 E019.46.17.374 Color_14ACI
N050.04.33.514 E019.46.17.374 N050.04.33.565 E019.46.17.347 Color_14ACI
N050.04.33.565 E019.46.17.347 N050.04.33.601 E019.46.17.284 Color_14ACI
N050.04.33.601 E019.46.17.284 N050.04.33.612 E019.46.17.228 Color_14ACI
N050.04.33.408 E019.46.15.739 N050.04.33.398 E019.46.15.649 Color_14ACI
N050.04.33.398 E019.46.15.649 N050.04.33.351 E019.46.15.576 Color_14ACI
N050.04.33.351 E019.46.15.576 N050.04.33.295 E019.46.15.558 Color_14ACI
N050.04.33.295 E019.46.15.558 N050.04.33.232 E019.46.15.601 Color_14ACI
N050.04.33.232 E019.46.15.601 N050.04.33.201 E019.46.15.685 Color_14ACI
N050.04.33.201 E019.46.15.685 N050.04.33.207 E019.46.15.787 Color_14ACI
N050.04.33.207 E019.46.15.787 N050.04.33.247 E019.46.15.860 Color_14ACI
N050.04.33.247 E019.46.15.860 N050.04.33.311 E019.46.15.885 Color_14ACI
N050.04.33.311 E019.46.15.885 N050.04.33.361 E019.46.15.859 Color_14ACI
N050.04.33.361 E019.46.15.859 N050.04.33.397 E019.46.15.796 Color_14ACI
N050.04.33.397 E019.46.15.796 N050.04.33.408 E019.46.15.739 Color_14ACI
N050.04.33.205 E019.46.14.251 N050.04.33.194 E019.46.14.160 Color_14ACI
N050.04.33.194 E019.46.14.160 N050.04.33.148 E019.46.14.087 Color_14ACI
N050.04.33.148 E019.46.14.087 N050.04.33.091 E019.46.14.070 Color_14ACI
N050.04.33.091 E019.46.14.070 N050.04.33.029 E019.46.14.113 Color_14ACI
N050.04.33.029 E019.46.14.113 N050.04.32.997 E019.46.14.197 Color_14ACI
N050.04.32.997 E019.46.14.197 N050.04.33.003 E019.46.14.299 Color_14ACI
N050.04.33.003 E019.46.14.299 N050.04.33.043 E019.46.14.371 Color_14ACI
N050.04.33.043 E019.46.14.371 N050.04.33.107 E019.46.14.397 Color_14ACI
N050.04.33.107 E019.46.14.397 N050.04.33.158 E019.46.14.370 Color_14ACI
N050.04.33.158 E019.46.14.370 N050.04.33.194 E019.46.14.307 Color_14ACI
N050.04.33.194 E019.46.14.307 N050.04.33.205 E019.46.14.251 Color_14ACI
N050.04.33.001 E019.46.12.762 N050.04.32.991 E019.46.12.672 Color_14ACI
N050.04.32.991 E019.46.12.672 N050.04.32.944 E019.46.12.599 Color_14ACI
N050.04.32.944 E019.46.12.599 N050.04.32.888 E019.46.12.582 Color_14ACI
N050.04.32.888 E019.46.12.582 N050.04.32.825 E019.46.12.624 Color_14ACI
N050.04.32.825 E019.46.12.624 N050.04.32.794 E019.46.12.708 Color_14ACI
N050.04.32.794 E019.46.12.708 N050.04.32.800 E019.46.12.810 Color_14ACI
N050.04.32.800 E019.46.12.810 N050.04.32.840 E019.46.12.883 Color_14ACI
N050.04.32.840 E019.46.12.883 N050.04.32.904 E019.46.12.908 Color_14ACI
N050.04.32.904 E019.46.12.908 N050.04.32.954 E019.46.12.882 Color_14ACI
N050.04.32.954 E019.46.12.882 N050.04.32.990 E019.46.12.819 Color_14ACI
N050.04.32.990 E019.46.12.819 N050.04.33.001 E019.46.12.762 Color_14ACI
N050.04.32.797 E019.46.11.274 N050.04.32.787 E019.46.11.184 Color_14ACI
N050.04.32.787 E019.46.11.184 N050.04.32.741 E019.46.11.110 Color_14ACI
N050.04.32.741 E019.46.11.110 N050.04.32.684 E019.46.11.093 Color_14ACI
N050.04.32.684 E019.46.11.093 N050.04.32.622 E019.46.11.136 Color_14ACI
N050.04.32.622 E019.46.11.136 N050.04.32.590 E019.46.11.220 Color_14ACI
N050.04.32.590 E019.46.11.220 N050.04.32.596 E019.46.11.322 Color_14ACI
N050.04.32.596 E019.46.11.322 N050.04.32.636 E019.46.11.394 Color_14ACI
N050.04.32.636 E019.46.11.394 N050.04.32.700 E019.46.11.420 Color_14ACI
N050.04.32.700 E019.46.11.420 N050.04.32.751 E019.46.11.393 Color_14ACI
N050.04.32.751 E019.46.11.393 N050.04.32.787 E019.46.11.331 Color_14ACI
N050.04.32.787 E019.46.11.331 N050.04.32.797 E019.46.11.274 Color_14ACI
N050.04.32.594 E019.46.09.785 N050.04.32.584 E019.46.09.695 Color_14ACI
N050.04.32.584 E019.46.09.695 N050.04.32.537 E019.46.09.622 Color_14ACI
N050.04.32.537 E019.46.09.622 N050.04.32.481 E019.46.09.605 Color_14ACI
N050.04.32.481 E019.46.09.605 N050.04.32.418 E019.46.09.647 Color_14ACI
N050.04.32.418 E019.46.09.647 N050.04.32.387 E019.46.09.731 Color_14ACI
N050.04.32.387 E019.46.09.731 N050.04.32.393 E019.46.09.833 Color_14ACI
N050.04.32.393 E019.46.09.833 N050.04.32.432 E019.46.09.906 Color_14ACI
N050.04.32.432 E019.46.09.906 N050.04.32.497 E019.46.09.932 Color_14ACI
N050.04.32.497 E019.46.09.932 N050.04.32.547 E019.46.09.905 Color_14ACI
N050.04.32.547 E019.46.09.905 N050.04.32.583 E019.46.09.842 Color_14ACI
N050.04.32.583 E019.46.09.842 N050.04.32.594 E019.46.09.785 Color_14ACI
N050.04.32.390 E019.46.08.297 N050.04.32.380 E019.46.08.207 Color_14ACI
N050.04.32.380 E019.46.08.207 N050.04.32.334 E019.46.08.133 Color_14ACI
N050.04.32.334 E019.46.08.133 N050.04.32.277 E019.46.08.116 Color_14ACI
N050.04.32.277 E019.46.08.116 N050.04.32.215 E019.46.08.159 Color_14ACI
N050.04.32.215 E019.46.08.159 N050.04.32.183 E019.46.08.243 Color_14ACI
N050.04.32.183 E019.46.08.243 N050.04.32.189 E019.46.08.345 Color_14ACI
N050.04.32.189 E019.46.08.345 N050.04.32.229 E019.46.08.417 Color_14ACI
N050.04.32.229 E019.46.08.417 N050.04.32.293 E019.46.08.443 Color_14ACI
N050.04.32.293 E019.46.08.443 N050.04.32.344 E019.46.08.417 Color_14ACI
N050.04.32.344 E019.46.08.417 N050.04.32.380 E019.46.08.354 Color_14ACI
N050.04.32.380 E019.46.08.354 N050.04.32.390 E019.46.08.297 Color_14ACI
;rwy_end_lgt N000.00.00.000 E000.00.00.000 N000.00.00.000 E000.00.00.000
N050.04.48.530 E019.48.12.425 N050.04.48.476 E019.48.12.388 Color_14ACI
N050.04.48.476 E019.48.12.388 N050.04.48.411 E019.48.12.409 Color_14ACI
N050.04.48.411 E019.48.12.409 N050.04.48.371 E019.48.12.472 Color_14ACI
N050.04.48.371 E019.48.12.472 N050.04.48.359 E019.48.12.577 Color_14ACI
N050.04.48.359 E019.48.12.577 N050.04.48.387 E019.48.12.664 Color_14ACI
N050.04.48.387 E019.48.12.664 N050.04.48.445 E019.48.12.713 Color_14ACI
N050.04.48.445 E019.48.12.713 N050.04.48.506 E019.48.12.701 Color_14ACI
N050.04.48.506 E019.48.12.701 N050.04.48.555 E019.48.12.632 Color_14ACI
N050.04.48.555 E019.48.12.632 N050.04.48.568 E019.48.12.551 Color_14ACI
N050.04.48.568 E019.48.12.551 N050.04.48.554 E019.48.12.470 Color_14ACI
N050.04.48.554 E019.48.12.470 N050.04.48.530 E019.48.12.425 Color_14ACI
N050.04.48.831 E019.48.12.311 N050.04.48.777 E019.48.12.275 Color_14ACI
N050.04.48.777 E019.48.12.275 N050.04.48.712 E019.48.12.295 Color_14ACI
N050.04.48.712 E019.48.12.295 N050.04.48.671 E019.48.12.359 Color_14ACI
N050.04.48.671 E019.48.12.359 N050.04.48.660 E019.48.12.464 Color_14ACI
N050.04.48.660 E019.48.12.464 N050.04.48.688 E019.48.12.551 Color_14ACI
N050.04.48.688 E019.48.12.551 N050.04.48.746 E019.48.12.599 Color_14ACI
N050.04.48.746 E019.48.12.599 N050.04.48.806 E019.48.12.587 Color_14ACI
N050.04.48.806 E019.48.12.587 N050.04.48.855 E019.48.12.518 Color_14ACI
N050.04.48.855 E019.48.12.518 N050.04.48.869 E019.48.12.438 Color_14ACI
N050.04.48.869 E019.48.12.438 N050.04.48.855 E019.48.12.356 Color_14ACI
N050.04.48.855 E019.48.12.356 N050.04.48.831 E019.48.12.311 Color_14ACI
N050.04.49.162 E019.48.12.188 N050.04.49.108 E019.48.12.151 Color_14ACI
N050.04.49.108 E019.48.12.151 N050.04.49.043 E019.48.12.172 Color_14ACI
N050.04.49.043 E019.48.12.172 N050.04.49.002 E019.48.12.235 Color_14ACI
N050.04.49.002 E019.48.12.235 N050.04.48.991 E019.48.12.340 Color_14ACI
N050.04.48.991 E019.48.12.340 N050.04.49.019 E019.48.12.428 Color_14ACI
N050.04.49.019 E019.48.12.428 N050.04.49.077 E019.48.12.476 Color_14ACI
N050.04.49.077 E019.48.12.476 N050.04.49.137 E019.48.12.464 Color_14ACI
N050.04.49.137 E019.48.12.464 N050.04.49.186 E019.48.12.395 Color_14ACI
N050.04.49.186 E019.48.12.395 N050.04.49.200 E019.48.12.314 Color_14ACI
N050.04.49.200 E019.48.12.314 N050.04.49.186 E019.48.12.233 Color_14ACI
N050.04.49.186 E019.48.12.233 N050.04.49.162 E019.48.12.188 Color_14ACI
N050.04.49.479 E019.48.12.093 N050.04.49.425 E019.48.12.057 Color_14ACI
N050.04.49.425 E019.48.12.057 N050.04.49.360 E019.48.12.077 Color_14ACI
N050.04.49.360 E019.48.12.077 N050.04.49.320 E019.48.12.141 Color_14ACI
N050.04.49.320 E019.48.12.141 N050.04.49.308 E019.48.12.246 Color_14ACI
N050.04.49.308 E019.48.12.246 N050.04.49.336 E019.48.12.333 Color_14ACI
N050.04.49.336 E019.48.12.333 N050.04.49.394 E019.48.12.381 Color_14ACI
N050.04.49.394 E019.48.12.381 N050.04.49.454 E019.48.12.370 Color_14ACI
N050.04.49.454 E019.48.12.370 N050.04.49.503 E019.48.12.300 Color_14ACI
N050.04.49.503 E019.48.12.300 N050.04.49.517 E019.48.12.220 Color_14ACI
N050.04.49.517 E019.48.12.220 N050.04.49.503 E019.48.12.139 Color_14ACI
N050.04.49.503 E019.48.12.139 N050.04.49.479 E019.48.12.093 Color_14ACI
N050.04.49.811 E019.48.11.982 N050.04.49.757 E019.48.11.946 Color_14ACI
N050.04.49.757 E019.48.11.946 N050.04.49.692 E019.48.11.966 Color_14ACI
N050.04.49.692 E019.48.11.966 N050.04.49.652 E019.48.12.030 Color_14ACI
N050.04.49.652 E019.48.12.030 N050.04.49.640 E019.48.12.135 Color_14ACI
N050.04.49.640 E019.48.12.135 N050.04.49.668 E019.48.12.222 Color_14ACI
N050.04.49.668 E019.48.12.222 N050.04.49.726 E019.48.12.270 Color_14ACI
N050.04.49.726 E019.48.12.270 N050.04.49.787 E019.48.12.258 Color_14ACI
N050.04.49.787 E019.48.12.258 N050.04.49.836 E019.48.12.189 Color_14ACI
N050.04.49.836 E019.48.12.189 N050.04.49.850 E019.48.12.109 Color_14ACI
N050.04.49.850 E019.48.12.109 N050.04.49.836 E019.48.12.027 Color_14ACI
N050.04.49.836 E019.48.12.027 N050.04.49.811 E019.48.11.982 Color_14ACI
N050.04.50.115 E019.48.11.880 N050.04.50.061 E019.48.11.844 Color_14ACI
N050.04.50.061 E019.48.11.844 N050.04.49.996 E019.48.11.864 Color_14ACI
N050.04.49.996 E019.48.11.864 N050.04.49.956 E019.48.11.928 Color_14ACI
N050.04.49.956 E019.48.11.928 N050.04.49.944 E019.48.12.033 Color_14ACI
N050.04.49.944 E019.48.12.033 N050.04.49.972 E019.48.12.120 Color_14ACI
N050.04.49.972 E019.48.12.120 N050.04.50.030 E019.48.12.168 Color_14ACI
N050.04.50.030 E019.48.12.168 N050.04.50.091 E019.48.12.157 Color_14ACI
N050.04.50.091 E019.48.12.157 N050.04.50.140 E019.48.12.087 Color_14ACI
N050.04.50.140 E019.48.12.087 N050.04.50.153 E019.48.12.007 Color_14ACI
N050.04.50.153 E019.48.12.007 N050.04.50.140 E019.48.11.925 Color_14ACI
N050.04.50.140 E019.48.11.925 N050.04.50.115 E019.48.11.880 Color_14ACI
N050.04.31.139 E019.46.05.309 N050.04.31.085 E019.46.05.273 Color_14ACI
N050.04.31.085 E019.46.05.273 N050.04.31.021 E019.46.05.293 Color_14ACI
N050.04.31.021 E019.46.05.293 N050.04.30.980 E019.46.05.357 Color_14ACI
N050.04.30.980 E019.46.05.357 N050.04.30.969 E019.46.05.462 Color_14ACI
N050.04.30.969 E019.46.05.462 N050.04.30.996 E019.46.05.549 Color_14ACI
N050.04.30.996 E019.46.05.549 N050.04.31.054 E019.46.05.597 Color_14ACI
N050.04.31.054 E019.46.05.597 N050.04.31.115 E019.46.05.586 Color_14ACI
N050.04.31.115 E019.46.05.586 N050.04.31.164 E019.46.05.516 Color_14ACI
N050.04.31.164 E019.46.05.516 N050.04.31.178 E019.46.05.436 Color_14ACI
N050.04.31.178 E019.46.05.436 N050.04.31.164 E019.46.05.354 Color_14ACI
N050.04.31.164 E019.46.05.354 N050.04.31.139 E019.46.05.309 Color_14ACI
N050.04.31.440 E019.46.05.196 N050.04.31.386 E019.46.05.160 Color_14ACI
N050.04.31.386 E019.46.05.160 N050.04.31.321 E019.46.05.180 Color_14ACI
N050.04.31.321 E019.46.05.180 N050.04.31.281 E019.46.05.243 Color_14ACI
N050.04.31.281 E019.46.05.243 N050.04.31.269 E019.46.05.348 Color_14ACI
N050.04.31.269 E019.46.05.348 N050.04.31.297 E019.46.05.436 Color_14ACI
N050.04.31.297 E019.46.05.436 N050.04.31.355 E019.46.05.484 Color_14ACI
N050.04.31.355 E019.46.05.484 N050.04.31.416 E019.46.05.472 Color_14ACI
N050.04.31.416 E019.46.05.472 N050.04.31.465 E019.46.05.403 Color_14ACI
N050.04.31.465 E019.46.05.403 N050.04.31.478 E019.46.05.323 Color_14ACI
N050.04.31.478 E019.46.05.323 N050.04.31.465 E019.46.05.241 Color_14ACI
N050.04.31.465 E019.46.05.241 N050.04.31.440 E019.46.05.196 Color_14ACI
N050.04.31.771 E019.46.05.072 N050.04.31.717 E019.46.05.036 Color_14ACI
N050.04.31.717 E019.46.05.036 N050.04.31.652 E019.46.05.056 Color_14ACI
N050.04.31.652 E019.46.05.056 N050.04.31.612 E019.46.05.120 Color_14ACI
N050.04.31.612 E019.46.05.120 N050.04.31.600 E019.46.05.225 Color_14ACI
N050.04.31.600 E019.46.05.225 N050.04.31.628 E019.46.05.312 Color_14ACI
N050.04.31.628 E019.46.05.312 N050.04.31.686 E019.46.05.360 Color_14ACI
N050.04.31.686 E019.46.05.360 N050.04.31.747 E019.46.05.349 Color_14ACI
N050.04.31.747 E019.46.05.349 N050.04.31.796 E019.46.05.279 Color_14ACI
N050.04.31.796 E019.46.05.279 N050.04.31.809 E019.46.05.199 Color_14ACI
N050.04.31.809 E019.46.05.199 N050.04.31.796 E019.46.05.118 Color_14ACI
N050.04.31.796 E019.46.05.118 N050.04.31.771 E019.46.05.072 Color_14ACI
N050.04.32.088 E019.46.04.978 N050.04.32.034 E019.46.04.942 Color_14ACI
N050.04.32.034 E019.46.04.942 N050.04.31.969 E019.46.04.962 Color_14ACI
N050.04.31.969 E019.46.04.962 N050.04.31.929 E019.46.05.026 Color_14ACI
N050.04.31.929 E019.46.05.026 N050.04.31.917 E019.46.05.131 Color_14ACI
N050.04.31.917 E019.46.05.131 N050.04.31.945 E019.46.05.218 Color_14ACI
N050.04.31.945 E019.46.05.218 N050.04.32.003 E019.46.05.266 Color_14ACI
N050.04.32.003 E019.46.05.266 N050.04.32.064 E019.46.05.254 Color_14ACI
N050.04.32.064 E019.46.05.254 N050.04.32.113 E019.46.05.185 Color_14ACI
N050.04.32.113 E019.46.05.185 N050.04.32.127 E019.46.05.105 Color_14ACI
N050.04.32.127 E019.46.05.105 N050.04.32.113 E019.46.05.023 Color_14ACI
N050.04.32.113 E019.46.05.023 N050.04.32.088 E019.46.04.978 Color_14ACI
N050.04.32.421 E019.46.04.867 N050.04.32.367 E019.46.04.830 Color_14ACI
N050.04.32.367 E019.46.04.830 N050.04.32.302 E019.46.04.850 Color_14ACI
N050.04.32.302 E019.46.04.850 N050.04.32.262 E019.46.04.914 Color_14ACI
N050.04.32.262 E019.46.04.914 N050.04.32.250 E019.46.05.019 Color_14ACI
N050.04.32.250 E019.46.05.019 N050.04.32.278 E019.46.05.106 Color_14ACI
N050.04.32.278 E019.46.05.106 N050.04.32.336 E019.46.05.155 Color_14ACI
N050.04.32.336 E019.46.05.155 N050.04.32.397 E019.46.05.143 Color_14ACI
N050.04.32.397 E019.46.05.143 N050.04.32.446 E019.46.05.073 Color_14ACI
N050.04.32.446 E019.46.05.073 N050.04.32.459 E019.46.04.993 Color_14ACI
N050.04.32.459 E019.46.04.993 N050.04.32.445 E019.46.04.912 Color_14ACI
N050.04.32.445 E019.46.04.912 N050.04.32.421 E019.46.04.867 Color_14ACI
N050.04.32.725 E019.46.04.765 N050.04.32.671 E019.46.04.729 Color_14ACI
N050.04.32.671 E019.46.04.729 N050.04.32.606 E019.46.04.749 Color_14ACI
N050.04.32.606 E019.46.04.749 N050.04.32.566 E019.46.04.813 Color_14ACI
N050.04.32.566 E019.46.04.813 N050.04.32.554 E019.46.04.918 Color_14ACI
N050.04.32.554 E019.46.04.918 N050.04.32.582 E019.46.05.005 Color_14ACI
N050.04.32.582 E019.46.05.005 N050.04.32.640 E019.46.05.053 Color_14ACI
N050.04.32.640 E019.46.05.053 N050.04.32.700 E019.46.05.041 Color_14ACI
N050.04.32.700 E019.46.05.041 N050.04.32.750 E019.46.04.972 Color_14ACI
N050.04.32.750 E019.46.04.972 N050.04.32.763 E019.46.04.892 Color_14ACI
N050.04.32.763 E019.46.04.892 N050.04.32.749 E019.46.04.810 Color_14ACI
N050.04.32.749 E019.46.04.810 N050.04.32.725 E019.46.04.765 Color_14ACI
;rwy_beg_lgt N000.00.00.000 E000.00.00.000 N000.00.00.000 E000.00.00.000
N050.04.45.737 E019.48.00.696 N050.04.45.682 E019.48.00.660 Color_96ACI
N050.04.45.682 E019.48.00.660 N050.04.45.618 E019.48.00.680 Color_96ACI
N050.04.45.618 E019.48.00.680 N050.04.45.577 E019.48.00.744 Color_96ACI
N050.04.45.577 E019.48.00.744 N050.04.45.566 E019.48.00.849 Color_96ACI
N050.04.45.566 E019.48.00.849 N050.04.45.594 E019.48.00.936 Color_96ACI
N050.04.45.594 E019.48.00.936 N050.04.45.652 E019.48.00.984 Color_96ACI
N050.04.45.652 E019.48.00.984 N050.04.45.712 E019.48.00.972 Color_96ACI
N050.04.45.712 E019.48.00.972 N050.04.45.761 E019.48.00.903 Color_96ACI
N050.04.45.761 E019.48.00.903 N050.04.45.775 E019.48.00.823 Color_96ACI
N050.04.45.775 E019.48.00.823 N050.04.45.761 E019.48.00.741 Color_96ACI
N050.04.45.761 E019.48.00.741 N050.04.45.737 E019.48.00.696 Color_96ACI
N050.04.46.013 E019.48.00.603 N050.04.45.959 E019.48.00.567 Color_96ACI
N050.04.45.959 E019.48.00.567 N050.04.45.895 E019.48.00.587 Color_96ACI
N050.04.45.895 E019.48.00.587 N050.04.45.854 E019.48.00.651 Color_96ACI
N050.04.45.854 E019.48.00.651 N050.04.45.843 E019.48.00.755 Color_96ACI
N050.04.45.843 E019.48.00.755 N050.04.45.871 E019.48.00.843 Color_96ACI
N050.04.45.871 E019.48.00.843 N050.04.45.928 E019.48.00.891 Color_96ACI
N050.04.45.928 E019.48.00.891 N050.04.45.989 E019.48.00.879 Color_96ACI
N050.04.45.989 E019.48.00.879 N050.04.46.038 E019.48.00.810 Color_96ACI
N050.04.46.038 E019.48.00.810 N050.04.46.052 E019.48.00.730 Color_96ACI
N050.04.46.052 E019.48.00.730 N050.04.46.038 E019.48.00.648 Color_96ACI
N050.04.46.038 E019.48.00.648 N050.04.46.013 E019.48.00.603 Color_96ACI
N050.04.46.286 E019.48.00.496 N050.04.46.232 E019.48.00.460 Color_96ACI
N050.04.46.232 E019.48.00.460 N050.04.46.167 E019.48.00.480 Color_96ACI
N050.04.46.167 E019.48.00.480 N050.04.46.127 E019.48.00.544 Color_96ACI
N050.04.46.127 E019.48.00.544 N050.04.46.115 E019.48.00.649 Color_96ACI
N050.04.46.115 E019.48.00.649 N050.04.46.143 E019.48.00.736 Color_96ACI
N050.04.46.143 E019.48.00.736 N050.04.46.201 E019.48.00.784 Color_96ACI
N050.04.46.201 E019.48.00.784 N050.04.46.262 E019.48.00.773 Color_96ACI
N050.04.46.262 E019.48.00.773 N050.04.46.311 E019.48.00.703 Color_96ACI
N050.04.46.311 E019.48.00.703 N050.04.46.325 E019.48.00.623 Color_96ACI
N050.04.46.325 E019.48.00.623 N050.04.46.311 E019.48.00.541 Color_96ACI
N050.04.46.311 E019.48.00.541 N050.04.46.286 E019.48.00.496 Color_96ACI
N050.04.46.576 E019.48.00.392 N050.04.46.522 E019.48.00.355 Color_96ACI
N050.04.46.522 E019.48.00.355 N050.04.46.457 E019.48.00.375 Color_96ACI
N050.04.46.457 E019.48.00.375 N050.04.46.417 E019.48.00.439 Color_96ACI
N050.04.46.417 E019.48.00.439 N050.04.46.405 E019.48.00.544 Color_96ACI
N050.04.46.405 E019.48.00.544 N050.04.46.433 E019.48.00.631 Color_96ACI
N050.04.46.433 E019.48.00.631 N050.04.46.491 E019.48.00.680 Color_96ACI
N050.04.46.491 E019.48.00.680 N050.04.46.552 E019.48.00.668 Color_96ACI
N050.04.46.552 E019.48.00.668 N050.04.46.601 E019.48.00.598 Color_96ACI
N050.04.46.601 E019.48.00.598 N050.04.46.615 E019.48.00.518 Color_96ACI
N050.04.46.615 E019.48.00.518 N050.04.46.601 E019.48.00.437 Color_96ACI
N050.04.46.601 E019.48.00.437 N050.04.46.576 E019.48.00.392 Color_96ACI
N050.04.49.583 E019.47.59.379 N050.04.49.529 E019.47.59.342 Color_96ACI
N050.04.49.529 E019.47.59.342 N050.04.49.464 E019.47.59.363 Color_96ACI
N050.04.49.464 E019.47.59.363 N050.04.49.424 E019.47.59.426 Color_96ACI
N050.04.49.424 E019.47.59.426 N050.04.49.412 E019.47.59.531 Color_96ACI
N050.04.49.412 E019.47.59.531 N050.04.49.440 E019.47.59.619 Color_96ACI
N050.04.49.440 E019.47.59.619 N050.04.49.498 E019.47.59.667 Color_96ACI
N050.04.49.498 E019.47.59.667 N050.04.49.558 E019.47.59.655 Color_96ACI
N050.04.49.558 E019.47.59.655 N050.04.49.607 E019.47.59.586 Color_96ACI
N050.04.49.607 E019.47.59.586 N050.04.49.621 E019.47.59.506 Color_96ACI
N050.04.49.621 E019.47.59.506 N050.04.49.607 E019.47.59.424 Color_96ACI
N050.04.49.607 E019.47.59.424 N050.04.49.583 E019.47.59.379 Color_96ACI
N050.04.49.298 E019.47.59.477 N050.04.49.244 E019.47.59.441 Color_96ACI
N050.04.49.244 E019.47.59.441 N050.04.49.179 E019.47.59.461 Color_96ACI
N050.04.49.179 E019.47.59.461 N050.04.49.139 E019.47.59.524 Color_96ACI
N050.04.49.139 E019.47.59.524 N050.04.49.127 E019.47.59.629 Color_96ACI
N050.04.49.127 E019.47.59.629 N050.04.49.155 E019.47.59.717 Color_96ACI
N050.04.49.155 E019.47.59.717 N050.04.49.213 E019.47.59.765 Color_96ACI
N050.04.49.213 E019.47.59.765 N050.04.49.273 E019.47.59.753 Color_96ACI
N050.04.49.273 E019.47.59.753 N050.04.49.323 E019.47.59.684 Color_96ACI
N050.04.49.323 E019.47.59.684 N050.04.49.336 E019.47.59.604 Color_96ACI
N050.04.49.336 E019.47.59.604 N050.04.49.322 E019.47.59.522 Color_96ACI
N050.04.49.322 E019.47.59.522 N050.04.49.298 E019.47.59.477 Color_96ACI
N050.04.49.000 E019.47.59.567 N050.04.48.945 E019.47.59.531 Color_96ACI
N050.04.48.945 E019.47.59.531 N050.04.48.881 E019.47.59.551 Color_96ACI
N050.04.48.881 E019.47.59.551 N050.04.48.840 E019.47.59.615 Color_96ACI
N050.04.48.840 E019.47.59.615 N050.04.48.829 E019.47.59.720 Color_96ACI
N050.04.48.829 E019.47.59.720 N050.04.48.857 E019.47.59.807 Color_96ACI
N050.04.48.857 E019.47.59.807 N050.04.48.915 E019.47.59.855 Color_96ACI
N050.04.48.915 E019.47.59.855 N050.04.48.975 E019.47.59.844 Color_96ACI
N050.04.48.975 E019.47.59.844 N050.04.49.024 E019.47.59.774 Color_96ACI
N050.04.49.024 E019.47.59.774 N050.04.49.038 E019.47.59.694 Color_96ACI
N050.04.49.038 E019.47.59.694 N050.04.49.024 E019.47.59.612 Color_96ACI
N050.04.49.024 E019.47.59.612 N050.04.49.000 E019.47.59.567 Color_96ACI
N050.04.48.724 E019.47.59.674 N050.04.48.669 E019.47.59.638 Color_96ACI
N050.04.48.669 E019.47.59.638 N050.04.48.605 E019.47.59.658 Color_96ACI
N050.04.48.605 E019.47.59.658 N050.04.48.564 E019.47.59.722 Color_96ACI
N050.04.48.564 E019.47.59.722 N050.04.48.553 E019.47.59.827 Color_96ACI
N050.04.48.553 E019.47.59.827 N050.04.48.581 E019.47.59.914 Color_96ACI
N050.04.48.581 E019.47.59.914 N050.04.48.639 E019.47.59.962 Color_96ACI
N050.04.48.639 E019.47.59.962 N050.04.48.699 E019.47.59.951 Color_96ACI
N050.04.48.699 E019.47.59.951 N050.04.48.748 E019.47.59.881 Color_96ACI
N050.04.48.748 E019.47.59.881 N050.04.48.762 E019.47.59.801 Color_96ACI
N050.04.48.762 E019.47.59.801 N050.04.48.748 E019.47.59.719 Color_96ACI
N050.04.48.748 E019.47.59.719 N050.04.48.724 E019.47.59.674 Color_96ACI
N050.04.46.871 E019.48.00.289 N050.04.46.817 E019.48.00.252 Color_96ACI
N050.04.46.817 E019.48.00.252 N050.04.46.752 E019.48.00.272 Color_96ACI
N050.04.46.752 E019.48.00.272 N050.04.46.712 E019.48.00.336 Color_96ACI
N050.04.46.712 E019.48.00.336 N050.04.46.700 E019.48.00.441 Color_96ACI
N050.04.46.700 E019.48.00.441 N050.04.46.728 E019.48.00.528 Color_96ACI
N050.04.46.728 E019.48.00.528 N050.04.46.786 E019.48.00.577 Color_96ACI
N050.04.46.786 E019.48.00.577 N050.04.46.847 E019.48.00.565 Color_96ACI
N050.04.46.847 E019.48.00.565 N050.04.46.896 E019.48.00.495 Color_96ACI
N050.04.46.896 E019.48.00.495 N050.04.46.909 E019.48.00.415 Color_96ACI
N050.04.46.909 E019.48.00.415 N050.04.46.895 E019.48.00.334 Color_96ACI
N050.04.46.895 E019.48.00.334 N050.04.46.871 E019.48.00.289 Color_96ACI
N050.04.47.172 E019.48.00.175 N050.04.47.117 E019.48.00.139 Color_96ACI
N050.04.47.117 E019.48.00.139 N050.04.47.053 E019.48.00.159 Color_96ACI
N050.04.47.053 E019.48.00.159 N050.04.47.012 E019.48.00.223 Color_96ACI
N050.04.47.012 E019.48.00.223 N050.04.47.001 E019.48.00.328 Color_96ACI
N050.04.47.001 E019.48.00.328 N050.04.47.029 E019.48.00.415 Color_96ACI
N050.04.47.029 E019.48.00.415 N050.04.47.087 E019.48.00.463 Color_96ACI
N050.04.47.087 E019.48.00.463 N050.04.47.147 E019.48.00.451 Color_96ACI
N050.04.47.147 E019.48.00.451 N050.04.47.196 E019.48.00.382 Color_96ACI
N050.04.47.196 E019.48.00.382 N050.04.47.210 E019.48.00.302 Color_96ACI
N050.04.47.210 E019.48.00.302 N050.04.47.196 E019.48.00.220 Color_96ACI
N050.04.47.196 E019.48.00.220 N050.04.47.172 E019.48.00.175 Color_96ACI
N050.04.47.503 E019.48.00.052 N050.04.47.448 E019.48.00.015 Color_96ACI
N050.04.47.448 E019.48.00.015 N050.04.47.384 E019.48.00.036 Color_96ACI
N050.04.47.384 E019.48.00.036 N050.04.47.343 E019.48.00.099 Color_96ACI
N050.04.47.343 E019.48.00.099 N050.04.47.332 E019.48.00.204 Color_96ACI
N050.04.47.332 E019.48.00.204 N050.04.47.360 E019.48.00.291 Color_96ACI
N050.04.47.360 E019.48.00.291 N050.04.47.418 E019.48.00.340 Color_96ACI
N050.04.47.418 E019.48.00.340 N050.04.47.478 E019.48.00.328 Color_96ACI
N050.04.47.478 E019.48.00.328 N050.04.47.527 E019.48.00.259 Color_96ACI
N050.04.47.527 E019.48.00.259 N050.04.47.541 E019.48.00.178 Color_96ACI
N050.04.47.541 E019.48.00.178 N050.04.47.527 E019.48.00.097 Color_96ACI
N050.04.47.527 E019.48.00.097 N050.04.47.503 E019.48.00.052 Color_96ACI
N050.04.47.820 E019.47.59.957 N050.04.47.766 E019.47.59.921 Color_96ACI
N050.04.47.766 E019.47.59.921 N050.04.47.701 E019.47.59.941 Color_96ACI
N050.04.47.701 E019.47.59.941 N050.04.47.660 E019.48.00.005 Color_96ACI
N050.04.47.660 E019.48.00.005 N050.04.47.649 E019.48.00.110 Color_96ACI
N050.04.47.649 E019.48.00.110 N050.04.47.677 E019.48.00.197 Color_96ACI
N050.04.47.677 E019.48.00.197 N050.04.47.735 E019.48.00.245 Color_96ACI
N050.04.47.735 E019.48.00.245 N050.04.47.795 E019.48.00.234 Color_96ACI
N050.04.47.795 E019.48.00.234 N050.04.47.844 E019.48.00.164 Color_96ACI
N050.04.47.844 E019.48.00.164 N050.04.47.858 E019.48.00.084 Color_96ACI
N050.04.47.858 E019.48.00.084 N050.04.47.844 E019.48.00.003 Color_96ACI
N050.04.47.844 E019.48.00.003 N050.04.47.820 E019.47.59.957 Color_96ACI
N050.04.48.152 E019.47.59.846 N050.04.48.098 E019.47.59.810 Color_96ACI
N050.04.48.098 E019.47.59.810 N050.04.48.033 E019.47.59.830 Color_96ACI
N050.04.48.033 E019.47.59.830 N050.04.47.993 E019.47.59.894 Color_96ACI
N050.04.47.993 E019.47.59.894 N050.04.47.981 E019.47.59.998 Color_96ACI
N050.04.47.981 E019.47.59.998 N050.04.48.009 E019.48.00.086 Color_96ACI
N050.04.48.009 E019.48.00.086 N050.04.48.067 E019.48.00.134 Color_96ACI
N050.04.48.067 E019.48.00.134 N050.04.48.128 E019.48.00.122 Color_96ACI
N050.04.48.128 E019.48.00.122 N050.04.48.177 E019.48.00.053 Color_96ACI
N050.04.48.177 E019.48.00.053 N050.04.48.191 E019.47.59.973 Color_96ACI
N050.04.48.191 E019.47.59.973 N050.04.48.177 E019.47.59.891 Color_96ACI
N050.04.48.177 E019.47.59.891 N050.04.48.152 E019.47.59.846 Color_96ACI
N050.04.48.456 E019.47.59.744 N050.04.48.402 E019.47.59.708 Color_96ACI
N050.04.48.402 E019.47.59.708 N050.04.48.337 E019.47.59.728 Color_96ACI
N050.04.48.337 E019.47.59.728 N050.04.48.297 E019.47.59.792 Color_96ACI
N050.04.48.297 E019.47.59.792 N050.04.48.285 E019.47.59.897 Color_96ACI
N050.04.48.285 E019.47.59.897 N050.04.48.313 E019.47.59.984 Color_96ACI
N050.04.48.313 E019.47.59.984 N050.04.48.371 E019.48.00.032 Color_96ACI
N050.04.48.371 E019.48.00.032 N050.04.48.432 E019.48.00.021 Color_96ACI
N050.04.48.432 E019.48.00.021 N050.04.48.481 E019.47.59.951 Color_96ACI
N050.04.48.481 E019.47.59.951 N050.04.48.494 E019.47.59.871 Color_96ACI
N050.04.48.494 E019.47.59.871 N050.04.48.481 E019.47.59.789 Color_96ACI
N050.04.48.481 E019.47.59.789 N050.04.48.456 E019.47.59.744 Color_96ACI
;rwy_edg_Y N000.00.00.000 E000.00.00.000 N000.00.00.000 E000.00.00.000
N050.04.31.670 E019.46.11.478 N050.04.31.616 E019.46.11.442 Color_45ACI
N050.04.31.616 E019.46.11.442 N050.04.31.552 E019.46.11.462 Color_45ACI
N050.04.31.552 E019.46.11.462 N050.04.31.511 E019.46.11.526 Color_45ACI
N050.04.31.511 E019.46.11.526 N050.04.31.500 E019.46.11.631 Color_45ACI
N050.04.31.500 E019.46.11.631 N050.04.31.527 E019.46.11.718 Color_45ACI
N050.04.31.527 E019.46.11.718 N050.04.31.585 E019.46.11.766 Color_45ACI
N050.04.31.585 E019.46.11.766 N050.04.31.646 E019.46.11.755 Color_45ACI
N050.04.31.646 E019.46.11.755 N050.04.31.695 E019.46.11.685 Color_45ACI
N050.04.31.695 E019.46.11.685 N050.04.31.709 E019.46.11.605 Color_45ACI
N050.04.31.709 E019.46.11.605 N050.04.31.695 E019.46.11.524 Color_45ACI
N050.04.31.695 E019.46.11.524 N050.04.31.670 E019.46.11.478 Color_45ACI
N050.04.32.072 E019.46.14.462 N050.04.32.018 E019.46.14.425 Color_45ACI
N050.04.32.018 E019.46.14.425 N050.04.31.953 E019.46.14.445 Color_45ACI
N050.04.31.953 E019.46.14.445 N050.04.31.912 E019.46.14.509 Color_45ACI
N050.04.31.912 E019.46.14.509 N050.04.31.901 E019.46.14.614 Color_45ACI
N050.04.31.901 E019.46.14.614 N050.04.31.929 E019.46.14.701 Color_45ACI
N050.04.31.929 E019.46.14.701 N050.04.31.987 E019.46.14.750 Color_45ACI
N050.04.31.987 E019.46.14.750 N050.04.32.047 E019.46.14.738 Color_45ACI
N050.04.32.047 E019.46.14.738 N050.04.32.096 E019.46.14.668 Color_45ACI
N050.04.32.096 E019.46.14.668 N050.04.32.110 E019.46.14.588 Color_45ACI
N050.04.32.110 E019.46.14.588 N050.04.32.096 E019.46.14.507 Color_45ACI
N050.04.32.096 E019.46.14.507 N050.04.32.072 E019.46.14.462 Color_45ACI
N050.04.32.492 E019.46.17.555 N050.04.32.438 E019.46.17.519 Color_45ACI
N050.04.32.438 E019.46.17.519 N050.04.32.373 E019.46.17.539 Color_45ACI
N050.04.32.373 E019.46.17.539 N050.04.32.333 E019.46.17.603 Color_45ACI
N050.04.32.333 E019.46.17.603 N050.04.32.321 E019.46.17.708 Color_45ACI
N050.04.32.321 E019.46.17.708 N050.04.32.349 E019.46.17.795 Color_45ACI
N050.04.32.349 E019.46.17.795 N050.04.32.407 E019.46.17.843 Color_45ACI
N050.04.32.407 E019.46.17.843 N050.04.32.467 E019.46.17.832 Color_45ACI
N050.04.32.467 E019.46.17.832 N050.04.32.517 E019.46.17.762 Color_45ACI
N050.04.32.517 E019.46.17.762 N050.04.32.530 E019.46.17.682 Color_45ACI
N050.04.32.530 E019.46.17.682 N050.04.32.516 E019.46.17.600 Color_45ACI
N050.04.32.516 E019.46.17.600 N050.04.32.492 E019.46.17.555 Color_45ACI
N050.04.33.323 E019.46.23.426 N050.04.33.269 E019.46.23.389 Color_45ACI
N050.04.33.269 E019.46.23.389 N050.04.33.205 E019.46.23.410 Color_45ACI
N050.04.33.205 E019.46.23.410 N050.04.33.164 E019.46.23.473 Color_45ACI
N050.04.33.164 E019.46.23.473 N050.04.33.153 E019.46.23.578 Color_45ACI
N050.04.33.153 E019.46.23.578 N050.04.33.180 E019.46.23.665 Color_45ACI
N050.04.33.180 E019.46.23.665 N050.04.33.238 E019.46.23.714 Color_45ACI
N050.04.33.238 E019.46.23.714 N050.04.33.299 E019.46.23.702 Color_45ACI
N050.04.33.299 E019.46.23.702 N050.04.33.348 E019.46.23.633 Color_45ACI
N050.04.33.348 E019.46.23.633 N050.04.33.362 E019.46.23.552 Color_45ACI
N050.04.33.362 E019.46.23.552 N050.04.33.348 E019.46.23.471 Color_45ACI
N050.04.33.348 E019.46.23.471 N050.04.33.323 E019.46.23.426 Color_45ACI
N050.04.33.730 E019.46.26.452 N050.04.33.676 E019.46.26.416 Color_45ACI
N050.04.33.676 E019.46.26.416 N050.04.33.611 E019.46.26.436 Color_45ACI
N050.04.33.611 E019.46.26.436 N050.04.33.571 E019.46.26.500 Color_45ACI
N050.04.33.571 E019.46.26.500 N050.04.33.560 E019.46.26.604 Color_45ACI
N050.04.33.560 E019.46.26.604 N050.04.33.587 E019.46.26.692 Color_45ACI
N050.04.33.587 E019.46.26.692 N050.04.33.645 E019.46.26.740 Color_45ACI
N050.04.33.645 E019.46.26.740 N050.04.33.706 E019.46.26.728 Color_45ACI
N050.04.33.706 E019.46.26.728 N050.04.33.755 E019.46.26.659 Color_45ACI
N050.04.33.755 E019.46.26.659 N050.04.33.769 E019.46.26.579 Color_45ACI
N050.04.33.769 E019.46.26.579 N050.04.33.755 E019.46.26.497 Color_45ACI
N050.04.33.755 E019.46.26.497 N050.04.33.730 E019.46.26.452 Color_45ACI
N050.04.34.138 E019.46.29.419 N050.04.34.084 E019.46.29.383 Color_45ACI
N050.04.34.084 E019.46.29.383 N050.04.34.019 E019.46.29.403 Color_45ACI
N050.04.34.019 E019.46.29.403 N050.04.33.979 E019.46.29.467 Color_45ACI
N050.04.33.979 E019.46.29.467 N050.04.33.967 E019.46.29.572 Color_45ACI
N050.04.33.967 E019.46.29.572 N050.04.33.995 E019.46.29.659 Color_45ACI
N050.04.33.995 E019.46.29.659 N050.04.34.053 E019.46.29.707 Color_45ACI
N050.04.34.053 E019.46.29.707 N050.04.34.114 E019.46.29.695 Color_45ACI
N050.04.34.114 E019.46.29.695 N050.04.34.163 E019.46.29.626 Color_45ACI
N050.04.34.163 E019.46.29.626 N050.04.34.176 E019.46.29.546 Color_45ACI
N050.04.34.176 E019.46.29.546 N050.04.34.162 E019.46.29.464 Color_45ACI
N050.04.34.162 E019.46.29.464 N050.04.34.138 E019.46.29.419 Color_45ACI
N050.04.34.529 E019.46.32.360 N050.04.34.475 E019.46.32.323 Color_45ACI
N050.04.34.475 E019.46.32.323 N050.04.34.410 E019.46.32.343 Color_45ACI
N050.04.34.410 E019.46.32.343 N050.04.34.370 E019.46.32.407 Color_45ACI
N050.04.34.370 E019.46.32.407 N050.04.34.358 E019.46.32.512 Color_45ACI
N050.04.34.358 E019.46.32.512 N050.04.34.386 E019.46.32.599 Color_45ACI
N050.04.34.386 E019.46.32.599 N050.04.34.444 E019.46.32.648 Color_45ACI
N050.04.34.444 E019.46.32.648 N050.04.34.505 E019.46.32.636 Color_45ACI
N050.04.34.505 E019.46.32.636 N050.04.34.554 E019.46.32.566 Color_45ACI
N050.04.34.554 E019.46.32.566 N050.04.34.567 E019.46.32.486 Color_45ACI
N050.04.34.567 E019.46.32.486 N050.04.34.554 E019.46.32.405 Color_45ACI
N050.04.34.554 E019.46.32.405 N050.04.34.529 E019.46.32.360 Color_45ACI
N050.04.34.946 E019.46.35.363 N050.04.34.891 E019.46.35.327 Color_45ACI
N050.04.34.891 E019.46.35.327 N050.04.34.827 E019.46.35.347 Color_45ACI
N050.04.34.827 E019.46.35.347 N050.04.34.786 E019.46.35.411 Color_45ACI
N050.04.34.786 E019.46.35.411 N050.04.34.775 E019.46.35.516 Color_45ACI
N050.04.34.775 E019.46.35.516 N050.04.34.803 E019.46.35.603 Color_45ACI
N050.04.34.803 E019.46.35.603 N050.04.34.861 E019.46.35.651 Color_45ACI
N050.04.34.861 E019.46.35.651 N050.04.34.921 E019.46.35.639 Color_45ACI
N050.04.34.921 E019.46.35.639 N050.04.34.970 E019.46.35.570 Color_45ACI
N050.04.34.970 E019.46.35.570 N050.04.34.984 E019.46.35.490 Color_45ACI
N050.04.34.984 E019.46.35.490 N050.04.34.970 E019.46.35.408 Color_45ACI
N050.04.34.970 E019.46.35.408 N050.04.34.946 E019.46.35.363 Color_45ACI
N050.04.37.124 E019.46.34.656 N050.04.37.070 E019.46.34.620 Color_45ACI
N050.04.37.070 E019.46.34.620 N050.04.37.005 E019.46.34.640 Color_45ACI
N050.04.37.005 E019.46.34.640 N050.04.36.965 E019.46.34.704 Color_45ACI
N050.04.36.965 E019.46.34.704 N050.04.36.953 E019.46.34.809 Color_45ACI
N050.04.36.953 E019.46.34.809 N050.04.36.981 E019.46.34.896 Color_45ACI
N050.04.36.981 E019.46.34.896 N050.04.37.039 E019.46.34.944 Color_45ACI
N050.04.37.039 E019.46.34.944 N050.04.37.100 E019.46.34.933 Color_45ACI
N050.04.37.100 E019.46.34.933 N050.04.37.149 E019.46.34.863 Color_45ACI
N050.04.37.149 E019.46.34.863 N050.04.37.162 E019.46.34.783 Color_45ACI
N050.04.37.162 E019.46.34.783 N050.04.37.148 E019.46.34.702 Color_45ACI
N050.04.37.148 E019.46.34.702 N050.04.37.124 E019.46.34.656 Color_45ACI
N050.04.36.695 E019.46.31.660 N050.04.36.641 E019.46.31.624 Color_45ACI
N050.04.36.641 E019.46.31.624 N050.04.36.576 E019.46.31.644 Color_45ACI
N050.04.36.576 E019.46.31.644 N050.04.36.536 E019.46.31.708 Color_45ACI
N050.04.36.536 E019.46.31.708 N050.04.36.524 E019.46.31.813 Color_45ACI
N050.04.36.524 E019.46.31.813 N050.04.36.552 E019.46.31.900 Color_45ACI
N050.04.36.552 E019.46.31.900 N050.04.36.610 E019.46.31.948 Color_45ACI
N050.04.36.610 E019.46.31.948 N050.04.36.670 E019.46.31.937 Color_45ACI
N050.04.36.670 E019.46.31.937 N050.04.36.720 E019.46.31.867 Color_45ACI
N050.04.36.720 E019.46.31.867 N050.04.36.733 E019.46.31.787 Color_45ACI
N050.04.36.733 E019.46.31.787 N050.04.36.719 E019.46.31.706 Color_45ACI
N050.04.36.719 E019.46.31.706 N050.04.36.695 E019.46.31.660 Color_45ACI
N050.04.36.316 E019.46.28.731 N050.04.36.262 E019.46.28.695 Color_45ACI
N050.04.36.262 E019.46.28.695 N050.04.36.197 E019.46.28.715 Color_45ACI
N050.04.36.197 E019.46.28.715 N050.04.36.157 E019.46.28.779 Color_45ACI
N050.04.36.157 E019.46.28.779 N050.04.36.145 E019.46.28.883 Color_45ACI
N050.04.36.145 E019.46.28.883 N050.04.36.173 E019.46.28.971 Color_45ACI
N050.04.36.173 E019.46.28.971 N050.04.36.231 E019.46.29.019 Color_45ACI
N050.04.36.231 E019.46.29.019 N050.04.36.292 E019.46.29.007 Color_45ACI
N050.04.36.292 E019.46.29.007 N050.04.36.341 E019.46.28.938 Color_45ACI
N050.04.36.341 E019.46.28.938 N050.04.36.354 E019.46.28.858 Color_45ACI
N050.04.36.354 E019.46.28.858 N050.04.36.341 E019.46.28.776 Color_45ACI
N050.04.36.341 E019.46.28.776 N050.04.36.316 E019.46.28.731 Color_45ACI
N050.04.35.905 E019.46.25.752 N050.04.35.850 E019.46.25.716 Color_45ACI
N050.04.35.850 E019.46.25.716 N050.04.35.786 E019.46.25.736 Color_45ACI
N050.04.35.786 E019.46.25.736 N050.04.35.745 E019.46.25.800 Color_45ACI
N050.04.35.745 E019.46.25.800 N050.04.35.734 E019.46.25.905 Color_45ACI
N050.04.35.734 E019.46.25.905 N050.04.35.762 E019.46.25.992 Color_45ACI
N050.04.35.762 E019.46.25.992 N050.04.35.820 E019.46.26.040 Color_45ACI
N050.04.35.820 E019.46.26.040 N050.04.35.880 E019.46.26.029 Color_45ACI
N050.04.35.880 E019.46.26.029 N050.04.35.929 E019.46.25.959 Color_45ACI
N050.04.35.929 E019.46.25.959 N050.04.35.943 E019.46.25.879 Color_45ACI
N050.04.35.943 E019.46.25.879 N050.04.35.929 E019.46.25.798 Color_45ACI
N050.04.35.929 E019.46.25.798 N050.04.35.905 E019.46.25.752 Color_45ACI
N050.04.35.478 E019.46.22.779 N050.04.35.424 E019.46.22.743 Color_45ACI
N050.04.35.424 E019.46.22.743 N050.04.35.360 E019.46.22.763 Color_45ACI
N050.04.35.360 E019.46.22.763 N050.04.35.319 E019.46.22.827 Color_45ACI
N050.04.35.319 E019.46.22.827 N050.04.35.308 E019.46.22.932 Color_45ACI
N050.04.35.308 E019.46.22.932 N050.04.35.336 E019.46.23.019 Color_45ACI
N050.04.35.336 E019.46.23.019 N050.04.35.393 E019.46.23.067 Color_45ACI
N050.04.35.393 E019.46.23.067 N050.04.35.454 E019.46.23.055 Color_45ACI
N050.04.35.454 E019.46.23.055 N050.04.35.503 E019.46.22.986 Color_45ACI
N050.04.35.503 E019.46.22.986 N050.04.35.517 E019.46.22.906 Color_45ACI
N050.04.35.517 E019.46.22.906 N050.04.35.503 E019.46.22.824 Color_45ACI
N050.04.35.503 E019.46.22.824 N050.04.35.478 E019.46.22.779 Color_45ACI
N050.04.35.079 E019.46.19.808 N050.04.35.025 E019.46.19.772 Color_45ACI
N050.04.35.025 E019.46.19.772 N050.04.34.961 E019.46.19.792 Color_45ACI
N050.04.34.961 E019.46.19.792 N050.04.34.920 E019.46.19.856 Color_45ACI
N050.04.34.920 E019.46.19.856 N050.04.34.909 E019.46.19.961 Color_45ACI
N050.04.34.909 E019.46.19.961 N050.04.34.936 E019.46.20.048 Color_45ACI
N050.04.34.936 E019.46.20.048 N050.04.34.994 E019.46.20.096 Color_45ACI
N050.04.34.994 E019.46.20.096 N050.04.35.055 E019.46.20.085 Color_45ACI
N050.04.35.055 E019.46.20.085 N050.04.35.104 E019.46.20.015 Color_45ACI
N050.04.35.104 E019.46.20.015 N050.04.35.118 E019.46.19.935 Color_45ACI
N050.04.35.118 E019.46.19.935 N050.04.35.104 E019.46.19.853 Color_45ACI
N050.04.35.104 E019.46.19.853 N050.04.35.079 E019.46.19.808 Color_45ACI
N050.04.34.668 E019.46.16.801 N050.04.34.614 E019.46.16.765 Color_45ACI
N050.04.34.614 E019.46.16.765 N050.04.34.549 E019.46.16.785 Color_45ACI
N050.04.34.549 E019.46.16.785 N050.04.34.508 E019.46.16.849 Color_45ACI
N050.04.34.508 E019.46.16.849 N050.04.34.497 E019.46.16.954 Color_45ACI
N050.04.34.497 E019.46.16.954 N050.04.34.525 E019.46.17.041 Color_45ACI
N050.04.34.525 E019.46.17.041 N050.04.34.583 E019.46.17.089 Color_45ACI
N050.04.34.583 E019.46.17.089 N050.04.34.643 E019.46.17.077 Color_45ACI
N050.04.34.643 E019.46.17.077 N050.04.34.692 E019.46.17.008 Color_45ACI
N050.04.34.692 E019.46.17.008 N050.04.34.706 E019.46.16.928 Color_45ACI
N050.04.34.706 E019.46.16.928 N050.04.34.692 E019.46.16.846 Color_45ACI
N050.04.34.692 E019.46.16.846 N050.04.34.668 E019.46.16.801 Color_45ACI
N050.04.34.246 E019.46.13.743 N050.04.34.191 E019.46.13.707 Color_45ACI
N050.04.34.191 E019.46.13.707 N050.04.34.127 E019.46.13.727 Color_45ACI
N050.04.34.127 E019.46.13.727 N050.04.34.086 E019.46.13.791 Color_45ACI
N050.04.34.086 E019.46.13.791 N050.04.34.075 E019.46.13.896 Color_45ACI
N050.04.34.075 E019.46.13.896 N050.04.34.103 E019.46.13.983 Color_45ACI
N050.04.34.103 E019.46.13.983 N050.04.34.161 E019.46.14.031 Color_45ACI
N050.04.34.161 E019.46.14.031 N050.04.34.221 E019.46.14.020 Color_45ACI
N050.04.34.221 E019.46.14.020 N050.04.34.270 E019.46.13.950 Color_45ACI
N050.04.34.270 E019.46.13.950 N050.04.34.284 E019.46.13.870 Color_45ACI
N050.04.34.284 E019.46.13.870 N050.04.34.270 E019.46.13.788 Color_45ACI
N050.04.34.270 E019.46.13.788 N050.04.34.246 E019.46.13.743 Color_45ACI
N050.04.33.846 E019.46.10.794 N050.04.33.792 E019.46.10.758 Color_45ACI
N050.04.33.792 E019.46.10.758 N050.04.33.727 E019.46.10.778 Color_45ACI
N050.04.33.727 E019.46.10.778 N050.04.33.687 E019.46.10.842 Color_45ACI
N050.04.33.687 E019.46.10.842 N050.04.33.675 E019.46.10.947 Color_45ACI
N050.04.33.675 E019.46.10.947 N050.04.33.703 E019.46.11.034 Color_45ACI
N050.04.33.703 E019.46.11.034 N050.04.33.761 E019.46.11.082 Color_45ACI
N050.04.33.761 E019.46.11.082 N050.04.33.822 E019.46.11.070 Color_45ACI
N050.04.33.822 E019.46.11.070 N050.04.33.871 E019.46.11.001 Color_45ACI
N050.04.33.871 E019.46.11.001 N050.04.33.885 E019.46.10.921 Color_45ACI
N050.04.33.885 E019.46.10.921 N050.04.33.871 E019.46.10.839 Color_45ACI
N050.04.33.871 E019.46.10.839 N050.04.33.846 E019.46.10.794 Color_45ACI
N050.04.33.425 E019.46.07.794 N050.04.33.371 E019.46.07.758 Color_45ACI
N050.04.33.371 E019.46.07.758 N050.04.33.307 E019.46.07.778 Color_45ACI
N050.04.33.307 E019.46.07.778 N050.04.33.266 E019.46.07.842 Color_45ACI
N050.04.33.266 E019.46.07.842 N050.04.33.255 E019.46.07.947 Color_45ACI
N050.04.33.255 E019.46.07.947 N050.04.33.282 E019.46.08.034 Color_45ACI
N050.04.33.282 E019.46.08.034 N050.04.33.340 E019.46.08.082 Color_45ACI
N050.04.33.340 E019.46.08.082 N050.04.33.401 E019.46.08.070 Color_45ACI
N050.04.33.401 E019.46.08.070 N050.04.33.450 E019.46.08.001 Color_45ACI
N050.04.33.450 E019.46.08.001 N050.04.33.464 E019.46.07.921 Color_45ACI
N050.04.33.464 E019.46.07.921 N050.04.33.450 E019.46.07.839 Color_45ACI
N050.04.33.450 E019.46.07.839 N050.04.33.425 E019.46.07.794 Color_45ACI
;app_lights N000.00.00.000 E000.00.00.000 N000.00.00.000 E000.00.00.000
N050.04.51.027 E019.48.25.349 N050.04.50.996 E019.48.25.716 Color_253ACI
N050.04.51.027 E019.48.25.349 N050.04.51.162 E019.48.25.672 Color_253ACI
N050.04.53.670 E019.48.44.734 N050.04.53.640 E019.48.45.100 Color_253ACI
N050.04.53.670 E019.48.44.734 N050.04.53.805 E019.48.45.057 Color_253ACI
N050.04.53.481 E019.48.43.270 N050.04.53.424 E019.48.43.620 Color_253ACI
N050.04.53.481 E019.48.43.270 N050.04.53.616 E019.48.43.593 Color_253ACI
N050.04.53.266 E019.48.41.790 N050.04.53.246 E019.48.42.115 Color_253ACI
N050.04.53.266 E019.48.41.790 N050.04.53.411 E019.48.42.071 Color_253ACI
N050.04.53.060 E019.48.40.268 N050.04.53.030 E019.48.40.635 Color_253ACI
N050.04.53.060 E019.48.40.268 N050.04.53.196 E019.48.40.591 Color_253ACI
N050.04.52.872 E019.48.38.804 N050.04.52.841 E019.48.39.171 Color_253ACI
N050.04.52.872 E019.48.38.804 N050.04.52.990 E019.48.39.069 Color_253ACI
N050.04.52.667 E019.48.37.282 N050.04.52.609 E019.48.37.633 Color_253ACI
N050.04.52.667 E019.48.37.282 N050.04.52.802 E019.48.37.606 Color_253ACI
N050.04.52.451 E019.48.35.802 N050.04.52.421 E019.48.36.169 Color_253ACI
N050.04.52.451 E019.48.35.802 N050.04.52.597 E019.48.36.084 Color_253ACI
N050.04.52.246 E019.48.34.280 N050.04.52.205 E019.48.34.689 Color_253ACI
N050.04.52.246 E019.48.34.280 N050.04.52.408 E019.48.34.620 Color_253ACI
N050.04.52.057 E019.48.32.817 N050.04.52.027 E019.48.33.183 Color_253ACI
N050.04.52.057 E019.48.32.817 N050.04.52.192 E019.48.33.140 Color_253ACI
N050.04.51.852 E019.48.31.295 N050.04.51.811 E019.48.31.703 Color_253ACI
N050.04.51.852 E019.48.31.295 N050.04.51.987 E019.48.31.618 Color_253ACI
N050.04.51.636 E019.48.29.815 N050.04.51.595 E019.48.30.223 Color_253ACI
N050.04.51.636 E019.48.29.815 N050.04.51.771 E019.48.30.138 Color_253ACI
N050.04.51.447 E019.48.28.351 N050.04.51.390 E019.48.28.701 Color_253ACI
N050.04.51.447 E019.48.28.351 N050.04.51.583 E019.48.28.674 Color_253ACI
N050.04.51.242 E019.48.26.829 N050.04.51.202 E019.48.27.238 Color_253ACI
N050.04.51.242 E019.48.26.829 N050.04.51.378 E019.48.27.152 Color_253ACI
N050.04.50.838 E019.48.23.885 N050.04.50.781 E019.48.24.236 Color_253ACI
N050.04.50.838 E019.48.23.885 N050.04.50.946 E019.48.24.192 Color_253ACI
N050.04.50.633 E019.48.22.363 N050.04.50.603 E019.48.22.730 Color_253ACI
N050.04.50.633 E019.48.22.363 N050.04.50.768 E019.48.22.687 Color_253ACI
N050.04.50.417 E019.48.20.883 N050.04.50.387 E019.48.21.250 Color_253ACI
N050.04.50.417 E019.48.20.883 N050.04.50.552 E019.48.21.207 Color_253ACI
N050.04.50.202 E019.48.19.403 N050.04.50.182 E019.48.19.728 Color_253ACI
N050.04.50.202 E019.48.19.403 N050.04.50.347 E019.48.19.685 Color_253ACI
N050.04.50.023 E019.48.17.898 N050.04.49.966 E019.48.18.248 Color_253ACI
N050.04.50.023 E019.48.17.898 N050.04.50.158 E019.48.18.221 Color_253ACI
N050.04.49.808 E019.48.16.418 N050.04.49.777 E019.48.16.785 Color_253ACI
N050.04.49.808 E019.48.16.418 N050.04.49.953 E019.48.16.699 Color_253ACI
N050.04.49.603 E019.48.14.896 N050.04.49.738 E019.48.15.219 Color_253ACI
N050.04.49.603 E019.48.14.896 N050.04.49.562 E019.48.15.304 Color_253ACI
;rwy_markings N000.00.00.000 E000.00.00.000 N000.00.00.000 E000.00.00.000
N050.04.48.903 E019.48.09.818 N050.04.48.767 E019.48.08.841 Color_252ACI
N050.04.48.811 E019.48.08.804 N050.04.48.706 E019.48.08.381 Color_252ACI
N050.04.48.706 E019.48.08.381 N050.04.48.718 E019.48.08.828 Color_252ACI
N050.04.48.556 E019.48.07.334 N050.04.48.421 E019.48.06.357 Color_252ACI
N050.04.48.465 E019.48.06.320 N050.04.48.359 E019.48.05.896 Color_252ACI
N050.04.48.359 E019.48.05.896 N050.04.48.371 E019.48.06.344 Color_252ACI
N050.04.48.220 E019.48.04.861 N050.04.48.084 E019.48.03.884 Color_252ACI
N050.04.48.128 E019.48.03.847 N050.04.48.023 E019.48.03.423 Color_252ACI
N050.04.48.023 E019.48.03.423 N050.04.48.034 E019.48.03.871 Color_252ACI
N050.04.47.880 E019.48.02.359 N050.04.47.744 E019.48.01.382 Color_252ACI
N050.04.47.788 E019.48.01.344 N050.04.47.683 E019.48.00.921 Color_252ACI
N050.04.47.683 E019.48.00.921 N050.04.47.694 E019.48.01.368 Color_252ACI
N050.04.43.017 E019.47.29.018 N050.04.43.166 E019.47.30.114 Color_252ACI
N050.04.42.859 E019.47.29.070 N050.04.43.008 E019.47.30.166 Color_252ACI
N050.04.43.754 E019.47.28.773 N050.04.43.904 E019.47.29.869 Color_252ACI
N050.04.43.589 E019.47.28.827 N050.04.43.738 E019.47.29.924 Color_252ACI
N050.04.44.028 E019.47.36.404 N050.04.44.177 E019.47.37.500 Color_252ACI
N050.04.43.870 E019.47.36.456 N050.04.44.019 E019.47.37.553 Color_252ACI
N050.04.44.765 E019.47.36.159 N050.04.44.915 E019.47.37.255 Color_252ACI
N050.04.44.600 E019.47.36.213 N050.04.44.749 E019.47.37.310 Color_252ACI
N050.04.41.570 E019.47.14.014 N050.04.41.714 E019.47.15.162 Color_252ACI
N050.04.40.988 E019.47.14.238 N050.04.41.143 E019.47.15.344 Color_252ACI
N050.04.34.969 E019.46.25.651 N050.04.35.294 E019.46.25.543 Color_252ACI
N050.04.35.294 E019.46.25.543 N050.04.35.596 E019.46.27.753 Color_252ACI
N050.04.35.596 E019.46.27.753 N050.04.35.271 E019.46.27.861 Color_252ACI
N050.04.35.271 E019.46.27.861 N050.04.34.969 E019.46.25.651 Color_252ACI
N050.04.34.397 E019.46.25.841 N050.04.34.088 E019.46.25.943 Color_252ACI
N050.04.34.088 E019.46.25.943 N050.04.34.391 E019.46.28.153 Color_252ACI
N050.04.34.391 E019.46.28.153 N050.04.34.699 E019.46.28.051 Color_252ACI
N050.04.34.699 E019.46.28.051 N050.04.34.397 E019.46.25.841 Color_252ACI
N050.04.32.800 E019.46.05.257 N050.04.33.008 E019.46.06.778 Color_252ACI
N050.04.32.571 E019.46.05.333 N050.04.32.779 E019.46.06.854 Color_252ACI
N050.04.32.305 E019.46.05.421 N050.04.32.513 E019.46.06.942 Color_252ACI
N050.04.32.059 E019.46.05.503 N050.04.32.267 E019.46.07.024 Color_252ACI
N050.04.31.798 E019.46.05.589 N050.04.32.006 E019.46.07.111 Color_252ACI
N050.04.31.532 E019.46.05.678 N050.04.31.740 E019.46.07.199 Color_252ACI
N050.04.31.290 E019.46.05.758 N050.04.31.498 E019.46.07.279 Color_252ACI
N050.04.31.028 E019.46.05.845 N050.04.31.233 E019.46.07.367 Color_252ACI
N050.04.32.645 E019.46.07.540 N050.04.32.628 E019.46.07.403 Color_252ACI
N050.04.32.628 E019.46.07.403 N050.04.32.628 E019.46.07.403 Color_252ACI
N050.04.32.628 E019.46.07.403 N050.04.32.572 E019.46.07.189 Color_252ACI
N050.04.32.572 E019.46.07.189 N050.04.32.499 E019.46.07.073 Color_252ACI
N050.04.32.499 E019.46.07.073 N050.04.32.409 E019.46.07.054 Color_252ACI
N050.04.32.409 E019.46.07.054 N050.04.32.351 E019.46.07.070 Color_252ACI
N050.04.32.351 E019.46.07.070 N050.04.32.272 E019.46.07.142 Color_252ACI
N050.04.32.272 E019.46.07.142 N050.04.32.231 E019.46.07.294 Color_252ACI
N050.04.32.231 E019.46.07.294 N050.04.32.229 E019.46.07.517 Color_252ACI
N050.04.32.229 E019.46.07.517 N050.04.32.246 E019.46.07.658 Color_252ACI
N050.04.32.246 E019.46.07.658 N050.04.32.301 E019.46.07.867 Color_252ACI
N050.04.32.301 E019.46.07.867 N050.04.32.301 E019.46.07.867 Color_252ACI
N050.04.32.301 E019.46.07.867 N050.04.32.375 E019.46.07.983 Color_252ACI
N050.04.32.375 E019.46.07.983 N050.04.32.465 E019.46.08.002 Color_252ACI
N050.04.32.465 E019.46.08.002 N050.04.32.465 E019.46.08.002 Color_252ACI
N050.04.32.465 E019.46.08.002 N050.04.32.522 E019.46.07.985 Color_252ACI
N050.04.32.522 E019.46.07.985 N050.04.32.605 E019.46.07.917 Color_252ACI
N050.04.32.605 E019.46.07.917 N050.04.32.642 E019.46.07.766 Color_252ACI
N050.04.32.642 E019.46.07.766 N050.04.32.645 E019.46.07.540 Color_252ACI
N050.04.32.645 E019.46.07.540 N050.04.32.628 E019.46.07.403 Color_252ACI
N050.04.32.628 E019.46.07.403 N050.04.32.628 E019.46.07.403 Color_252ACI
N050.04.32.628 E019.46.07.403 N050.04.32.572 E019.46.07.189 Color_252ACI
N050.04.32.572 E019.46.07.189 N050.04.32.499 E019.46.07.073 Color_252ACI
N050.04.32.499 E019.46.07.073 N050.04.32.409 E019.46.07.054 Color_252ACI
N050.04.32.409 E019.46.07.054 N050.04.32.351 E019.46.07.070 Color_252ACI
N050.04.32.351 E019.46.07.070 N050.04.32.272 E019.46.07.142 Color_252ACI
N050.04.32.272 E019.46.07.142 N050.04.32.231 E019.46.07.294 Color_252ACI
N050.04.32.231 E019.46.07.294 N050.04.32.229 E019.46.07.517 Color_252ACI
N050.04.32.229 E019.46.07.517 N050.04.32.246 E019.46.07.658 Color_252ACI
N050.04.32.246 E019.46.07.658 N050.04.32.301 E019.46.07.867 Color_252ACI
N050.04.32.301 E019.46.07.867 N050.04.32.301 E019.46.07.867 Color_252ACI
N050.04.32.301 E019.46.07.867 N050.04.32.375 E019.46.07.983 Color_252ACI
N050.04.32.375 E019.46.07.983 N050.04.32.465 E019.46.08.002 Color_252ACI
N050.04.32.465 E019.46.08.002 N050.04.32.465 E019.46.08.002 Color_252ACI
N050.04.32.465 E019.46.08.002 N050.04.32.522 E019.46.07.985 Color_252ACI
N050.04.32.522 E019.46.07.985 N050.04.32.605 E019.46.07.917 Color_252ACI
N050.04.32.605 E019.46.07.917 N050.04.32.642 E019.46.07.766 Color_252ACI
N050.04.32.642 E019.46.07.766 N050.04.32.645 E019.46.07.540 Color_252ACI
N050.04.46.048 E019.47.51.177 N050.04.46.198 E019.47.52.273 Color_252ACI
N050.04.45.739 E019.47.51.280 N050.04.45.889 E019.47.52.376 Color_252ACI
N050.04.45.890 E019.47.51.229 N050.04.46.040 E019.47.52.325 Color_252ACI
N050.04.46.944 E019.47.50.879 N050.04.47.094 E019.47.51.977 Color_252ACI
N050.04.33.243 E019.46.13.038 N050.04.33.397 E019.46.14.160 Color_252ACI
N050.04.33.393 E019.46.12.990 N050.04.33.546 E019.46.14.109 Color_252ACI
N050.04.33.569 E019.46.12.934 N050.04.33.719 E019.46.14.033 Color_252ACI
N050.04.34.586 E019.46.20.379 N050.04.34.742 E019.46.21.517 Color_252ACI
N050.04.34.411 E019.46.20.389 N050.04.34.561 E019.46.21.513 Color_252ACI
N050.04.34.261 E019.46.20.481 N050.04.34.409 E019.46.21.596 Color_252ACI
N050.04.36.453 E019.46.35.365 N050.04.36.608 E019.46.36.471 Color_252ACI
N050.04.36.301 E019.46.35.409 N050.04.36.452 E019.46.36.509 Color_252ACI
N050.04.37.379 E019.46.42.847 N050.04.37.534 E019.46.43.985 Color_252ACI
N050.04.38.334 E019.46.50.282 N050.04.38.491 E019.46.51.427 Color_252ACI
N050.04.42.580 E019.47.21.432 N050.04.42.725 E019.47.22.580 Color_252ACI
N050.04.45.405 E019.47.42.119 N050.04.45.730 E019.47.42.011 Color_252ACI
N050.04.45.730 E019.47.42.011 N050.04.46.032 E019.47.44.221 Color_252ACI
N050.04.46.032 E019.47.44.221 N050.04.45.708 E019.47.44.329 Color_252ACI
N050.04.45.708 E019.47.44.329 N050.04.45.405 E019.47.42.119 Color_252ACI
N050.04.46.786 E019.47.50.932 N050.04.46.935 E019.47.52.028 Color_252ACI
N050.04.46.620 E019.47.50.986 N050.04.46.769 E019.47.52.083 Color_252ACI
N050.04.35.551 E019.46.35.634 N050.04.35.706 E019.46.36.768 Color_252ACI
N050.04.35.729 E019.46.35.596 N050.04.35.879 E019.46.36.699 Color_252ACI
N050.04.36.747 E019.46.43.058 N050.04.36.900 E019.46.44.167 Color_252ACI
N050.04.37.767 E019.46.50.510 N050.04.37.919 E019.46.51.620 Color_252ACI
N050.04.41.999 E019.47.21.656 N050.04.42.154 E019.47.22.762 Color_252ACI
N050.04.44.833 E019.47.42.309 N050.04.44.524 E019.47.42.412 Color_252ACI
N050.04.44.524 E019.47.42.412 N050.04.44.827 E019.47.44.621 Color_252ACI
N050.04.44.827 E019.47.44.621 N050.04.45.135 E019.47.44.519 Color_252ACI
N050.04.45.135 E019.47.44.519 N050.04.44.833 E019.47.42.309 Color_252ACI
N050.04.48.562 E019.48.07.470 N050.04.48.758 E019.48.09.275 Color_252ACI
N050.04.31.817 E019.46.08.196 N050.04.32.211 E019.46.08.070 Color_252ACI
N050.04.32.211 E019.46.08.070 N050.04.32.188 E019.46.07.912 Color_252ACI
N050.04.32.188 E019.46.07.912 N050.04.31.922 E019.46.08.002 Color_252ACI
N050.04.31.922 E019.46.08.002 N050.04.31.954 E019.46.07.771 Color_252ACI
N050.04.31.954 E019.46.07.771 N050.04.31.954 E019.46.07.771 Color_252ACI
N050.04.31.954 E019.46.07.771 N050.04.32.019 E019.46.07.231 Color_252ACI
N050.04.32.019 E019.46.07.231 N050.04.31.918 E019.46.07.266 Color_252ACI
N050.04.31.918 E019.46.07.266 N050.04.31.802 E019.46.08.042 Color_252ACI
N050.04.31.802 E019.46.08.042 N050.04.31.817 E019.46.08.196 Color_252ACI
N050.04.32.529 E019.46.07.542 N050.04.32.529 E019.46.07.542 Color_252ACI
N050.04.32.529 E019.46.07.542 N050.04.32.545 E019.46.07.600 Color_252ACI
N050.04.32.545 E019.46.07.600 N050.04.32.551 E019.46.07.700 Color_252ACI
N050.04.32.551 E019.46.07.700 N050.04.32.540 E019.46.07.741 Color_252ACI
N050.04.32.540 E019.46.07.741 N050.04.32.519 E019.46.07.825 Color_252ACI
N050.04.32.519 E019.46.07.825 N050.04.32.482 E019.46.07.850 Color_252ACI
N050.04.32.482 E019.46.07.850 N050.04.32.429 E019.46.07.818 Color_252ACI
N050.04.32.429 E019.46.07.818 N050.04.32.402 E019.46.07.801 Color_252ACI
N050.04.32.402 E019.46.07.801 N050.04.32.385 E019.46.07.743 Color_252ACI
N050.04.32.385 E019.46.07.743 N050.04.32.385 E019.46.07.743 Color_252ACI
N050.04.32.385 E019.46.07.743 N050.04.32.369 E019.46.07.685 Color_252ACI
N050.04.32.369 E019.46.07.685 N050.04.32.347 E019.46.07.527 Color_252ACI
N050.04.32.347 E019.46.07.527 N050.04.32.341 E019.46.07.427 Color_252ACI
N050.04.32.341 E019.46.07.427 N050.04.32.341 E019.46.07.427 Color_252ACI
N050.04.32.341 E019.46.07.427 N050.04.32.335 E019.46.07.327 Color_252ACI
N050.04.32.335 E019.46.07.327 N050.04.32.356 E019.46.07.244 Color_252ACI
N050.04.32.356 E019.46.07.244 N050.04.32.394 E019.46.07.218 Color_252ACI
N050.04.32.394 E019.46.07.218 N050.04.32.394 E019.46.07.218 Color_252ACI
N050.04.32.394 E019.46.07.218 N050.04.32.439 E019.46.07.203 Color_252ACI
N050.04.32.439 E019.46.07.203 N050.04.32.439 E019.46.07.203 Color_252ACI
N050.04.32.439 E019.46.07.203 N050.04.32.471 E019.46.07.246 Color_252ACI
N050.04.32.471 E019.46.07.246 N050.04.32.507 E019.46.07.384 Color_252ACI
N050.04.32.507 E019.46.07.384 N050.04.32.523 E019.46.07.442 Color_252ACI
N050.04.32.523 E019.46.07.442 N050.04.32.523 E019.46.07.442 Color_252ACI
N050.04.32.523 E019.46.07.442 N050.04.32.529 E019.46.07.542 Color_252ACI
N050.04.32.645 E019.46.07.540 N050.04.32.628 E019.46.07.403 Color_252ACI
N050.04.32.628 E019.46.07.403 N050.04.32.628 E019.46.07.403 Color_252ACI
N050.04.32.628 E019.46.07.403 N050.04.32.572 E019.46.07.189 Color_252ACI
N050.04.32.572 E019.46.07.189 N050.04.32.499 E019.46.07.073 Color_252ACI
N050.04.32.499 E019.46.07.073 N050.04.32.409 E019.46.07.054 Color_252ACI
N050.04.32.409 E019.46.07.054 N050.04.32.351 E019.46.07.070 Color_252ACI
N050.04.32.351 E019.46.07.070 N050.04.32.272 E019.46.07.142 Color_252ACI
N050.04.32.272 E019.46.07.142 N050.04.32.231 E019.46.07.294 Color_252ACI
N050.04.32.231 E019.46.07.294 N050.04.32.229 E019.46.07.517 Color_252ACI
N050.04.32.229 E019.46.07.517 N050.04.32.246 E019.46.07.658 Color_252ACI
N050.04.32.246 E019.46.07.658 N050.04.32.301 E019.46.07.867 Color_252ACI
N050.04.32.301 E019.46.07.867 N050.04.32.301 E019.46.07.867 Color_252ACI
N050.04.32.301 E019.46.07.867 N050.04.32.375 E019.46.07.983 Color_252ACI
N050.04.32.375 E019.46.07.983 N050.04.32.465 E019.46.08.002 Color_252ACI
N050.04.32.465 E019.46.08.002 N050.04.32.465 E019.46.08.002 Color_252ACI
N050.04.32.465 E019.46.08.002 N050.04.32.522 E019.46.07.985 Color_252ACI
N050.04.32.522 E019.46.07.985 N050.04.32.605 E019.46.07.917 Color_252ACI
N050.04.32.605 E019.46.07.917 N050.04.32.642 E019.46.07.766 Color_252ACI
N050.04.32.642 E019.46.07.766 N050.04.32.645 E019.46.07.540 Color_252ACI
N050.04.47.434 E019.47.57.458 N050.04.47.663 E019.47.57.385 Color_252ACI
N050.04.47.663 E019.47.57.385 N050.04.47.641 E019.47.57.228 Color_252ACI
N050.04.47.641 E019.47.57.228 N050.04.47.337 E019.47.57.331 Color_252ACI
N050.04.47.337 E019.47.57.331 N050.04.47.366 E019.47.57.830 Color_252ACI
N050.04.47.366 E019.47.57.830 N050.04.47.467 E019.47.57.796 Color_252ACI
N050.04.47.467 E019.47.57.796 N050.04.47.478 E019.47.57.754 Color_252ACI
N050.04.47.478 E019.47.57.754 N050.04.47.515 E019.47.57.729 Color_252ACI
N050.04.47.515 E019.47.57.729 N050.04.47.515 E019.47.57.729 Color_252ACI
N050.04.47.515 E019.47.57.729 N050.04.47.515 E019.47.57.729 Color_252ACI
N050.04.47.515 E019.47.57.729 N050.04.47.579 E019.47.57.720 Color_252ACI
N050.04.47.579 E019.47.57.720 N050.04.47.606 E019.47.57.736 Color_252ACI
N050.04.47.606 E019.47.57.736 N050.04.47.622 E019.47.57.794 Color_252ACI
N050.04.47.622 E019.47.57.794 N050.04.47.639 E019.47.57.852 Color_252ACI
N050.04.47.639 E019.47.57.852 N050.04.47.655 E019.47.57.910 Color_252ACI
N050.04.47.655 E019.47.57.910 N050.04.47.624 E019.47.58.036 Color_252ACI
N050.04.47.624 E019.47.58.036 N050.04.47.586 E019.47.58.061 Color_252ACI
N050.04.47.586 E019.47.58.061 N050.04.47.560 E019.47.58.056 Color_252ACI
N050.04.47.560 E019.47.58.056 N050.04.47.535 E019.47.58.049 Color_252ACI
N050.04.47.535 E019.47.58.049 N050.04.47.506 E019.47.58.012 Color_252ACI
N050.04.47.506 E019.47.58.012 N050.04.47.506 E019.47.58.012 Color_252ACI
N050.04.47.506 E019.47.58.012 N050.04.47.495 E019.47.57.974 Color_252ACI
N050.04.47.495 E019.47.57.974 N050.04.47.373 E019.47.58.009 Color_252ACI
N050.04.47.373 E019.47.58.009 N050.04.47.394 E019.47.58.088 Color_252ACI
N050.04.47.394 E019.47.58.088 N050.04.47.394 E019.47.58.088 Color_252ACI
N050.04.47.394 E019.47.58.088 N050.04.47.464 E019.47.58.179 Color_252ACI
N050.04.47.464 E019.47.58.179 N050.04.47.491 E019.47.58.195 Color_252ACI
N050.04.47.491 E019.47.58.195 N050.04.47.589 E019.47.58.180 Color_252ACI
N050.04.47.589 E019.47.58.180 N050.04.47.627 E019.47.58.171 Color_252ACI
N050.04.47.627 E019.47.58.171 N050.04.47.693 E019.47.58.126 Color_252ACI
N050.04.47.693 E019.47.58.126 N050.04.47.737 E019.47.58.000 Color_252ACI
N050.04.47.737 E019.47.58.000 N050.04.47.756 E019.47.57.876 Color_252ACI
N050.04.47.756 E019.47.57.876 N050.04.47.756 E019.47.57.876 Color_252ACI
N050.04.47.756 E019.47.57.876 N050.04.47.751 E019.47.57.776 Color_252ACI
N050.04.47.751 E019.47.57.776 N050.04.47.734 E019.47.57.718 Color_252ACI
N050.04.47.734 E019.47.57.718 N050.04.47.718 E019.47.57.660 Color_252ACI
N050.04.47.718 E019.47.57.660 N050.04.47.691 E019.47.57.643 Color_252ACI
N050.04.47.691 E019.47.57.643 N050.04.47.611 E019.47.57.594 Color_252ACI
N050.04.47.611 E019.47.57.594 N050.04.47.520 E019.47.57.587 Color_252ACI
N050.04.47.520 E019.47.57.587 N050.04.47.520 E019.47.57.587 Color_252ACI
N050.04.47.520 E019.47.57.587 N050.04.47.483 E019.47.57.613 Color_252ACI
N050.04.47.483 E019.47.57.613 N050.04.47.483 E019.47.57.613 Color_252ACI
N050.04.47.483 E019.47.57.613 N050.04.47.445 E019.47.57.638 Color_252ACI
N050.04.47.445 E019.47.57.638 N050.04.47.435 E019.47.57.680 Color_252ACI
N050.04.47.435 E019.47.57.680 N050.04.47.434 E019.47.57.458 Color_252ACI
N050.04.46.949 E019.47.57.769 N050.04.46.943 E019.47.57.669 Color_252ACI
N050.04.46.943 E019.47.57.669 N050.04.46.964 E019.47.57.585 Color_252ACI
N050.04.46.964 E019.47.57.585 N050.04.47.001 E019.47.57.560 Color_252ACI
N050.04.47.001 E019.47.57.560 N050.04.47.001 E019.47.57.560 Color_252ACI
N050.04.47.001 E019.47.57.560 N050.04.47.039 E019.47.57.534 Color_252ACI
N050.04.47.039 E019.47.57.534 N050.04.47.092 E019.47.57.567 Color_252ACI
N050.04.47.092 E019.47.57.567 N050.04.47.108 E019.47.57.625 Color_252ACI
N050.04.47.108 E019.47.57.625 N050.04.47.125 E019.47.57.683 Color_252ACI
N050.04.47.125 E019.47.57.683 N050.04.47.114 E019.47.57.725 Color_252ACI
N050.04.47.114 E019.47.57.725 N050.04.47.114 E019.47.57.725 Color_252ACI
N050.04.47.114 E019.47.57.725 N050.04.47.046 E019.47.57.876 Color_252ACI
N050.04.47.046 E019.47.57.876 N050.04.46.872 E019.47.58.418 Color_252ACI
N050.04.46.872 E019.47.58.418 N050.04.47.313 E019.47.58.272 Color_252ACI
N050.04.47.313 E019.47.58.272 N050.04.47.293 E019.47.58.123 Color_252ACI
N050.04.47.293 E019.47.58.123 N050.04.47.067 E019.47.58.189 Color_252ACI
N050.04.47.067 E019.47.58.189 N050.04.47.103 E019.47.58.071 Color_252ACI
N050.04.47.103 E019.47.58.071 N050.04.47.103 E019.47.58.071 Color_252ACI
N050.04.47.103 E019.47.58.071 N050.04.47.153 E019.47.57.941 Color_252ACI
N050.04.47.153 E019.47.57.941 N050.04.47.232 E019.47.57.749 Color_252ACI
N050.04.47.232 E019.47.57.749 N050.04.47.237 E019.47.57.607 Color_252ACI
N050.04.47.237 E019.47.57.607 N050.04.47.220 E019.47.57.549 Color_252ACI
N050.04.47.220 E019.47.57.549 N050.04.47.204 E019.47.57.517 Color_252ACI
N050.04.47.204 E019.47.57.517 N050.04.47.204 E019.47.57.517 Color_252ACI
N050.04.47.204 E019.47.57.517 N050.04.47.177 E019.47.57.474 Color_252ACI
N050.04.47.177 E019.47.57.474 N050.04.47.124 E019.47.57.442 Color_252ACI
N050.04.47.124 E019.47.57.442 N050.04.47.097 E019.47.57.425 Color_252ACI
N050.04.47.097 E019.47.57.425 N050.04.47.070 E019.47.57.409 Color_252ACI
N050.04.47.070 E019.47.57.409 N050.04.47.006 E019.47.57.418 Color_252ACI
N050.04.47.006 E019.47.57.418 N050.04.46.969 E019.47.57.444 Color_252ACI
N050.04.46.969 E019.47.57.444 N050.04.46.931 E019.47.57.469 Color_252ACI
N050.04.46.931 E019.47.57.469 N050.04.46.894 E019.47.57.494 Color_252ACI
N050.04.46.894 E019.47.57.494 N050.04.46.846 E019.47.57.562 Color_252ACI
N050.04.46.846 E019.47.57.562 N050.04.46.836 E019.47.57.603 Color_252ACI
N050.04.46.836 E019.47.57.603 N050.04.46.847 E019.47.57.803 Color_252ACI
N050.04.46.847 E019.47.57.803 N050.04.46.949 E019.47.57.769 Color_252ACI
N050.04.32.412 E019.46.13.299 N050.04.32.567 E019.46.14.405 Color_252ACI
N050.04.32.541 E019.46.13.280 N050.04.32.696 E019.46.14.386 Color_252ACI
N050.04.32.669 E019.46.13.262 N050.04.32.824 E019.46.14.368 Color_252ACI
N050.04.33.380 E019.46.20.768 N050.04.33.535 E019.46.21.906 Color_252ACI
N050.04.33.544 E019.46.20.732 N050.04.33.701 E019.46.21.877 Color_252ACI
N050.04.33.683 E019.46.20.672 N050.04.33.844 E019.46.21.809 Color_252ACI
N050.04.48.220 E019.47.58.091 N050.04.48.428 E019.47.59.612 Color_252ACI
N050.04.47.990 E019.47.58.167 N050.04.48.198 E019.47.59.688 Color_252ACI
N050.04.47.725 E019.47.58.255 N050.04.47.933 E019.47.59.776 Color_252ACI
N050.04.47.478 E019.47.58.337 N050.04.47.686 E019.47.59.858 Color_252ACI
N050.04.47.217 E019.47.58.424 N050.04.47.425 E019.47.59.945 Color_252ACI
N050.04.46.952 E019.47.58.512 N050.04.47.160 E019.48.00.033 Color_252ACI
N050.04.46.710 E019.47.58.592 N050.04.46.918 E019.48.00.113 Color_252ACI
N050.04.46.447 E019.47.58.679 N050.04.46.652 E019.48.00.201 Color_252ACI

EPBC_NEW N000.00.00.000 E000.00.00.000 N000.00.00.000 E000.00.00.000
N052.16.02.693 E020.53.49.680 N052.16.02.219 E020.53.52.903 Color_251ACI
N052.16.02.219 E020.53.52.903 N052.15.57.651 E020.54.25.759 Color_251ACI
N052.15.57.651 E020.54.25.759 N052.15.56.998 E020.54.26.584 Color_251ACI
N052.15.56.998 E020.54.26.584 N052.15.41.873 E020.54.38.861 Color_251ACI
N052.15.41.873 E020.54.38.861 N052.15.40.922 E020.54.39.548 Color_251ACI
N052.15.40.922 E020.54.39.548 N052.15.39.436 E020.54.40.759 Color_251ACI
N052.15.39.436 E020.54.40.759 N052.15.39.249 E020.54.40.749 Color_251ACI
N052.15.39.249 E020.54.40.749 N052.15.39.100 E020.54.40.680 Color_251ACI
N052.15.39.100 E020.54.40.680 N052.15.38.990 E020.54.40.552 Color_251ACI
N052.15.38.990 E020.54.40.552 N052.15.38.636 E020.54.39.431 Color_251ACI
N052.15.38.636 E020.54.39.431 N052.15.38.142 E020.54.37.812 Color_251ACI
N052.15.38.142 E020.54.37.812 N052.15.35.817 E020.54.39.777 Color_251ACI
N052.15.35.817 E020.54.39.777 N052.15.35.961 E020.54.40.091 Color_251ACI
N052.15.35.961 E020.54.40.091 N052.15.35.312 E020.54.40.670 Color_251ACI
N052.15.35.312 E020.54.40.670 N052.15.35.738 E020.54.41.917 Color_251ACI
N052.15.35.738 E020.54.41.917 N052.15.36.271 E020.54.41.516 Color_251ACI
N052.15.36.271 E020.54.41.516 N052.15.36.627 E020.54.42.515 Color_251ACI
N052.15.36.627 E020.54.42.515 N052.15.36.499 E020.54.43.305 Color_251ACI
N052.15.36.499 E020.54.43.305 N052.15.36.384 E020.54.43.421 Color_251ACI
N052.15.36.384 E020.54.43.421 N052.15.32.689 E020.54.46.418 Color_251ACI
N052.15.32.689 E020.54.46.418 N052.15.32.466 E020.54.46.285 Color_251ACI
N052.15.32.466 E020.54.46.285 N052.15.31.323 E020.54.47.206 Color_251ACI
N052.15.31.323 E020.54.47.206 N052.15.30.870 E020.54.47.367 Color_251ACI
N052.15.30.870 E020.54.47.367 N052.15.27.429 E020.54.42.963 Color_251ACI
N052.15.27.429 E020.54.42.963 N052.15.27.322 E020.54.42.651 Color_251ACI
N052.15.27.322 E020.54.42.651 N052.15.27.292 E020.54.42.281 Color_251ACI
N052.15.27.292 E020.54.42.281 N052.15.27.336 E020.54.41.916 Color_251ACI
N052.15.27.336 E020.54.41.916 N052.15.28.124 E020.54.39.934 Color_251ACI
N052.15.28.124 E020.54.39.934 N052.15.28.321 E020.54.39.454 Color_251ACI
N052.15.28.321 E020.54.39.454 N052.15.27.113 E020.54.37.922 Color_251ACI
N052.15.27.113 E020.54.37.922 N052.15.26.746 E020.54.37.474 Color_251ACI
N052.15.26.746 E020.54.37.474 N052.15.26.552 E020.54.37.832 Color_251ACI
N052.15.26.552 E020.54.37.832 N052.15.25.651 E020.54.39.808 Color_251ACI
N052.15.25.651 E020.54.39.808 N052.15.25.613 E020.54.39.867 Color_251ACI
N052.15.25.613 E020.54.39.867 N052.15.25.497 E020.54.40.045 Color_251ACI
N052.15.25.497 E020.54.40.045 N052.15.25.458 E020.54.40.104 Color_251ACI
N052.15.25.458 E020.54.40.104 N052.15.25.269 E020.54.40.156 Color_251ACI
N052.15.25.269 E020.54.40.156 N052.15.25.083 E020.54.40.085 Color_251ACI
N052.15.25.083 E020.54.40.085 N052.15.23.508 E020.54.38.105 Color_251ACI
N052.15.23.508 E020.54.38.105 N052.15.23.437 E020.54.37.917 Color_251ACI
N052.15.23.437 E020.54.37.917 N052.15.23.329 E020.54.37.666 Color_251ACI
N052.15.23.329 E020.54.37.666 N052.15.23.296 E020.54.37.420 Color_251ACI
N052.15.23.296 E020.54.37.420 N052.15.23.301 E020.54.37.175 Color_251ACI
N052.15.23.301 E020.54.37.175 N052.15.23.386 E020.54.36.689 Color_251ACI
N052.15.23.386 E020.54.36.689 N052.15.24.363 E020.54.34.594 Color_251ACI
N052.15.24.363 E020.54.34.594 N052.15.24.143 E020.54.34.338 Color_251ACI
N052.15.24.143 E020.54.34.338 N052.15.24.262 E020.54.34.038 Color_251ACI
N052.15.24.262 E020.54.34.038 N052.15.23.127 E020.54.32.570 Color_251ACI
N052.15.23.127 E020.54.32.570 N052.15.21.800 E020.54.35.260 Color_251ACI
N052.15.21.800 E020.54.35.260 N052.15.21.053 E020.54.35.099 Color_251ACI
N052.15.21.053 E020.54.35.099 N052.15.19.993 E020.54.33.635 Color_251ACI
N052.15.19.993 E020.54.33.635 N052.15.19.602 E020.54.34.473 Color_251ACI
N052.15.19.602 E020.54.34.473 N052.15.31.144 E020.54.48.729 Color_251ACI
N052.15.31.144 E020.54.48.729 N052.15.37.848 E020.54.43.374 Color_251ACI
N052.15.37.848 E020.54.43.374 N052.15.56.406 E020.54.28.086 Color_251ACI
N052.15.56.406 E020.54.28.086 N052.15.57.171 E020.54.29.289 Color_251ACI
N052.15.57.171 E020.54.29.289 N052.15.53.610 E020.54.54.598 Color_251ACI
N052.15.53.610 E020.54.54.598 N052.15.54.765 E020.54.54.964 Color_251ACI
N052.15.54.765 E020.54.54.964 N052.15.54.414 E020.54.57.642 Color_251ACI
N052.15.54.414 E020.54.57.642 N052.15.54.971 E020.54.57.916 Color_251ACI
N052.15.54.971 E020.54.57.916 N052.15.55.280 E020.54.57.442 Color_251ACI
N052.15.55.280 E020.54.57.442 N052.15.58.967 E020.54.58.795 Color_251ACI
N052.15.58.967 E020.54.58.795 N052.16.00.503 E020.54.56.913 Color_251ACI
N052.16.00.503 E020.54.56.913 N052.16.02.031 E020.54.57.420 Color_251ACI
N052.16.02.031 E020.54.57.420 N052.16.02.247 E020.54.55.960 Color_251ACI
N052.16.02.247 E020.54.55.960 N052.16.01.714 E020.54.56.362 Color_251ACI
N052.16.01.714 E020.54.56.362 N052.15.54.342 E020.54.53.594 Color_251ACI
N052.15.54.342 E020.54.53.594 N052.15.58.105 E020.54.27.498 Color_251ACI
N052.15.58.105 E020.54.27.498 N052.15.58.503 E020.54.26.293 Color_251ACI
N052.15.58.503 E020.54.26.293 N052.16.06.923 E020.54.19.432 Color_251ACI
N052.16.06.923 E020.54.19.432 N052.16.07.335 E020.54.19.454 Color_251ACI
N052.16.07.335 E020.54.19.454 N052.16.07.555 E020.54.17.749 Color_251ACI
N052.16.07.555 E020.54.17.749 N052.15.58.487 E020.54.25.189 Color_251ACI
N052.15.58.487 E020.54.25.189 N052.16.03.071 E020.53.51.476 Color_251ACI
N052.16.03.071 E020.53.51.476 N052.16.03.797 E020.53.50.778 Color_251ACI
N052.16.03.797 E020.53.50.778 N052.16.10.761 E020.53.53.341 Color_251ACI
N052.16.10.761 E020.53.53.341 N052.16.10.901 E020.53.53.838 Color_251ACI
N052.16.10.901 E020.53.53.838 N052.16.11.118 E020.53.52.317 Color_251ACI
N052.16.11.118 E020.53.52.317 N052.16.08.662 E020.53.51.333 Color_251ACI
N052.16.08.662 E020.53.51.333 N052.16.03.262 E020.53.49.341 Color_251ACI
N052.16.03.262 E020.53.49.341 N052.16.02.693 E020.53.49.680 Color_251ACI
N052.15.55.086 E020.54.26.547 N052.15.55.046 E020.54.26.668 Color_251ACI
N052.16.13.910 E020.53.53.379 N052.16.13.477 E020.53.56.421 Color_251ACI
N052.16.13.477 E020.53.56.421 N052.16.14.932 E020.53.54.841 Color_251ACI
N052.16.14.932 E020.53.54.841 N052.16.21.632 E020.53.57.390 Color_251ACI
N052.16.21.632 E020.53.57.390 N052.16.22.076 E020.53.53.798 Color_251ACI
N052.16.22.076 E020.53.53.798 N052.16.21.590 E020.53.53.712 Color_251ACI
N052.16.21.590 E020.53.53.712 N052.16.21.283 E020.53.54.125 Color_251ACI
N052.16.21.283 E020.53.54.125 N052.16.17.486 E020.53.52.643 Color_251ACI
N052.16.17.486 E020.53.52.643 N052.16.13.910 E020.53.53.379 Color_251ACI
N052.15.59.202 E020.54.56.356 N052.16.00.206 E020.54.56.775 Color_251ACI
N052.16.00.206 E020.54.56.775 N052.15.58.978 E020.54.58.244 Color_251ACI
N052.15.58.978 E020.54.58.244 N052.15.59.202 E020.54.56.356 Color_251ACI
N052.15.24.953 E020.54.25.371 N052.15.25.133 E020.54.25.748 Color_251ACI
N052.15.25.133 E020.54.25.748 N052.15.25.163 E020.54.26.179 Color_251ACI
N052.15.25.163 E020.54.26.179 N052.15.25.150 E020.54.26.852 Color_251ACI
N052.15.25.150 E020.54.26.852 N052.15.25.106 E020.54.27.156 Color_251ACI
N052.15.25.106 E020.54.27.156 N052.15.25.063 E020.54.27.460 Color_251ACI
N052.15.25.063 E020.54.27.460 N052.15.24.983 E020.54.27.702 Color_251ACI
N052.15.24.983 E020.54.27.702 N052.15.24.867 E020.54.27.879 Color_251ACI
N052.15.24.867 E020.54.27.879 N052.15.24.637 E020.54.28.174 Color_251ACI
N052.15.24.637 E020.54.28.174 N052.15.24.447 E020.54.28.287 Color_251ACI
N052.15.24.447 E020.54.28.287 N052.15.24.219 E020.54.28.459 Color_251ACI
N052.15.24.219 E020.54.28.459 N052.15.24.069 E020.54.28.451 Color_251ACI
N052.15.24.069 E020.54.28.451 N052.15.23.844 E020.54.28.440 Color_251ACI
N052.15.23.844 E020.54.28.440 N052.15.23.584 E020.54.28.304 Color_251ACI
N052.15.23.584 E020.54.28.304 N052.15.21.090 E020.54.25.357 Color_251ACI
N052.15.21.090 E020.54.25.357 N052.15.20.945 E020.54.25.105 Color_251ACI
N052.15.20.945 E020.54.25.105 N052.15.20.839 E020.54.24.732 Color_251ACI
N052.15.20.839 E020.54.24.732 N052.15.20.809 E020.54.24.362 Color_251ACI
N052.15.20.809 E020.54.24.362 N052.15.20.817 E020.54.23.934 Color_251ACI
N052.15.20.817 E020.54.23.934 N052.15.20.862 E020.54.23.569 Color_251ACI
N052.15.20.862 E020.54.23.569 N052.15.20.944 E020.54.23.205 Color_251ACI
N052.15.20.944 E020.54.23.205 N052.15.21.023 E020.54.22.964 Color_251ACI
N052.15.21.023 E020.54.22.964 N052.15.21.180 E020.54.22.604 Color_251ACI
N052.15.21.180 E020.54.22.604 N052.15.21.334 E020.54.22.428 Color_251ACI
N052.15.21.334 E020.54.22.428 N052.15.21.487 E020.54.22.252 Color_251ACI
N052.15.21.487 E020.54.22.252 N052.15.21.601 E020.54.22.197 Color_251ACI
N052.15.21.601 E020.54.22.197 N052.15.21.752 E020.54.22.143 Color_251ACI
N052.15.21.752 E020.54.22.143 N052.15.21.865 E020.54.22.088 Color_251ACI
N052.15.21.865 E020.54.22.088 N052.15.21.979 E020.54.22.033 Color_251ACI
N052.15.21.979 E020.54.22.033 N052.15.22.166 E020.54.22.042 Color_251ACI
N052.15.22.166 E020.54.22.042 N052.15.22.279 E020.54.22.048 Color_251ACI
N052.15.22.279 E020.54.22.048 N052.15.22.427 E020.54.22.117 Color_251ACI
N052.15.22.427 E020.54.22.117 N052.15.24.953 E020.54.25.371 Color_251ACI
N052.15.51.593 E020.55.09.815 N052.15.50.243 E020.55.19.550 Color_251ACI
N052.15.52.100 E020.55.08.799 N052.15.50.581 E020.55.19.567 Color_251ACI
N052.16.12.435 E020.55.20.013 N052.16.14.071 E020.55.20.771 Color_251ACI
N052.16.14.970 E020.55.20.817 N052.16.14.970 E020.55.20.817 Color_251ACI
N052.16.14.970 E020.55.20.817 N052.16.15.822 E020.55.17.429 Color_251ACI
N052.16.15.822 E020.55.17.429 N052.16.16.143 E020.55.16.342 Color_251ACI
N052.16.16.143 E020.55.16.342 N052.16.16.422 E020.55.15.499 Color_251ACI
N052.16.16.422 E020.55.15.499 N052.16.18.509 E020.55.10.275 Color_251ACI
N052.16.18.509 E020.55.10.275 N052.16.20.078 E020.55.06.678 Color_251ACI
N052.16.20.078 E020.55.06.678 N052.16.21.943 E020.55.03.281 Color_251ACI
N052.16.21.943 E020.55.03.281 N052.16.22.745 E020.55.02.525 Color_251ACI
N052.16.22.745 E020.55.02.525 N052.16.23.089 E020.55.02.175 Color_251ACI
N052.16.23.089 E020.55.02.175 N052.16.23.656 E020.55.01.959 Color_251ACI
N052.16.23.656 E020.55.01.959 N052.16.23.957 E020.55.01.913 Color_251ACI
N052.16.23.957 E020.55.01.913 N052.16.24.145 E020.55.01.862 Color_251ACI
N052.16.24.145 E020.55.01.862 N052.16.24.259 E020.55.01.806 Color_251ACI
N052.16.15.195 E020.55.20.828 N052.16.15.764 E020.55.18.529 Color_251ACI
N052.16.15.764 E020.55.18.529 N052.16.16.368 E020.55.16.354 Color_251ACI
N052.16.16.368 E020.55.16.354 N052.16.17.316 E020.55.13.829 Color_251ACI
N052.16.17.316 E020.55.13.829 N052.16.18.301 E020.55.11.367 Color_251ACI
N052.16.18.301 E020.55.11.367 N052.16.20.107 E020.55.07.109 Color_251ACI
N052.16.20.107 E020.55.07.109 N052.16.21.971 E020.55.03.773 Color_251ACI
N052.16.21.971 E020.55.03.773 N052.16.22.509 E020.55.03.126 Color_251ACI
N052.16.22.509 E020.55.03.126 N052.16.23.044 E020.55.02.602 Color_251ACI
N052.16.23.044 E020.55.02.602 N052.16.23.422 E020.55.02.437 Color_251ACI
N052.16.23.422 E020.55.02.437 N052.16.23.875 E020.55.02.277 Color_251ACI
N052.16.23.875 E020.55.02.277 N052.16.24.063 E020.55.02.225 Color_251ACI
N052.16.18.537 E020.54.53.179 N052.16.14.049 E020.55.12.130 Color_251ACI
N052.16.14.049 E020.55.12.130 N052.16.12.048 E020.55.20.667 Color_251ACI
N052.16.12.392 E020.55.20.317 N052.16.12.272 E020.55.20.679 Color_251ACI
N052.16.12.392 E020.55.20.317 N052.16.13.359 E020.55.20.734 Color_251ACI
N052.16.03.262 E020.53.49.341 N052.16.03.957 E020.53.44.413 Color_251ACI
N052.16.03.957 E020.53.44.413 N052.16.09.275 E020.53.46.708 Color_251ACI
N052.16.09.275 E020.53.46.708 N052.16.08.624 E020.53.51.331 Color_251ACI
N052.15.59.282 E020.53.51.588 N052.15.57.859 E020.53.51.454 Color_251ACI
N052.15.57.859 E020.53.51.454 N052.15.57.916 E020.53.48.516 Color_251ACI
N052.15.57.916 E020.53.48.516 N052.15.59.227 E020.53.48.583 Color_251ACI
N052.15.59.227 E020.53.48.583 N052.15.59.655 E020.53.49.708 Color_251ACI
N052.15.59.655 E020.53.49.708 N052.16.00.211 E020.53.50.043 Color_251ACI
N052.16.01.338 E020.53.51.939 N052.16.01.122 E020.53.51.437 Color_251ACI
N052.16.01.122 E020.53.51.437 N052.15.59.708 E020.53.50.875 Color_251ACI
N052.15.59.708 E020.53.50.875 N052.15.59.282 E020.53.51.588 Color_251ACI
N052.16.08.490 E020.53.52.489 N052.16.08.056 E020.53.55.531 Color_251ACI
N052.16.08.056 E020.53.55.531 N052.16.03.848 E020.53.54.028 Color_251ACI
N052.16.03.848 E020.53.54.028 N052.16.02.882 E020.54.01.332 Color_251ACI
N052.16.02.882 E020.54.01.332 N052.16.01.765 E020.54.00.907 Color_251ACI
N052.16.26.294 E020.55.01.237 N052.16.26.476 E020.55.01.552 Color_251ACI
N052.16.26.476 E020.55.01.552 N052.16.28.702 E020.55.06.691 Color_251ACI
N052.16.28.702 E020.55.06.691 N052.16.29.816 E020.55.09.199 Color_251ACI
N052.16.25.961 E020.55.01.036 N052.16.29.804 E020.55.09.812 Color_251ACI
N052.15.43.951 E020.53.29.662 N052.15.43.712 E020.53.30.385 Color_251ACI
N052.15.43.712 E020.53.30.385 N052.15.43.080 E020.53.32.068 Color_251ACI
N052.15.43.080 E020.53.32.068 N052.15.43.411 E020.53.34.353 Color_251ACI
N052.15.43.411 E020.53.34.353 N052.15.45.119 E020.53.48.902 Color_251ACI
N052.15.45.119 E020.53.48.902 N052.15.46.053 E020.53.54.955 Color_251ACI
N052.16.18.619 E020.54.52.816 N052.16.19.887 E020.54.47.304 Color_251ACI
N052.16.19.887 E020.54.47.304 N052.16.28.661 E020.54.10.190 Color_251ACI
N052.16.28.661 E020.54.10.190 N052.16.29.620 E020.54.09.075 Color_251ACI
N052.16.29.620 E020.54.09.075 N052.16.30.618 E020.54.07.839 Color_251ACI
N052.16.30.618 E020.54.07.839 N052.16.31.001 E020.54.07.430 Color_251ACI
N052.16.30.531 E020.54.08.509 N052.16.30.991 E020.54.07.981 Color_251ACI
N052.15.15.640 E020.53.52.662 N052.15.31.461 E020.53.51.144 Color_251ACI
N052.15.31.461 E020.53.51.144 N052.15.32.738 E020.53.51.086 Color_251ACI
N052.15.32.738 E020.53.51.086 N052.15.33.337 E020.53.51.117 Color_251ACI
N052.15.33.337 E020.53.51.117 N052.15.36.339 E020.53.45.204 Color_251ACI
N052.15.36.339 E020.53.45.204 N052.15.42.436 E020.53.32.403 Color_251ACI
N052.15.42.436 E020.53.32.403 N052.15.43.534 E020.53.29.886 Color_251ACI
N052.15.43.534 E020.53.29.886 N052.15.43.614 E020.53.29.644 Color_251ACI
N052.15.58.573 E020.54.14.838 N052.15.58.260 E020.54.17.457 Color_251ACI
N052.15.58.260 E020.54.17.457 N052.15.58.017 E020.54.18.425 Color_251ACI
N052.15.58.017 E020.54.18.425 N052.15.56.902 E020.54.21.799 Color_251ACI
N052.15.56.902 E020.54.21.799 N052.15.55.189 E020.54.27.043 Color_251ACI
N052.15.55.189 E020.54.27.043 N052.15.54.916 E020.54.27.580 Color_251ACI
N052.15.54.916 E020.54.27.580 N052.15.54.604 E020.54.28.177 Color_251ACI
N052.15.54.604 E020.54.28.177 N052.15.54.335 E020.54.28.531 Color_251ACI
N052.15.54.335 E020.54.28.531 N052.15.54.067 E020.54.28.824 Color_251ACI
N052.15.54.067 E020.54.28.824 N052.15.53.611 E020.54.29.107 Color_251ACI
N052.15.53.611 E020.54.29.107 N052.15.53.157 E020.54.29.328 Color_251ACI
N052.15.53.157 E020.54.29.328 N052.15.52.894 E020.54.29.376 Color_251ACI
N052.15.52.894 E020.54.29.376 N052.15.52.071 E020.54.29.273 Color_251ACI
N052.15.52.416 E020.54.28.862 N052.15.52.827 E020.54.28.944 Color_251ACI
N052.15.52.827 E020.54.28.944 N052.15.53.090 E020.54.28.896 Color_251ACI
N052.15.53.090 E020.54.28.896 N052.15.53.506 E020.54.28.734 Color_251ACI
N052.15.53.506 E020.54.28.734 N052.15.53.771 E020.54.28.625 Color_251ACI
N052.15.53.771 E020.54.28.625 N052.15.53.962 E020.54.28.451 Color_251ACI
N052.15.53.962 E020.54.28.451 N052.15.54.191 E020.54.28.217 Color_251ACI
N052.15.54.191 E020.54.28.217 N052.15.54.423 E020.54.27.861 Color_251ACI
N052.15.54.423 E020.54.27.861 N052.15.54.966 E020.54.26.909 Color_251ACI
N052.15.54.966 E020.54.26.909 N052.15.55.084 E020.54.26.608 Color_251ACI
N052.15.53.908 E020.54.54.675 N052.15.51.766 E020.55.08.598 Color_251ACI
N052.15.51.766 E020.55.08.598 N052.15.51.678 E020.55.09.268 Color_251ACI
N052.15.51.593 E020.55.09.815 N052.15.51.148 E020.55.09.547 Color_251ACI
N052.15.51.148 E020.55.09.547 N052.15.48.725 E020.55.08.749 Color_251ACI
N052.15.51.678 E020.55.09.268 N052.15.50.819 E020.55.09.101 Color_251ACI
N052.15.50.819 E020.55.09.101 N052.15.50.037 E020.55.08.816 Color_251ACI
N052.15.50.037 E020.55.08.816 N052.15.49.220 E020.55.08.406 Color_251ACI
N052.15.49.220 E020.55.08.406 N052.15.48.771 E020.55.08.322 Color_251ACI
N052.16.01.087 E020.53.45.430 N052.16.00.827 E020.53.45.294 Color_251ACI
N052.16.00.827 E020.53.45.294 N052.16.00.256 E020.53.49.677 Color_251ACI
N052.16.00.256 E020.53.49.677 N052.16.01.484 E020.53.50.169 Color_251ACI
N052.16.01.484 E020.53.50.169 N052.16.01.439 E020.53.50.534 Color_251ACI
N052.16.01.439 E020.53.50.534 N052.16.00.211 E020.53.50.043 Color_251ACI
N052.16.02.264 E020.53.52.538 N052.16.01.867 E020.53.51.721 Color_251ACI
N052.16.01.867 E020.53.51.721 N052.16.01.602 E020.53.51.830 Color_251ACI
N052.16.01.602 E020.53.51.830 N052.15.58.573 E020.54.14.838 Color_251ACI
N052.16.02.693 E020.53.49.680 N052.16.01.739 E020.53.50.550 Color_251ACI
N052.16.01.739 E020.53.50.550 N052.16.02.221 E020.53.46.959 Color_251ACI
N052.16.20.099 E020.54.34.324 N052.16.20.508 E020.54.32.568 Color_251ACI
N052.16.21.062 E020.54.34.925 N052.16.20.099 E020.54.34.324 Color_251ACI
N052.16.21.472 E020.54.33.108 N052.16.21.062 E020.54.34.925 Color_251ACI
N052.16.20.508 E020.54.32.568 N052.16.21.435 E020.54.33.106 Color_251ACI
N052.16.21.736 E020.54.27.177 N052.16.21.069 E020.54.26.775 Color_251ACI
N052.16.20.714 E020.54.31.598 N052.16.21.736 E020.54.27.177 Color_251ACI
N052.16.20.046 E020.54.31.196 N052.16.20.714 E020.54.31.598 Color_251ACI
N052.16.21.069 E020.54.26.775 N052.16.20.046 E020.54.31.196 Color_251ACI
N052.16.18.687 E020.54.29.717 N052.16.20.168 E020.54.30.712 Color_251ACI
N052.16.18.075 E020.54.32.321 N052.16.18.687 E020.54.29.717 Color_251ACI
N052.16.19.559 E020.54.33.132 N052.16.18.075 E020.54.32.321 Color_251ACI
N052.16.20.168 E020.54.30.712 N052.16.19.559 E020.54.33.132 Color_251ACI
N052.16.18.654 E020.54.37.314 N052.16.16.808 E020.54.45.615 Color_251ACI
N052.16.19.284 E020.54.37.714 N052.16.18.654 E020.54.37.314 Color_251ACI
N052.16.17.401 E020.54.45.951 N052.16.19.284 E020.54.37.714 Color_251ACI
N052.16.16.808 E020.54.45.615 N052.16.17.401 E020.54.45.951 Color_251ACI
N052.16.22.376 E020.54.36.831 N052.16.21.375 E020.54.36.228 Color_251ACI
N052.16.21.375 E020.54.36.228 N052.16.21.186 E020.54.36.280 Color_251ACI
N052.16.21.186 E020.54.36.280 N052.16.21.107 E020.54.36.521 Color_251ACI
N052.16.21.107 E020.54.36.521 N052.16.20.805 E020.54.38.589 Color_251ACI
N052.16.20.805 E020.54.38.589 N052.16.20.409 E020.54.41.632 Color_251ACI
N052.16.20.409 E020.54.41.632 N052.16.20.279 E020.54.42.545 Color_251ACI
N052.16.20.279 E020.54.42.545 N052.16.20.073 E020.54.43.515 Color_251ACI
N052.16.20.073 E020.54.43.515 N052.16.19.294 E020.54.46.968 Color_251ACI
N052.16.19.294 E020.54.46.968 N052.16.18.721 E020.54.49.451 Color_251ACI
N052.16.18.721 E020.54.49.451 N052.16.18.069 E020.54.52.175 Color_251ACI
N052.16.18.069 E020.54.52.175 N052.16.18.064 E020.54.52.420 Color_251ACI
N052.16.18.064 E020.54.52.420 N052.16.18.174 E020.54.52.548 Color_251ACI
N052.16.18.174 E020.54.52.548 N052.16.18.619 E020.54.52.816 Color_251ACI
N052.16.22.419 E020.54.36.527 N052.16.21.456 E020.54.35.926 Color_251ACI
N052.16.21.456 E020.54.35.926 N052.16.21.385 E020.54.35.677 Color_251ACI
N052.16.21.385 E020.54.35.677 N052.16.21.351 E020.54.35.491 Color_251ACI
N052.16.21.351 E020.54.35.491 N052.16.21.471 E020.54.35.130 Color_251ACI
N052.16.21.471 E020.54.35.130 N052.16.24.534 E020.54.22.051 Color_251ACI
N052.16.24.534 E020.54.22.051 N052.16.24.312 E020.54.21.917 Color_251ACI
N052.16.24.312 E020.54.21.917 N052.16.21.325 E020.54.34.938 Color_251ACI
N052.16.21.325 E020.54.34.938 N052.16.21.204 E020.54.35.361 Color_251ACI
N052.16.21.204 E020.54.35.361 N052.16.21.127 E020.54.35.480 Color_251ACI
N052.16.21.127 E020.54.35.480 N052.16.21.051 E020.54.35.537 Color_251ACI
N052.16.21.051 E020.54.35.537 N052.16.20.938 E020.54.35.531 Color_251ACI
N052.16.20.938 E020.54.35.531 N052.16.20.085 E020.54.35.059 Color_251ACI
N052.16.20.085 E020.54.35.059 N052.16.19.900 E020.54.34.927 Color_251ACI
N052.16.19.900 E020.54.34.927 N052.16.19.826 E020.54.34.862 Color_251ACI
N052.16.19.826 E020.54.34.862 N052.16.19.754 E020.54.34.735 Color_251ACI
N052.16.19.754 E020.54.34.735 N052.16.19.717 E020.54.34.672 Color_251ACI
N052.16.19.717 E020.54.34.672 N052.16.19.718 E020.54.34.611 Color_251ACI
N052.16.19.718 E020.54.34.611 N052.16.19.720 E020.54.34.550 Color_251ACI
N052.16.19.720 E020.54.34.550 N052.16.19.759 E020.54.34.429 Color_251ACI
N052.16.19.759 E020.54.34.429 N052.16.19.798 E020.54.34.370 Color_251ACI
N052.16.19.798 E020.54.34.370 N052.16.19.837 E020.54.34.311 Color_251ACI
N052.16.19.837 E020.54.34.311 N052.16.19.912 E020.54.34.315 Color_251ACI
N052.16.19.912 E020.54.34.315 N052.16.19.987 E020.54.34.318 Color_251ACI
N052.16.19.987 E020.54.34.318 N052.16.20.099 E020.54.34.324 Color_251ACI
N052.16.20.508 E020.54.32.568 N052.16.20.714 E020.54.31.598 Color_251ACI
N052.16.21.736 E020.54.27.177 N052.16.23.002 E020.54.21.788 Color_251ACI
N052.16.23.003 E020.54.21.727 N052.16.22.409 E020.54.21.390 Color_251ACI
N052.16.22.409 E020.54.21.390 N052.16.21.069 E020.54.26.775 Color_251ACI
N052.16.18.075 E020.54.32.321 N052.16.17.668 E020.54.32.055 Color_251ACI
N052.16.17.668 E020.54.32.055 N052.16.17.546 E020.54.32.539 Color_251ACI
N052.16.17.546 E020.54.32.539 N052.16.19.102 E020.54.33.538 Color_251ACI
N052.16.19.102 E020.54.33.538 N052.16.19.212 E020.54.33.666 Color_251ACI
N052.16.19.212 E020.54.33.666 N052.16.19.246 E020.54.33.852 Color_251ACI
N052.16.19.246 E020.54.33.852 N052.16.19.244 E020.54.33.913 Color_251ACI
N052.16.19.244 E020.54.33.913 N052.16.19.200 E020.54.34.278 Color_251ACI
N052.16.19.200 E020.54.34.278 N052.16.18.906 E020.54.35.918 Color_251ACI
N052.16.18.906 E020.54.35.918 N052.16.19.464 E020.54.36.130 Color_251ACI
N052.16.17.216 E020.54.45.819 N052.16.17.063 E020.54.45.995 Color_251ACI
N052.16.17.063 E020.54.45.995 N052.16.17.060 E020.54.46.118 Color_251ACI
N052.16.17.060 E020.54.46.118 N052.16.17.018 E020.54.46.361 Color_251ACI
N052.16.17.018 E020.54.46.361 N052.16.16.969 E020.54.46.971 Color_251ACI
N052.16.16.969 E020.54.46.971 N052.16.17.001 E020.54.47.279 Color_251ACI
N052.16.17.001 E020.54.47.279 N052.16.17.072 E020.54.47.467 Color_251ACI
N052.16.17.072 E020.54.47.467 N052.16.17.404 E020.54.47.729 Color_251ACI
N052.16.17.790 E020.54.41.314 N052.16.15.822 E020.54.40.294 Color_251ACI
N052.16.15.822 E020.54.40.294 N052.16.15.739 E020.54.40.719 Color_251ACI
N052.16.15.739 E020.54.40.719 N052.16.17.708 E020.54.41.678 Color_251ACI
N052.16.16.808 E020.54.45.615 N052.16.16.734 E020.54.47.510 Color_251ACI
N052.16.16.734 E020.54.47.510 N052.16.16.428 E020.54.47.801 Color_251ACI
N052.16.16.428 E020.54.47.801 N052.16.15.057 E020.54.46.934 Color_251ACI
N052.16.15.057 E020.54.46.934 N052.16.15.023 E020.54.46.749 Color_251ACI
N052.16.15.023 E020.54.46.749 N052.16.14.957 E020.54.46.316 Color_251ACI
N052.16.14.957 E020.54.46.316 N052.16.14.323 E020.54.46.100 Color_251ACI
N052.16.14.323 E020.54.46.100 N052.16.14.156 E020.54.47.011 Color_251ACI
N052.16.14.156 E020.54.47.011 N052.16.14.863 E020.54.47.292 Color_251ACI
N052.16.14.863 E020.54.47.292 N052.16.15.088 E020.54.47.304 Color_251ACI
N052.16.15.088 E020.54.47.304 N052.16.16.421 E020.54.48.169 Color_251ACI
N052.16.16.421 E020.54.48.169 N052.16.14.584 E020.54.55.979 Color_251ACI
N052.16.14.584 E020.54.55.979 N052.16.14.542 E020.54.56.222 Color_251ACI
N052.16.14.542 E020.54.56.222 N052.16.14.538 E020.54.56.406 Color_251ACI
N052.16.14.538 E020.54.56.406 N052.16.14.498 E020.54.56.526 Color_251ACI
N052.16.14.498 E020.54.56.526 N052.16.14.532 E020.54.56.712 Color_251ACI
N052.16.14.532 E020.54.56.712 N052.16.14.530 E020.54.56.834 Color_251ACI
N052.16.14.530 E020.54.56.834 N052.16.14.601 E020.54.57.022 Color_251ACI
N052.16.14.601 E020.54.57.022 N052.16.14.674 E020.54.57.148 Color_251ACI
N052.16.14.674 E020.54.57.148 N052.16.14.783 E020.54.57.338 Color_251ACI
N052.16.14.783 E020.54.57.338 N052.16.14.892 E020.54.57.527 Color_251ACI
N052.16.14.892 E020.54.57.527 N052.16.15.077 E020.54.57.659 Color_251ACI
N052.16.15.077 E020.54.57.659 N052.16.15.299 E020.54.57.793 Color_251ACI
N052.16.15.299 E020.54.57.793 N052.16.15.706 E020.54.58.059 Color_251ACI
N052.16.15.706 E020.54.58.059 N052.16.16.042 E020.54.58.138 Color_251ACI
N052.16.16.042 E020.54.58.138 N052.16.16.305 E020.54.58.151 Color_251ACI
N052.16.16.305 E020.54.58.151 N052.16.16.493 E020.54.58.099 Color_251ACI
N052.16.16.493 E020.54.58.099 N052.16.16.722 E020.54.57.866 Color_251ACI
N052.15.58.378 E020.54.13.296 N052.15.58.189 E020.54.13.347 Color_251ACI
N052.15.58.189 E020.54.13.347 N052.15.58.152 E020.54.13.346 Color_251ACI
N052.15.58.152 E020.54.13.346 N052.15.57.518 E020.54.13.129 Color_251ACI
N052.15.57.518 E020.54.13.129 N052.15.56.487 E020.54.12.157 Color_251ACI
N052.15.56.487 E020.54.12.157 N052.15.56.084 E020.54.11.646 Color_251ACI
N052.15.46.053 E020.53.54.955 N052.15.46.412 E020.53.55.831 Color_251ACI
N052.15.46.412 E020.53.55.831 N052.15.50.310 E020.54.01.791 Color_251ACI
N052.15.50.310 E020.54.01.791 N052.15.53.662 E020.54.06.926 Color_251ACI
N052.15.53.662 E020.54.06.926 N052.15.56.682 E020.54.11.738 Color_251ACI
N052.15.56.682 E020.54.11.738 N052.15.57.679 E020.54.12.586 Color_251ACI
N052.15.57.679 E020.54.12.586 N052.15.58.200 E020.54.12.796 Color_251ACI
N052.15.58.200 E020.54.12.796 N052.15.58.465 E020.54.12.626 Color_251ACI
N052.16.20.144 E020.54.47.624 N052.16.15.295 E020.55.07.781 Color_251ACI
N052.16.15.295 E020.55.07.781 N052.16.12.435 E020.55.20.013 Color_251ACI
N052.16.18.537 E020.54.53.179 N052.16.18.019 E020.54.52.846 Color_251ACI
N052.16.18.019 E020.54.52.846 N052.16.17.908 E020.54.52.779 Color_251ACI
N052.16.17.908 E020.54.52.779 N052.16.17.830 E020.54.52.898 Color_251ACI
N052.16.17.830 E020.54.52.898 N052.16.17.786 E020.54.53.263 Color_251ACI
N052.16.20.144 E020.54.47.624 N052.16.22.871 E020.54.54.014 Color_251ACI
N052.16.22.871 E020.54.54.014 N052.16.25.817 E020.55.00.722 Color_251ACI
N052.16.25.923 E020.55.01.034 N052.16.25.768 E020.55.01.332 Color_251ACI
N052.16.25.768 E020.55.01.332 N052.16.25.577 E020.55.01.506 Color_251ACI
N052.16.25.577 E020.55.01.506 N052.16.25.390 E020.55.01.497 Color_251ACI
N052.16.25.390 E020.55.01.497 N052.16.25.130 E020.55.01.361 Color_251ACI
N052.16.25.130 E020.55.01.361 N052.16.24.980 E020.55.01.353 Color_251ACI
N052.16.24.980 E020.55.01.353 N052.16.24.789 E020.55.01.527 Color_251ACI
N052.16.24.789 E020.55.01.527 N052.16.24.709 E020.55.01.768 Color_251ACI
N052.16.24.709 E020.55.01.768 N052.16.24.630 E020.55.02.009 Color_251ACI
N052.16.24.630 E020.55.02.009 N052.16.24.514 E020.55.02.187 Color_251ACI
N052.16.24.514 E020.55.02.187 N052.16.24.288 E020.55.02.237 Color_251ACI
N052.16.24.288 E020.55.02.237 N052.16.24.063 E020.55.02.225 Color_251ACI
N052.16.24.259 E020.55.01.806 N052.16.24.410 E020.55.01.753 Color_251ACI
N052.16.24.410 E020.55.01.753 N052.16.24.568 E020.55.01.332 Color_251ACI
N052.16.24.568 E020.55.01.332 N052.16.24.836 E020.55.01.039 Color_251ACI
N052.16.24.836 E020.55.01.039 N052.16.25.062 E020.55.00.990 Color_251ACI
N052.16.25.062 E020.55.00.990 N052.16.25.398 E020.55.01.068 Color_251ACI
N052.16.25.398 E020.55.01.068 N052.16.25.546 E020.55.01.137 Color_251ACI
N052.16.25.546 E020.55.01.137 N052.16.25.700 E020.55.00.961 Color_251ACI
N052.16.25.700 E020.55.00.961 N052.16.25.779 E020.55.00.720 Color_251ACI
N052.16.26.294 E020.55.01.237 N052.16.20.266 E020.54.47.140 Color_251ACI
N052.16.29.612 E020.54.09.504 N052.16.28.920 E020.54.10.387 Color_251ACI
N052.16.28.920 E020.54.10.387 N052.16.28.560 E020.54.11.533 Color_251ACI
N052.16.28.560 E020.54.11.533 N052.16.24.555 E020.54.28.792 Color_251ACI
N052.16.24.555 E020.54.28.792 N052.16.20.266 E020.54.47.140 Color_251ACI
N052.16.16.722 E020.54.57.866 N052.16.16.926 E020.54.57.019 Color_251ACI
N052.16.16.926 E020.54.57.019 N052.16.17.787 E020.54.53.202 Color_251ACI
N052.16.16.047 E020.54.57.893 N052.16.16.272 E020.54.57.904 Color_251ACI
N052.16.16.272 E020.54.57.904 N052.16.16.423 E020.54.57.851 Color_251ACI
N052.16.16.423 E020.54.57.851 N052.16.16.576 E020.54.57.675 Color_251ACI
N052.16.16.576 E020.54.57.675 N052.16.16.738 E020.54.57.070 Color_251ACI
N052.16.16.738 E020.54.57.070 N052.16.17.682 E020.54.52.829 Color_251ACI
N052.16.17.682 E020.54.52.829 N052.16.17.685 E020.54.52.645 Color_251ACI
N052.16.17.685 E020.54.52.645 N052.16.17.687 E020.54.52.523 Color_251ACI
N052.16.17.687 E020.54.52.523 N052.16.17.651 E020.54.52.460 Color_251ACI
N052.16.17.651 E020.54.52.460 N052.16.16.019 E020.54.51.518 Color_251ACI
N052.16.16.019 E020.54.51.518 N052.16.15.165 E020.54.55.029 Color_251ACI
N052.16.15.165 E020.54.55.029 N052.16.15.423 E020.54.55.226 Color_251ACI
N052.16.15.423 E020.54.55.226 N052.16.15.178 E020.54.56.255 Color_251ACI
N052.16.15.178 E020.54.56.255 N052.16.14.956 E020.54.56.121 Color_251ACI
N052.16.14.956 E020.54.56.121 N052.16.14.919 E020.54.56.119 Color_251ACI
N052.16.14.919 E020.54.56.119 N052.16.14.880 E020.54.56.178 Color_251ACI
N052.16.14.880 E020.54.56.178 N052.16.14.879 E020.54.56.240 Color_251ACI
N052.16.14.879 E020.54.56.240 N052.16.14.839 E020.54.56.360 Color_251ACI
N052.16.14.839 E020.54.56.360 N052.16.14.799 E020.54.56.481 Color_251ACI
N052.16.14.799 E020.54.56.481 N052.16.14.797 E020.54.56.603 Color_251ACI
N052.16.14.797 E020.54.56.603 N052.16.14.794 E020.54.56.725 Color_251ACI
N052.16.14.794 E020.54.56.725 N052.16.14.828 E020.54.56.911 Color_251ACI
N052.16.14.828 E020.54.56.911 N052.16.14.900 E020.54.57.099 Color_251ACI
N052.16.14.900 E020.54.57.099 N052.16.15.010 E020.54.57.227 Color_251ACI
N052.16.15.010 E020.54.57.227 N052.16.15.119 E020.54.57.416 Color_251ACI
N052.16.15.119 E020.54.57.416 N052.16.15.266 E020.54.57.546 Color_251ACI
N052.16.15.266 E020.54.57.546 N052.16.15.415 E020.54.57.615 Color_251ACI
N052.16.15.415 E020.54.57.615 N052.16.15.600 E020.54.57.747 Color_251ACI
N052.16.15.600 E020.54.57.747 N052.16.15.823 E020.54.57.820 Color_251ACI
N052.16.15.823 E020.54.57.820 N052.16.16.010 E020.54.57.891 Color_251ACI
N052.16.16.010 E020.54.57.891 N052.16.16.084 E020.54.57.895 Color_251ACI
N052.16.16.788 E020.54.50.516 N052.16.16.270 E020.54.50.183 Color_251ACI
N052.16.16.270 E020.54.50.183 N052.16.16.025 E020.54.51.212 Color_251ACI
N052.16.16.025 E020.54.51.212 N052.16.17.656 E020.54.52.215 Color_251ACI
N052.16.17.656 E020.54.52.215 N052.16.17.768 E020.54.52.221 Color_251ACI
N052.16.17.768 E020.54.52.221 N052.16.17.847 E020.54.52.041 Color_251ACI
N052.16.17.847 E020.54.52.041 N052.16.17.967 E020.54.51.618 Color_251ACI
N052.16.17.967 E020.54.51.618 N052.16.18.013 E020.54.51.191 Color_251ACI
N052.16.18.013 E020.54.51.191 N052.16.18.014 E020.54.51.130 Color_251ACI
N052.16.18.014 E020.54.51.130 N052.16.17.754 E020.54.50.994 Color_251ACI
N052.16.18.798 E020.54.45.471 N052.16.19.317 E020.54.45.743 Color_251ACI
N052.16.19.317 E020.54.45.743 N052.16.19.353 E020.54.45.868 Color_251ACI
N052.16.19.353 E020.54.45.868 N052.16.19.350 E020.54.45.990 Color_251ACI
N052.16.19.350 E020.54.45.990 N052.16.18.170 E020.54.50.832 Color_251ACI
N052.16.18.170 E020.54.50.832 N052.16.18.095 E020.54.50.828 Color_251ACI
N052.16.18.095 E020.54.50.828 N052.16.17.798 E020.54.50.690 Color_251ACI
N052.16.19.994 E020.54.39.773 N052.16.20.403 E020.54.39.977 Color_251ACI
N052.16.20.403 E020.54.39.977 N052.16.20.933 E020.54.35.776 Color_251ACI
N052.16.20.933 E020.54.35.776 N052.16.19.931 E020.54.35.235 Color_251ACI
N052.16.19.931 E020.54.35.235 N052.16.19.858 E020.54.35.170 Color_251ACI
N052.16.19.858 E020.54.35.170 N052.16.19.783 E020.54.35.166 Color_251ACI
N052.16.19.783 E020.54.35.166 N052.16.19.708 E020.54.35.162 Color_251ACI
N052.16.19.708 E020.54.35.162 N052.16.19.633 E020.54.35.158 Color_251ACI
N052.16.19.633 E020.54.35.158 N052.16.19.594 E020.54.35.218 Color_251ACI
N052.16.19.594 E020.54.35.218 N052.16.19.557 E020.54.35.216 Color_251ACI
N052.16.19.557 E020.54.35.216 N052.16.19.517 E020.54.35.336 Color_251ACI
N052.16.19.517 E020.54.35.336 N052.16.19.516 E020.54.35.397 Color_251ACI
N052.16.19.516 E020.54.35.397 N052.16.19.515 E020.54.35.459 Color_251ACI
N052.16.19.515 E020.54.35.459 N052.16.19.551 E020.54.35.522 Color_251ACI
N052.16.19.551 E020.54.35.522 N052.16.19.550 E020.54.35.583 Color_251ACI
N052.16.19.550 E020.54.35.583 N052.16.19.587 E020.54.35.585 Color_251ACI
N052.16.19.912 E020.54.40.136 N052.16.20.321 E020.54.40.341 Color_251ACI
N052.16.20.321 E020.54.40.341 N052.16.20.354 E020.54.40.588 Color_251ACI
N052.16.20.354 E020.54.40.588 N052.16.20.350 E020.54.40.771 Color_251ACI
N052.16.20.350 E020.54.40.771 N052.16.20.182 E020.54.41.743 Color_251ACI
N052.16.20.182 E020.54.41.743 N052.16.19.554 E020.54.45.143 Color_251ACI
N052.16.19.554 E020.54.45.143 N052.16.19.514 E020.54.45.263 Color_251ACI
N052.16.19.514 E020.54.45.263 N052.16.19.324 E020.54.45.376 Color_251ACI
N052.16.19.324 E020.54.45.376 N052.16.18.841 E020.54.45.167 Color_251ACI
N052.15.58.039 E020.54.17.262 N052.15.57.875 E020.54.17.989 Color_251ACI
N052.15.57.875 E020.54.17.989 N052.15.57.557 E020.54.18.953 Color_251ACI
N052.15.57.557 E020.54.18.953 N052.15.57.115 E020.54.20.462 Color_251ACI
N052.15.57.115 E020.54.20.462 N052.15.55.084 E020.54.26.608 Color_251ACI
N052.15.24.032 E020.54.22.567 N052.15.25.282 E020.54.19.934 Color_251ACI
N052.15.25.282 E020.54.19.934 N052.15.25.287 E020.54.19.690 Color_251ACI
N052.15.25.287 E020.54.19.690 N052.15.25.176 E020.54.19.623 Color_251ACI
N052.15.25.176 E020.54.19.623 N052.15.24.801 E020.54.19.603 Color_251ACI
N052.15.24.801 E020.54.19.603 N052.15.23.526 E020.54.19.599 Color_251ACI
N052.15.23.526 E020.54.19.599 N052.15.22.562 E020.54.20.959 Color_251ACI
N052.15.24.032 E020.54.22.567 N052.15.24.027 E020.54.22.812 Color_251ACI
N052.15.24.027 E020.54.22.812 N052.15.26.886 E020.54.26.267 Color_251ACI
N052.15.26.886 E020.54.26.267 N052.15.26.961 E020.54.26.271 Color_251ACI
N052.15.26.961 E020.54.26.271 N052.15.27.351 E020.54.25.494 Color_251ACI
N052.15.26.292 E020.54.25.991 N052.15.24.174 E020.54.30.785 Color_251ACI
N052.15.24.174 E020.54.30.785 N052.15.23.991 E020.54.30.531 Color_251ACI
N052.15.23.991 E020.54.30.531 N052.15.26.145 E020.54.25.800 Color_251ACI
N052.15.26.145 E020.54.25.800 N052.15.20.060 E020.54.18.441 Color_251ACI
N052.15.20.060 E020.54.18.441 N052.15.19.905 E020.54.18.679 Color_251ACI
N052.15.19.905 E020.54.18.679 N052.15.18.477 E020.54.24.672 Color_251ACI
N052.15.18.477 E020.54.24.672 N052.15.16.751 E020.54.30.589 Color_251ACI
N052.15.16.751 E020.54.30.589 N052.15.13.424 E020.54.37.772 Color_251ACI
N052.15.20.259 E020.54.17.839 N052.15.20.289 E020.54.18.208 Color_251ACI
N052.15.20.289 E020.54.18.208 N052.15.22.562 E020.54.20.959 Color_251ACI
N052.15.16.631 E020.54.28.990 N052.15.16.665 E020.54.29.175 Color_251ACI
N052.15.16.665 E020.54.29.175 N052.15.16.740 E020.54.29.179 Color_251ACI
N052.15.16.740 E020.54.29.179 N052.15.16.815 E020.54.29.183 Color_251ACI
N052.15.16.815 E020.54.29.183 N052.15.18.376 E020.54.24.054 Color_251ACI
N052.15.18.376 E020.54.24.054 N052.15.19.357 E020.54.19.876 Color_251ACI
N052.15.16.631 E020.54.28.990 N052.15.16.947 E020.54.24.287 Color_251ACI
N052.15.16.947 E020.54.24.287 N052.15.19.247 E020.54.19.748 Color_251ACI
N052.15.19.247 E020.54.19.748 N052.15.19.356 E020.54.19.937 Color_251ACI
N052.15.20.259 E020.54.17.839 N052.15.33.396 E020.53.51.978 Color_251ACI
N052.15.33.396 E020.53.51.978 N052.15.34.556 E020.53.52.099 Color_251ACI
N052.15.34.556 E020.53.52.099 N052.15.36.167 E020.53.52.181 Color_251ACI
N052.15.36.167 E020.53.52.181 N052.15.37.028 E020.53.52.287 Color_251ACI
N052.15.37.028 E020.53.52.287 N052.15.37.440 E020.53.52.308 Color_251ACI
N052.15.37.440 E020.53.52.308 N052.15.39.309 E020.53.52.649 Color_251ACI
N052.15.39.309 E020.53.52.649 N052.15.40.543 E020.53.52.834 Color_251ACI
N052.15.40.543 E020.53.52.834 N052.15.41.966 E020.53.52.968 Color_251ACI
N052.15.41.966 E020.53.52.968 N052.15.43.869 E020.53.53.495 Color_251ACI
N052.15.43.869 E020.53.53.495 N052.15.44.051 E020.53.53.749 Color_251ACI
N052.15.44.051 E020.53.53.749 N052.15.45.347 E020.53.54.612 Color_251ACI
N052.15.45.347 E020.53.54.612 N052.15.48.074 E020.53.59.103 Color_251ACI
N052.15.48.074 E020.53.59.103 N052.15.56.084 E020.54.11.646 Color_251ACI
N052.15.45.418 E020.53.52.900 N052.15.44.787 E020.53.48.640 Color_251ACI
N052.15.44.787 E020.53.48.640 N052.15.43.041 E020.53.34.088 Color_251ACI
N052.15.43.041 E020.53.34.088 N052.15.42.810 E020.53.32.422 Color_251ACI
N052.15.42.810 E020.53.32.422 N052.15.36.401 E020.53.45.882 Color_251ACI
N052.15.36.401 E020.53.45.882 N052.15.33.667 E020.53.51.502 Color_251ACI
N052.15.33.667 E020.53.51.502 N052.15.33.926 E020.53.51.699 Color_251ACI
N052.15.33.926 E020.53.51.699 N052.15.35.537 E020.53.51.781 Color_251ACI
N052.15.35.537 E020.53.51.781 N052.15.36.399 E020.53.51.825 Color_251ACI
N052.15.36.399 E020.53.51.825 N052.15.36.811 E020.53.51.847 Color_251ACI
N052.15.36.811 E020.53.51.847 N052.15.38.679 E020.53.52.249 Color_251ACI
N052.15.38.679 E020.53.52.249 N052.15.39.951 E020.53.52.436 Color_251ACI
N052.15.39.951 E020.53.52.436 N052.15.41.336 E020.53.52.569 Color_251ACI
N052.15.41.336 E020.53.52.569 N052.15.42.458 E020.53.52.749 Color_251ACI
N052.15.42.458 E020.53.52.749 N052.15.43.952 E020.53.53.070 Color_251ACI
N052.15.43.952 E020.53.53.070 N052.15.44.986 E020.53.53.920 Color_251ACI
N052.15.44.986 E020.53.53.920 N052.15.45.097 E020.53.53.987 Color_251ACI
N052.15.45.097 E020.53.53.987 N052.15.45.249 E020.53.53.872 Color_251ACI
N052.15.45.249 E020.53.53.872 N052.15.45.365 E020.53.53.694 Color_251ACI
N052.15.45.365 E020.53.53.694 N052.15.45.448 E020.53.53.269 Color_251ACI
N052.15.45.448 E020.53.53.269 N052.15.45.419 E020.53.52.839 Color_251ACI
N052.15.15.626 E020.53.53.396 N052.15.31.334 E020.53.51.934 Color_251ACI
N052.15.31.334 E020.53.51.934 N052.15.32.573 E020.53.51.875 Color_251ACI
N052.15.32.573 E020.53.51.875 N052.15.32.597 E020.53.52.550 Color_251ACI
N052.15.32.597 E020.53.52.550 N052.15.16.613 E020.54.24.086 Color_251ACI
N052.15.16.613 E020.54.24.086 N052.15.16.310 E020.54.30.076 Color_251ACI
N052.15.16.310 E020.54.30.076 N052.15.13.458 E020.54.35.997 Color_251ACI
N052.15.21.473 E020.54.21.026 N052.15.21.950 E020.54.21.602 Color_251ACI
N052.15.21.950 E020.54.21.602 N052.15.21.685 E020.54.21.711 Color_251ACI
N052.15.21.685 E020.54.21.711 N052.15.21.420 E020.54.21.820 Color_251ACI
N052.15.21.420 E020.54.21.820 N052.15.21.115 E020.54.22.111 Color_251ACI
N052.15.21.115 E020.54.22.111 N052.15.20.999 E020.54.22.289 Color_251ACI
N052.15.20.999 E020.54.22.289 N052.15.20.843 E020.54.22.587 Color_251ACI
N052.15.20.843 E020.54.22.587 N052.15.20.725 E020.54.22.887 Color_251ACI
N052.15.20.725 E020.54.22.887 N052.15.20.682 E020.54.23.130 Color_251ACI
N052.15.20.682 E020.54.23.130 N052.15.20.602 E020.54.23.433 Color_251ACI
N052.15.20.602 E020.54.23.433 N052.15.20.556 E020.54.23.859 Color_251ACI
N052.15.20.556 E020.54.23.859 N052.15.20.543 E020.54.24.533 Color_251ACI
N052.15.20.543 E020.54.24.533 N052.15.20.608 E020.54.25.026 Color_251ACI
N052.15.20.608 E020.54.25.026 N052.15.20.678 E020.54.25.336 Color_251ACI
N052.15.20.678 E020.54.25.336 N052.15.20.823 E020.54.25.589 Color_251ACI
N052.15.20.823 E020.54.25.589 N052.15.20.968 E020.54.25.841 Color_251ACI
N052.15.20.968 E020.54.25.841 N052.15.23.168 E020.54.28.466 Color_251ACI
N052.15.23.168 E020.54.28.466 N052.15.23.426 E020.54.28.725 Color_251ACI
N052.15.23.426 E020.54.28.725 N052.15.23.761 E020.54.28.864 Color_251ACI
N052.15.23.761 E020.54.28.864 N052.15.24.061 E020.54.28.880 Color_251ACI
N052.15.24.061 E020.54.28.880 N052.15.24.363 E020.54.28.773 Color_251ACI
N052.15.24.363 E020.54.28.773 N052.15.24.552 E020.54.28.660 Color_251ACI
N052.15.24.552 E020.54.28.660 N052.15.24.780 E020.54.28.549 Color_251ACI
N052.15.24.780 E020.54.28.549 N052.15.24.972 E020.54.28.314 Color_251ACI
N052.15.24.972 E020.54.28.314 N052.15.25.126 E020.54.28.076 Color_251ACI
N052.15.25.126 E020.54.28.076 N052.15.25.247 E020.54.27.654 Color_251ACI
N052.15.25.247 E020.54.27.654 N052.15.25.366 E020.54.27.292 Color_251ACI
N052.15.25.366 E020.54.27.292 N052.15.25.448 E020.54.26.929 Color_251ACI
N052.15.25.448 E020.54.26.929 N052.15.25.454 E020.54.26.623 Color_251ACI
N052.15.25.454 E020.54.26.623 N052.15.25.426 E020.54.26.131 Color_251ACI
N052.15.25.426 E020.54.26.131 N052.15.25.395 E020.54.25.823 Color_251ACI
N052.15.25.395 E020.54.25.823 N052.15.25.219 E020.54.25.201 Color_251ACI
N052.15.25.219 E020.54.25.201 N052.15.25.036 E020.54.24.947 Color_251ACI
N052.15.25.036 E020.54.24.947 N052.15.21.595 E020.54.20.542 Color_251ACI
N052.15.21.595 E020.54.20.542 N052.15.21.437 E020.54.20.963 Color_251ACI
N052.15.21.437 E020.54.20.963 N052.15.21.473 E020.54.21.026 Color_251ACI
N052.15.52.440 E020.55.08.633 N052.15.52.100 E020.55.08.799 Color_251ACI
N052.16.00.523 E020.53.49.446 N052.16.00.824 E020.53.47.439 Color_251ACI
N052.16.00.824 E020.53.47.439 N052.16.01.827 E020.53.47.919 Color_251ACI
N052.16.01.827 E020.53.47.919 N052.16.01.565 E020.53.49.867 Color_251ACI
N052.16.02.221 E020.53.46.959 N052.16.01.998 E020.53.46.825 Color_251ACI
N052.15.50.585 E020.54.28.523 N052.15.48.080 E020.54.28.088 Color_251ACI
N052.15.52.416 E020.54.28.862 N052.15.50.585 E020.54.28.523 Color_251ACI
N052.16.01.338 E020.53.51.939 N052.15.58.039 E020.54.17.262 Color_251ACI
N052.15.52.440 E020.55.08.633 N052.15.54.429 E020.54.54.886 Color_251ACI
N052.15.44.475 E020.54.28.332 N052.15.45.876 E020.54.27.669 Color_251ACI
N052.15.45.876 E020.54.27.669 N052.15.46.960 E020.54.27.847 Color_251ACI
N052.15.46.960 E020.54.27.847 N052.15.48.080 E020.54.28.088 Color_251ACI
N052.16.29.612 E020.54.09.504 N052.16.30.531 E020.54.08.509 Color_251ACI
N052.16.00.868 E020.53.47.074 N052.16.01.087 E020.53.45.430 Color_251ACI
N052.16.01.872 E020.53.47.554 N052.16.00.868 E020.53.47.074 Color_251ACI
N052.16.01.961 E020.53.46.823 N052.16.01.872 E020.53.47.554 Color_251ACI
N052.15.51.593 E020.55.09.815 N052.15.50.243 E020.55.19.550 Color_251ACI
N052.15.52.100 E020.55.08.799 N052.15.50.581 E020.55.19.567 Color_251ACI
N052.16.12.435 E020.55.20.013 N052.16.14.071 E020.55.20.771 Color_251ACI
N052.16.14.970 E020.55.20.817 N052.16.14.970 E020.55.20.817 Color_251ACI
N052.16.14.970 E020.55.20.817 N052.16.15.822 E020.55.17.429 Color_251ACI
N052.16.15.822 E020.55.17.429 N052.16.16.143 E020.55.16.342 Color_251ACI
N052.16.16.143 E020.55.16.342 N052.16.16.422 E020.55.15.499 Color_251ACI
N052.16.16.422 E020.55.15.499 N052.16.18.509 E020.55.10.275 Color_251ACI
N052.16.18.509 E020.55.10.275 N052.16.20.078 E020.55.06.678 Color_251ACI
N052.16.20.078 E020.55.06.678 N052.16.21.943 E020.55.03.281 Color_251ACI
N052.16.21.943 E020.55.03.281 N052.16.22.745 E020.55.02.525 Color_251ACI
N052.16.22.745 E020.55.02.525 N052.16.23.089 E020.55.02.175 Color_251ACI
N052.16.23.089 E020.55.02.175 N052.16.23.656 E020.55.01.959 Color_251ACI
N052.16.23.656 E020.55.01.959 N052.16.23.957 E020.55.01.913 Color_251ACI
N052.16.23.957 E020.55.01.913 N052.16.24.145 E020.55.01.862 Color_251ACI
N052.16.24.145 E020.55.01.862 N052.16.24.259 E020.55.01.806 Color_251ACI
N052.16.23.422 E020.55.02.437 N052.16.23.875 E020.55.02.277 Color_251ACI
N052.16.23.875 E020.55.02.277 N052.16.24.063 E020.55.02.225 Color_251ACI
N052.16.15.195 E020.55.20.828 N052.16.15.764 E020.55.18.529 Color_251ACI
N052.16.15.764 E020.55.18.529 N052.16.16.368 E020.55.16.354 Color_251ACI
N052.16.16.368 E020.55.16.354 N052.16.17.316 E020.55.13.829 Color_251ACI
N052.16.17.316 E020.55.13.829 N052.16.18.301 E020.55.11.367 Color_251ACI
N052.16.18.301 E020.55.11.367 N052.16.20.107 E020.55.07.109 Color_251ACI
N052.16.20.107 E020.55.07.109 N052.16.21.971 E020.55.03.773 Color_251ACI
N052.16.21.971 E020.55.03.773 N052.16.22.509 E020.55.03.126 Color_251ACI
N052.16.22.509 E020.55.03.126 N052.16.23.044 E020.55.02.602 Color_251ACI
N052.16.23.044 E020.55.02.602 N052.16.23.422 E020.55.02.437 Color_251ACI
N052.16.18.537 E020.54.53.179 N052.16.14.049 E020.55.12.130 Color_251ACI
N052.16.14.049 E020.55.12.130 N052.16.12.048 E020.55.20.667 Color_251ACI
N052.16.12.392 E020.55.20.317 N052.16.12.272 E020.55.20.679 Color_251ACI
N052.16.12.392 E020.55.20.317 N052.16.13.359 E020.55.20.734 Color_251ACI
N052.16.03.262 E020.53.49.341 N052.16.03.957 E020.53.44.413 Color_251ACI
N052.16.03.957 E020.53.44.413 N052.16.09.275 E020.53.46.708 Color_251ACI
N052.16.09.275 E020.53.46.708 N052.16.08.624 E020.53.51.331 Color_251ACI
N052.16.01.338 E020.53.51.939 N052.16.01.122 E020.53.51.437 Color_251ACI
N052.16.01.122 E020.53.51.437 N052.15.59.708 E020.53.50.875 Color_251ACI
N052.15.59.708 E020.53.50.875 N052.15.59.282 E020.53.51.588 Color_251ACI
N052.15.59.282 E020.53.51.588 N052.15.57.859 E020.53.51.454 Color_251ACI
N052.15.57.859 E020.53.51.454 N052.15.57.916 E020.53.48.516 Color_251ACI
N052.15.57.916 E020.53.48.516 N052.15.59.227 E020.53.48.583 Color_251ACI
N052.15.59.227 E020.53.48.583 N052.15.59.655 E020.53.49.708 Color_251ACI
N052.15.59.655 E020.53.49.708 N052.16.00.211 E020.53.50.043 Color_251ACI
N052.16.08.490 E020.53.52.489 N052.16.08.056 E020.53.55.531 Color_251ACI
N052.16.08.056 E020.53.55.531 N052.16.03.848 E020.53.54.028 Color_251ACI
N052.16.03.848 E020.53.54.028 N052.16.02.882 E020.54.01.332 Color_251ACI
N052.16.02.882 E020.54.01.332 N052.16.01.765 E020.54.00.907 Color_251ACI
N052.16.26.294 E020.55.01.237 N052.16.26.476 E020.55.01.552 Color_251ACI
N052.16.26.476 E020.55.01.552 N052.16.28.702 E020.55.06.691 Color_251ACI
N052.16.28.702 E020.55.06.691 N052.16.29.816 E020.55.09.199 Color_251ACI
N052.16.25.961 E020.55.01.036 N052.16.29.804 E020.55.09.812 Color_251ACI
N052.15.43.951 E020.53.29.662 N052.15.43.712 E020.53.30.385 Color_251ACI
N052.15.43.712 E020.53.30.385 N052.15.43.080 E020.53.32.068 Color_251ACI
N052.15.43.080 E020.53.32.068 N052.15.43.411 E020.53.34.353 Color_251ACI
N052.15.43.411 E020.53.34.353 N052.15.45.119 E020.53.48.902 Color_251ACI
N052.15.45.119 E020.53.48.902 N052.15.46.053 E020.53.54.955 Color_251ACI
N052.16.18.619 E020.54.52.816 N052.16.19.887 E020.54.47.304 Color_251ACI
N052.16.19.887 E020.54.47.304 N052.16.28.661 E020.54.10.190 Color_251ACI
N052.16.28.661 E020.54.10.190 N052.16.29.620 E020.54.09.075 Color_251ACI
N052.16.29.620 E020.54.09.075 N052.16.30.618 E020.54.07.839 Color_251ACI
N052.16.30.618 E020.54.07.839 N052.16.31.001 E020.54.07.430 Color_251ACI
N052.16.30.531 E020.54.08.509 N052.16.30.991 E020.54.07.981 Color_251ACI
N052.15.15.640 E020.53.52.662 N052.15.31.461 E020.53.51.144 Color_251ACI
N052.15.31.461 E020.53.51.144 N052.15.32.738 E020.53.51.086 Color_251ACI
N052.15.32.738 E020.53.51.086 N052.15.33.337 E020.53.51.117 Color_251ACI
N052.15.33.337 E020.53.51.117 N052.15.36.339 E020.53.45.204 Color_251ACI
N052.15.36.339 E020.53.45.204 N052.15.42.436 E020.53.32.403 Color_251ACI
N052.15.42.436 E020.53.32.403 N052.15.43.534 E020.53.29.886 Color_251ACI
N052.15.43.534 E020.53.29.886 N052.15.43.614 E020.53.29.644 Color_251ACI
N052.15.58.573 E020.54.14.838 N052.15.58.260 E020.54.17.457 Color_251ACI
N052.15.58.260 E020.54.17.457 N052.15.58.017 E020.54.18.425 Color_251ACI
N052.15.58.017 E020.54.18.425 N052.15.56.902 E020.54.21.799 Color_251ACI
N052.15.56.902 E020.54.21.799 N052.15.55.189 E020.54.27.043 Color_251ACI
N052.15.55.189 E020.54.27.043 N052.15.54.916 E020.54.27.580 Color_251ACI
N052.15.54.916 E020.54.27.580 N052.15.54.604 E020.54.28.177 Color_251ACI
N052.15.54.604 E020.54.28.177 N052.15.54.335 E020.54.28.531 Color_251ACI
N052.15.54.335 E020.54.28.531 N052.15.54.067 E020.54.28.824 Color_251ACI
N052.15.54.067 E020.54.28.824 N052.15.53.611 E020.54.29.107 Color_251ACI
N052.15.53.611 E020.54.29.107 N052.15.53.157 E020.54.29.328 Color_251ACI
N052.15.53.157 E020.54.29.328 N052.15.52.894 E020.54.29.376 Color_251ACI
N052.15.52.894 E020.54.29.376 N052.15.52.071 E020.54.29.273 Color_251ACI
N052.15.52.416 E020.54.28.862 N052.15.52.827 E020.54.28.944 Color_251ACI
N052.15.52.827 E020.54.28.944 N052.15.53.090 E020.54.28.896 Color_251ACI
N052.15.53.090 E020.54.28.896 N052.15.53.506 E020.54.28.734 Color_251ACI
N052.15.53.506 E020.54.28.734 N052.15.53.771 E020.54.28.625 Color_251ACI
N052.15.53.771 E020.54.28.625 N052.15.53.962 E020.54.28.451 Color_251ACI
N052.15.53.962 E020.54.28.451 N052.15.54.191 E020.54.28.217 Color_251ACI
N052.15.54.191 E020.54.28.217 N052.15.54.423 E020.54.27.861 Color_251ACI
N052.15.54.423 E020.54.27.861 N052.15.54.966 E020.54.26.909 Color_251ACI
N052.15.54.966 E020.54.26.909 N052.15.55.084 E020.54.26.608 Color_251ACI
N052.15.53.908 E020.54.54.675 N052.15.51.766 E020.55.08.598 Color_251ACI
N052.15.51.766 E020.55.08.598 N052.15.51.678 E020.55.09.268 Color_251ACI
N052.15.51.593 E020.55.09.815 N052.15.51.148 E020.55.09.547 Color_251ACI
N052.15.51.148 E020.55.09.547 N052.15.48.725 E020.55.08.749 Color_251ACI
N052.15.51.678 E020.55.09.268 N052.15.50.819 E020.55.09.101 Color_251ACI
N052.15.50.819 E020.55.09.101 N052.15.50.037 E020.55.08.816 Color_251ACI
N052.15.50.037 E020.55.08.816 N052.15.49.220 E020.55.08.406 Color_251ACI
N052.15.49.220 E020.55.08.406 N052.15.48.771 E020.55.08.322 Color_251ACI
N052.16.01.087 E020.53.45.430 N052.16.00.827 E020.53.45.294 Color_251ACI
N052.16.00.827 E020.53.45.294 N052.16.00.256 E020.53.49.677 Color_251ACI
N052.16.00.256 E020.53.49.677 N052.16.01.484 E020.53.50.169 Color_251ACI
N052.16.01.484 E020.53.50.169 N052.16.01.439 E020.53.50.534 Color_251ACI
N052.16.01.439 E020.53.50.534 N052.16.00.211 E020.53.50.043 Color_251ACI
N052.16.02.264 E020.53.52.538 N052.16.01.867 E020.53.51.721 Color_251ACI
N052.16.01.867 E020.53.51.721 N052.16.01.602 E020.53.51.830 Color_251ACI
N052.16.01.602 E020.53.51.830 N052.15.58.573 E020.54.14.838 Color_251ACI
N052.16.02.693 E020.53.49.680 N052.16.01.739 E020.53.50.550 Color_251ACI
N052.16.01.739 E020.53.50.550 N052.16.02.221 E020.53.46.959 Color_251ACI
N052.16.20.099 E020.54.34.324 N052.16.20.508 E020.54.32.568 Color_251ACI
N052.16.21.062 E020.54.34.925 N052.16.20.099 E020.54.34.324 Color_251ACI
N052.16.21.472 E020.54.33.108 N052.16.21.062 E020.54.34.925 Color_251ACI
N052.16.20.508 E020.54.32.568 N052.16.21.435 E020.54.33.106 Color_251ACI
N052.16.21.736 E020.54.27.177 N052.16.21.069 E020.54.26.775 Color_251ACI
N052.16.20.714 E020.54.31.598 N052.16.21.736 E020.54.27.177 Color_251ACI
N052.16.20.046 E020.54.31.196 N052.16.20.714 E020.54.31.598 Color_251ACI
N052.16.21.069 E020.54.26.775 N052.16.20.046 E020.54.31.196 Color_251ACI
N052.16.18.687 E020.54.29.717 N052.16.20.168 E020.54.30.712 Color_251ACI
N052.16.18.075 E020.54.32.321 N052.16.18.687 E020.54.29.717 Color_251ACI
N052.16.19.559 E020.54.33.132 N052.16.18.075 E020.54.32.321 Color_251ACI
N052.16.20.168 E020.54.30.712 N052.16.19.559 E020.54.33.132 Color_251ACI
N052.16.18.654 E020.54.37.314 N052.16.16.808 E020.54.45.615 Color_251ACI
N052.16.19.284 E020.54.37.714 N052.16.18.654 E020.54.37.314 Color_251ACI
N052.16.17.401 E020.54.45.951 N052.16.19.284 E020.54.37.714 Color_251ACI
N052.16.16.808 E020.54.45.615 N052.16.17.401 E020.54.45.951 Color_251ACI
N052.15.47.427 E020.54.28.912 N052.15.47.433 E020.54.28.606 Color_251ACI
N052.15.47.433 E020.54.28.606 N052.15.45.904 E020.54.28.160 Color_251ACI
N052.16.22.376 E020.54.36.831 N052.16.21.375 E020.54.36.228 Color_251ACI
N052.16.21.375 E020.54.36.228 N052.16.21.186 E020.54.36.280 Color_251ACI
N052.16.21.186 E020.54.36.280 N052.16.21.107 E020.54.36.521 Color_251ACI
N052.16.21.107 E020.54.36.521 N052.16.20.805 E020.54.38.589 Color_251ACI
N052.16.20.805 E020.54.38.589 N052.16.20.409 E020.54.41.632 Color_251ACI
N052.16.20.409 E020.54.41.632 N052.16.20.279 E020.54.42.545 Color_251ACI
N052.16.20.279 E020.54.42.545 N052.16.20.073 E020.54.43.515 Color_251ACI
N052.16.20.073 E020.54.43.515 N052.16.19.294 E020.54.46.968 Color_251ACI
N052.16.19.294 E020.54.46.968 N052.16.18.721 E020.54.49.451 Color_251ACI
N052.16.18.721 E020.54.49.451 N052.16.18.069 E020.54.52.175 Color_251ACI
N052.16.18.069 E020.54.52.175 N052.16.18.064 E020.54.52.420 Color_251ACI
N052.16.18.064 E020.54.52.420 N052.16.18.174 E020.54.52.548 Color_251ACI
N052.16.18.174 E020.54.52.548 N052.16.18.619 E020.54.52.816 Color_251ACI
N052.16.22.419 E020.54.36.527 N052.16.21.456 E020.54.35.926 Color_251ACI
N052.16.21.456 E020.54.35.926 N052.16.21.385 E020.54.35.677 Color_251ACI
N052.16.21.385 E020.54.35.677 N052.16.21.351 E020.54.35.491 Color_251ACI
N052.16.21.351 E020.54.35.491 N052.16.21.471 E020.54.35.130 Color_251ACI
N052.16.21.471 E020.54.35.130 N052.16.24.534 E020.54.22.051 Color_251ACI
N052.16.24.534 E020.54.22.051 N052.16.24.312 E020.54.21.917 Color_251ACI
N052.16.24.312 E020.54.21.917 N052.16.21.325 E020.54.34.938 Color_251ACI
N052.16.21.325 E020.54.34.938 N052.16.21.204 E020.54.35.361 Color_251ACI
N052.16.21.204 E020.54.35.361 N052.16.21.127 E020.54.35.480 Color_251ACI
N052.16.21.127 E020.54.35.480 N052.16.21.051 E020.54.35.537 Color_251ACI
N052.16.21.051 E020.54.35.537 N052.16.20.938 E020.54.35.531 Color_251ACI
N052.16.20.938 E020.54.35.531 N052.16.20.085 E020.54.35.059 Color_251ACI
N052.16.20.085 E020.54.35.059 N052.16.19.900 E020.54.34.927 Color_251ACI
N052.16.19.900 E020.54.34.927 N052.16.19.826 E020.54.34.862 Color_251ACI
N052.16.19.826 E020.54.34.862 N052.16.19.754 E020.54.34.735 Color_251ACI
N052.16.19.754 E020.54.34.735 N052.16.19.717 E020.54.34.672 Color_251ACI
N052.16.19.717 E020.54.34.672 N052.16.19.718 E020.54.34.611 Color_251ACI
N052.16.19.718 E020.54.34.611 N052.16.19.720 E020.54.34.550 Color_251ACI
N052.16.19.720 E020.54.34.550 N052.16.19.759 E020.54.34.429 Color_251ACI
N052.16.19.759 E020.54.34.429 N052.16.19.798 E020.54.34.370 Color_251ACI
N052.16.19.798 E020.54.34.370 N052.16.19.837 E020.54.34.311 Color_251ACI
N052.16.19.837 E020.54.34.311 N052.16.19.912 E020.54.34.315 Color_251ACI
N052.16.19.912 E020.54.34.315 N052.16.19.987 E020.54.34.318 Color_251ACI
N052.16.19.987 E020.54.34.318 N052.16.20.099 E020.54.34.324 Color_251ACI
N052.16.20.508 E020.54.32.568 N052.16.20.714 E020.54.31.598 Color_251ACI
N052.16.21.736 E020.54.27.177 N052.16.23.002 E020.54.21.788 Color_251ACI
N052.16.23.003 E020.54.21.727 N052.16.22.409 E020.54.21.390 Color_251ACI
N052.16.22.409 E020.54.21.390 N052.16.21.069 E020.54.26.775 Color_251ACI
N052.16.18.075 E020.54.32.321 N052.16.17.668 E020.54.32.055 Color_251ACI
N052.16.17.668 E020.54.32.055 N052.16.17.546 E020.54.32.539 Color_251ACI
N052.16.17.546 E020.54.32.539 N052.16.19.102 E020.54.33.538 Color_251ACI
N052.16.19.102 E020.54.33.538 N052.16.19.212 E020.54.33.666 Color_251ACI
N052.16.19.212 E020.54.33.666 N052.16.19.246 E020.54.33.852 Color_251ACI
N052.16.19.246 E020.54.33.852 N052.16.19.244 E020.54.33.913 Color_251ACI
N052.16.19.244 E020.54.33.913 N052.16.19.200 E020.54.34.278 Color_251ACI
N052.16.19.200 E020.54.34.278 N052.16.18.906 E020.54.35.918 Color_251ACI
N052.16.18.906 E020.54.35.918 N052.16.19.464 E020.54.36.130 Color_251ACI
N052.16.17.216 E020.54.45.819 N052.16.17.063 E020.54.45.995 Color_251ACI
N052.16.17.063 E020.54.45.995 N052.16.17.060 E020.54.46.118 Color_251ACI
N052.16.17.060 E020.54.46.118 N052.16.17.018 E020.54.46.361 Color_251ACI
N052.16.17.018 E020.54.46.361 N052.16.16.969 E020.54.46.971 Color_251ACI
N052.16.16.969 E020.54.46.971 N052.16.17.001 E020.54.47.279 Color_251ACI
N052.16.17.001 E020.54.47.279 N052.16.17.072 E020.54.47.467 Color_251ACI
N052.16.17.072 E020.54.47.467 N052.16.17.404 E020.54.47.729 Color_251ACI
N052.16.17.790 E020.54.41.314 N052.16.15.822 E020.54.40.294 Color_251ACI
N052.16.15.822 E020.54.40.294 N052.16.15.739 E020.54.40.719 Color_251ACI
N052.16.15.739 E020.54.40.719 N052.16.17.708 E020.54.41.678 Color_251ACI
N052.16.16.808 E020.54.45.615 N052.16.16.734 E020.54.47.510 Color_251ACI
N052.16.16.734 E020.54.47.510 N052.16.16.428 E020.54.47.801 Color_251ACI
N052.16.16.428 E020.54.47.801 N052.16.15.057 E020.54.46.934 Color_251ACI
N052.16.15.057 E020.54.46.934 N052.16.15.023 E020.54.46.749 Color_251ACI
N052.16.15.023 E020.54.46.749 N052.16.14.957 E020.54.46.316 Color_251ACI
N052.16.14.957 E020.54.46.316 N052.16.14.323 E020.54.46.100 Color_251ACI
N052.16.14.323 E020.54.46.100 N052.16.14.156 E020.54.47.011 Color_251ACI
N052.16.14.156 E020.54.47.011 N052.16.14.863 E020.54.47.292 Color_251ACI
N052.16.14.863 E020.54.47.292 N052.16.15.088 E020.54.47.304 Color_251ACI
N052.16.15.088 E020.54.47.304 N052.16.16.421 E020.54.48.169 Color_251ACI
N052.16.16.421 E020.54.48.169 N052.16.14.584 E020.54.55.979 Color_251ACI
N052.16.14.584 E020.54.55.979 N052.16.14.542 E020.54.56.222 Color_251ACI
N052.16.14.542 E020.54.56.222 N052.16.14.538 E020.54.56.406 Color_251ACI
N052.16.14.538 E020.54.56.406 N052.16.14.498 E020.54.56.526 Color_251ACI
N052.16.14.498 E020.54.56.526 N052.16.14.532 E020.54.56.712 Color_251ACI
N052.16.14.532 E020.54.56.712 N052.16.14.530 E020.54.56.834 Color_251ACI
N052.16.14.530 E020.54.56.834 N052.16.14.601 E020.54.57.022 Color_251ACI
N052.16.14.601 E020.54.57.022 N052.16.14.674 E020.54.57.148 Color_251ACI
N052.16.14.674 E020.54.57.148 N052.16.14.783 E020.54.57.338 Color_251ACI
N052.16.14.783 E020.54.57.338 N052.16.14.892 E020.54.57.527 Color_251ACI
N052.16.14.892 E020.54.57.527 N052.16.15.077 E020.54.57.659 Color_251ACI
N052.16.15.077 E020.54.57.659 N052.16.15.299 E020.54.57.793 Color_251ACI
N052.16.15.299 E020.54.57.793 N052.16.15.706 E020.54.58.059 Color_251ACI
N052.16.15.706 E020.54.58.059 N052.16.16.042 E020.54.58.138 Color_251ACI
N052.16.16.042 E020.54.58.138 N052.16.16.305 E020.54.58.151 Color_251ACI
N052.16.16.305 E020.54.58.151 N052.16.16.493 E020.54.58.099 Color_251ACI
N052.16.16.493 E020.54.58.099 N052.16.16.722 E020.54.57.866 Color_251ACI
N052.15.58.378 E020.54.13.296 N052.15.58.189 E020.54.13.347 Color_251ACI
N052.15.58.189 E020.54.13.347 N052.15.58.152 E020.54.13.346 Color_251ACI
N052.15.58.152 E020.54.13.346 N052.15.57.518 E020.54.13.129 Color_251ACI
N052.15.57.518 E020.54.13.129 N052.15.56.487 E020.54.12.157 Color_251ACI
N052.15.56.487 E020.54.12.157 N052.15.56.084 E020.54.11.646 Color_251ACI
N052.15.46.053 E020.53.54.955 N052.15.46.412 E020.53.55.831 Color_251ACI
N052.15.46.412 E020.53.55.831 N052.15.50.310 E020.54.01.791 Color_251ACI
N052.15.50.310 E020.54.01.791 N052.15.53.662 E020.54.06.926 Color_251ACI
N052.15.53.662 E020.54.06.926 N052.15.56.682 E020.54.11.738 Color_251ACI
N052.15.56.682 E020.54.11.738 N052.15.57.679 E020.54.12.586 Color_251ACI
N052.15.57.679 E020.54.12.586 N052.15.58.200 E020.54.12.796 Color_251ACI
N052.15.58.200 E020.54.12.796 N052.15.58.465 E020.54.12.626 Color_251ACI
N052.16.20.144 E020.54.47.624 N052.16.15.295 E020.55.07.781 Color_251ACI
N052.16.15.295 E020.55.07.781 N052.16.12.435 E020.55.20.013 Color_251ACI
N052.16.18.537 E020.54.53.179 N052.16.18.019 E020.54.52.846 Color_251ACI
N052.16.18.019 E020.54.52.846 N052.16.17.908 E020.54.52.779 Color_251ACI
N052.16.17.908 E020.54.52.779 N052.16.17.830 E020.54.52.898 Color_251ACI
N052.16.17.830 E020.54.52.898 N052.16.17.786 E020.54.53.263 Color_251ACI
N052.16.20.144 E020.54.47.624 N052.16.22.871 E020.54.54.014 Color_251ACI
N052.16.22.871 E020.54.54.014 N052.16.25.817 E020.55.00.722 Color_251ACI
N052.16.25.923 E020.55.01.034 N052.16.25.768 E020.55.01.332 Color_251ACI
N052.16.25.768 E020.55.01.332 N052.16.25.577 E020.55.01.506 Color_251ACI
N052.16.25.577 E020.55.01.506 N052.16.25.390 E020.55.01.497 Color_251ACI
N052.16.25.390 E020.55.01.497 N052.16.25.130 E020.55.01.361 Color_251ACI
N052.16.25.130 E020.55.01.361 N052.16.24.980 E020.55.01.353 Color_251ACI
N052.16.24.980 E020.55.01.353 N052.16.24.789 E020.55.01.527 Color_251ACI
N052.16.24.789 E020.55.01.527 N052.16.24.709 E020.55.01.768 Color_251ACI
N052.16.24.709 E020.55.01.768 N052.16.24.630 E020.55.02.009 Color_251ACI
N052.16.24.630 E020.55.02.009 N052.16.24.514 E020.55.02.187 Color_251ACI
N052.16.24.514 E020.55.02.187 N052.16.24.288 E020.55.02.237 Color_251ACI
N052.16.24.288 E020.55.02.237 N052.16.24.063 E020.55.02.225 Color_251ACI
N052.16.24.259 E020.55.01.806 N052.16.24.410 E020.55.01.753 Color_251ACI
N052.16.24.410 E020.55.01.753 N052.16.24.568 E020.55.01.332 Color_251ACI
N052.16.24.568 E020.55.01.332 N052.16.24.836 E020.55.01.039 Color_251ACI
N052.16.24.836 E020.55.01.039 N052.16.25.062 E020.55.00.990 Color_251ACI
N052.16.25.062 E020.55.00.990 N052.16.25.398 E020.55.01.068 Color_251ACI
N052.16.25.398 E020.55.01.068 N052.16.25.546 E020.55.01.137 Color_251ACI
N052.16.25.546 E020.55.01.137 N052.16.25.700 E020.55.00.961 Color_251ACI
N052.16.25.700 E020.55.00.961 N052.16.25.779 E020.55.00.720 Color_251ACI
N052.16.26.294 E020.55.01.237 N052.16.20.266 E020.54.47.140 Color_251ACI
N052.16.29.612 E020.54.09.504 N052.16.28.920 E020.54.10.387 Color_251ACI
N052.16.28.920 E020.54.10.387 N052.16.28.560 E020.54.11.533 Color_251ACI
N052.16.28.560 E020.54.11.533 N052.16.24.555 E020.54.28.792 Color_251ACI
N052.16.24.555 E020.54.28.792 N052.16.20.266 E020.54.47.140 Color_251ACI
N052.16.16.722 E020.54.57.866 N052.16.16.926 E020.54.57.019 Color_251ACI
N052.16.16.926 E020.54.57.019 N052.16.17.787 E020.54.53.202 Color_251ACI
N052.16.16.047 E020.54.57.893 N052.16.16.272 E020.54.57.904 Color_251ACI
N052.16.16.272 E020.54.57.904 N052.16.16.423 E020.54.57.851 Color_251ACI
N052.16.16.423 E020.54.57.851 N052.16.16.576 E020.54.57.675 Color_251ACI
N052.16.16.576 E020.54.57.675 N052.16.16.738 E020.54.57.070 Color_251ACI
N052.16.16.738 E020.54.57.070 N052.16.17.682 E020.54.52.829 Color_251ACI
N052.16.17.682 E020.54.52.829 N052.16.17.685 E020.54.52.645 Color_251ACI
N052.16.17.685 E020.54.52.645 N052.16.17.687 E020.54.52.523 Color_251ACI
N052.16.17.687 E020.54.52.523 N052.16.17.651 E020.54.52.460 Color_251ACI
N052.16.17.651 E020.54.52.460 N052.16.16.019 E020.54.51.518 Color_251ACI
N052.16.16.019 E020.54.51.518 N052.16.15.165 E020.54.55.029 Color_251ACI
N052.16.15.165 E020.54.55.029 N052.16.15.423 E020.54.55.226 Color_251ACI
N052.16.15.423 E020.54.55.226 N052.16.15.178 E020.54.56.255 Color_251ACI
N052.16.15.178 E020.54.56.255 N052.16.14.956 E020.54.56.121 Color_251ACI
N052.16.14.956 E020.54.56.121 N052.16.14.919 E020.54.56.119 Color_251ACI
N052.16.14.919 E020.54.56.119 N052.16.14.880 E020.54.56.178 Color_251ACI
N052.16.14.880 E020.54.56.178 N052.16.14.879 E020.54.56.240 Color_251ACI
N052.16.14.879 E020.54.56.240 N052.16.14.839 E020.54.56.360 Color_251ACI
N052.16.14.839 E020.54.56.360 N052.16.14.799 E020.54.56.481 Color_251ACI
N052.16.14.799 E020.54.56.481 N052.16.14.797 E020.54.56.603 Color_251ACI
N052.16.14.797 E020.54.56.603 N052.16.14.794 E020.54.56.725 Color_251ACI
N052.16.14.794 E020.54.56.725 N052.16.14.828 E020.54.56.911 Color_251ACI
N052.16.14.828 E020.54.56.911 N052.16.14.900 E020.54.57.099 Color_251ACI
N052.16.14.900 E020.54.57.099 N052.16.15.010 E020.54.57.227 Color_251ACI
N052.16.15.010 E020.54.57.227 N052.16.15.119 E020.54.57.416 Color_251ACI
N052.16.15.119 E020.54.57.416 N052.16.15.266 E020.54.57.546 Color_251ACI
N052.16.15.266 E020.54.57.546 N052.16.15.415 E020.54.57.615 Color_251ACI
N052.16.15.415 E020.54.57.615 N052.16.15.600 E020.54.57.747 Color_251ACI
N052.16.15.600 E020.54.57.747 N052.16.15.823 E020.54.57.820 Color_251ACI
N052.16.15.823 E020.54.57.820 N052.16.16.010 E020.54.57.891 Color_251ACI
N052.16.16.010 E020.54.57.891 N052.16.16.084 E020.54.57.895 Color_251ACI
N052.16.16.788 E020.54.50.516 N052.16.16.270 E020.54.50.183 Color_251ACI
N052.16.16.270 E020.54.50.183 N052.16.16.025 E020.54.51.212 Color_251ACI
N052.16.16.025 E020.54.51.212 N052.16.17.656 E020.54.52.215 Color_251ACI
N052.16.17.656 E020.54.52.215 N052.16.17.768 E020.54.52.221 Color_251ACI
N052.16.17.768 E020.54.52.221 N052.16.17.847 E020.54.52.041 Color_251ACI
N052.16.17.847 E020.54.52.041 N052.16.17.967 E020.54.51.618 Color_251ACI
N052.16.17.967 E020.54.51.618 N052.16.18.013 E020.54.51.191 Color_251ACI
N052.16.18.013 E020.54.51.191 N052.16.18.014 E020.54.51.130 Color_251ACI
N052.16.18.014 E020.54.51.130 N052.16.17.754 E020.54.50.994 Color_251ACI
N052.16.18.798 E020.54.45.471 N052.16.19.317 E020.54.45.743 Color_251ACI
N052.16.19.317 E020.54.45.743 N052.16.19.353 E020.54.45.868 Color_251ACI
N052.16.19.353 E020.54.45.868 N052.16.19.350 E020.54.45.990 Color_251ACI
N052.16.19.350 E020.54.45.990 N052.16.18.170 E020.54.50.832 Color_251ACI
N052.16.18.170 E020.54.50.832 N052.16.18.095 E020.54.50.828 Color_251ACI
N052.16.18.095 E020.54.50.828 N052.16.17.798 E020.54.50.690 Color_251ACI
N052.16.19.994 E020.54.39.773 N052.16.20.403 E020.54.39.977 Color_251ACI
N052.16.20.403 E020.54.39.977 N052.16.20.933 E020.54.35.776 Color_251ACI
N052.16.20.933 E020.54.35.776 N052.16.19.931 E020.54.35.235 Color_251ACI
N052.16.19.931 E020.54.35.235 N052.16.19.858 E020.54.35.170 Color_251ACI
N052.16.19.858 E020.54.35.170 N052.16.19.783 E020.54.35.166 Color_251ACI
N052.16.19.783 E020.54.35.166 N052.16.19.708 E020.54.35.162 Color_251ACI
N052.16.19.708 E020.54.35.162 N052.16.19.633 E020.54.35.158 Color_251ACI
N052.16.19.633 E020.54.35.158 N052.16.19.594 E020.54.35.218 Color_251ACI
N052.16.19.594 E020.54.35.218 N052.16.19.557 E020.54.35.216 Color_251ACI
N052.16.19.557 E020.54.35.216 N052.16.19.517 E020.54.35.336 Color_251ACI
N052.16.19.517 E020.54.35.336 N052.16.19.516 E020.54.35.397 Color_251ACI
N052.16.19.516 E020.54.35.397 N052.16.19.515 E020.54.35.459 Color_251ACI
N052.16.19.515 E020.54.35.459 N052.16.19.551 E020.54.35.522 Color_251ACI
N052.16.19.551 E020.54.35.522 N052.16.19.550 E020.54.35.583 Color_251ACI
N052.16.19.550 E020.54.35.583 N052.16.19.587 E020.54.35.585 Color_251ACI
N052.16.19.912 E020.54.40.136 N052.16.20.321 E020.54.40.341 Color_251ACI
N052.16.20.321 E020.54.40.341 N052.16.20.354 E020.54.40.588 Color_251ACI
N052.16.20.354 E020.54.40.588 N052.16.20.350 E020.54.40.771 Color_251ACI
N052.16.20.350 E020.54.40.771 N052.16.20.182 E020.54.41.743 Color_251ACI
N052.16.20.182 E020.54.41.743 N052.16.19.554 E020.54.45.143 Color_251ACI
N052.16.19.554 E020.54.45.143 N052.16.19.514 E020.54.45.263 Color_251ACI
N052.16.19.514 E020.54.45.263 N052.16.19.324 E020.54.45.376 Color_251ACI
N052.16.19.324 E020.54.45.376 N052.16.18.841 E020.54.45.167 Color_251ACI
N052.15.58.039 E020.54.17.262 N052.15.57.875 E020.54.17.989 Color_251ACI
N052.15.57.875 E020.54.17.989 N052.15.57.557 E020.54.18.953 Color_251ACI
N052.15.57.557 E020.54.18.953 N052.15.57.115 E020.54.20.462 Color_251ACI
N052.15.57.115 E020.54.20.462 N052.15.55.084 E020.54.26.608 Color_251ACI
N052.15.24.032 E020.54.22.567 N052.15.25.282 E020.54.19.934 Color_251ACI
N052.15.25.282 E020.54.19.934 N052.15.25.287 E020.54.19.690 Color_251ACI
N052.15.25.287 E020.54.19.690 N052.15.25.176 E020.54.19.623 Color_251ACI
N052.15.25.176 E020.54.19.623 N052.15.24.801 E020.54.19.603 Color_251ACI
N052.15.24.801 E020.54.19.603 N052.15.23.526 E020.54.19.599 Color_251ACI
N052.15.23.526 E020.54.19.599 N052.15.22.562 E020.54.20.959 Color_251ACI
N052.15.24.032 E020.54.22.567 N052.15.24.027 E020.54.22.812 Color_251ACI
N052.15.24.027 E020.54.22.812 N052.15.26.886 E020.54.26.267 Color_251ACI
N052.15.26.886 E020.54.26.267 N052.15.26.961 E020.54.26.271 Color_251ACI
N052.15.26.961 E020.54.26.271 N052.15.27.351 E020.54.25.494 Color_251ACI
N052.15.26.292 E020.54.25.991 N052.15.24.174 E020.54.30.785 Color_251ACI
N052.15.24.174 E020.54.30.785 N052.15.23.991 E020.54.30.531 Color_251ACI
N052.15.23.991 E020.54.30.531 N052.15.26.145 E020.54.25.800 Color_251ACI
N052.15.26.145 E020.54.25.800 N052.15.20.060 E020.54.18.441 Color_251ACI
N052.15.20.060 E020.54.18.441 N052.15.19.905 E020.54.18.679 Color_251ACI
N052.15.19.905 E020.54.18.679 N052.15.18.477 E020.54.24.672 Color_251ACI
N052.15.18.477 E020.54.24.672 N052.15.16.751 E020.54.30.589 Color_251ACI
N052.15.16.751 E020.54.30.589 N052.15.13.424 E020.54.37.772 Color_251ACI
N052.15.20.259 E020.54.17.839 N052.15.20.289 E020.54.18.208 Color_251ACI
N052.15.20.289 E020.54.18.208 N052.15.22.562 E020.54.20.959 Color_251ACI
N052.15.16.631 E020.54.28.990 N052.15.16.665 E020.54.29.175 Color_251ACI
N052.15.16.665 E020.54.29.175 N052.15.16.740 E020.54.29.179 Color_251ACI
N052.15.16.740 E020.54.29.179 N052.15.16.815 E020.54.29.183 Color_251ACI
N052.15.16.815 E020.54.29.183 N052.15.18.376 E020.54.24.054 Color_251ACI
N052.15.18.376 E020.54.24.054 N052.15.19.357 E020.54.19.876 Color_251ACI
N052.15.16.631 E020.54.28.990 N052.15.16.947 E020.54.24.287 Color_251ACI
N052.15.16.947 E020.54.24.287 N052.15.19.247 E020.54.19.748 Color_251ACI
N052.15.19.247 E020.54.19.748 N052.15.19.356 E020.54.19.937 Color_251ACI
N052.15.20.259 E020.54.17.839 N052.15.33.396 E020.53.51.978 Color_251ACI
N052.15.33.396 E020.53.51.978 N052.15.34.556 E020.53.52.099 Color_251ACI
N052.15.34.556 E020.53.52.099 N052.15.36.167 E020.53.52.181 Color_251ACI
N052.15.36.167 E020.53.52.181 N052.15.37.028 E020.53.52.287 Color_251ACI
N052.15.37.028 E020.53.52.287 N052.15.37.440 E020.53.52.308 Color_251ACI
N052.15.37.440 E020.53.52.308 N052.15.39.309 E020.53.52.649 Color_251ACI
N052.15.39.309 E020.53.52.649 N052.15.40.543 E020.53.52.834 Color_251ACI
N052.15.40.543 E020.53.52.834 N052.15.41.966 E020.53.52.968 Color_251ACI
N052.15.41.966 E020.53.52.968 N052.15.43.869 E020.53.53.495 Color_251ACI
N052.15.43.869 E020.53.53.495 N052.15.44.051 E020.53.53.749 Color_251ACI
N052.15.44.051 E020.53.53.749 N052.15.45.347 E020.53.54.612 Color_251ACI
N052.15.45.347 E020.53.54.612 N052.15.48.074 E020.53.59.103 Color_251ACI
N052.15.48.074 E020.53.59.103 N052.15.56.084 E020.54.11.646 Color_251ACI
N052.15.45.418 E020.53.52.900 N052.15.44.787 E020.53.48.640 Color_251ACI
N052.15.44.787 E020.53.48.640 N052.15.43.041 E020.53.34.088 Color_251ACI
N052.15.43.041 E020.53.34.088 N052.15.42.810 E020.53.32.422 Color_251ACI
N052.15.42.810 E020.53.32.422 N052.15.36.401 E020.53.45.882 Color_251ACI
N052.15.36.401 E020.53.45.882 N052.15.33.667 E020.53.51.502 Color_251ACI
N052.15.33.667 E020.53.51.502 N052.15.33.926 E020.53.51.699 Color_251ACI
N052.15.33.926 E020.53.51.699 N052.15.35.537 E020.53.51.781 Color_251ACI
N052.15.35.537 E020.53.51.781 N052.15.36.399 E020.53.51.825 Color_251ACI
N052.15.36.399 E020.53.51.825 N052.15.36.811 E020.53.51.847 Color_251ACI
N052.15.36.811 E020.53.51.847 N052.15.38.679 E020.53.52.249 Color_251ACI
N052.15.38.679 E020.53.52.249 N052.15.39.951 E020.53.52.436 Color_251ACI
N052.15.39.951 E020.53.52.436 N052.15.41.336 E020.53.52.569 Color_251ACI
N052.15.41.336 E020.53.52.569 N052.15.42.458 E020.53.52.749 Color_251ACI
N052.15.42.458 E020.53.52.749 N052.15.43.952 E020.53.53.070 Color_251ACI
N052.15.43.952 E020.53.53.070 N052.15.44.986 E020.53.53.920 Color_251ACI
N052.15.44.986 E020.53.53.920 N052.15.45.097 E020.53.53.987 Color_251ACI
N052.15.45.097 E020.53.53.987 N052.15.45.249 E020.53.53.872 Color_251ACI
N052.15.45.249 E020.53.53.872 N052.15.45.365 E020.53.53.694 Color_251ACI
N052.15.45.365 E020.53.53.694 N052.15.45.448 E020.53.53.269 Color_251ACI
N052.15.45.448 E020.53.53.269 N052.15.45.419 E020.53.52.839 Color_251ACI
N052.15.15.626 E020.53.53.396 N052.15.31.334 E020.53.51.934 Color_251ACI
N052.15.31.334 E020.53.51.934 N052.15.32.573 E020.53.51.875 Color_251ACI
N052.15.32.573 E020.53.51.875 N052.15.32.597 E020.53.52.550 Color_251ACI
N052.15.32.597 E020.53.52.550 N052.15.16.613 E020.54.24.086 Color_251ACI
N052.15.16.613 E020.54.24.086 N052.15.16.310 E020.54.30.076 Color_251ACI
N052.15.16.310 E020.54.30.076 N052.15.13.458 E020.54.35.997 Color_251ACI
N052.15.21.473 E020.54.21.026 N052.15.21.950 E020.54.21.602 Color_251ACI
N052.15.21.950 E020.54.21.602 N052.15.21.685 E020.54.21.711 Color_251ACI
N052.15.21.685 E020.54.21.711 N052.15.21.420 E020.54.21.820 Color_251ACI
N052.15.21.420 E020.54.21.820 N052.15.21.115 E020.54.22.111 Color_251ACI
N052.15.21.115 E020.54.22.111 N052.15.20.999 E020.54.22.289 Color_251ACI
N052.15.20.999 E020.54.22.289 N052.15.20.843 E020.54.22.587 Color_251ACI
N052.15.20.843 E020.54.22.587 N052.15.20.725 E020.54.22.887 Color_251ACI
N052.15.20.725 E020.54.22.887 N052.15.20.682 E020.54.23.130 Color_251ACI
N052.15.20.682 E020.54.23.130 N052.15.20.602 E020.54.23.433 Color_251ACI
N052.15.20.602 E020.54.23.433 N052.15.20.556 E020.54.23.859 Color_251ACI
N052.15.20.556 E020.54.23.859 N052.15.20.543 E020.54.24.533 Color_251ACI
N052.15.20.543 E020.54.24.533 N052.15.20.608 E020.54.25.026 Color_251ACI
N052.15.20.608 E020.54.25.026 N052.15.20.678 E020.54.25.336 Color_251ACI
N052.15.20.678 E020.54.25.336 N052.15.20.823 E020.54.25.589 Color_251ACI
N052.15.20.823 E020.54.25.589 N052.15.20.968 E020.54.25.841 Color_251ACI
N052.15.20.968 E020.54.25.841 N052.15.23.168 E020.54.28.466 Color_251ACI
N052.15.23.168 E020.54.28.466 N052.15.23.426 E020.54.28.725 Color_251ACI
N052.15.23.426 E020.54.28.725 N052.15.23.761 E020.54.28.864 Color_251ACI
N052.15.23.761 E020.54.28.864 N052.15.24.061 E020.54.28.880 Color_251ACI
N052.15.24.061 E020.54.28.880 N052.15.24.363 E020.54.28.773 Color_251ACI
N052.15.24.363 E020.54.28.773 N052.15.24.552 E020.54.28.660 Color_251ACI
N052.15.24.552 E020.54.28.660 N052.15.24.780 E020.54.28.549 Color_251ACI
N052.15.24.780 E020.54.28.549 N052.15.24.972 E020.54.28.314 Color_251ACI
N052.15.24.972 E020.54.28.314 N052.15.25.126 E020.54.28.076 Color_251ACI
N052.15.25.126 E020.54.28.076 N052.15.25.247 E020.54.27.654 Color_251ACI
N052.15.25.247 E020.54.27.654 N052.15.25.366 E020.54.27.292 Color_251ACI
N052.15.25.366 E020.54.27.292 N052.15.25.448 E020.54.26.929 Color_251ACI
N052.15.25.448 E020.54.26.929 N052.15.25.454 E020.54.26.623 Color_251ACI
N052.15.25.454 E020.54.26.623 N052.15.25.426 E020.54.26.131 Color_251ACI
N052.15.25.426 E020.54.26.131 N052.15.25.395 E020.54.25.823 Color_251ACI
N052.15.25.395 E020.54.25.823 N052.15.25.219 E020.54.25.201 Color_251ACI
N052.15.25.219 E020.54.25.201 N052.15.25.036 E020.54.24.947 Color_251ACI
N052.15.25.036 E020.54.24.947 N052.15.21.595 E020.54.20.542 Color_251ACI
N052.15.21.595 E020.54.20.542 N052.15.21.437 E020.54.20.963 Color_251ACI
N052.15.21.437 E020.54.20.963 N052.15.21.473 E020.54.21.026 Color_251ACI
N052.15.52.440 E020.55.08.633 N052.15.52.100 E020.55.08.799 Color_251ACI
N052.16.00.523 E020.53.49.446 N052.16.00.824 E020.53.47.439 Color_251ACI
N052.16.00.824 E020.53.47.439 N052.16.01.827 E020.53.47.919 Color_251ACI
N052.16.01.827 E020.53.47.919 N052.16.01.565 E020.53.49.867 Color_251ACI
N052.16.02.221 E020.53.46.959 N052.16.01.998 E020.53.46.825 Color_251ACI
N052.15.50.585 E020.54.28.523 N052.15.48.080 E020.54.28.088 Color_251ACI
N052.15.52.416 E020.54.28.862 N052.15.50.585 E020.54.28.523 Color_251ACI
N052.16.01.338 E020.53.51.939 N052.15.58.039 E020.54.17.262 Color_251ACI
N052.15.52.440 E020.55.08.633 N052.15.54.429 E020.54.54.886 Color_251ACI
N052.15.44.475 E020.54.28.332 N052.15.45.876 E020.54.27.669 Color_251ACI
N052.15.45.876 E020.54.27.669 N052.15.46.960 E020.54.27.847 Color_251ACI
N052.15.46.960 E020.54.27.847 N052.15.48.080 E020.54.28.088 Color_251ACI
N052.16.29.612 E020.54.09.504 N052.16.30.531 E020.54.08.509 Color_251ACI
N052.16.00.868 E020.53.47.074 N052.16.01.087 E020.53.45.430 Color_251ACI
N052.16.01.872 E020.53.47.554 N052.16.00.868 E020.53.47.074 Color_251ACI
N052.16.01.961 E020.53.46.823 N052.16.01.872 E020.53.47.554 Color_251ACI
N052.16.00.181 E020.53.53.595 N052.16.00.516 E020.53.53.735 Color_251ACI
N052.16.00.516 E020.53.53.735 N052.16.00.431 E020.53.54.221 Color_251ACI
N052.16.00.431 E020.53.54.221 N052.16.00.133 E020.53.54.144 Color_251ACI
N052.16.00.583 E020.53.54.106 N052.16.00.919 E020.53.54.185 Color_251ACI
N052.16.00.919 E020.53.54.185 N052.16.00.834 E020.53.54.732 Color_251ACI
N052.16.00.834 E020.53.54.732 N052.16.00.535 E020.53.54.655 Color_251ACI
N052.15.59.755 E020.53.44.504 N052.16.00.091 E020.53.44.583 Color_251ACI
N052.16.00.091 E020.53.44.583 N052.16.00.006 E020.53.45.130 Color_251ACI
N052.16.00.006 E020.53.45.130 N052.15.59.708 E020.53.44.992 Color_251ACI
N052.16.21.222 E020.54.38.304 N052.16.21.437 E020.54.36.905 Color_251ACI
N052.16.21.437 E020.54.36.905 N052.16.21.660 E020.54.36.978 Color_251ACI
N052.16.21.660 E020.54.36.978 N052.16.21.446 E020.54.38.376 Color_251ACI
N052.16.15.199 E020.54.59.075 N052.16.14.197 E020.54.58.533 Color_251ACI
N052.16.14.197 E020.54.58.533 N052.16.14.154 E020.54.58.837 Color_251ACI
N052.16.14.154 E020.54.58.837 N052.16.15.119 E020.54.59.377 Color_251ACI
N052.16.16.944 E020.54.54.139 N052.16.15.869 E020.54.53.472 Color_251ACI
N052.16.15.869 E020.54.53.472 N052.16.15.745 E020.54.54.078 Color_251ACI
N052.16.15.745 E020.54.54.078 N052.16.16.821 E020.54.54.685 Color_251ACI
N052.16.02.499 E020.53.46.115 N052.16.02.872 E020.53.46.257 Color_251ACI
N052.16.02.872 E020.53.46.257 N052.16.02.740 E020.53.47.231 Color_251ACI
N052.16.02.740 E020.53.47.231 N052.16.02.368 E020.53.47.089 Color_251ACI
N052.16.01.693 E020.53.45.155 N052.16.02.176 E020.53.45.364 Color_251ACI
N052.16.02.176 E020.53.45.364 N052.16.01.914 E020.53.47.311 Color_251ACI
N052.16.01.914 E020.53.47.311 N052.16.01.393 E020.53.47.100 Color_251ACI
N052.16.00.353 E020.53.44.596 N052.16.00.652 E020.53.44.673 Color_251ACI
N052.16.00.652 E020.53.44.673 N052.16.00.604 E020.53.45.222 Color_251ACI
N052.16.00.604 E020.53.45.222 N052.16.00.268 E020.53.45.143 Color_251ACI
N052.16.13.667 E020.54.58.812 N052.16.12.722 E020.55.03.115 Color_251ACI
N052.16.12.722 E020.55.03.115 N052.16.12.462 E020.55.02.979 Color_251ACI
N052.16.12.462 E020.55.02.979 N052.16.13.445 E020.54.58.679 Color_251ACI
N052.16.14.539 E020.55.00.267 N052.16.13.542 E020.55.01.441 Color_251ACI
N052.16.13.542 E020.55.01.441 N052.16.13.434 E020.55.01.190 Color_251ACI
N052.16.13.434 E020.55.01.190 N052.16.14.395 E020.54.59.953 Color_251ACI
N052.16.14.204 E020.55.00.127 N052.16.13.436 E020.55.01.068 Color_251ACI
N052.16.13.436 E020.55.01.068 N052.16.13.327 E020.55.00.879 Color_251ACI
N052.16.13.327 E020.55.00.879 N052.16.14.097 E020.54.59.876 Color_251ACI
N052.16.15.001 E020.54.59.616 N052.16.13.888 E020.54.59.008 Color_251ACI
N052.16.13.888 E020.54.59.008 N052.16.13.807 E020.54.59.310 Color_251ACI
N052.16.13.807 E020.54.59.310 N052.16.14.957 E020.54.59.982 Color_251ACI
N052.16.15.964 E020.54.58.317 N052.16.14.926 E020.54.57.713 Color_251ACI
N052.16.14.926 E020.54.57.713 N052.16.14.801 E020.54.58.319 Color_251ACI
N052.16.14.801 E020.54.58.319 N052.16.15.840 E020.54.58.924 Color_251ACI
N052.16.16.539 E020.54.55.712 N052.16.16.205 E020.54.55.511 Color_251ACI
N052.16.16.205 E020.54.55.511 N052.16.15.836 E020.54.57.147 Color_251ACI
N052.16.15.836 E020.54.57.147 N052.16.16.170 E020.54.57.347 Color_251ACI
N052.16.17.312 E020.54.52.565 N052.16.16.348 E020.54.51.964 Color_251ACI
N052.16.16.348 E020.54.51.964 N052.16.16.187 E020.54.52.569 Color_251ACI
N052.16.16.187 E020.54.52.569 N052.16.17.188 E020.54.53.171 Color_251ACI
N052.16.17.404 E020.54.47.729 N052.16.16.750 E020.54.50.575 Color_251ACI
N052.16.16.750 E020.54.50.575 N052.16.17.714 E020.54.51.115 Color_251ACI
N052.16.17.714 E020.54.51.115 N052.16.18.368 E020.54.48.330 Color_251ACI
N052.16.18.093 E020.54.43.107 N052.16.17.437 E020.54.46.015 Color_251ACI
N052.16.17.437 E020.54.46.015 N052.16.18.512 E020.54.46.682 Color_251ACI
N052.16.18.512 E020.54.46.682 N052.16.19.168 E020.54.43.775 Color_251ACI
N052.16.18.664 E020.54.40.685 N052.16.19.284 E020.54.37.714 Color_251ACI
N052.16.19.284 E020.54.37.714 N052.16.20.285 E020.54.38.317 Color_251ACI
N052.16.20.285 E020.54.38.317 N052.16.19.667 E020.54.41.227 Color_251ACI
N052.16.19.588 E020.54.35.524 N052.16.20.627 E020.54.36.128 Color_251ACI
N052.16.20.627 E020.54.36.128 N052.16.20.504 E020.54.36.674 Color_251ACI
N052.16.20.504 E020.54.36.674 N052.16.19.465 E020.54.36.069 Color_251ACI
N052.16.21.160 E020.54.29.844 N052.16.22.126 E020.54.30.322 Color_251ACI
N052.16.22.126 E020.54.30.322 N052.16.21.715 E020.54.32.201 Color_251ACI
N052.16.21.715 E020.54.32.201 N052.16.20.787 E020.54.31.663 Color_251ACI
N052.16.21.772 E020.54.27.240 N052.16.22.663 E020.54.27.715 Color_251ACI
N052.16.22.663 E020.54.27.715 N052.16.22.292 E020.54.29.473 Color_251ACI
N052.16.22.292 E020.54.29.473 N052.16.21.401 E020.54.28.998 Color_251ACI
N052.16.22.423 E020.54.24.577 N052.16.23.313 E020.54.25.113 Color_251ACI
N052.16.23.313 E020.54.25.113 N052.16.22.903 E020.54.26.931 Color_251ACI
N052.16.22.903 E020.54.26.931 N052.16.22.013 E020.54.26.395 Color_251ACI
N052.16.23.113 E020.54.21.855 N052.16.23.965 E020.54.22.389 Color_251ACI
N052.16.23.965 E020.54.22.389 N052.16.23.555 E020.54.24.206 Color_251ACI
N052.16.23.555 E020.54.24.206 N052.16.22.667 E020.54.23.609 Color_251ACI
;buildings N000.00.00.000 E000.00.00.000 N000.00.00.000 E000.00.00.000
N052.16.00.353 E020.53.44.596 N052.16.00.652 E020.53.44.673 Color_16ACI
N052.16.00.652 E020.53.44.673 N052.16.00.604 E020.53.45.222 Color_16ACI
N052.16.00.604 E020.53.45.222 N052.16.00.268 E020.53.45.143 Color_16ACI
N052.16.00.268 E020.53.45.143 N052.16.00.353 E020.53.44.596 Color_16ACI
N052.16.01.693 E020.53.45.155 N052.16.02.176 E020.53.45.364 Color_16ACI
N052.16.02.176 E020.53.45.364 N052.16.01.914 E020.53.47.311 Color_16ACI
N052.16.01.914 E020.53.47.311 N052.16.01.393 E020.53.47.100 Color_16ACI
N052.16.01.393 E020.53.47.100 N052.16.01.693 E020.53.45.155 Color_16ACI
N052.16.02.499 E020.53.46.115 N052.16.02.872 E020.53.46.257 Color_16ACI
N052.16.02.872 E020.53.46.257 N052.16.02.740 E020.53.47.231 Color_16ACI
N052.16.02.740 E020.53.47.231 N052.16.02.368 E020.53.47.089 Color_16ACI
N052.16.02.368 E020.53.47.089 N052.16.02.499 E020.53.46.115 Color_16ACI
N052.15.59.755 E020.53.44.504 N052.16.00.091 E020.53.44.583 Color_16ACI
N052.16.00.091 E020.53.44.583 N052.16.00.006 E020.53.45.130 Color_16ACI
N052.16.00.006 E020.53.45.130 N052.15.59.708 E020.53.44.992 Color_16ACI
N052.15.59.708 E020.53.44.992 N052.15.59.755 E020.53.44.504 Color_16ACI
N052.16.00.583 E020.53.54.106 N052.16.00.919 E020.53.54.185 Color_16ACI
N052.16.00.919 E020.53.54.185 N052.16.00.834 E020.53.54.732 Color_16ACI
N052.16.00.834 E020.53.54.732 N052.16.00.535 E020.53.54.655 Color_16ACI
N052.16.00.535 E020.53.54.655 N052.16.00.583 E020.53.54.106 Color_16ACI
N052.16.00.181 E020.53.53.595 N052.16.00.516 E020.53.53.735 Color_16ACI
N052.16.00.516 E020.53.53.735 N052.16.00.431 E020.53.54.221 Color_16ACI
N052.16.00.431 E020.53.54.221 N052.16.00.133 E020.53.54.144 Color_16ACI
N052.16.00.133 E020.53.54.144 N052.16.00.181 E020.53.53.595 Color_16ACI
N052.16.23.113 E020.54.21.855 N052.16.23.965 E020.54.22.389 Color_16ACI
N052.16.23.965 E020.54.22.389 N052.16.23.555 E020.54.24.206 Color_16ACI
N052.16.23.555 E020.54.24.206 N052.16.22.667 E020.54.23.609 Color_16ACI
N052.16.22.667 E020.54.23.609 N052.16.23.113 E020.54.21.855 Color_16ACI
N052.16.22.423 E020.54.24.577 N052.16.23.313 E020.54.25.113 Color_16ACI
N052.16.23.313 E020.54.25.113 N052.16.22.903 E020.54.26.931 Color_16ACI
N052.16.22.903 E020.54.26.931 N052.16.22.013 E020.54.26.395 Color_16ACI
N052.16.22.013 E020.54.26.395 N052.16.22.423 E020.54.24.577 Color_16ACI
N052.16.21.772 E020.54.27.240 N052.16.22.663 E020.54.27.715 Color_16ACI
N052.16.22.663 E020.54.27.715 N052.16.22.292 E020.54.29.473 Color_16ACI
N052.16.22.292 E020.54.29.473 N052.16.21.401 E020.54.28.998 Color_16ACI
N052.16.21.401 E020.54.28.998 N052.16.21.772 E020.54.27.240 Color_16ACI
N052.16.21.160 E020.54.29.844 N052.16.22.126 E020.54.30.322 Color_16ACI
N052.16.22.126 E020.54.30.322 N052.16.21.715 E020.54.32.201 Color_16ACI
N052.16.21.715 E020.54.32.201 N052.16.20.787 E020.54.31.663 Color_16ACI
N052.16.20.787 E020.54.31.663 N052.16.21.160 E020.54.29.844 Color_16ACI
N052.16.19.588 E020.54.35.524 N052.16.20.627 E020.54.36.128 Color_16ACI
N052.16.20.627 E020.54.36.128 N052.16.20.504 E020.54.36.674 Color_16ACI
N052.16.20.504 E020.54.36.674 N052.16.19.465 E020.54.36.069 Color_16ACI
N052.16.19.465 E020.54.36.069 N052.16.19.588 E020.54.35.524 Color_16ACI
N052.16.18.664 E020.54.40.685 N052.16.19.284 E020.54.37.714 Color_16ACI
N052.16.19.284 E020.54.37.714 N052.16.20.285 E020.54.38.317 Color_16ACI
N052.16.20.285 E020.54.38.317 N052.16.19.667 E020.54.41.227 Color_16ACI
N052.16.19.667 E020.54.41.227 N052.16.18.664 E020.54.40.685 Color_16ACI
N052.16.18.093 E020.54.43.107 N052.16.17.437 E020.54.46.015 Color_16ACI
N052.16.17.437 E020.54.46.015 N052.16.18.512 E020.54.46.682 Color_16ACI
N052.16.18.512 E020.54.46.682 N052.16.19.168 E020.54.43.775 Color_16ACI
N052.16.19.168 E020.54.43.775 N052.16.18.093 E020.54.43.107 Color_16ACI
N052.16.17.404 E020.54.47.729 N052.16.16.750 E020.54.50.575 Color_16ACI
N052.16.16.750 E020.54.50.575 N052.16.17.714 E020.54.51.115 Color_16ACI
N052.16.17.714 E020.54.51.115 N052.16.18.368 E020.54.48.330 Color_16ACI
N052.16.18.368 E020.54.48.330 N052.16.17.404 E020.54.47.729 Color_16ACI
N052.16.17.312 E020.54.52.565 N052.16.16.348 E020.54.51.964 Color_16ACI
N052.16.16.348 E020.54.51.964 N052.16.16.187 E020.54.52.569 Color_16ACI
N052.16.16.187 E020.54.52.569 N052.16.17.188 E020.54.53.171 Color_16ACI
N052.16.17.188 E020.54.53.171 N052.16.17.312 E020.54.52.565 Color_16ACI
N052.16.16.539 E020.54.55.712 N052.16.16.205 E020.54.55.511 Color_16ACI
N052.16.16.205 E020.54.55.511 N052.16.15.836 E020.54.57.147 Color_16ACI
N052.16.15.836 E020.54.57.147 N052.16.16.170 E020.54.57.347 Color_16ACI
N052.16.16.170 E020.54.57.347 N052.16.16.539 E020.54.55.712 Color_16ACI
N052.16.15.964 E020.54.58.317 N052.16.14.926 E020.54.57.713 Color_16ACI
N052.16.14.926 E020.54.57.713 N052.16.14.801 E020.54.58.319 Color_16ACI
N052.16.14.801 E020.54.58.319 N052.16.15.840 E020.54.58.924 Color_16ACI
N052.16.15.840 E020.54.58.924 N052.16.15.964 E020.54.58.317 Color_16ACI
N052.16.15.001 E020.54.59.616 N052.16.13.888 E020.54.59.008 Color_16ACI
N052.16.13.888 E020.54.59.008 N052.16.13.807 E020.54.59.310 Color_16ACI
N052.16.13.807 E020.54.59.310 N052.16.14.957 E020.54.59.982 Color_16ACI
N052.16.14.957 E020.54.59.982 N052.16.15.001 E020.54.59.616 Color_16ACI
N052.16.14.204 E020.55.00.127 N052.16.13.436 E020.55.01.068 Color_16ACI
N052.16.13.436 E020.55.01.068 N052.16.13.327 E020.55.00.879 Color_16ACI
N052.16.13.327 E020.55.00.879 N052.16.14.097 E020.54.59.876 Color_16ACI
N052.16.14.097 E020.54.59.876 N052.16.14.204 E020.55.00.127 Color_16ACI
N052.16.14.539 E020.55.00.267 N052.16.13.542 E020.55.01.441 Color_16ACI
N052.16.13.542 E020.55.01.441 N052.16.13.434 E020.55.01.190 Color_16ACI
N052.16.13.434 E020.55.01.190 N052.16.14.395 E020.54.59.953 Color_16ACI
N052.16.14.395 E020.54.59.953 N052.16.14.539 E020.55.00.267 Color_16ACI
N052.16.13.667 E020.54.58.812 N052.16.12.722 E020.55.03.115 Color_16ACI
N052.16.12.722 E020.55.03.115 N052.16.12.462 E020.55.02.979 Color_16ACI
N052.16.12.462 E020.55.02.979 N052.16.13.445 E020.54.58.679 Color_16ACI
N052.16.13.445 E020.54.58.679 N052.16.13.667 E020.54.58.812 Color_16ACI
N052.16.16.944 E020.54.54.139 N052.16.15.869 E020.54.53.472 Color_16ACI
N052.16.15.869 E020.54.53.472 N052.16.15.745 E020.54.54.078 Color_16ACI
N052.16.15.745 E020.54.54.078 N052.16.16.821 E020.54.54.685 Color_16ACI
N052.16.16.821 E020.54.54.685 N052.16.16.944 E020.54.54.139 Color_16ACI
N052.16.15.199 E020.54.59.075 N052.16.14.197 E020.54.58.533 Color_16ACI
N052.16.14.197 E020.54.58.533 N052.16.14.154 E020.54.58.837 Color_16ACI
N052.16.14.154 E020.54.58.837 N052.16.15.119 E020.54.59.377 Color_16ACI
N052.16.15.119 E020.54.59.377 N052.16.15.199 E020.54.59.075 Color_16ACI
N052.16.21.222 E020.54.38.304 N052.16.21.437 E020.54.36.905 Color_16ACI
N052.16.21.437 E020.54.36.905 N052.16.21.660 E020.54.36.978 Color_16ACI
N052.16.21.660 E020.54.36.978 N052.16.21.446 E020.54.38.376 Color_16ACI
N052.16.21.446 E020.54.38.376 N052.16.21.222 E020.54.38.304 Color_16ACI
N052.15.28.036 E020.54.24.978 N052.15.27.683 E020.54.25.818 Color_16ACI
N052.15.27.683 E020.54.25.818 N052.15.26.509 E020.54.24.409 Color_16ACI
N052.15.26.509 E020.54.24.409 N052.15.26.782 E020.54.23.872 Color_16ACI
N052.15.26.782 E020.54.23.872 N052.15.27.588 E020.54.24.894 Color_16ACI
N052.15.27.588 E020.54.24.894 N052.15.27.745 E020.54.24.534 Color_16ACI
N052.15.27.745 E020.54.24.534 N052.15.28.036 E020.54.24.978 Color_16ACI
N052.15.27.848 E020.54.15.225 N052.15.27.873 E020.54.15.900 Color_16ACI
N052.15.27.873 E020.54.15.900 N052.15.27.460 E020.54.15.940 Color_16ACI
N052.15.27.460 E020.54.15.940 N052.15.27.435 E020.54.15.265 Color_16ACI
N052.15.27.435 E020.54.15.265 N052.15.27.848 E020.54.15.225 Color_16ACI
N052.15.32.585 E020.54.14.671 N052.15.32.546 E020.54.16.691 Color_16ACI
N052.15.32.546 E020.54.16.691 N052.15.31.797 E020.54.16.653 Color_16ACI
N052.15.31.797 E020.54.16.653 N052.15.31.836 E020.54.14.632 Color_16ACI
N052.15.31.836 E020.54.14.632 N052.15.32.585 E020.54.14.671 Color_16ACI
N052.15.32.398 E020.54.12.700 N052.15.32.380 E020.54.13.619 Color_16ACI
N052.15.32.380 E020.54.13.619 N052.15.30.132 E020.54.13.503 Color_16ACI
N052.15.30.132 E020.54.13.503 N052.15.30.113 E020.54.12.522 Color_16ACI
N052.15.30.113 E020.54.12.522 N052.15.32.398 E020.54.12.700 Color_16ACI
N052.15.32.337 E020.54.19.806 N052.15.32.319 E020.54.20.724 Color_16ACI
N052.15.32.319 E020.54.20.724 N052.15.30.033 E020.54.20.607 Color_16ACI
N052.15.30.033 E020.54.20.607 N052.15.30.051 E020.54.19.688 Color_16ACI
N052.15.30.051 E020.54.19.688 N052.15.32.337 E020.54.19.806 Color_16ACI
N052.15.31.664 E020.54.21.609 N052.15.31.642 E020.54.22.773 Color_16ACI
N052.15.31.642 E020.54.22.773 N052.15.30.744 E020.54.22.665 Color_16ACI
N052.15.30.744 E020.54.22.665 N052.15.30.756 E020.54.22.053 Color_16ACI
N052.15.30.756 E020.54.22.053 N052.15.31.205 E020.54.22.076 Color_16ACI
N052.15.31.205 E020.54.22.076 N052.15.31.252 E020.54.21.588 Color_16ACI
N052.15.31.252 E020.54.21.588 N052.15.31.664 E020.54.21.609 Color_16ACI
N052.15.33.665 E020.54.34.642 N052.15.33.632 E020.54.36.356 Color_16ACI
N052.15.33.632 E020.54.36.356 N052.15.33.034 E020.54.36.264 Color_16ACI
N052.15.33.034 E020.54.36.264 N052.15.33.066 E020.54.34.550 Color_16ACI
N052.15.33.066 E020.54.34.550 N052.15.33.665 E020.54.34.642 Color_16ACI
N052.15.32.073 E020.54.37.440 N052.15.31.775 E020.54.37.364 Color_16ACI
N052.15.31.775 E020.54.37.364 N052.15.31.642 E020.54.38.399 Color_16ACI
N052.15.31.642 E020.54.38.399 N052.15.31.941 E020.54.38.475 Color_16ACI
N052.15.31.941 E020.54.38.475 N052.15.32.073 E020.54.37.440 Color_16ACI
N052.15.32.491 E020.54.29.373 N052.15.32.290 E020.54.31.998 Color_16ACI
N052.15.32.290 E020.54.31.998 N052.15.31.917 E020.54.31.917 Color_16ACI
N052.15.31.917 E020.54.31.917 N052.15.32.080 E020.54.29.291 Color_16ACI
N052.15.32.080 E020.54.29.291 N052.15.32.491 E020.54.29.373 Color_16ACI
N052.15.31.837 E020.54.28.236 N052.15.31.564 E020.54.28.774 Color_16ACI
N052.15.31.564 E020.54.28.774 N052.15.31.050 E020.54.28.196 Color_16ACI
N052.15.31.050 E020.54.28.196 N052.15.30.308 E020.54.29.751 Color_16ACI
N052.15.30.308 E020.54.29.751 N052.15.29.941 E020.54.29.304 Color_16ACI
N052.15.29.941 E020.54.29.304 N052.15.30.684 E020.54.27.748 Color_16ACI
N052.15.30.684 E020.54.27.748 N052.15.29.331 E020.54.25.902 Color_16ACI
N052.15.29.331 E020.54.25.902 N052.15.28.591 E020.54.27.335 Color_16ACI
N052.15.28.591 E020.54.27.335 N052.15.28.300 E020.54.26.891 Color_16ACI
N052.15.28.300 E020.54.26.891 N052.15.29.428 E020.54.24.804 Color_16ACI
N052.15.29.428 E020.54.24.804 N052.15.31.837 E020.54.28.236 Color_16ACI
N052.15.34.802 E020.54.14.478 N052.15.34.722 E020.54.16.680 Color_16ACI
N052.15.34.722 E020.54.16.680 N052.15.34.385 E020.54.16.663 Color_16ACI
N052.15.34.385 E020.54.16.663 N052.15.34.377 E020.54.17.091 Color_16ACI
N052.15.34.377 E020.54.17.091 N052.15.33.891 E020.54.17.005 Color_16ACI
N052.15.33.891 E020.54.17.005 N052.15.34.029 E020.54.13.703 Color_16ACI
N052.15.34.029 E020.54.13.703 N052.15.34.515 E020.54.13.789 Color_16ACI
N052.15.34.515 E020.54.13.789 N052.15.34.502 E020.54.14.463 Color_16ACI
N052.15.34.502 E020.54.14.463 N052.15.34.802 E020.54.14.478 Color_16ACI
N052.15.37.530 E020.54.22.829 N052.15.37.477 E020.54.23.623 Color_16ACI
N052.15.37.477 E020.54.23.623 N052.15.34.747 E020.54.23.177 Color_16ACI
N052.15.34.747 E020.54.23.177 N052.15.34.800 E020.54.22.383 Color_16ACI
N052.15.34.800 E020.54.22.383 N052.15.37.530 E020.54.22.829 Color_16ACI
N052.15.37.695 E020.54.20.080 N052.15.37.683 E020.54.20.692 Color_16ACI
N052.15.37.683 E020.54.20.692 N052.15.35.738 E020.54.20.409 Color_16ACI
N052.15.35.738 E020.54.20.409 N052.15.35.784 E020.54.19.982 Color_16ACI
N052.15.35.784 E020.54.19.982 N052.15.35.336 E020.54.19.898 Color_16ACI
N052.15.35.336 E020.54.19.898 N052.15.35.293 E020.54.20.141 Color_16ACI
N052.15.35.293 E020.54.20.141 N052.15.34.170 E020.54.20.022 Color_16ACI
N052.15.34.170 E020.54.20.022 N052.15.34.221 E020.54.19.351 Color_16ACI
N052.15.34.221 E020.54.19.351 N052.15.35.305 E020.54.19.529 Color_16ACI
N052.15.35.305 E020.54.19.529 N052.15.35.351 E020.54.19.102 Color_16ACI
N052.15.35.351 E020.54.19.102 N052.15.35.799 E020.54.19.186 Color_16ACI
N052.15.35.799 E020.54.19.186 N052.15.35.789 E020.54.19.737 Color_16ACI
N052.15.35.789 E020.54.19.737 N052.15.37.696 E020.54.20.019 Color_16ACI
N052.15.37.696 E020.54.20.019 N052.15.37.695 E020.54.20.080 Color_16ACI
N052.15.37.630 E020.54.25.408 N052.15.37.575 E020.54.26.324 Color_16ACI
N052.15.37.575 E020.54.26.324 N052.15.35.330 E020.54.26.025 Color_16ACI
N052.15.35.330 E020.54.26.025 N052.15.35.386 E020.54.25.109 Color_16ACI
N052.15.35.386 E020.54.25.109 N052.15.37.630 E020.54.25.408 Color_16ACI
N052.15.40.099 E020.54.23.819 N052.15.39.912 E020.54.25.709 Color_16ACI
N052.15.39.912 E020.54.25.709 N052.15.39.539 E020.54.25.628 Color_16ACI
N052.15.39.539 E020.54.25.628 N052.15.39.725 E020.54.23.738 Color_16ACI
N052.15.39.725 E020.54.23.738 N052.15.40.099 E020.54.23.819 Color_16ACI
N052.15.39.695 E020.54.19.447 N052.15.39.422 E020.54.19.985 Color_16ACI
N052.15.39.422 E020.54.19.985 N052.15.40.115 E020.54.21.001 Color_16ACI
N052.15.40.115 E020.54.21.001 N052.15.40.388 E020.54.20.463 Color_16ACI
N052.15.40.388 E020.54.20.463 N052.15.39.695 E020.54.19.447 Color_16ACI
N052.15.41.304 E020.54.23.574 N052.15.40.913 E020.54.22.451 Color_16ACI
N052.15.40.913 E020.54.22.451 N052.15.40.607 E020.54.22.742 Color_16ACI
N052.15.40.607 E020.54.22.742 N052.15.40.998 E020.54.23.865 Color_16ACI
N052.15.40.998 E020.54.23.865 N052.15.41.304 E020.54.23.574 Color_16ACI
N052.15.42.229 E020.54.28.095 N052.15.42.407 E020.54.28.594 Color_16ACI
N052.15.42.407 E020.54.28.594 N052.15.41.452 E020.54.29.525 Color_16ACI
N052.15.41.452 E020.54.29.525 N052.15.41.275 E020.54.28.965 Color_16ACI
N052.15.41.275 E020.54.28.965 N052.15.42.229 E020.54.28.095 Color_16ACI
N052.15.38.141 E020.54.37.874 N052.15.35.817 E020.54.39.777 Color_16ACI
N052.15.35.817 E020.54.39.777 N052.15.35.215 E020.54.37.908 Color_16ACI
N052.15.35.215 E020.54.37.908 N052.15.37.578 E020.54.35.945 Color_16ACI
N052.15.37.578 E020.54.35.945 N052.15.38.141 E020.54.37.874 Color_16ACI
N052.15.30.905 E020.54.24.022 N052.15.30.781 E020.54.24.628 Color_16ACI
N052.15.30.781 E020.54.24.628 N052.15.29.965 E020.54.24.157 Color_16ACI
N052.15.29.965 E020.54.24.157 N052.15.30.088 E020.54.23.612 Color_16ACI
N052.15.30.088 E020.54.23.612 N052.15.30.905 E020.54.24.022 Color_16ACI
N052.15.29.144 E020.54.21.971 N052.15.29.181 E020.54.20.073 Color_16ACI
N052.15.29.181 E020.54.20.073 N052.15.29.705 E020.54.20.100 Color_16ACI
N052.15.29.705 E020.54.20.100 N052.15.29.684 E020.54.21.202 Color_16ACI
N052.15.29.684 E020.54.21.202 N052.15.29.497 E020.54.21.192 Color_16ACI
N052.15.29.497 E020.54.21.192 N052.15.29.482 E020.54.21.988 Color_16ACI
N052.15.29.482 E020.54.21.988 N052.15.29.144 E020.54.21.971 Color_16ACI
N052.15.32.621 E020.54.44.086 N052.15.32.532 E020.54.44.817 Color_16ACI
N052.15.32.532 E020.54.44.817 N052.15.31.673 E020.54.44.589 Color_16ACI
N052.15.31.673 E020.54.44.589 N052.15.31.761 E020.54.43.920 Color_16ACI
N052.15.31.761 E020.54.43.920 N052.15.32.621 E020.54.44.086 Color_16ACI
N052.15.31.577 E020.54.39.866 N052.15.31.358 E020.54.41.509 Color_16ACI
N052.15.31.358 E020.54.41.509 N052.15.31.098 E020.54.41.373 Color_16ACI
N052.15.31.098 E020.54.41.373 N052.15.31.317 E020.54.39.730 Color_16ACI
N052.15.31.317 E020.54.39.730 N052.15.31.577 E020.54.39.866 Color_16ACI
N052.15.27.858 E020.54.34.283 N052.15.27.663 E020.54.34.641 Color_16ACI
N052.15.27.663 E020.54.34.641 N052.15.28.285 E020.54.35.469 Color_16ACI
N052.15.28.285 E020.54.35.469 N052.15.28.480 E020.54.35.111 Color_16ACI
N052.15.28.480 E020.54.35.111 N052.15.27.858 E020.54.34.283 Color_16ACI
N052.15.29.616 E020.54.38.417 N052.15.27.125 E020.54.35.348 Color_16ACI
N052.15.27.125 E020.54.35.348 N052.15.26.929 E020.54.35.767 Color_16ACI
N052.15.26.929 E020.54.35.767 N052.15.27.258 E020.54.36.213 Color_16ACI
N052.15.27.258 E020.54.36.213 N052.15.26.711 E020.54.37.349 Color_16ACI
N052.15.26.711 E020.54.37.349 N052.15.26.271 E020.54.36.837 Color_16ACI
N052.15.26.271 E020.54.36.837 N052.15.26.037 E020.54.37.315 Color_16ACI
N052.15.26.037 E020.54.37.315 N052.15.26.513 E020.54.37.891 Color_16ACI
N052.15.26.513 E020.54.37.891 N052.15.26.746 E020.54.37.474 Color_16ACI
N052.15.26.746 E020.54.37.474 N052.15.28.321 E020.54.39.454 Color_16ACI
N052.15.28.321 E020.54.39.454 N052.15.28.126 E020.54.39.873 Color_16ACI
N052.15.28.126 E020.54.39.873 N052.15.28.676 E020.54.40.514 Color_16ACI
N052.15.28.676 E020.54.40.514 N052.15.28.872 E020.54.40.095 Color_16ACI
N052.15.28.872 E020.54.40.095 N052.15.28.396 E020.54.39.458 Color_16ACI
N052.15.28.396 E020.54.39.458 N052.15.28.942 E020.54.38.383 Color_16ACI
N052.15.28.942 E020.54.38.383 N052.15.29.381 E020.54.38.957 Color_16ACI
N052.15.29.381 E020.54.38.957 N052.15.29.616 E020.54.38.417 Color_16ACI
N052.15.47.069 E020.54.29.997 N052.15.46.497 E020.54.30.458 Color_16ACI
N052.15.46.497 E020.54.30.458 N052.15.46.322 E020.54.29.836 Color_16ACI
N052.15.46.322 E020.54.29.836 N052.15.46.929 E020.54.29.438 Color_16ACI
N052.15.46.929 E020.54.29.438 N052.15.47.069 E020.54.29.997 Color_16ACI
N052.15.46.560 E020.54.31.074 N052.15.46.256 E020.54.31.304 Color_16ACI
N052.15.46.256 E020.54.31.304 N052.15.46.647 E020.54.32.427 Color_16ACI
N052.15.46.647 E020.54.32.427 N052.15.46.914 E020.54.32.195 Color_16ACI
N052.15.46.914 E020.54.32.195 N052.15.46.560 E020.54.31.074 Color_16ACI
N052.15.49.194 E020.54.30.657 N052.15.48.889 E020.54.30.887 Color_16ACI
N052.15.48.889 E020.54.30.887 N052.15.49.173 E020.54.31.759 Color_16ACI
N052.15.49.173 E020.54.31.759 N052.15.49.477 E020.54.31.530 Color_16ACI
N052.15.49.477 E020.54.31.530 N052.15.49.194 E020.54.30.657 Color_16ACI
N052.15.48.629 E020.54.30.751 N052.15.48.419 E020.54.30.005 Color_16ACI
N052.15.48.419 E020.54.30.005 N052.15.48.113 E020.54.30.296 Color_16ACI
N052.15.48.113 E020.54.30.296 N052.15.48.362 E020.54.30.982 Color_16ACI
N052.15.48.362 E020.54.30.982 N052.15.48.629 E020.54.30.751 Color_16ACI
N052.15.47.737 E020.54.30.338 N052.15.48.018 E020.54.31.333 Color_16ACI
N052.15.48.018 E020.54.31.333 N052.15.47.789 E020.54.31.566 Color_16ACI
N052.15.47.789 E020.54.31.566 N052.15.47.470 E020.54.30.569 Color_16ACI
N052.15.47.470 E020.54.30.569 N052.15.47.737 E020.54.30.338 Color_16ACI
N052.15.48.921 E020.54.31.195 N052.15.49.063 E020.54.31.631 Color_16ACI
N052.15.49.063 E020.54.31.631 N052.15.48.072 E020.54.32.438 Color_16ACI
N052.15.48.072 E020.54.32.438 N052.15.47.930 E020.54.32.002 Color_16ACI
N052.15.47.930 E020.54.32.002 N052.15.48.921 E020.54.31.195 Color_16ACI
N052.15.44.316 E020.54.30.775 N052.15.44.724 E020.54.32.941 Color_16ACI
N052.15.44.724 E020.54.32.941 N052.15.45.066 E020.54.32.713 Color_16ACI
N052.15.45.066 E020.54.32.713 N052.15.44.619 E020.54.30.607 Color_16ACI
N052.15.44.619 E020.54.30.607 N052.15.44.316 E020.54.30.775 Color_16ACI
N052.15.41.963 E020.54.34.148 N052.15.42.528 E020.54.36.015 Color_16ACI
N052.15.42.528 E020.54.36.015 N052.15.42.298 E020.54.36.248 Color_16ACI
N052.15.42.298 E020.54.36.248 N052.15.41.696 E020.54.34.379 Color_16ACI
N052.15.41.696 E020.54.34.379 N052.15.41.963 E020.54.34.148 Color_16ACI
N052.15.40.805 E020.54.33.904 N052.15.40.653 E020.54.34.019 Color_16ACI
N052.15.40.844 E020.54.33.845 N052.15.40.805 E020.54.33.904 Color_16ACI
N052.15.40.920 E020.54.33.788 N052.15.40.844 E020.54.33.845 Color_16ACI
N052.15.40.425 E020.54.32.230 N052.15.40.920 E020.54.33.788 Color_16ACI
N052.15.39.928 E020.54.32.695 N052.15.40.425 E020.54.32.230 Color_16ACI
N052.15.40.387 E020.54.34.189 N052.15.39.928 E020.54.32.695 Color_16ACI
N052.15.40.616 E020.54.34.017 N052.15.40.387 E020.54.34.189 Color_16ACI
N052.15.35.018 E020.54.26.683 N052.15.35.269 E020.54.27.248 Color_16ACI
N052.15.35.269 E020.54.27.248 N052.15.35.077 E020.54.27.483 Color_16ACI
N052.15.35.077 E020.54.27.483 N052.15.34.826 E020.54.26.919 Color_16ACI
N052.15.34.826 E020.54.26.919 N052.15.35.018 E020.54.26.683 Color_16ACI
N052.15.34.787 E020.54.26.978 N052.15.34.535 E020.54.26.414 Color_16ACI
N052.15.34.535 E020.54.26.414 N052.15.33.922 E020.54.27.118 Color_16ACI
N052.15.33.922 E020.54.27.118 N052.15.34.172 E020.54.27.743 Color_16ACI
N052.15.34.172 E020.54.27.743 N052.15.34.787 E020.54.26.978 Color_16ACI
N052.15.34.331 E020.54.11.635 N052.15.34.314 E020.54.12.553 Color_16ACI
N052.15.34.314 E020.54.12.553 N052.15.33.939 E020.54.12.534 Color_16ACI
N052.15.33.939 E020.54.12.534 N052.15.33.919 E020.54.11.614 Color_16ACI
N052.15.33.919 E020.54.11.614 N052.15.34.331 E020.54.11.635 Color_16ACI
N052.15.35.422 E020.54.15.368 N052.15.35.442 E020.54.16.288 Color_16ACI
N052.15.35.442 E020.54.16.288 N052.15.35.143 E020.54.16.273 Color_16ACI
N052.15.35.143 E020.54.16.273 N052.15.35.160 E020.54.15.354 Color_16ACI
N052.15.35.160 E020.54.15.354 N052.15.35.422 E020.54.15.368 Color_16ACI
N052.15.40.502 E020.54.30.151 N052.15.39.584 E020.54.31.084 Color_16ACI
N052.15.39.584 E020.54.31.084 N052.15.39.370 E020.54.30.522 Color_16ACI
N052.15.39.370 E020.54.30.522 N052.15.40.251 E020.54.29.587 Color_16ACI
N052.15.40.251 E020.54.29.587 N052.15.40.502 E020.54.30.151 Color_16ACI
N052.15.38.593 E020.54.26.070 N052.15.38.583 E020.54.26.560 Color_16ACI
N052.15.38.583 E020.54.26.560 N052.15.38.059 E020.54.26.533 Color_16ACI
N052.15.38.059 E020.54.26.533 N052.15.38.068 E020.54.26.043 Color_16ACI
N052.15.38.068 E020.54.26.043 N052.15.38.593 E020.54.26.070 Color_16ACI
N052.15.45.067 E020.54.26.831 N052.15.45.132 E020.54.27.324 Color_16ACI
N052.15.45.132 E020.54.27.324 N052.15.43.885 E020.54.27.812 Color_16ACI
N052.15.43.885 E020.54.27.812 N052.15.43.857 E020.54.27.320 Color_16ACI
N052.15.43.857 E020.54.27.320 N052.15.45.067 E020.54.26.831 Color_16ACI
N052.15.29.820 E020.54.39.531 N052.15.29.647 E020.54.40.748 Color_16ACI
N052.15.29.647 E020.54.40.748 N052.15.29.870 E020.54.40.820 Color_16ACI
N052.15.29.870 E020.54.40.820 N052.15.30.080 E020.54.39.667 Color_16ACI
N052.15.30.080 E020.54.39.667 N052.15.29.820 E020.54.39.531 Color_16ACI
N052.15.37.009 E020.54.34.323 N052.15.37.329 E020.54.35.258 Color_16ACI
N052.15.37.329 E020.54.35.258 N052.15.37.100 E020.54.35.430 Color_16ACI
N052.15.37.100 E020.54.35.430 N052.15.36.781 E020.54.34.495 Color_16ACI
N052.15.36.781 E020.54.34.495 N052.15.37.009 E020.54.34.323 Color_16ACI
N052.15.50.863 E020.54.29.640 N052.15.50.855 E020.54.30.068 Color_16ACI
N052.15.50.855 E020.54.30.068 N052.15.49.546 E020.54.29.879 Color_16ACI
N052.15.49.546 E020.54.29.879 N052.15.49.592 E020.54.29.452 Color_16ACI
N052.15.49.592 E020.54.29.452 N052.15.50.863 E020.54.29.640 Color_16ACI
N052.15.47.569 E020.54.29.349 N052.15.47.390 E020.54.28.910 Color_16ACI
N052.15.47.390 E020.54.28.910 N052.15.47.200 E020.54.29.023 Color_16ACI
N052.15.47.200 E020.54.29.023 N052.15.47.340 E020.54.29.521 Color_16ACI
N052.15.47.340 E020.54.29.521 N052.15.47.569 E020.54.29.349 Color_16ACI
N052.15.38.598 E020.54.33.608 N052.15.39.585 E020.54.36.906 Color_16ACI
N052.15.39.585 E020.54.36.906 N052.15.39.166 E020.54.37.252 Color_16ACI
N052.15.39.166 E020.54.37.252 N052.15.38.218 E020.54.33.894 Color_16ACI
N052.15.38.218 E020.54.33.894 N052.15.38.598 E020.54.33.608 Color_16ACI
N052.15.23.743 E020.54.31.744 N052.15.23.311 E020.54.32.763 Color_16ACI
N052.15.23.311 E020.54.32.763 N052.15.24.299 E020.54.34.039 Color_16ACI
N052.15.24.299 E020.54.34.039 N052.15.24.144 E020.54.34.277 Color_16ACI
N052.15.24.144 E020.54.34.277 N052.15.24.400 E020.54.34.657 Color_16ACI
N052.15.24.400 E020.54.34.657 N052.15.24.673 E020.54.34.120 Color_16ACI
N052.15.24.673 E020.54.34.120 N052.15.25.025 E020.54.33.341 Color_16ACI
N052.15.25.025 E020.54.33.341 N052.15.23.743 E020.54.31.744 Color_16ACI
N052.15.26.655 E020.54.16.818 N052.15.24.394 E020.54.17.377 Color_16ACI
N052.15.24.394 E020.54.17.377 N052.15.24.202 E020.54.15.651 Color_16ACI
N052.15.24.202 E020.54.15.651 N052.15.25.483 E020.54.15.349 Color_16ACI
N052.15.25.483 E020.54.15.349 N052.15.25.577 E020.54.16.334 Color_16ACI
N052.15.25.577 E020.54.16.334 N052.15.26.105 E020.54.16.177 Color_16ACI
N052.15.26.105 E020.54.16.177 N052.15.25.920 E020.54.14.084 Color_16ACI
N052.15.25.920 E020.54.14.084 N052.15.26.372 E020.54.13.985 Color_16ACI
N052.15.26.372 E020.54.13.985 N052.15.26.655 E020.54.16.818 Color_16ACI
N052.15.25.655 E020.54.23.998 N052.15.24.261 E020.54.22.333 Color_16ACI
N052.15.24.261 E020.54.22.333 N052.15.25.278 E020.54.20.179 Color_16ACI
N052.15.25.278 E020.54.20.179 N052.15.25.717 E020.54.20.753 Color_16ACI
N052.15.25.717 E020.54.20.753 N052.15.25.520 E020.54.21.233 Color_16ACI
N052.15.25.520 E020.54.21.233 N052.15.25.299 E020.54.21.038 Color_16ACI
N052.15.25.299 E020.54.21.038 N052.15.24.790 E020.54.22.115 Color_16ACI
N052.15.24.790 E020.54.22.115 N052.15.25.927 E020.54.23.460 Color_16ACI
N052.15.25.927 E020.54.23.460 N052.15.25.655 E020.54.23.998 Color_16ACI
N052.15.29.344 E020.54.17.446 N052.15.29.291 E020.54.18.240 Color_16ACI
N052.15.29.291 E020.54.18.240 N052.15.27.461 E020.54.17.840 Color_16ACI
N052.15.27.461 E020.54.17.840 N052.15.27.550 E020.54.17.109 Color_16ACI
N052.15.27.550 E020.54.17.109 N052.15.29.344 E020.54.17.446 Color_16ACI
N052.15.40.912 E020.54.26.373 N052.15.39.900 E020.54.28.282 Color_16ACI
N052.15.39.900 E020.54.28.282 N052.15.39.644 E020.54.27.962 Color_16ACI
N052.15.39.644 E020.54.27.962 N052.15.40.693 E020.54.26.055 Color_16ACI
N052.15.40.693 E020.54.26.055 N052.15.40.912 E020.54.26.373 Color_16ACI
N052.15.26.828 E020.54.35.149 N052.15.26.670 E020.54.35.570 Color_16ACI
N052.15.26.670 E020.54.35.570 N052.15.26.414 E020.54.35.251 Color_16ACI
N052.15.26.414 E020.54.35.251 N052.15.26.099 E020.54.36.031 Color_16ACI
N052.15.26.099 E020.54.36.031 N052.15.25.695 E020.54.35.582 Color_16ACI
N052.15.25.695 E020.54.35.582 N052.15.26.243 E020.54.34.384 Color_16ACI
N052.15.26.243 E020.54.34.384 N052.15.26.828 E020.54.35.149 Color_16ACI
N052.15.32.450 E020.54.17.789 N052.15.32.434 E020.54.18.646 Color_16ACI
N052.15.32.434 E020.54.18.646 N052.15.30.153 E020.54.18.284 Color_16ACI
N052.15.30.153 E020.54.18.284 N052.15.30.167 E020.54.17.550 Color_16ACI
N052.15.30.167 E020.54.17.550 N052.15.32.450 E020.54.17.789 Color_16ACI
N052.15.36.152 E020.54.14.486 N052.15.35.996 E020.54.14.784 Color_16ACI
N052.15.35.996 E020.54.14.784 N052.15.38.586 E020.54.18.594 Color_16ACI
N052.15.38.586 E020.54.18.594 N052.15.38.779 E020.54.18.297 Color_16ACI
N052.15.38.779 E020.54.18.297 N052.15.36.152 E020.54.14.486 Color_16ACI
;grass_rwy N000.00.00.000 E000.00.00.000 N000.00.00.000 E000.00.00.000
N052.16.17.626 E020.54.08.828 N052.16.10.577 E020.54.59.573 Color_96ACI
N052.16.15.317 E020.54.07.975 N052.16.17.626 E020.54.08.828 Color_96ACI
N052.16.15.317 E020.54.07.975 N052.16.12.971 E020.54.07.119 Color_96ACI
N052.16.12.971 E020.54.07.119 N052.16.05.923 E020.54.57.864 Color_96ACI
N052.16.05.923 E020.54.57.864 N052.16.08.231 E020.54.58.718 Color_96ACI
N052.16.08.231 E020.54.58.718 N052.16.10.577 E020.54.59.573 Color_96ACI
N052.16.10.577 E020.54.59.573 N052.16.17.626 E020.54.08.828 Color_96ACI
N052.16.17.626 E020.54.08.828 N052.16.15.317 E020.54.07.975 Color_96ACI
;linia_energ N000.00.00.000 E000.00.00.000 N000.00.00.000 E000.00.00.000
N052.15.42.864 E020.54.24.328 N052.15.42.435 E020.54.25.225 Color_196ACI
N052.15.59.285 E020.53.59.248 N052.15.59.286 E020.53.59.187 Color_196ACI
N052.15.59.286 E020.53.59.187 N052.15.57.811 E020.53.53.964 Color_196ACI
N052.15.57.811 E020.53.53.964 N052.15.55.764 E020.53.47.302 Color_196ACI
N052.15.55.764 E020.53.47.302 N052.15.53.904 E020.53.40.650 Color_196ACI
N052.15.53.904 E020.53.40.650 N052.15.52.636 E020.53.36.357 Color_196ACI
N052.15.52.636 E020.53.36.357 N052.15.51.856 E020.53.33.989 Color_196ACI
N052.15.51.856 E020.53.33.989 N052.15.51.390 E020.53.32.862 Color_196ACI
N052.15.51.390 E020.53.32.862 N052.15.50.662 E020.53.31.721 Color_196ACI
N052.15.50.662 E020.53.31.721 N052.15.49.571 E020.53.29.950 Color_196ACI
N052.15.35.788 E020.54.13.916 N052.15.35.321 E020.54.14.811 Color_196ACI
N052.15.39.325 E020.54.19.183 N052.15.38.859 E020.54.20.017 Color_196ACI
N052.15.47.115 E020.54.25.649 N052.15.47.205 E020.54.26.818 Color_196ACI
N052.15.50.721 E020.54.21.421 N052.15.51.232 E020.54.22.183 Color_196ACI
N052.15.53.944 E020.54.15.704 N052.15.54.454 E020.54.16.465 Color_196ACI
N052.15.56.982 E020.54.09.793 N052.15.57.569 E020.54.10.497 Color_196ACI
N052.15.59.133 E020.54.03.224 N052.15.59.803 E020.54.03.503 Color_196ACI
N052.15.59.248 E020.53.59.185 N052.15.59.383 E020.53.59.989 Color_196ACI
N052.15.59.383 E020.53.59.989 N052.15.59.544 E020.54.01.345 Color_196ACI
N052.15.59.544 E020.54.01.345 N052.15.59.509 E020.54.03.182 Color_196ACI
N052.15.59.509 E020.54.03.182 N052.15.59.212 E020.54.05.005 Color_196ACI
N052.15.59.212 E020.54.05.005 N052.15.58.492 E020.54.07.358 Color_196ACI
N052.15.58.492 E020.54.07.358 N052.15.57.666 E020.54.09.338 Color_196ACI
N052.15.57.666 E020.54.09.338 N052.15.56.257 E020.54.12.391 Color_196ACI
N052.15.56.257 E020.54.12.391 N052.15.51.557 E020.54.20.851 Color_196ACI
N052.15.51.557 E020.54.20.851 N052.15.50.161 E020.54.23.231 Color_196ACI
N052.15.50.161 E020.54.23.231 N052.15.49.387 E020.54.24.478 Color_196ACI
N052.15.49.387 E020.54.24.478 N052.15.48.470 E020.54.25.350 Color_196ACI
N052.15.48.470 E020.54.25.350 N052.15.47.179 E020.54.26.203 Color_196ACI
N052.15.47.179 E020.54.26.203 N052.15.45.786 E020.54.26.500 Color_196ACI
N052.15.45.786 E020.54.26.500 N052.15.44.217 E020.54.26.174 Color_196ACI
N052.15.44.217 E020.54.26.174 N052.15.43.217 E020.54.25.510 Color_196ACI
N052.15.43.217 E020.54.25.510 N052.15.42.045 E020.54.24.041 Color_196ACI
N052.15.42.045 E020.54.24.041 N052.15.33.658 E020.54.11.539 Color_196ACI
N052.15.52.879 E020.53.35.389 N052.15.52.040 E020.53.36.143 Color_196ACI
N052.15.53.126 E020.53.36.198 N052.15.52.252 E020.53.36.828 Color_196ACI
N052.15.55.903 E020.53.45.900 N052.15.55.028 E020.53.46.529 Color_196ACI
N052.15.56.114 E020.53.46.646 N052.15.55.239 E020.53.47.275 Color_196ACI
N052.15.59.004 E020.53.56.292 N052.15.58.129 E020.53.56.922 Color_196ACI
N052.15.59.215 E020.53.57.039 N052.15.58.340 E020.53.57.668 Color_196ACI
;rwy N000.00.00.000 E000.00.00.000 N000.00.00.000 E000.00.00.000
N052.16.13.910 E020.53.53.379 N052.16.11.118 E020.53.52.317 Color_46ACI
N052.16.11.118 E020.53.52.317 N052.16.01.901 E020.54.58.332 Color_46ACI
N052.16.01.901 E020.54.58.332 N052.16.04.695 E020.54.59.333 Color_46ACI
N052.16.04.695 E020.54.59.333 N052.16.13.910 E020.53.53.379 Color_46ACI
N052.16.04.695 E020.54.59.333 N052.16.01.820 E020.55.20.143 Color_46ACI
N052.16.01.901 E020.54.58.332 N052.15.58.898 E020.55.19.994 Color_46ACI


[REGIONS]
; - Bialystok
URBAN region_URBAN N053.07.56.392 E023.04.06.128
N053.07.56.809 E023.04.06.488
N053.07.58.854 E023.04.05.257
N053.08.03.592 E023.04.02.266
N053.08.43.433 E023.04.12.248
N053.08.47.332 E023.04.12.353
N053.08.52.408 E023.04.13.523
N053.08.54.701 E023.04.13.897
N053.08.56.465 E023.04.14.261
N053.09.02.887 E023.04.16.111
N053.09.05.008 E023.04.14.419
N053.09.06.649 E023.04.14.851
N053.09.07.682 E023.04.18.041
N053.09.18.270 E023.04.20.053
N053.09.20.084 E023.04.20.701
N053.09.21.697 E023.04.22.066
N053.09.19.850 E023.04.31.966
N053.09.22.388 E023.04.29.687
N053.09.28.094 E023.04.25.133
N053.09.34.754 E023.04.20.258
N053.09.36.346 E023.04.14.383
N053.09.39.355 E023.04.16.648
N053.09.40.759 E023.04.16.986
N053.09.42.451 E023.04.19.236
N053.09.44.165 E023.04.20.258
N053.09.46.890 E023.04.22.408
N053.09.46.192 E023.04.25.853
N053.09.49.565 E023.04.27.851
N053.09.48.035 E023.04.33.704
N053.10.00.995 E023.04.39.137
N053.10.01.481 E023.04.36.890
N053.10.06.254 E023.04.38.021
N053.10.02.856 E023.05.12.883
N053.09.40.828 E023.05.58.427
N053.09.21.179 E023.06.25.423
N053.09.23.832 E023.07.04.469
N053.09.24.181 E023.08.20.562
N053.09.34.294 E023.09.09.806
N053.09.14.764 E023.10.07.622
N053.10.06.971 E023.11.16.976
N053.10.09.890 E023.11.51.648
N053.10.04.559 E023.11.50.572
N053.10.03.036 E023.12.30.827
N053.09.42.649 E023.12.58.036
N053.09.14.033 E023.12.11.027
N053.09.10.433 E023.12.37.800
N053.09.16.679 E023.12.54.187
N053.09.11.819 E023.13.16.860
N053.08.33.443 E023.13.02.860
N053.08.23.507 E023.12.50.623
N053.08.04.999 E023.12.59.040
N053.07.24.287 E023.13.20.010
N053.06.55.843 E023.13.16.190
N053.06.52.024 E023.12.47.462
N053.06.24.782 E023.12.35.417
N053.06.17.564 E023.12.02.585
N053.06.24.610 E023.11.52.278
N053.06.13.241 E023.10.52.828
N053.06.36.623 E023.10.27.916
N053.05.51.410 E023.07.46.160
N053.05.52.663 E023.07.41.920
N053.06.03.661 E023.07.29.960
N053.06.09.511 E023.07.22.224
N053.06.17.453 E023.07.11.208
N053.06.18.284 E023.07.09.451
N053.06.17.647 E023.07.06.751
N053.06.17.154 E023.07.03.860
N053.06.17.150 E023.07.02.089
N053.06.24.530 E023.06.52.340
N053.06.34.124 E023.05.50.582
N053.06.49.982 E023.05.07.224
N053.06.44.618 E023.04.46.880
N053.07.07.752 E023.04.34.295
N053.07.09.815 E023.04.32.228
N053.07.11.255 E023.04.29.881
N053.07.15.820 E023.04.27.077
N053.07.19.513 E023.04.25.043
N053.07.20.838 E023.04.24.996
N053.07.23.333 E023.04.23.686
N053.07.30.842 E023.04.18.541
N053.07.31.908 E023.04.23.624
N053.07.32.880 E023.04.23.077
N053.07.33.143 E023.04.24.643
N053.07.38.086 E023.04.21.270
N053.07.37.412 E023.04.18.620
N053.07.37.999 E023.04.18.221
N053.07.36.725 E023.04.06.949
N053.07.39.166 E023.04.02.582
N053.07.41.106 E023.04.01.794
N053.07.43.568 E023.04.13.501
N053.07.43.878 E023.04.12.922
N053.07.44.425 E023.04.11.071
N053.07.45.527 E023.04.08.357
N053.07.48.220 E023.04.07.835
N053.07.48.407 E023.04.06.089
N053.07.49.058 E023.04.05.783
N053.07.51.902 E023.04.05.020
N053.07.52.345 E023.04.04.688
N053.07.52.907 E023.04.02.453
; - Bydgoszcz
URBAN region_URBAN N053.09.20.322 E017.55.04.703
N053.09.20.196 E017.55.06.334
N053.09.19.339 E017.55.03.490
N053.09.14.285 E017.55.08.256
N053.09.13.075 E017.55.05.005
N053.09.10.793 E017.55.05.905
N053.09.11.196 E017.55.09.253
N053.09.10.969 E017.55.09.361
N053.09.10.901 E017.55.09.343
N053.09.10.912 E017.55.09.386
N053.09.08.456 E017.55.10.535
N053.09.09.011 E017.55.12.680
N053.09.03.449 E017.55.14.653
N053.09.02.596 E017.55.08.515
N053.09.00.432 E017.55.11.424
N053.08.58.614 E017.55.12.518
N053.08.54.863 E017.55.14.279
N053.08.52.552 E017.55.13.555
N053.08.51.630 E017.55.13.742
N053.08.48.095 E017.55.26.598
N053.08.27.233 E017.55.36.494
N053.08.27.899 E017.56.29.382
N053.08.30.066 E017.56.30.534
N053.08.25.004 E017.56.48.340
N053.08.25.642 E017.56.47.947
N053.08.24.817 E017.56.50.935
N053.08.44.948 E017.56.38.447
N053.08.50.179 E017.56.41.230
N053.08.52.076 E017.56.48.372
N053.09.01.382 E017.57.28.076
N053.09.05.270 E017.57.28.800
N053.09.27.684 E017.57.15.217
N053.09.33.152 E017.57.13.280
N053.09.58.468 E017.57.05.677
N053.09.58.324 E017.57.03.514
N053.10.00.160 E017.57.02.963
N053.10.00.185 E017.57.03.218
N053.10.00.808 E017.57.03.269
N053.10.01.031 E017.57.05.198
N053.10.04.926 E017.57.03.870
N053.10.08.306 E017.57.00.727
N053.11.18.370 E017.57.28.033
N053.11.46.172 E017.57.58.939
N053.11.37.828 E017.58.32.653
N053.11.36.719 E017.58.30.990
N053.11.36.676 E017.58.29.608
N053.11.35.927 E017.58.26.674
N053.11.35.848 E017.58.24.632
N053.11.34.426 E017.58.21.878
N053.11.28.392 E017.58.15.737
N053.11.27.550 E017.58.15.359
N053.11.22.481 E017.58.14.196
N053.11.20.602 E017.58.14.412
N053.11.19.259 E017.58.13.703
N053.11.18.542 E017.58.09.797
N053.11.16.332 E017.58.08.566
N053.11.13.258 E017.58.05.567
N053.11.11.796 E017.58.06.064
N053.11.10.817 E017.58.06.100
N053.11.09.586 E017.58.05.254
N053.11.07.120 E017.58.05.462
N053.11.04.909 E017.58.04.048
N053.11.00.006 E017.58.03.122
N053.10.58.577 E017.58.02.968
N053.10.56.806 E017.58.05.178
N053.10.55.405 E017.58.05.585
N053.10.54.667 E017.58.05.628
N053.10.39.907 E017.57.47.783
N053.10.40.181 E017.58.06.251
N053.10.39.547 E017.58.06.269
N053.10.32.765 E017.58.08.364
N053.10.24.251 E017.58.12.169
N053.10.14.506 E017.58.13.696
N053.10.08.998 E017.58.14.128
N053.10.05.311 E017.58.16.144
N053.10.04.908 E017.58.19.409
N053.10.04.242 E017.58.19.567
N053.10.03.443 E017.58.31.166
N053.09.54.011 E017.58.34.100
N053.09.36.634 E017.58.35.436
N053.09.15.473 E017.58.23.887
N053.09.03.726 E017.58.50.952
N053.08.41.442 E017.59.05.024
N053.08.29.724 E017.59.27.276
N053.08.31.438 E018.00.02.556
N053.08.27.132 E018.00.37.552
N053.09.15.505 E018.01.10.517
N053.10.29.082 E018.02.50.971
N053.10.27.682 E018.02.54.092
N053.10.21.371 E018.03.07.438
N053.10.28.823 E018.03.17.726
N053.10.28.740 E018.03.18.504
N053.10.23.387 E018.03.42.890
N053.10.23.412 E018.03.45.133
N053.10.23.304 E018.03.49.136
N053.10.21.986 E018.03.49.381
N053.10.04.300 E018.03.32.339
N053.09.29.549 E018.03.27.954
N053.09.18.684 E018.02.22.481
N053.08.48.653 E018.01.50.855
N053.08.20.933 E018.02.58.384
N053.07.59.329 E018.05.40.171
N053.08.05.197 E018.06.04.097
N053.08.22.560 E018.06.02.308
N053.08.51.756 E018.07.18.779
N053.09.28.422 E018.07.19.992
N053.09.23.836 E018.08.36.848
N053.09.58.673 E018.09.11.711
N053.10.35.195 E018.09.48.539
N053.10.34.950 E018.09.51.883
N053.10.35.594 E018.09.52.200
N053.10.19.189 E018.10.41.153
N053.09.36.742 E018.10.43.144
N053.09.31.961 E018.10.59.189
N053.09.01.080 E018.10.57.868
N053.08.32.870 E018.09.34.942
N053.08.15.288 E018.08.21.538
N053.07.12.338 E018.07.07.028
N053.06.00.774 E018.06.15.044
N053.06.09.378 E018.05.50.982
N053.06.26.701 E018.05.38.004
N053.06.40.928 E018.04.29.111
N053.06.44.683 E018.04.00.296
N053.05.51.522 E018.03.33.754
N053.05.39.754 E018.02.42.763
N053.05.52.084 E018.01.48.284
N053.05.41.352 E018.01.10.866
N053.05.40.812 E018.00.50.195
N053.05.39.671 E018.00.50.036
N053.05.41.950 E018.00.31.486
N053.05.43.670 E018.00.32.098
N053.05.43.861 E018.00.29.833
N053.05.46.363 E018.00.30.168
N053.05.46.442 E018.00.29.034
N053.06.02.358 E018.00.25.056
N053.06.05.188 E018.00.09.036
N053.05.47.926 E018.00.04.306
N053.05.47.911 E017.59.59.798
N053.05.48.293 E017.59.36.204
N053.05.49.718 E017.59.16.505
N053.05.53.124 E017.58.32.920
N053.05.54.175 E017.58.17.274
N053.05.48.034 E017.58.15.164
N053.05.49.121 E017.57.48.593
N053.05.44.675 E017.57.35.402
N053.05.49.088 E017.57.25.571
N053.05.52.184 E017.57.11.473
N053.06.00.500 E017.56.59.406
N053.06.40.579 E017.57.03.031
N053.06.49.151 E017.57.22.374
N053.06.59.818 E017.57.04.086
N053.07.07.316 E017.57.05.821
N053.07.08.562 E017.56.57.710
N053.07.08.101 E017.56.46.608
N053.07.09.055 E017.56.37.640
N053.07.11.507 E017.56.36.535
N053.07.26.141 E017.56.33.493
N053.07.30.040 E017.56.34.458
N053.07.33.359 E017.56.31.996
N053.07.37.337 E017.56.26.408
N053.07.37.308 E017.56.26.189
N053.07.37.844 E017.56.25.397
N053.07.37.668 E017.56.22.420
N053.07.36.023 E017.56.14.827
N053.07.34.900 E017.56.10.525
N053.07.34.745 E017.56.10.414
N053.07.40.944 E017.55.24.967
N053.07.56.298 E017.54.47.174
N053.07.56.172 E017.54.46.184
N053.08.13.056 E017.54.43.420
N053.08.32.464 E017.54.24.462
N053.09.15.833 E017.54.34.686
N053.09.26.258 E017.55.08.490
; - Gdansk
URBAN region_URBAN N054.25.24.017 E018.33.47.405
N054.25.25.352 E018.33.49.342
N054.25.26.083 E018.33.57.114
N054.25.25.774 E018.34.03.335
N054.25.24.406 E018.34.18.667
N054.25.29.579 E018.34.37.358
N054.25.28.477 E018.34.39.086
N054.25.32.578 E018.34.56.784
N054.25.32.585 E018.35.00.168
N054.25.40.829 E018.35.14.341
N054.25.02.716 E018.36.00.918
N054.24.14.760 E018.37.22.123
N054.24.43.931 E018.37.44.818
N054.24.41.756 E018.37.51.427
N054.24.37.447 E018.38.06.148
N054.24.34.232 E018.38.18.661
N054.24.32.357 E018.38.27.654
N054.24.25.096 E018.39.00.079
N054.24.06.304 E018.40.47.885
N054.23.37.136 E018.40.34.655
N054.23.17.916 E018.39.21.784
N054.22.48.634 E018.38.22.470
N054.22.04.940 E018.38.26.689
N054.21.19.274 E018.40.18.455
N054.21.42.862 E018.40.43.234
N054.21.39.586 E018.41.21.664
N054.21.49.882 E018.43.05.293
N054.21.02.837 E018.43.13.289
N054.20.44.707 E018.41.35.513
N054.20.38.980 E018.40.37.974
N054.19.50.614 E018.39.21.593
N054.19.11.410 E018.39.27.673
N054.18.55.602 E018.38.39.851
N054.17.38.224 E018.38.17.513
N054.16.46.132 E018.38.29.998
N054.16.46.398 E018.38.20.918
N054.16.41.837 E018.38.22.121
N054.16.41.030 E018.38.00.769
N054.18.20.653 E018.37.21.522
N054.17.58.060 E018.36.16.535
N054.17.59.647 E018.36.15.545
N054.18.02.275 E018.36.17.532
N054.18.13.241 E018.36.07.092
N054.18.29.380 E018.35.57.055
N054.18.44.165 E018.37.13.634
N054.19.34.644 E018.37.32.354
N054.19.35.713 E018.37.13.159
N054.18.53.989 E018.35.41.467
N054.18.48.276 E018.35.05.075
N054.19.22.883 E018.34.22.519
N054.19.35.292 E018.34.49.253
N054.19.14.099 E018.35.22.085
N054.20.02.602 E018.37.10.992
N054.20.12.696 E018.37.14.736
N054.20.11.386 E018.36.07.574
N054.19.51.118 E018.35.35.149
N054.19.46.409 E018.34.20.352
N054.19.29.359 E018.33.05.699
N054.19.51.654 E018.32.30.912
N054.20.05.284 E018.33.26.417
N054.20.12.347 E018.35.13.823
N054.20.30.347 E018.35.38.598
N054.20.59.464 E018.35.30.631
N054.21.16.254 E018.35.24.702
N054.21.54.518 E018.36.21.942
N054.22.14.718 E018.36.31.356
N054.22.39.097 E018.34.58.904
N054.22.52.414 E018.34.16.500
N054.24.02.837 E018.33.21.946
N054.24.19.620 E018.33.14.076
N054.24.49.900 E018.33.21.442
N054.25.13.332 E018.33.19.958
N054.25.11.611 E018.33.25.913
N054.25.24.866 E018.33.34.488
N054.25.25.255 E018.33.36.716
N054.25.24.370 E018.33.39.542
; - Gorzów_Wielkopolski
URBAN region_URBAN N052.43.42.784 E015.10.31.228
N052.43.42.740 E015.10.53.418
N052.43.35.000 E015.11.06.072
N052.43.54.102 E015.12.38.074
N052.44.18.308 E015.11.52.188
N052.44.48.131 E015.12.28.768
N052.44.39.408 E015.12.49.349
N052.44.41.294 E015.13.08.382
N052.44.56.720 E015.13.10.031
N052.45.01.476 E015.13.40.181
N052.45.26.510 E015.13.57.734
N052.45.29.329 E015.14.29.472
N052.45.05.209 E015.14.32.532
N052.45.08.946 E015.15.23.303
N052.45.57.974 E015.16.23.826
N052.45.42.498 E015.16.41.196
N052.45.03.082 E015.15.53.406
N052.44.07.951 E015.16.51.784
N052.43.59.642 E015.17.48.858
N052.43.55.942 E015.17.48.332
N052.43.52.280 E015.17.47.000
N052.43.49.843 E015.17.45.802
N052.43.49.562 E015.17.45.827
N052.43.52.252 E015.17.20.731
N052.43.51.301 E015.17.20.220
N052.43.53.598 E015.16.59.128
N052.43.51.100 E015.16.58.436
N052.43.49.958 E015.16.57.907
N052.43.57.461 E015.16.05.754
N052.43.42.197 E015.15.00.684
N052.43.18.941 E015.15.44.950
N052.43.15.024 E015.16.07.115
N052.43.22.667 E015.16.34.100
N052.42.51.761 E015.16.49.782
N052.42.20.801 E015.17.24.464
N052.42.08.359 E015.16.49.541
N052.42.51.865 E015.16.11.752
N052.42.36.511 E015.15.41.566
N052.42.11.408 E015.15.52.528
N052.41.13.625 E015.15.20.556
N052.41.24.320 E015.14.45.769
N052.42.17.273 E015.15.22.457
N052.42.29.822 E015.15.17.766
N052.42.26.039 E015.14.47.645
N052.43.08.558 E015.14.12.980
N052.42.56.081 E015.13.47.568
N052.43.11.550 E015.13.31.789
N052.43.05.808 E015.13.11.165
N052.43.28.034 E015.12.52.236
; - Katowice
URBAN region_URBAN N050.13.46.855 E018.55.12.155
N050.13.46.474 E018.55.17.476
N050.13.45.977 E018.55.20.330
N050.13.43.698 E018.55.27.779
N050.13.43.428 E018.55.29.158
N050.13.43.493 E018.55.30.778
N050.13.45.329 E018.55.46.290
N050.13.45.995 E018.55.49.829
N050.13.46.265 E018.55.54.998
N050.13.46.463 E018.55.56.100
N050.13.47.338 E018.55.58.609
N050.13.48.914 E018.56.01.568
N050.13.49.181 E018.56.02.702
N050.13.49.480 E018.56.04.495
N050.13.49.897 E018.56.06.097
N050.13.50.909 E018.56.08.070
N050.13.51.172 E018.56.08.750
N050.13.51.175 E018.56.09.730
N050.13.51.049 E018.56.10.507
N050.13.50.743 E018.56.15.691
N050.13.51.341 E018.56.18.794
N050.13.52.302 E018.56.22.870
N050.13.52.878 E018.56.25.584
N050.13.53.188 E018.56.27.524
N050.13.53.155 E018.56.28.493
N050.13.53.198 E018.56.33.104
N050.13.53.476 E018.56.35.974
N050.13.53.850 E018.56.39.343
N050.13.54.998 E018.56.45.125
N050.13.55.963 E018.56.53.653
N050.13.55.405 E018.56.54.175
N050.14.07.699 E018.57.11.678
N050.14.23.078 E018.57.28.040
N050.14.39.556 E018.57.43.326
N050.14.58.250 E018.58.18.235
N050.15.19.886 E018.57.33.826
N050.15.18.850 E018.57.24.361
N050.15.23.580 E018.57.23.188
N050.15.27.400 E018.57.21.514
N050.15.29.239 E018.57.19.998
N050.15.30.445 E018.57.19.732
N050.15.31.957 E018.57.19.836
N050.15.34.358 E018.57.18.878
N050.15.36.173 E018.57.17.698
N050.15.39.215 E018.57.16.607
N050.15.41.612 E018.57.15.880
N050.15.42.898 E018.57.15.336
N050.15.44.658 E018.57.14.152
N050.15.46.058 E018.57.13.702
N050.15.46.116 E018.57.15.696
N050.15.49.684 E018.57.16.787
N050.15.53.370 E018.57.19.418
N050.15.55.591 E018.57.20.236
N050.15.56.412 E018.57.20.236
N050.15.58.633 E018.57.19.508
N050.16.01.499 E018.57.18.785
N050.16.02.964 E018.57.18.785
N050.16.04.602 E018.57.19.782
N050.16.06.006 E018.57.20.963
N050.16.07.349 E018.57.21.780
N050.16.08.285 E018.57.22.961
N050.16.09.923 E018.57.23.778
N050.16.12.907 E018.57.26.503
N050.16.14.545 E018.57.27.684
N050.16.16.302 E018.57.28.411
N050.16.19.812 E018.57.28.318
N050.16.20.896 E018.57.27.832
N050.16.22.048 E018.57.27.464
N050.16.22.958 E018.57.27.673
N050.16.23.873 E018.57.28.148
N050.16.24.413 E018.57.28.674
N050.16.23.941 E018.57.30.301
N050.16.24.586 E018.57.31.036
N050.16.24.820 E018.57.31.720
N050.16.24.956 E018.57.32.400
N050.16.26.443 E018.57.33.138
N050.16.25.601 E018.57.37.498
N050.16.25.565 E018.57.38.653
N050.16.25.770 E018.57.39.492
N050.16.26.040 E018.57.40.122
N050.16.29.424 E018.57.40.144
N050.16.33.348 E018.57.40.702
N050.16.35.818 E018.57.40.543
N050.16.42.820 E018.57.40.702
N050.16.46.204 E018.57.39.287
N050.16.48.166 E018.57.38.394
N050.16.48.133 E018.57.39.391
N050.16.48.979 E018.57.43.067
N050.16.52.262 E018.57.43.121
N050.16.53.447 E018.57.43.488
N050.16.54.257 E018.57.43.333
N050.16.54.494 E018.57.43.070
N050.16.54.664 E018.57.44.802
N050.16.54.934 E018.57.45.065
N050.16.56.287 E018.57.45.277
N050.16.57.234 E018.57.45.940
N050.16.57.943 E018.57.46.512
N050.17.00.751 E018.57.48.096
N050.17.03.674 E018.57.50.476
N050.17.05.233 E018.57.51.887
N050.17.05.914 E018.57.52.679
N050.17.07.361 E018.57.54.662
N050.17.09.348 E018.57.56.027
N050.17.10.622 E018.57.56.732
N050.17.11.933 E018.57.57.661
N050.17.12.725 E018.57.58.759
N050.17.13.150 E018.58.00.739
N050.17.13.236 E018.58.03.112
N050.17.13.207 E018.58.04.080
N050.17.13.754 E018.58.05.995
N050.17.13.895 E018.58.07.795
N050.17.13.837 E018.58.09.818
N050.17.13.686 E018.58.10.618
N050.17.13.222 E018.58.11.453
N050.17.12.541 E018.58.11.928
N050.17.11.861 E018.58.11.932
N050.17.11.015 E018.58.12.155
N050.17.08.282 E018.58.16.298
N050.17.05.507 E018.58.20.647
N050.17.04.121 E018.58.22.670
N050.17.03.300 E018.58.24.557
N050.17.03.120 E018.58.25.100
N050.17.02.987 E018.58.25.939
N050.17.02.976 E018.58.27.437
N050.17.02.720 E018.58.28.236
N050.17.02.231 E018.58.28.906
N050.17.01.835 E018.58.29.298
N050.16.59.812 E018.58.29.492
N050.16.59.423 E018.58.29.885
N050.16.56.514 E018.58.34.068
N050.16.49.220 E018.58.45.718
N050.16.47.147 E018.58.48.821
N050.16.41.952 E018.58.57.104
N050.16.36.703 E018.59.05.136
N050.16.36.142 E018.59.06.871
N050.16.35.573 E018.59.07.966
N050.16.34.482 E018.59.09.629
N050.16.33.982 E018.59.09.820
N050.16.33.384 E018.59.10.201
N050.16.19.938 E018.59.31.945
N050.16.21.630 E018.59.34.570
N050.16.34.104 E018.59.54.575
N050.16.39.302 E019.00.05.418
N050.16.53.378 E019.00.29.686
N050.17.43.912 E019.00.15.980
N050.17.44.196 E019.00.16.754
N050.17.44.340 E019.00.16.207
N050.17.44.405 E019.00.16.794
N050.17.42.032 E019.00.26.338
N050.17.36.906 E019.00.47.909
N050.17.35.290 E019.00.53.968
N050.17.34.800 E019.00.54.378
N050.17.34.991 E019.00.55.163
N050.17.32.770 E019.01.02.744
N050.17.30.548 E019.01.07.122
N050.17.30.088 E019.01.07.194
N050.17.28.878 E019.01.06.096
N050.17.26.848 E019.01.03.860
N050.17.25.094 E019.01.04.609
N050.17.24.947 E019.01.06.748
N050.17.24.659 E019.01.07.367
N050.17.21.358 E019.01.09.757
N050.17.20.004 E019.01.11.309
N050.17.18.935 E019.01.15.845
N050.17.18.103 E019.01.17.224
N050.17.16.840 E019.01.18.106
N050.17.14.132 E019.01.23.480
N050.17.13.524 E019.01.25.748
N050.17.13.610 E019.01.27.440
N050.17.13.578 E019.01.29.532
N050.17.12.080 E019.01.32.599
N050.17.11.645 E019.01.34.468
N050.17.11.612 E019.01.36.869
N050.17.12.473 E019.01.37.409
N050.17.12.901 E019.01.38.302
N050.17.13.186 E019.01.39.461
N050.17.12.926 E019.01.41.329
N050.17.10.453 E019.01.44.076
N050.17.09.445 E019.01.46.297
N050.17.07.948 E019.01.48.875
N050.17.07.346 E019.01.49.670
N050.17.05.824 E019.01.50.999
N050.17.01.633 E019.01.49.912
N050.17.02.915 E019.01.55.661
N050.17.02.666 E019.01.55.754
N050.16.56.860 E019.01.57.054
N050.16.56.572 E019.01.56.741
N050.16.55.225 E019.01.56.158
N050.16.53.990 E019.01.56.150
N050.16.52.414 E019.01.56.946
N050.16.49.541 E019.01.58.220
N050.16.46.985 E019.01.59.902
N050.16.45.577 E019.02.00.960
N050.16.43.964 E019.02.03.044
N050.16.42.467 E019.02.06.378
N050.16.41.488 E019.02.09.042
N050.16.41.106 E019.02.13.492
N050.16.41.106 E019.02.14.561
N050.16.42.539 E019.02.15.367
N050.16.42.103 E019.02.17.725
N050.16.41.873 E019.02.18.524
N050.16.35.620 E019.02.48.052
N050.16.33.683 E019.02.55.522
N050.16.32.588 E019.02.59.474
N050.16.32.387 E019.02.59.834
N050.16.39.292 E019.03.05.080
N050.16.42.578 E019.02.55.522
N050.16.52.810 E019.03.03.233
N050.16.50.412 E019.03.11.232
N050.16.57.803 E019.03.17.194
N050.16.57.734 E019.03.20.016
N050.17.00.236 E019.03.22.442
N050.17.02.288 E019.03.26.474
N050.17.06.014 E019.03.28.386
N050.17.06.731 E019.03.28.728
N050.17.11.292 E019.03.30.442
N050.17.12.754 E019.03.30.539
N050.17.13.844 E019.03.30.812
N050.17.15.104 E019.03.31.309
N050.17.16.195 E019.03.32.162
N050.17.16.796 E019.03.32.789
N050.17.18.895 E019.03.30.841
N050.17.20.015 E019.03.30.359
N050.17.20.987 E019.03.30.762
N050.17.21.905 E019.03.32.148
N050.17.22.819 E019.03.32.821
N050.17.23.737 E019.03.33.228
N050.17.25.087 E019.03.33.102
N050.17.25.422 E019.03.33.491
N050.17.25.775 E019.03.33.595
N050.17.26.668 E019.03.33.199
N050.17.28.734 E019.03.28.480
N050.17.30.808 E019.03.26.860
N050.17.31.384 E019.03.26.176
N050.17.31.960 E019.03.25.200
N050.17.34.912 E019.03.25.538
N050.17.35.599 E019.03.25.819
N050.17.36.326 E019.03.26.402
N050.17.38.548 E019.03.28.526
N050.17.39.278 E019.03.28.926
N050.17.39.905 E019.03.29.743
N050.17.40.060 E019.03.30.276
N050.17.41.071 E019.03.31.147
N050.17.41.352 E019.03.32.069
N050.17.41.741 E019.03.32.717
N050.17.41.906 E019.03.33.329
N050.17.41.975 E019.03.33.991
N050.17.27.722 E019.04.14.210
N050.16.49.318 E019.04.21.540
N050.16.50.146 E019.05.07.220
N050.16.00.296 E019.06.41.810
N050.16.00.059 E019.07.18.138
N050.16.02.467 E019.07.17.760
N050.16.00.584 E019.07.22.217
N050.15.56.747 E019.07.16.882
N050.15.54.745 E019.07.15.200
N050.15.50.792 E019.07.10.416
N050.15.49.331 E019.07.08.551
N050.15.47.588 E019.07.07.054
N050.15.43.823 E019.07.04.314
N050.15.42.786 E019.07.04.022
N050.15.39.136 E019.07.04.030
N050.15.35.932 E019.07.03.810
N050.15.35.392 E019.07.03.007
N050.15.33.509 E019.07.02.204
N050.15.24.336 E019.06.59.036
N050.15.26.939 E019.06.53.406
N050.15.28.451 E019.06.49.208
N050.15.17.431 E019.06.45.979
N050.15.08.503 E019.06.43.441
N050.15.08.471 E019.06.41.148
N050.15.04.583 E019.06.40.104
N050.15.03.748 E019.06.38.610
N050.15.02.459 E019.06.38.257
N050.15.01.595 E019.06.38.362
N050.15.00.054 E019.06.37.764
N050.14.59.381 E019.06.35.521
N050.14.59.478 E019.06.31.036
N050.14.58.279 E019.06.29.794
N050.14.57.476 E019.06.28.670
N050.14.56.558 E019.06.26.773
N050.14.55.450 E019.06.23.512
N050.14.55.028 E019.06.21.496
N050.14.55.522 E019.06.17.816
N050.14.55.064 E019.06.17.222
N050.14.54.604 E019.06.14.317
N050.14.52.811 E019.06.14.378
N050.14.51.932 E019.06.14.026
N050.14.51.475 E019.06.13.136
N050.14.51.281 E019.06.09.457
N050.14.49.067 E019.06.08.986
N050.14.48.872 E019.06.08.633
N050.14.48.412 E019.06.07.207
N050.14.47.422 E019.06.05.609
N050.14.46.428 E019.06.04.482
N050.14.44.020 E019.06.02.707
N050.14.42.454 E019.06.04.907
N050.14.37.856 E019.06.09.295
N050.14.36.510 E019.06.10.760
N050.14.36.092 E019.06.10.764
N050.14.35.315 E019.06.08.302
N050.14.34.984 E019.06.07.016
N050.14.34.523 E019.06.07.265
N050.14.33.526 E019.06.02.761
N050.14.28.331 E019.06.02.974
N050.14.26.725 E019.06.03.629
N050.14.25.044 E019.06.04.698
N050.14.24.166 E019.06.05.530
N050.14.23.518 E019.06.04.288
N050.14.22.106 E019.06.05.890
N050.14.20.328 E019.06.08.712
N050.14.15.637 E019.06.05.922
N050.14.04.175 E019.05.53.963
N050.12.38.030 E019.05.08.027
N050.13.26.249 E019.01.54.361
N050.13.05.959 E019.00.19.408
N050.12.49.558 E019.00.19.465
N050.12.15.516 E019.03.44.518
N050.11.20.641 E019.03.15.653
N050.10.24.643 E019.01.55.686
N050.10.32.434 E019.01.17.630
N050.10.32.567 E019.01.17.580
N050.10.32.509 E019.01.17.252
N050.10.41.048 E019.00.35.554
N050.10.13.559 E018.59.24.079
N050.09.59.652 E018.56.50.622
N050.10.00.163 E018.56.51.112
N050.10.00.635 E018.56.51.756
N050.10.01.520 E018.56.54.236
N050.10.03.536 E018.56.51.576
N050.10.05.434 E018.56.49.556
N050.10.06.733 E018.56.48.916
N050.10.07.327 E018.56.48.826
N050.10.09.516 E018.56.49.931
N050.10.11.813 E018.56.51.637
N050.10.12.713 E018.56.50.356
N050.10.14.128 E018.56.48.865
N050.10.15.406 E018.56.47.965
N050.10.16.511 E018.56.46.151
N050.10.17.756 E018.56.43.854
N050.10.27.685 E018.56.38.724
N050.10.26.789 E018.56.37.810
N050.10.28.229 E018.56.37.741
N050.10.28.762 E018.56.36.913
N050.10.29.417 E018.56.32.690
N050.10.29.420 E018.56.29.839
N050.10.24.449 E018.56.27.629
N050.10.22.868 E018.56.27.276
N050.10.22.768 E018.56.22.207
N050.10.26.440 E018.56.20.371
N050.10.29.334 E018.56.21.401
N050.10.30.090 E018.56.22.538
N050.10.30.050 E018.56.18.564
N050.10.37.038 E018.56.15.068
N050.10.36.239 E018.56.09.913
N050.10.36.790 E018.56.08.995
N050.10.37.261 E018.56.09.168
N050.10.37.571 E018.56.09.064
N050.10.37.812 E018.56.08.905
N050.10.38.363 E018.56.06.378
N050.10.39.770 E018.56.04.031
N050.10.44.231 E018.56.05.096
N050.10.52.226 E018.56.11.641
N050.10.52.716 E018.56.01.860
N050.10.54.552 E018.55.59.959
N050.10.56.680 E018.56.10.568
N050.11.05.356 E018.56.06.457
N050.11.04.592 E018.56.04.657
N050.11.09.013 E018.56.00.431
N050.11.10.374 E018.56.00.337
N050.11.14.024 E018.56.00.373
N050.11.16.458 E018.55.56.856
N050.11.17.048 E018.55.56.561
N050.11.18.164 E018.55.55.772
N050.11.19.090 E018.55.59.142
N050.11.21.397 E018.56.00.157
N050.11.22.513 E018.56.01.176
N050.11.21.973 E018.56.05.212
N050.11.23.050 E018.56.05.201
N050.11.24.054 E018.56.04.783
N050.11.28.234 E018.56.03.448
N050.11.28.860 E018.56.08.678
N050.11.28.946 E018.56.11.278
N050.11.29.753 E018.56.10.892
N050.11.30.700 E018.56.10.550
N050.11.31.808 E018.56.09.568
N050.11.32.730 E018.56.09.078
N050.11.35.268 E018.56.08.833
N050.11.37.043 E018.56.09.182
N050.11.41.100 E018.56.08.840
N050.11.41.924 E018.56.08.891
N050.11.42.464 E018.56.08.549
N050.11.38.242 E018.55.49.660
N050.11.46.230 E018.55.44.483
N050.11.49.686 E018.55.51.118
N050.11.49.880 E018.55.50.862
N050.11.51.720 E018.55.54.070
N050.12.22.313 E018.56.37.392
N050.12.59.638 E018.56.51.724
N050.13.19.294 E018.55.41.707
N050.13.42.308 E018.55.24.996
N050.13.44.231 E018.55.25.082
N050.13.46.794 E018.55.05.405
; - Kielce
URBAN region_URBAN N050.53.53.531 E020.33.01.040
N050.54.14.260 E020.33.35.557
N050.54.20.376 E020.33.59.515
N050.54.21.895 E020.34.07.190
N050.54.27.288 E020.34.35.936
N050.54.36.688 E020.35.20.321
N050.54.38.567 E020.35.26.394
N050.54.37.210 E020.36.07.578
N050.54.05.443 E020.36.24.620
N050.54.19.105 E020.36.36.893
N050.54.44.086 E020.36.35.251
N050.54.44.150 E020.36.56.689
N050.54.42.354 E020.37.00.124
N050.54.32.839 E020.36.57.971
N050.54.12.920 E020.37.00.916
N050.54.14.216 E020.38.02.490
N050.54.24.656 E020.38.11.065
N050.54.24.505 E020.38.20.274
N050.54.23.933 E020.38.20.141
N050.54.22.000 E020.38.31.034
N050.54.20.880 E020.38.42.252
N050.54.17.118 E020.39.03.560
N050.54.12.737 E020.39.36.086
N050.54.15.973 E020.39.37.930
N050.54.16.394 E020.39.38.048
N050.54.15.998 E020.39.41.069
N050.54.23.144 E020.39.42.422
N050.54.23.033 E020.39.49.165
N050.54.32.011 E020.40.15.384
N050.54.44.474 E020.40.29.734
N050.54.44.914 E020.40.36.055
N050.54.46.573 E020.40.36.948
N050.54.44.748 E020.40.48.252
N050.54.38.556 E020.40.58.256
N050.54.38.383 E020.40.58.120
N050.54.40.594 E020.40.53.227
N050.54.33.660 E020.40.53.594
N050.54.22.878 E020.40.57.842
N050.54.19.487 E020.40.57.828
N050.54.15.185 E020.40.56.777
N050.54.10.886 E020.40.54.372
N050.54.09.461 E020.41.00.089
N050.54.02.837 E020.40.59.981
N050.53.46.763 E020.40.43.964
N050.53.46.504 E020.40.43.907
N050.53.44.639 E020.40.36.692
N050.53.37.504 E020.40.38.096
N050.53.34.364 E020.40.37.765
N050.53.34.339 E020.40.39.936
N050.53.27.856 E020.40.39.648
N050.53.16.400 E020.40.37.045
N050.53.00.046 E020.39.44.600
N050.52.48.083 E020.39.44.849
N050.52.37.110 E020.40.10.204
N050.52.37.304 E020.40.35.328
N050.52.33.503 E020.40.35.731
N050.52.25.748 E020.40.32.516
N050.52.11.791 E020.40.34.280
N050.52.06.226 E020.40.35.526
N050.52.05.218 E020.40.35.663
N050.51.59.771 E020.40.29.813
N050.51.53.442 E020.40.36.224
N050.51.53.413 E020.40.37.222
N050.51.48.222 E020.40.37.906
N050.51.47.808 E020.41.08.851
N050.51.47.718 E020.41.18.827
N050.51.01.908 E020.41.17.459
N050.51.02.538 E020.41.07.429
N050.51.03.247 E020.41.06.493
N050.51.06.394 E020.40.58.879
N050.51.08.521 E020.40.57.302
N050.51.08.831 E020.40.09.217
N050.51.06.433 E020.40.08.674
N050.51.32.591 E020.38.39.847
N050.51.25.362 E020.38.33.720
N050.50.53.876 E020.39.27.122
N050.50.26.783 E020.39.30.197
N050.50.21.779 E020.39.02.678
N050.50.23.118 E020.38.30.008
N050.50.35.678 E020.38.04.636
N050.50.13.106 E020.37.34.986
N050.49.49.292 E020.37.49.307
N050.49.39.025 E020.38.02.076
N050.49.30.461 E020.38.28.615
N050.49.22.055 E020.38.28.792
N050.49.23.117 E020.38.16.008
N050.49.15.474 E020.38.15.356
N050.49.08.184 E020.38.14.942
N050.49.08.173 E020.38.15.050
N050.49.00.440 E020.38.13.164
N050.48.58.777 E020.38.32.708
N050.48.55.339 E020.38.31.934
N050.49.02.132 E020.37.37.765
N050.48.36.594 E020.37.35.800
N050.48.41.890 E020.37.00.556
N050.49.20.190 E020.37.02.237
N050.49.14.952 E020.36.07.135
N050.49.11.363 E020.34.51.384
N050.49.30.662 E020.33.44.510
N050.49.43.097 E020.33.46.181
N050.49.27.570 E020.34.58.836
N050.49.36.962 E020.36.22.655
N050.49.43.338 E020.37.04.249
N050.50.23.352 E020.37.19.700
N050.50.35.750 E020.36.35.489
N050.51.20.527 E020.36.48.330
N050.51.20.279 E020.36.18.191
N050.51.31.453 E020.36.19.199
N050.51.14.231 E020.33.48.877
N050.50.03.282 E020.32.22.625
N050.50.34.148 E020.31.55.538
N050.50.56.512 E020.31.58.778
N050.51.26.014 E020.31.56.831
N050.52.09.023 E020.31.49.537
N050.52.11.680 E020.32.19.630
N050.50.59.230 E020.32.35.131
N050.51.46.076 E020.33.41.872
N050.51.54.904 E020.35.22.160
N050.52.31.606 E020.35.22.600
N050.52.46.466 E020.33.15.358
N050.52.50.268 E020.32.53.909
N050.53.07.879 E020.33.01.040
N050.53.05.179 E020.33.57.654
N050.53.43.591 E020.34.11.863
N050.53.50.500 E020.33.40.280
N050.53.37.529 E020.33.16.697
; - Kraków
URBAN region_URBAN N050.01.13.570 E019.49.07.489
N050.01.13.771 E019.49.12.601
N050.01.17.933 E019.49.24.305
N050.01.21.443 E019.49.31.516
N050.01.20.388 E019.49.32.909
N050.01.20.186 E019.49.34.766
N050.01.20.636 E019.49.36.548
N050.01.22.044 E019.49.38.179
N050.01.24.049 E019.49.38.723
N050.01.24.463 E019.49.38.086
N050.01.24.550 E019.49.38.395
N050.01.24.708 E019.49.38.204
N050.01.26.357 E019.49.40.822
N050.01.27.282 E019.49.41.596
N050.01.44.026 E019.50.19.518
N050.02.00.121 E019.51.07.726
N050.02.30.656 E019.52.15.913
N050.02.12.026 E019.53.14.903
N050.02.19.946 E019.53.55.954
N050.02.43.458 E019.54.23.134
N050.02.57.898 E019.54.43.124
N050.03.11.084 E019.53.42.630
N050.03.40.964 E019.51.57.197
N050.03.46.015 E019.50.42.439
N050.03.11.711 E019.49.51.125
N050.03.16.492 E019.49.15.899
N050.03.48.229 E019.49.41.758
N050.04.32.884 E019.49.42.380
N050.04.38.255 E019.49.57.994
N050.04.27.127 E019.50.27.496
N050.04.38.874 E019.50.43.195
N050.04.56.410 E019.50.09.550
N050.05.09.175 E019.50.08.318
N050.05.25.462 E019.50.26.916
N050.05.17.988 E019.50.55.064
N050.05.02.933 E019.52.06.884
N050.05.26.599 E019.52.11.478
N050.05.49.279 E019.52.27.358
N050.06.18.414 E019.52.32.034
N050.06.42.732 E019.53.14.806
N050.06.56.092 E019.54.00.238
N050.06.11.041 E019.54.56.066
N050.05.49.960 E019.55.12.684
N050.05.58.560 E019.56.23.474
N050.06.44.140 E019.56.22.808
N050.06.43.880 E019.56.58.142
N050.06.10.987 E019.57.08.899
N050.05.54.193 E019.58.00.901
N050.06.02.221 E019.58.23.650
N050.05.35.556 E019.58.54.278
N050.05.27.114 E019.59.25.217
N050.05.57.080 E019.59.46.655
N050.06.14.159 E020.00.56.887
N050.06.06.962 E020.01.08.353
N050.06.03.676 E020.01.47.978
N050.06.29.686 E020.02.38.245
N050.05.59.651 E020.02.47.396
N050.05.59.021 E020.03.18.486
N050.06.39.910 E020.02.59.212
N050.06.40.302 E020.03.00.446
N050.06.39.852 E020.03.01.318
N050.06.40.464 E020.03.02.520
N050.06.38.095 E020.03.06.628
N050.06.38.848 E020.03.06.710
N050.06.29.995 E020.03.15.394
N050.06.30.467 E020.03.22.558
N050.06.40.795 E020.03.38.243
N050.06.18.576 E020.04.03.256
N050.06.14.310 E020.04.37.254
N050.05.55.349 E020.05.00.265
N050.05.53.804 E020.05.32.784
N050.06.04.270 E020.06.23.411
N050.06.48.002 E020.06.15.422
N050.06.54.824 E020.07.12.925
N050.06.49.273 E020.07.13.678
N050.06.34.819 E020.07.15.294
N050.06.30.510 E020.07.15.456
N050.06.30.614 E020.07.21.778
N050.06.29.916 E020.07.25.489
N050.06.11.203 E020.07.28.247
N050.05.47.764 E020.08.02.634
N050.05.46.237 E020.08.39.386
N050.06.22.997 E020.08.58.150
N050.06.22.982 E020.08.58.236
N050.06.23.450 E020.08.58.380
N050.06.42.131 E020.09.07.916
N050.06.45.590 E020.09.05.310
N050.06.51.300 E020.09.07.308
N050.07.02.060 E020.09.11.963
N050.07.03.173 E020.09.13.183
N050.07.06.571 E020.09.23.386
N050.07.06.398 E020.09.23.782
N050.07.06.708 E020.09.23.803
N050.07.07.835 E020.09.27.180
N050.06.33.548 E020.10.15.902
N050.06.53.798 E020.10.38.111
N050.06.52.380 E020.11.30.415
N050.06.35.993 E020.11.34.976
N050.06.15.433 E020.10.33.215
N050.05.43.822 E020.11.14.798
N050.05.23.737 E020.11.13.776
N050.05.15.407 E020.10.58.404
N050.04.47.212 E020.11.10.255
N050.04.39.932 E020.11.13.218
N050.04.31.303 E020.10.19.740
N050.03.53.896 E020.10.20.478
N050.03.29.606 E020.11.04.708
N050.03.27.356 E020.12.08.258
N050.03.09.122 E020.12.10.022
N050.03.14.062 E020.11.00.776
N050.03.03.038 E020.10.51.118
N050.03.04.720 E020.10.32.740
N050.03.19.361 E020.10.38.093
N050.03.44.597 E020.09.58.079
N050.03.44.518 E020.09.48.200
N050.03.57.190 E020.09.35.244
N050.03.55.274 E020.09.23.990
N050.04.13.357 E020.09.03.866
N050.04.25.165 E020.08.56.569
N050.04.16.853 E020.08.44.030
N050.03.53.183 E020.08.51.569
N050.03.45.644 E020.08.22.081
N050.04.03.720 E020.08.00.539
N050.04.13.566 E020.07.37.751
N050.03.58.640 E020.06.58.536
N050.03.39.413 E020.06.50.472
N050.03.24.851 E020.06.55.012
N050.03.07.445 E020.06.46.908
N050.03.08.143 E020.06.21.492
N050.03.52.776 E020.06.12.082
N050.03.53.471 E020.05.46.658
N050.03.48.719 E020.05.24.176
N050.03.41.371 E020.05.18.690
N050.03.44.626 E020.04.33.452
N050.03.32.605 E020.04.15.370
N050.03.27.896 E020.03.58.536
N050.03.50.515 E020.03.36.864
N050.03.51.253 E020.03.17.089
N050.02.49.038 E020.02.58.718
N050.02.38.828 E020.04.22.188
N050.02.18.571 E020.04.01.470
N050.02.16.235 E020.03.03.683
N050.02.21.210 E020.02.08.552
N050.02.09.953 E020.01.34.950
N050.01.55.074 E020.01.04.256
N050.01.48.688 E020.01.04.404
N050.01.50.023 E020.01.50.920
N050.01.52.180 E020.02.27.542
N050.01.44.958 E020.02.36.168
N050.01.24.787 E020.02.25.339
N050.01.05.056 E020.03.03.856
N050.00.48.647 E020.03.05.630
N050.00.33.761 E020.02.33.536
N050.00.26.575 E020.02.46.385
N050.00.17.248 E020.02.24.036
N050.00.13.165 E020.01.36.199
N050.00.01.048 E020.01.45.901
N049.59.58.654 E020.01.47.125
N049.59.57.520 E020.01.45.743
N049.59.57.451 E020.01.45.602
N050.00.13.892 E020.01.31.274
N050.00.12.780 E020.01.23.502
N050.00.17.122 E020.01.14.286
N050.00.15.430 E020.01.12.724
N050.00.13.774 E020.01.05.542
N050.00.11.858 E020.01.05.599
N050.00.12.305 E020.01.01.373
N050.00.11.513 E020.00.49.615
N050.00.10.271 E020.00.47.354
N050.00.10.436 E020.00.45.310
N050.00.08.863 E020.00.38.120
N050.00.09.101 E020.00.34.729
N050.00.06.876 E020.00.21.989
N050.00.05.623 E020.00.20.362
N050.00.03.154 E020.00.13.709
N050.00.01.577 E020.00.13.536
N049.59.59.885 E020.00.12.899
N049.59.58.859 E020.00.12.308
N049.59.57.815 E020.00.10.757
N049.59.56.497 E020.00.10.156
N049.59.53.120 E020.00.12.053
N049.59.59.237 E019.59.32.471
N049.59.39.570 E019.59.38.836
N049.59.27.488 E020.00.01.109
N049.59.09.114 E020.00.23.303
N049.58.53.836 E019.59.53.239
N049.58.52.230 E019.59.32.057
N049.58.37.646 E019.59.31.704
N049.58.32.423 E019.59.07.613
N049.58.46.124 E019.59.05.125
N049.58.48.396 E019.58.56.824
N049.58.48.785 E019.58.56.978
N049.58.51.438 E019.58.56.762
N049.58.51.730 E019.58.54.606
N049.58.51.103 E019.58.53.116
N049.58.51.056 E019.58.51.035
N049.58.51.679 E019.58.44.818
N049.59.02.216 E019.58.06.301
N049.58.38.813 E019.57.36.148
N049.58.33.704 E019.56.59.381
N049.58.28.376 E019.56.45.161
N049.58.22.584 E019.56.45.920
N049.58.26.303 E019.56.38.987
N049.58.31.400 E019.56.31.906
N049.58.30.590 E019.56.25.573
N049.58.30.900 E019.56.24.976
N049.58.30.313 E019.56.23.413
N049.58.30.094 E019.56.21.703
N049.58.30.522 E019.56.19.568
N049.59.00.665 E019.56.06.436
N049.59.15.191 E019.56.12.408
N049.59.27.179 E019.55.58.584
N049.59.44.524 E019.55.56.165
N049.59.51.652 E019.56.13.247
N050.00.03.046 E019.56.28.946
N050.00.48.604 E019.56.31.103
N050.00.53.384 E019.56.00.150
N049.59.48.952 E019.55.21.036
N049.59.23.820 E019.55.28.902
N049.58.49.015 E019.55.26.036
N049.58.48.630 E019.55.24.722
N049.58.48.259 E019.55.22.526
N049.58.47.042 E019.55.08.688
N049.58.47.075 E019.54.49.583
N049.58.48.911 E019.54.45.810
N049.58.49.127 E019.54.43.898
N049.58.51.229 E019.54.41.656
N049.58.51.877 E019.54.39.697
N049.58.51.474 E019.54.38.599
N049.58.51.143 E019.54.34.614
N049.58.57.097 E019.54.23.447
N049.59.17.308 E019.54.06.980
N049.59.22.657 E019.54.19.789
N049.59.49.222 E019.54.42.970
N050.00.06.876 E019.53.55.298
N050.00.09.356 E019.52.19.445
N049.59.43.274 E019.51.40.914
N049.59.14.514 E019.52.35.281
N049.58.59.304 E019.53.42.616
N049.58.47.939 E019.53.30.883
N049.58.48.626 E019.53.29.944
N049.58.49.120 E019.53.26.696
N049.58.48.929 E019.53.21.304
N049.58.49.199 E019.53.14.474
N049.58.48.148 E019.53.14.284
N049.58.46.567 E019.53.14.669
N049.58.45.451 E019.53.13.762
N049.58.45.203 E019.53.12.426
N049.58.44.616 E019.53.11.227
N049.58.47.442 E019.52.05.092
N049.58.58.598 E019.51.47.758
N049.59.00.460 E019.51.49.568
N049.59.01.140 E019.51.47.200
N049.59.02.184 E019.51.45.594
N049.59.04.628 E019.51.44.413
N049.59.04.423 E019.51.38.711
N049.59.15.187 E019.51.21.985
N049.59.13.528 E019.51.03.622
N049.59.19.781 E019.50.55.478
N049.59.32.222 E019.50.56.796
N049.59.32.276 E019.50.56.861
N049.59.34.076 E019.50.56.994
N049.59.39.530 E019.50.57.570
N049.59.39.505 E019.50.57.390
N049.59.44.041 E019.50.57.721
N049.59.44.318 E019.50.54.092
N049.59.44.592 E019.50.51.508
N049.59.44.549 E019.50.47.738
N049.59.43.602 E019.50.44.873
N049.59.43.544 E019.50.43.656
N049.59.47.443 E019.50.43.192
N049.59.53.646 E019.51.03.064
N050.00.09.767 E019.51.17.402
N050.00.31.658 E019.51.14.900
N050.00.37.782 E019.51.54.482
N050.01.34.453 E019.51.29.923
N050.01.32.891 E019.50.50.399
N050.00.52.456 E019.49.19.542
N050.00.34.229 E019.49.19.290
N050.00.22.428 E019.49.12.072
N050.00.03.701 E019.49.17.512
N049.59.49.729 E019.49.51.067
N049.59.46.547 E019.49.48.878
N049.59.46.694 E019.49.24.996
N049.59.47.062 E019.49.19.830
N049.59.48.466 E019.49.18.574
N049.59.49.920 E019.49.08.310
N049.59.47.839 E019.49.07.608
N049.59.47.116 E019.49.04.674
N049.59.45.776 E019.49.00.487
N050.00.13.532 E019.48.36.695
N050.00.35.590 E019.48.07.376
N050.01.00.196 E019.48.07.708
N050.01.11.906 E019.48.30.438
N050.01.13.570 E019.48.55.850
; - Lublin
URBAN region_URBAN N051.17.04.783 E022.34.37.607
N051.17.04.344 E022.34.41.621
N051.17.03.826 E022.34.44.749
N051.17.03.692 E022.34.50.660
N051.16.44.573 E022.34.44.918
N051.16.23.196 E022.34.35.522
N051.16.06.110 E022.34.36.970
N051.16.20.658 E022.34.49.112
N051.16.18.980 E022.35.05.410
N051.16.48.936 E022.35.32.413
N051.16.45.566 E022.35.56.868
N051.16.25.046 E022.35.50.176
N051.16.12.220 E022.35.44.808
N051.16.07.964 E022.35.54.330
N051.15.57.694 E022.35.44.876
N051.15.40.644 E022.36.05.314
N051.15.32.918 E022.35.46.352
N051.15.21.823 E022.35.53.189
N051.15.37.278 E022.36.35.186
N051.15.51.912 E022.37.41.624
N051.15.35.683 E022.37.45.761
N051.15.25.387 E022.37.20.017
N051.15.14.321 E022.37.44.494
N051.15.03.121 E022.36.48.906
N051.14.51.148 E022.36.40.820
N051.14.46.108 E022.37.33.751
N051.14.18.748 E022.37.23.012
N051.14.16.926 E022.36.13.842
N051.14.08.383 E022.36.15.239
N051.13.59.023 E022.36.38.336
N051.13.38.478 E022.36.14.018
N051.13.27.430 E022.36.49.327
N051.13.20.572 E022.36.35.795
N051.13.20.514 E022.36.01.897
N051.13.00.851 E022.35.56.566
N051.12.48.053 E022.36.06.116
N051.12.42.048 E022.35.52.588
N051.12.27.540 E022.36.03.499
N051.12.23.281 E022.36.11.653
N051.12.06.516 E022.36.10.408
N051.12.01.030 E022.35.51.425
N051.11.38.400 E022.35.53.833
N051.11.26.812 E022.35.29.908
N051.11.32.417 E022.34.45.181
N051.11.48.091 E022.34.47.791
N051.11.51.385 E022.33.45.432
N051.12.16.949 E022.33.14.119
N051.12.20.315 E022.32.51.050
N051.12.47.653 E022.32.48.181
N051.12.52.722 E022.32.23.748
N051.13.04.706 E022.32.33.169
N051.13.25.126 E022.31.55.081
N051.13.44.587 E022.30.37.656
N051.14.23.831 E022.30.14.335
N051.13.52.892 E022.29.09.445
N051.13.59.743 E022.29.14.820
N051.14.23.633 E022.29.02.440
N051.14.58.884 E022.30.23.594
N051.15.09.893 E022.29.45.528
N051.15.27.893 E022.30.07.117
N051.16.09.764 E022.30.08.190
N051.16.33.686 E022.30.08.028
N051.16.45.707 E022.30.31.025
N051.16.42.316 E022.30.40.550
N051.16.00.480 E022.30.53.046
N051.15.39.136 E022.30.59.969
N051.15.44.359 E022.31.39.292
N051.15.42.725 E022.32.11.875
N051.16.13.519 E022.32.25.264
N051.16.15.348 E022.33.19.548
N051.16.54.602 E022.32.56.249
N051.16.59.794 E022.33.26.089
N051.16.37.585 E022.33.30.287
N051.16.18.811 E022.33.41.249
N051.16.18.836 E022.33.53.467
N051.16.36.793 E022.34.00.156
N051.16.37.675 E022.34.13.728
; - Olsztyn
URBAN region_URBAN N053.44.33.886 E020.27.36.144
N053.44.33.522 E020.27.31.399
N053.44.32.647 E020.27.30.593
N053.44.33.310 E020.27.24.221
N053.44.33.583 E020.27.19.822
N053.44.34.732 E020.27.12.956
N053.44.35.531 E020.27.11.668
N053.44.36.733 E020.27.10.505
N053.44.36.640 E020.27.07.124
N053.44.31.553 E020.27.03.679
N053.44.32.798 E020.26.55.662
N053.44.34.879 E020.26.51.626
N053.44.36.614 E020.26.45.560
N053.44.38.519 E020.26.41.492
N053.44.46.154 E020.26.33.907
N053.44.56.422 E020.26.28.709
N053.44.59.798 E020.26.25.742
N053.45.01.174 E020.26.24.410
N053.45.18.666 E020.26.37.403
N053.45.38.945 E020.26.12.498
N053.45.21.488 E020.25.26.951
N053.45.39.841 E020.24.37.656
N053.46.12.479 E020.25.01.290
N053.46.42.323 E020.24.57.690
N053.46.21.382 E020.25.44.184
N053.46.09.530 E020.25.55.963
N053.46.38.381 E020.27.17.197
N053.46.57.047 E020.27.03.823
N053.46.58.588 E020.26.43.663
N053.47.15.511 E020.26.26.009
N053.47.29.746 E020.25.54.044
N053.47.48.361 E020.25.34.907
N053.47.41.809 E020.24.27.486
N053.47.42.277 E020.23.42.900
N053.47.44.671 E020.23.39.073
N053.47.47.281 E020.23.40.751
N053.47.47.342 E020.23.40.538
N053.47.47.746 E020.23.40.816
N053.47.55.777 E020.23.22.960
N053.48.00.439 E020.23.29.465
N053.48.08.953 E020.23.09.445
N053.48.12.971 E020.23.13.240
N053.48.16.096 E020.23.06.032
N053.48.32.746 E020.23.27.899
N053.48.32.436 E020.24.11.768
N053.48.39.704 E020.24.08.759
N053.48.28.004 E020.24.39.294
N053.48.02.660 E020.25.10.114
N053.47.42.878 E020.26.32.550
N053.47.15.893 E020.27.12.002
N053.47.09.182 E020.27.26.536
N053.46.51.334 E020.27.35.579
N053.46.42.917 E020.27.50.148
N053.47.16.318 E020.28.03.749
N053.47.17.520 E020.28.46.848
N053.47.29.454 E020.28.45.138
N053.48.23.263 E020.28.49.660
N053.48.11.732 E020.29.41.694
N053.47.56.702 E020.30.23.731
N053.47.46.907 E020.31.21.468
N053.47.23.975 E020.31.36.343
N053.47.18.002 E020.31.36.473
N053.47.08.120 E020.32.24.122
N053.46.52.910 E020.32.44.570
N053.46.20.093 E020.31.53.537
N053.46.09.494 E020.31.07.784
N053.45.26.557 E020.30.34.243
N053.45.07.456 E020.29.53.012
N053.45.03.917 E020.29.37.291
N053.44.49.636 E020.29.36.964
N053.44.47.681 E020.29.05.424
N053.44.53.390 E020.29.01.622
N053.45.03.586 E020.28.55.646
N053.45.03.481 E020.28.42.722
N053.44.36.895 E020.28.27.530
N053.44.33.274 E020.28.01.765
N053.44.30.311 E020.27.42.959
N053.44.32.942 E020.27.37.588
; - Opole
URBAN region_URBAN N050.41.31.538 E017.51.00.896
N050.41.26.646 E017.51.00.187
N050.41.24.281 E017.51.03.164
N050.41.21.761 E017.51.07.376
N050.41.19.241 E017.51.16.308
N050.41.17.740 E017.51.21.413
N050.41.17.927 E017.51.23.198
N050.41.17.779 E017.51.23.969
N050.41.18.560 E017.51.29.272
N050.41.18.949 E017.51.32.980
N050.41.09.593 E017.51.37.411
N050.40.54.811 E017.52.56.892
N050.41.22.852 E017.52.46.603
N050.41.27.431 E017.53.25.850
N050.40.51.233 E017.53.53.156
N050.41.08.876 E017.54.23.324
N050.42.02.894 E017.54.08.982
N050.42.39.190 E017.53.32.273
N050.42.51.088 E017.54.05.904
N050.42.50.800 E017.54.06.318
N050.42.50.396 E017.54.07.114
N050.42.49.892 E017.54.07.715
N050.42.49.903 E017.54.08.086
N050.42.49.482 E017.54.08.917
N050.42.49.993 E017.54.10.976
N050.42.50.051 E017.54.12.928
N050.42.50.440 E017.54.14.591
N050.42.50.677 E017.54.16.798
N050.42.50.864 E017.54.20.290
N050.42.50.162 E017.54.22.896
N050.42.49.406 E017.54.24.520
N050.42.48.157 E017.54.26.384
N050.42.46.519 E017.54.28.645
N050.42.49.457 E017.54.32.519
N050.42.52.002 E017.54.34.762
N050.42.52.754 E017.54.35.316
N050.42.52.412 E017.54.43.078
N050.42.40.187 E017.55.08.843
N050.42.35.932 E017.55.05.354
N050.42.33.782 E017.55.03.112
N050.42.24.962 E017.54.54.295
N050.42.20.383 E017.54.55.508
N050.42.20.358 E017.54.55.832
N050.42.20.106 E017.54.55.919
N050.42.20.146 E017.54.58.730
N050.42.17.035 E017.55.05.426
N050.42.16.330 E017.55.06.560
N050.42.14.260 E017.55.10.567
N050.42.13.925 E017.55.10.628
N050.42.07.164 E017.55.01.762
N050.42.05.738 E017.55.04.976
N050.42.04.133 E017.55.11.140
N050.42.03.006 E017.55.12.605
N050.41.55.115 E017.55.14.034
N050.42.12.902 E017.55.59.686
N050.41.04.070 E017.55.39.914
N050.41.06.727 E017.56.11.288
N050.41.27.553 E017.56.22.765
N050.41.45.654 E017.56.09.125
N050.41.57.386 E017.56.31.344
N050.41.47.159 E017.56.54.571
N050.42.02.059 E017.57.19.966
N050.42.01.256 E017.57.23.814
N050.42.01.346 E017.57.27.612
N050.42.02.250 E017.57.30.035
N050.42.02.264 E017.57.30.463
N050.42.00.871 E017.57.33.127
N050.41.42.572 E017.57.49.259
N050.41.24.839 E017.57.28.454
N050.40.32.599 E017.58.01.556
N050.40.34.457 E017.58.14.124
N050.41.03.260 E017.58.25.824
N050.41.01.820 E017.58.45.023
N050.41.01.165 E017.58.45.865
N050.40.58.789 E017.58.48.036
N050.40.56.579 E017.58.51.748
N050.41.00.456 E017.59.03.181
N050.40.58.570 E017.59.28.316
N050.40.22.260 E017.59.41.546
N050.40.22.793 E017.59.29.656
N050.40.22.300 E017.59.29.738
N050.40.22.372 E017.59.28.889
N050.40.20.111 E017.59.30.102
N050.40.19.596 E017.59.29.796
N050.40.04.847 E017.59.37.619
N050.40.02.204 E017.59.38.886
N050.40.00.998 E017.59.40.063
N050.40.00.854 E017.59.40.452
N050.40.00.070 E017.59.42.594
N050.39.58.266 E017.59.49.592
N050.39.56.851 E017.59.50.806
N050.39.54.457 E017.59.51.677
N050.39.39.182 E017.59.22.376
N050.38.23.453 E017.59.12.844
N050.38.20.879 E017.58.27.433
N050.39.00.904 E017.58.14.246
N050.39.05.108 E017.57.50.875
N050.38.51.245 E017.57.39.618
N050.38.39.613 E017.57.01.825
N050.38.28.684 E017.56.56.897
N050.37.32.704 E017.58.59.189
N050.37.41.156 E017.59.55.666
N050.37.17.026 E018.00.15.437
N050.37.03.673 E018.00.02.135
N050.37.04.177 E017.59.53.362
N050.36.51.678 E017.59.48.775
N050.37.17.004 E017.58.30.695
N050.37.05.153 E017.58.17.922
N050.36.51.188 E017.58.17.612
N050.36.43.636 E017.57.30.553
N050.36.46.184 E017.57.29.912
N050.37.00.124 E017.57.35.867
N050.37.08.929 E017.57.37.278
N050.37.13.253 E017.57.38.992
N050.37.17.915 E017.57.36.662
N050.37.20.550 E017.57.34.326
N050.37.22.433 E017.57.31.046
N050.37.24.960 E017.57.22.255
N050.37.25.867 E017.57.16.859
N050.37.25.597 E017.57.14.533
N050.37.29.780 E017.57.01.868
N050.37.47.748 E017.57.00.695
N050.38.02.908 E017.56.39.134
N050.38.25.080 E017.56.13.027
N050.38.45.128 E017.56.02.512
N050.39.33.354 E017.55.22.872
N050.39.26.849 E017.54.27.976
N050.38.25.847 E017.54.45.468
N050.38.40.412 E017.53.35.394
N050.38.53.444 E017.53.27.845
N050.39.01.739 E017.52.50.473
N050.39.22.604 E017.53.00.283
N050.39.28.602 E017.52.58.840
N050.39.32.710 E017.52.44.843
N050.39.52.880 E017.52.04.044
N050.39.53.442 E017.52.04.195
N050.39.53.467 E017.52.04.469
N050.39.56.002 E017.52.05.009
N050.39.58.982 E017.52.06.762
N050.39.59.638 E017.52.06.251
N050.39.59.026 E017.52.04.577
N050.39.59.519 E017.52.02.968
N050.40.00.055 E017.51.55.764
N050.40.00.412 E017.51.49.655
N050.40.08.285 E017.51.36.083
N050.40.08.389 E017.51.36.094
N050.40.11.215 E017.51.31.039
N050.40.28.056 E017.51.02.012
N050.40.36.998 E017.51.05.350
N050.40.43.853 E017.51.18.025
N050.40.57.990 E017.51.01.138
N050.41.27.240 E017.50.28.939
N050.41.36.060 E017.50.44.801
; - Poznan
URBAN region_URBAN N052.20.41.446 E016.54.14.342
N052.20.45.020 E016.54.10.555
N052.20.50.179 E016.54.05.879
N052.20.49.996 E016.54.08.827
N052.20.51.713 E016.54.14.267
N052.20.53.502 E016.54.18.454
N052.20.55.356 E016.54.18.439
N052.20.55.475 E016.54.19.879
N052.20.56.404 E016.54.19.872
N052.20.56.839 E016.54.11.974
N052.20.57.919 E016.54.11.837
N052.20.57.970 E016.54.15.037
N052.20.59.089 E016.54.15.340
N052.20.59.251 E016.54.17.532
N052.21.04.104 E016.54.14.800
N052.21.02.898 E016.54.11.675
N052.21.04.288 E016.54.11.351
N052.21.06.016 E016.54.09.522
N052.21.06.818 E016.54.06.757
N052.21.07.772 E016.54.03.989
N052.21.11.372 E016.54.06.408
N052.21.11.830 E016.54.05.087
N052.21.19.451 E016.54.09.356
N052.21.20.178 E016.54.08.222
N052.21.21.290 E016.54.06.271
N052.21.20.858 E016.54.03.640
N052.21.20.221 E016.53.57.754
N052.21.20.275 E016.53.51.922
N052.21.20.930 E016.53.47.900
N052.21.21.143 E016.53.48.174
N052.21.42.149 E016.53.53.318
N052.21.45.479 E016.52.29.719
N052.22.17.857 E016.51.59.015
N052.21.38.588 E016.50.54.064
N052.21.59.324 E016.50.04.099
N052.22.08.105 E016.50.06.580
N052.22.10.654 E016.50.01.169
N052.22.12.882 E016.50.01.856
N052.22.15.776 E016.50.00.701
N052.22.18.901 E016.49.57.234
N052.22.19.582 E016.49.54.570
N052.22.25.723 E016.49.47.885
N052.22.26.263 E016.49.48.572
N052.22.28.913 E016.49.46.402
N052.22.29.762 E016.49.46.661
N052.22.32.153 E016.49.40.886
N052.22.37.722 E016.49.34.828
N052.22.38.374 E016.49.35.731
N052.22.40.019 E016.49.34.432
N052.22.39.893 E016.49.32.466
N052.22.41.376 E016.49.30.853
N052.22.39.940 E016.48.58.968
N052.22.45.070 E016.48.48.074
N052.23.01.478 E016.48.17.046
N052.23.08.567 E016.48.31.752
N052.23.09.294 E016.48.30.352
N052.23.09.805 E016.48.31.378
N052.23.16.458 E016.48.19.339
N052.23.25.526 E016.48.37.624
N052.23.25.832 E016.48.37.264
N052.23.26.790 E016.48.39.384
N052.23.35.110 E016.48.28.912
N052.23.37.867 E016.48.36.637
N052.23.23.014 E016.49.24.312
N052.23.59.136 E016.51.21.866
N052.24.16.718 E016.51.22.050
N052.24.30.114 E016.50.34.354
N052.24.19.919 E016.50.19.896
N052.24.17.287 E016.49.10.506
N052.24.59.796 E016.49.06.146
N052.24.50.188 E016.52.12.652
N052.25.10.578 E016.52.39.198
N052.25.42.575 E016.53.29.814
N052.26.43.940 E016.54.06.437
N052.26.43.526 E016.55.30.227
N052.26.55.126 E016.55.54.314
N052.27.36.007 E016.56.23.564
N052.27.26.989 E016.57.06.556
N052.26.01.889 E016.57.27.000
N052.25.02.003 E016.56.50.327
N052.24.57.568 E016.56.57.448
N052.25.39.745 E016.57.57.823
N052.25.33.434 E016.59.19.108
N052.23.33.277 E016.59.17.455
N052.22.48.014 E016.58.48.144
N052.22.21.508 E016.59.11.684
N052.22.07.122 E016.58.23.686
N052.22.20.399 E016.58.07.133
N052.22.01.801 E016.56.43.235
N052.21.48.838 E016.56.00.053
N052.20.32.669 E016.55.54.318
N052.20.10.676 E016.55.56.435
N052.19.35.234 E016.56.48.516
N052.20.44.851 E016.59.00.798
N052.20.15.400 E016.59.26.671
N052.19.51.013 E016.59.31.096
N052.19.34.090 E016.59.00.136
N052.19.29.730 E016.58.58.087
N052.19.24.856 E016.59.11.519
N052.19.22.458 E016.59.09.575
N052.19.18.674 E016.59.18.370
N052.18.43.272 E016.58.51.974
N052.18.27.004 E016.59.18.002
N052.18.09.598 E016.58.46.736
N052.18.13.439 E016.58.37.682
N052.18.17.370 E016.58.39.799
N052.18.41.699 E016.57.32.029
N052.18.42.340 E016.57.32.411
N052.18.43.114 E016.57.32.256
N052.18.43.855 E016.57.31.648
N052.18.44.345 E016.57.30.236
N052.18.45.212 E016.57.30.182
N052.18.45.734 E016.57.29.272
N052.18.46.022 E016.57.28.022
N052.18.49.237 E016.57.25.880
N052.18.50.054 E016.57.25.675
N052.18.50.954 E016.57.26.071
N052.18.51.480 E016.57.25.715
N052.18.51.908 E016.57.24.102
N052.19.01.974 E016.57.17.384
N052.19.02.824 E016.57.18.446
N052.19.04.782 E016.57.14.497
N052.19.04.976 E016.57.13.021
N052.18.55.620 E016.57.10.058
N052.18.54.000 E016.57.09.090
N052.18.51.984 E016.57.06.862
N052.19.06.006 E016.56.33.814
N052.19.45.793 E016.55.51.344
N052.20.09.557 E016.54.49.547
N052.20.33.191 E016.54.11.614
N052.20.29.843 E016.54.01.746
; - Rzeszów
URBAN region_URBAN N050.03.47.686 E021.57.14.548
N050.03.47.837 E021.57.16.355
N050.03.46.868 E021.57.16.654
N050.03.46.890 E021.57.17.640
N050.03.43.956 E021.57.18.936
N050.03.44.705 E021.57.21.427
N050.03.44.352 E021.57.24.253
N050.03.44.874 E021.57.23.976
N050.03.44.568 E021.57.24.710
N050.03.44.903 E021.57.49.460
N050.03.44.654 E021.57.49.536
N050.03.44.932 E021.57.52.679
N050.03.45.018 E021.57.58.000
N050.03.36.464 E021.58.29.986
N050.03.44.507 E021.58.37.787
N050.03.44.208 E021.58.59.977
N050.03.54.313 E021.59.04.466
N050.03.59.440 E022.00.06.372
N050.03.51.872 E022.00.30.971
N050.03.25.517 E022.01.12.997
N050.03.01.472 E022.01.06.460
N050.03.01.537 E022.01.13.588
N050.03.24.721 E022.01.44.252
N050.03.23.771 E022.01.50.272
N050.03.22.302 E022.01.58.814
N050.03.22.435 E022.02.01.507
N050.03.23.321 E022.02.01.964
N050.03.23.324 E022.02.03.214
N050.03.23.490 E022.02.03.412
N050.03.22.622 E022.02.07.303
N050.03.22.399 E022.02.07.289
N050.03.22.511 E022.02.07.807
N050.03.21.848 E022.02.10.777
N050.03.14.717 E022.02.06.770
N050.03.14.598 E022.02.06.407
N050.03.13.007 E022.02.05.312
N050.03.12.125 E022.02.05.316
N050.03.12.010 E022.02.06.745
N050.03.11.880 E022.02.06.724
N050.03.11.808 E022.02.09.244
N050.03.11.135 E022.02.17.617
N050.03.10.757 E022.02.19.270
N050.03.07.380 E022.02.20.670
N050.03.05.602 E022.02.19.478
N050.03.02.732 E022.02.21.127
N050.03.02.441 E022.02.23.626
N050.03.02.729 E022.02.24.486
N050.03.02.412 E022.02.25.634
N050.02.48.304 E022.02.18.085
N050.02.40.034 E022.02.41.910
N050.02.37.918 E022.02.42.400
N050.02.34.577 E022.02.50.903
N050.02.35.117 E022.02.57.754
N050.02.34.951 E022.03.05.429
N050.02.37.338 E022.03.05.584
N050.02.36.917 E022.03.22.421
N050.02.28.795 E022.03.24.628
N050.02.26.142 E022.03.21.618
N050.02.19.957 E022.03.19.717
N050.02.15.720 E022.03.20.272
N050.02.10.421 E022.03.18.364
N050.02.04.945 E022.03.19.472
N050.01.59.999 E022.03.18.385
N050.01.56.820 E022.03.17.842
N050.01.53.260 E022.03.13.777
N050.01.55.164 E022.02.57.869
N050.01.21.806 E022.02.41.568
N050.01.17.803 E022.02.07.458
N050.00.58.104 E022.01.32.311
N050.00.47.920 E022.01.28.286
N050.00.34.715 E022.02.14.968
N050.00.32.548 E022.02.14.284
N050.00.28.987 E022.02.11.576
N050.00.26.456 E022.02.08.178
N050.00.23.807 E022.02.07.638
N050.00.21.517 E022.02.10.928
N050.00.20.995 E022.02.16.411
N050.00.20.660 E022.02.29.285
N050.00.19.822 E022.02.36.229
N050.00.07.243 E022.02.33.151
N049.59.51.526 E022.02.12.048
N049.59.50.510 E022.01.35.227
N049.59.41.852 E022.01.29.856
N049.59.44.131 E022.01.13.159
N049.59.44.275 E022.01.03.014
N049.59.43.980 E022.00.45.202
N049.59.54.488 E022.00.28.030
N049.59.53.941 E022.00.19.840
N049.59.53.736 E022.00.03.283
N049.59.55.464 E022.00.04.104
N050.00.10.415 E022.00.05.018
N050.00.28.750 E021.59.54.074
N050.01.02.615 E021.59.40.589
N050.00.19.228 E021.58.47.647
N050.00.49.712 E021.57.58.842
N050.01.12.328 E021.58.24.614
N050.01.22.483 E021.58.09.282
N050.01.35.288 E021.58.05.279
N050.01.26.368 E021.57.23.404
N050.01.33.769 E021.57.16.196
N050.01.45.581 E021.57.10.015
N050.02.04.441 E021.58.11.431
N050.02.04.312 E021.58.28.355
N050.02.17.084 E021.58.28.582
N050.02.28.237 E021.58.01.978
N050.02.39.196 E021.58.00.757
N050.02.51.698 E021.57.26.266
N050.02.56.112 E021.57.24.815
N050.03.03.668 E021.57.28.904
N050.03.07.261 E021.57.29.740
N050.03.08.672 E021.57.27.270
N050.03.10.310 E021.57.23.749
N050.03.11.866 E021.57.19.638
N050.03.45.846 E021.57.08.467
N050.03.47.113 E021.57.08.316
; - Szczecin
URBAN region_URBAN N053.22.16.507 E014.44.12.214
N053.22.15.042 E014.44.14.993
N053.22.13.703 E014.44.15.655
N053.22.11.705 E014.44.12.905
N053.22.13.163 E014.44.19.684
N053.22.13.224 E014.44.28.313
N053.21.39.348 E014.44.50.824
N053.21.23.947 E014.45.01.890
N053.21.01.886 E014.45.00.011
N053.20.34.922 E014.45.22.187
N053.20.40.438 E014.46.16.910
N053.20.46.252 E014.46.24.827
N053.20.45.715 E014.46.27.984
N053.20.49.675 E014.46.37.636
N053.20.52.922 E014.46.41.513
N053.20.45.006 E014.47.03.872
N053.20.44.502 E014.47.03.498
N053.20.44.038 E014.47.06.605
N053.20.41.136 E014.47.14.788
N053.20.18.193 E014.46.55.200
N053.20.25.505 E014.46.24.071
N053.20.26.394 E014.46.23.740
N053.20.28.975 E014.46.13.044
N053.20.33.972 E014.46.03.479
N053.20.29.314 E014.45.45.803
N053.20.26.120 E014.45.34.618
N053.20.31.355 E014.45.24.365
N053.20.29.216 E014.45.23.015
N053.20.20.677 E014.45.23.166
N053.20.04.258 E014.45.13.770
N053.20.06.274 E014.44.51.295
N053.20.32.165 E014.44.54.827
N053.21.01.066 E014.44.27.848
N053.20.51.626 E014.43.50.761
N053.21.15.646 E014.43.43.007
N053.21.29.023 E014.43.56.028
N053.21.50.152 E014.43.51.452
N053.22.25.165 E014.41.52.832
N053.22.31.008 E014.41.30.379
N053.22.12.925 E014.40.51.582
N053.22.03.562 E014.39.48.758
N053.21.27.076 E014.39.56.430
N053.21.26.705 E014.39.46.141
N053.21.30.100 E014.39.34.870
N053.21.33.581 E014.39.35.104
N053.21.37.062 E014.39.34.668
N053.21.42.152 E014.39.28.868
N053.21.42.991 E014.39.24.545
N053.22.03.684 E014.39.14.990
N053.22.19.222 E014.38.20.461
N053.22.33.708 E014.37.51.647
N053.22.17.620 E014.36.42.336
N053.22.09.005 E014.36.35.827
N053.21.50.674 E014.37.07.820
N053.21.33.487 E014.36.41.940
N053.21.31.676 E014.36.08.158
N053.20.47.778 E014.34.49.015
N053.20.32.438 E014.34.45.671
N053.20.23.896 E014.34.13.462
N053.20.33.497 E014.34.10.322
N053.20.11.566 E014.33.21.938
N053.20.18.326 E014.33.05.922
N053.20.47.000 E014.33.44.716
N053.21.36.655 E014.35.07.105
N053.22.28.272 E014.36.10.264
N053.22.42.506 E014.37.00.257
N053.22.53.029 E014.37.09.998
N053.23.07.289 E014.37.51.960
N053.23.15.911 E014.37.55.261
N053.23.25.642 E014.37.13.516
N053.23.46.774 E014.37.05.664
N053.23.49.805 E014.36.15.804
N053.23.44.106 E014.35.56.443
N053.24.09.173 E014.35.14.816
N053.24.38.988 E014.34.49.307
N053.24.49.597 E014.34.30.076
N053.25.04.091 E014.33.51.552
N053.25.13.786 E014.33.14.591
N053.24.55.624 E014.32.48.700
N053.24.22.100 E014.32.27.524
N053.23.29.422 E014.31.53.357
N053.23.19.910 E014.31.19.502
N053.23.31.477 E014.30.55.447
N053.24.00.292 E014.30.41.155
N053.24.38.567 E014.31.21.648
N053.24.03.244 E014.30.07.380
N053.24.28.285 E014.29.20.861
N053.24.40.745 E014.29.25.768
N053.24.40.723 E014.29.37.032
N053.25.03.749 E014.29.35.563
N053.25.03.857 E014.28.44.044
N053.25.24.949 E014.28.48.997
N053.25.42.146 E014.29.22.913
N053.25.51.726 E014.29.29.414
N053.25.54.541 E014.30.00.029
N053.26.04.135 E014.29.58.481
N053.26.22.398 E014.29.42.482
N053.26.33.994 E014.29.02.281
N053.26.43.613 E014.28.47.842
N053.27.23.897 E014.28.51.294
N053.27.38.192 E014.29.38.112
N053.27.51.689 E014.29.04.344
N053.28.05.077 E014.29.26.988
N053.27.55.440 E014.29.49.495
N053.28.09.714 E014.30.41.162
N053.28.46.182 E014.30.34.949
N053.29.04.326 E014.31.12.155
N053.29.04.294 E014.31.26.666
N053.28.56.586 E014.31.39.511
N053.28.41.293 E014.31.16.838
N053.28.26.893 E014.31.19.963
N053.28.22.080 E014.31.27.991
N053.28.17.195 E014.32.05.035
N053.28.26.713 E014.32.35.732
N053.28.35.342 E014.32.37.406
N053.28.39.119 E014.33.01.616
N053.27.45.320 E014.33.31.846
N053.27.52.906 E014.34.05.750
N053.27.48.974 E014.34.39.565
N053.27.51.793 E014.35.00.542
N053.28.19.618 E014.34.59.156
N053.28.55.139 E014.34.49.771
N053.29.03.696 E014.35.17.254
N053.29.48.818 E014.35.06.331
N053.29.57.340 E014.35.46.727
N053.30.06.890 E014.36.01.328
N053.30.04.903 E014.36.23.897
N053.30.51.894 E014.36.30.758
N053.31.02.611 E014.35.34.364
N053.31.22.814 E014.35.15.162
N053.31.44.882 E014.35.13.729
N053.31.46.780 E014.35.21.815
N053.31.54.386 E014.35.46.093
N053.31.23.513 E014.36.43.942
N053.30.47.956 E014.37.02.996
N053.29.39.851 E014.36.59.166
N053.28.50.002 E014.36.47.434
N053.28.25.151 E014.36.14.972
N053.27.39.190 E014.35.45.568
N053.27.17.215 E014.35.14.762
N053.26.47.548 E014.34.48.742
N053.26.03.448 E014.34.37.106
N053.25.37.686 E014.33.45.367
N053.25.26.184 E014.33.42.059
N053.25.08.778 E014.34.31.840
N053.24.34.049 E014.35.37.558
N053.24.07.063 E014.36.19.174
N053.23.51.504 E014.37.26.627
N053.23.27.460 E014.37.44.105
N053.23.22.585 E014.38.08.196
N053.23.28.126 E014.39.11.002
N053.23.48.160 E014.39.43.387
N053.23.58.729 E014.39.38.668
N053.24.17.784 E014.40.17.490
N053.24.36.738 E014.41.20.472
N053.24.16.488 E014.41.47.616
N053.23.45.910 E014.41.15.097
N053.23.42.263 E014.40.21.950
N053.22.55.038 E014.41.19.378
N053.22.37.560 E014.42.13.882
N053.21.56.768 E014.44.15.655
; - Szczecin
URBAN region_URBAN N053.23.09.496 E014.46.09.527
N053.23.03.718 E014.46.05.066
N053.23.05.399 E014.46.01.056
N053.22.57.547 E014.45.41.602
N053.22.58.847 E014.45.31.007
N053.22.27.077 E014.44.06.907
N053.22.34.234 E014.44.04.841
N053.23.05.712 E014.44.48.656
N053.23.20.843 E014.45.40.334
N053.23.34.224 E014.45.51.764
N053.23.53.398 E014.45.55.220
N053.24.04.813 E014.46.17.900
; - Torun
URBAN region_URBAN N053.01.29.046 E018.33.44.370
N053.02.10.525 E018.34.05.106
N053.02.16.296 E018.34.33.834
N053.03.08.424 E018.33.58.720
N053.03.26.690 E018.35.36.114
N053.02.23.953 E018.35.55.230
N053.02.38.393 E018.36.38.336
N053.03.01.530 E018.36.59.112
N053.02.50.834 E018.38.12.530
N053.03.20.689 E018.39.00.475
N053.02.50.701 E018.39.54.695
N053.03.07.956 E018.41.14.557
N053.03.08.813 E018.42.18.418
N053.02.45.622 E018.42.35.910
N053.02.27.326 E018.42.13.504
N053.01.47.734 E018.42.30.931
N053.01.41.977 E018.42.11.765
N053.01.28.474 E018.42.08.536
N053.01.10.240 E018.41.06.259
N053.00.56.653 E018.41.54.078
N053.00.19.926 E018.42.27.457
N053.00.06.937 E018.42.26.341
N053.00.07.096 E018.42.24.980
N053.00.07.002 E018.42.23.224
N053.00.06.714 E018.42.21.312
N053.00.04.795 E018.42.17.795
N053.00.01.231 E018.42.18.097
N053.00.00.158 E018.42.19.465
N052.59.59.532 E018.42.10.984
N053.00.01.339 E018.42.08.366
N053.00.02.498 E018.42.05.663
N053.00.02.311 E018.42.01.994
N053.00.01.836 E018.41.58.330
N053.00.01.354 E018.41.57.127
N053.00.46.120 E018.41.03.005
N053.01.06.521 E018.39.30.535
N053.00.54.068 E018.38.17.135
N053.00.36.756 E018.37.26.069
N053.00.08.752 E018.37.43.572
N053.00.10.577 E018.39.12.877
N052.59.23.294 E018.39.11.189
N052.59.24.353 E018.37.54.671
N052.59.03.170 E018.37.11.600
N052.58.59.358 E018.36.22.187
N052.58.59.394 E018.35.42.338
N052.58.47.827 E018.35.24.799
N052.58.46.895 E018.34.41.768
N052.58.31.598 E018.34.25.403
N052.58.30.814 E018.34.13.148
N052.58.30.338 E018.34.12.896
N052.58.29.575 E018.33.20.488
N052.58.35.105 E018.33.22.378
N052.58.41.714 E018.33.30.672
N052.58.48.745 E018.33.32.926
N052.58.55.211 E018.33.37.321
N052.59.08.005 E018.33.41.688
N052.59.41.910 E018.34.19.459
N053.00.04.018 E018.36.15.865
N053.00.25.261 E018.35.59.935
N053.00.18.572 E018.34.33.816
N053.00.30.179 E018.33.47.563
; - Warszawa
URBAN region_URBAN N052.12.30.305 E020.52.19.672
N052.12.34.078 E020.52.20.327
N052.12.48.600 E020.52.23.542
N052.12.55.451 E020.52.24.618
N052.13.00.304 E020.52.25.280
N052.13.00.268 E020.52.28.823
N052.13.10.358 E020.52.29.413
N052.13.28.272 E020.53.37.403
N052.14.46.756 E020.53.40.340
N052.14.56.094 E020.53.19.842
N052.16.07.590 E020.53.33.936
N052.16.47.899 E020.53.51.371
N052.16.56.320 E020.52.45.808
N052.17.11.324 E020.52.46.006
N052.17.26.088 E020.53.33.126
N052.17.43.451 E020.53.23.975
N052.18.15.768 E020.53.24.410
N052.19.02.482 E020.55.19.607
N052.18.33.365 E020.56.06.137
N052.18.02.963 E020.57.15.160
N052.18.16.452 E020.58.17.321
N052.18.42.163 E020.57.23.256
N052.19.07.907 E020.56.21.664
N052.19.48.410 E020.56.03.466
N052.20.27.654 E020.56.04.038
N052.21.08.154 E020.55.45.829
N052.21.28.638 E020.55.43.741
N052.21.26.698 E020.55.48.824
N052.21.28.465 E020.55.51.589
N052.21.35.453 E020.56.01.601
N052.21.28.372 E020.56.20.026
N052.21.29.599 E020.56.19.108
N052.21.29.902 E020.56.19.608
N052.21.37.494 E020.56.13.484
N052.21.40.234 E020.56.20.260
N052.21.41.645 E020.56.19.439
N052.21.42.282 E020.56.20.098
N052.20.47.994 E020.57.21.388
N052.19.59.146 E020.58.24.532
N052.20.10.597 E020.58.39.738
N052.21.36.252 E020.57.59.710
N052.21.38.110 E020.58.11.730
N052.21.32.522 E020.58.14.934
N052.21.32.393 E020.58.40.649
N052.21.43.704 E020.59.22.790
N052.19.26.958 E021.01.11.215
N052.18.43.888 E021.02.08.722
N052.18.47.142 E021.02.40.700
N052.19.05.560 E021.02.48.530
N052.18.53.870 E021.03.10.865
N052.18.19.195 E021.03.17.777
N052.18.29.333 E021.03.55.508
N052.17.39.257 E021.05.00.337
N052.17.48.815 E021.05.09.589
N052.17.52.116 E021.05.10.543
N052.17.44.088 E021.05.15.540
N052.17.40.196 E021.05.19.345
N052.17.23.262 E021.05.36.668
N052.17.17.210 E021.05.42.025
N052.17.10.597 E021.05.45.614
N052.17.09.964 E021.05.57.343
N052.17.05.204 E021.06.01.030
N052.16.56.431 E021.06.04.928
N052.16.49.447 E021.06.07.463
N052.16.48.641 E021.06.06.152
N052.16.42.175 E021.06.08.860
N052.16.30.911 E021.05.34.922
N052.15.47.034 E021.06.31.824
N052.15.33.984 E021.06.48.398
N052.15.34.207 E021.06.53.694
N052.15.49.864 E021.06.50.976
N052.15.48.690 E021.06.40.237
N052.15.54.083 E021.06.36.850
N052.16.05.218 E021.06.44.665
N052.16.16.424 E021.06.34.200
N052.16.28.088 E021.06.29.617
N052.16.31.757 E021.06.59.706
N052.16.31.591 E021.07.01.938
N052.16.33.712 E021.07.19.708
N052.15.34.747 E021.08.14.766
N052.16.14.905 E021.08.48.347
N052.16.43.259 E021.09.56.138
N052.16.04.332 E021.10.54.782
N052.15.50.929 E021.10.46.697
N052.14.59.939 E021.10.47.237
N052.14.55.046 E021.11.00.118
N052.14.48.948 E021.11.03.966
N052.14.48.268 E021.11.02.260
N052.14.46.676 E021.11.02.976
N052.14.43.778 E021.10.45.606
N052.14.42.799 E021.10.36.768
N052.14.42.313 E021.10.36.138
N052.14.39.520 E021.10.39.691
N052.14.37.259 E021.10.43.144
N052.14.33.371 E021.10.47.518
N052.14.26.916 E021.10.57.454
N052.14.23.960 E021.11.03.430
N052.14.21.278 E021.11.08.232
N052.14.20.461 E021.11.10.982
N052.14.15.018 E021.11.23.957
N052.14.20.954 E021.09.47.088
N052.13.02.212 E021.10.19.589
N052.13.08.195 E021.12.21.517
N052.12.10.307 E021.12.42.808
N052.09.55.890 E021.13.45.538
N052.09.31.676 E021.14.04.528
N052.09.27.914 E021.13.53.011
N052.08.58.326 E021.11.19.259
N052.09.01.678 E021.11.17.797
N052.09.00.360 E021.11.09.632
N052.09.14.519 E021.10.56.248
N052.09.50.990 E021.09.25.265
N052.10.57.554 E021.07.41.704
N052.12.15.358 E021.06.37.598
N052.13.05.398 E021.05.40.427
N052.13.13.091 E021.03.48.125
N052.13.03.047 E021.02.55.482
N052.12.51.430 E021.03.06.527
N052.12.49.522 E021.04.58.919
N052.12.28.411 E021.05.47.252
N052.11.15.482 E021.06.15.894
N052.09.56.531 E021.07.19.963
N052.08.59.622 E021.05.24.767
N052.09.53.053 E021.04.37.063
N052.10.01.636 E021.03.22.342
N052.09.48.938 E021.03.22.122
N052.07.48.166 E021.05.08.520
N052.07.36.739 E021.04.51.488
N052.08.02.551 E021.03.50.220
N052.07.53.760 E021.02.42.738
N052.08.12.617 E021.01.43.201
N052.06.23.000 E021.01.52.590
N052.06.22.082 E021.01.09.091
N052.06.21.283 E021.01.09.106
N052.06.21.276 E021.01.07.907
N052.06.20.545 E021.01.07.871
N052.06.18.770 E021.00.34.027
N052.06.30.658 E020.59.38.137
N052.07.40.015 E020.59.22.402
N052.07.46.805 E020.59.44.948
N052.09.10.015 E020.59.29.425
N052.09.33.419 E020.58.37.391
N052.09.59.832 E020.55.39.986
N052.10.39.180 E020.55.21.824
N052.10.57.011 E020.54.45.997
N052.11.08.768 E020.54.52.790
N052.11.08.776 E020.54.33.718
N052.11.07.858 E020.54.33.682
N052.11.07.840 E020.54.33.152
N052.11.05.374 E020.54.33.577
N052.11.04.283 E020.54.33.534
N052.11.04.157 E020.54.31.644
N052.11.06.022 E020.54.27.904
N052.11.03.052 E020.54.14.846
N052.11.02.702 E020.54.09.558
N052.11.03.876 E020.54.06.476
N052.11.03.246 E020.54.00.040
N052.11.02.706 E020.53.59.546
N052.11.02.929 E020.53.57.332
N052.10.58.537 E020.53.55.010
N052.10.56.640 E020.53.46.669
N052.10.56.845 E020.52.10.254
N052.10.56.953 E020.52.03.104
N052.11.15.407 E020.52.00.728
N052.11.17.718 E020.51.59.789
N052.11.19.644 E020.51.58.061
N052.11.22.628 E020.51.58.216
N052.11.23.975 E020.51.57.744
N052.11.15.065 E020.51.22.392
N052.11.15.979 E020.51.21.762
N052.11.18.172 E020.51.24.059
N052.11.21.559 E020.51.25.013
N052.11.25.195 E020.51.25.488
N052.11.27.161 E020.51.25.020
N052.11.43.364 E020.51.14.908
N052.11.49.560 E020.51.13.151
N052.11.58.819 E020.51.09.824
N052.12.08.600 E020.51.10.361
N052.12.14.234 E020.51.09.194
N052.12.20.927 E020.51.20.930
N052.12.26.377 E020.51.30.661
N052.12.28.735 E020.51.45.684
; - Wroclaw
URBAN region_URBAN N051.10.24.557 E017.06.32.864
N051.10.28.841 E017.06.35.046
N051.10.23.207 E017.07.01.139
N051.10.22.933 E017.07.01.492
N051.10.15.089 E017.07.29.226
N051.10.17.062 E017.07.29.608
N051.10.16.867 E017.07.30.511
N051.10.03.983 E017.07.42.398
N051.09.52.776 E017.08.47.134
N051.10.02.687 E017.09.03.020
N051.09.49.900 E017.09.14.573
N051.09.47.495 E017.09.14.335
N051.09.44.042 E017.09.13.619
N051.09.43.942 E017.09.14.584
N051.09.39.877 E017.09.14.184
N051.09.35.320 E017.09.08.644
N051.09.35.467 E017.09.10.462
N051.09.28.001 E017.09.11.164
N051.08.59.039 E017.08.19.849
N051.08.33.011 E017.08.48.098
N051.08.18.143 E017.08.24.284
N051.07.53.296 E017.08.03.556
N051.08.33.479 E017.06.36.947
N051.08.18.676 E017.05.52.606
N051.07.58.505 E017.07.00.404
N051.07.47.528 E017.07.01.906
N051.07.06.434 E017.08.03.203
N051.06.36.158 E017.09.39.301
N051.06.18.223 E017.09.35.996
N051.05.46.208 E017.10.04.152
N051.05.40.844 E017.09.55.562
N051.05.42.666 E017.09.53.644
N051.05.42.738 E017.09.50.497
N051.05.36.712 E017.09.43.628
N051.05.33.547 E017.09.43.096
N051.06.34.600 E017.07.42.442
N051.06.30.654 E017.07.31.361
N051.06.06.707 E017.07.35.918
N051.05.47.987 E017.06.32.638
N051.05.49.124 E017.05.51.605
N051.05.55.316 E017.04.48.504
N051.05.19.475 E017.04.30.914
N051.05.10.453 E017.04.46.639
N051.04.51.272 E017.05.57.530
N051.04.08.396 E017.05.58.816
N051.04.00.584 E017.05.09.859
N051.04.28.628 E017.04.30.598
N051.04.06.830 E017.03.47.866
N051.03.20.938 E017.03.57.053
N051.03.18.047 E017.03.23.915
N051.04.00.980 E017.03.03.661
N051.04.01.070 E017.02.33.691
N051.03.38.160 E017.02.25.674
N051.03.28.260 E017.02.00.384
N051.03.02.376 E017.01.47.629
N051.03.12.784 E017.00.35.014
N051.03.16.070 E017.00.21.164
N051.03.14.893 E017.00.20.272
N051.03.20.660 E016.59.39.984
N051.03.24.466 E016.59.27.848
N051.03.25.088 E016.59.27.020
N051.03.24.808 E016.59.26.761
N051.03.50.796 E016.58.03.904
N051.04.03.742 E016.58.10.261
N051.04.05.603 E016.59.08.639
N051.04.23.520 E016.59.19.759
N051.04.31.544 E016.58.59.282
N051.04.31.732 E016.57.37.242
N051.04.48.734 E016.57.12.064
N051.05.13.560 E016.57.57.917
N051.05.25.566 E016.57.39.028
N051.05.25.667 E016.56.50.100
N051.05.14.795 E016.56.04.301
N051.05.23.784 E016.55.54.854
N051.06.30.467 E016.56.53.484
N051.06.45.454 E016.56.37.748
N051.07.01.477 E016.56.01.478
N051.07.02.561 E016.55.14.110
N051.06.54.648 E016.54.39.348
N051.06.25.772 E016.54.17.172
N051.06.13.849 E016.53.55.039
N051.06.11.912 E016.53.18.726
N051.06.29.905 E016.52.48.770
N051.07.11.687 E016.53.45.701
N051.07.14.790 E016.52.31.487
N051.06.47.887 E016.52.21.961
N051.06.59.976 E016.50.44.084
N051.07.53.807 E016.50.44.153
N051.08.47.641 E016.50.47.378
N051.08.52.634 E016.50.39.484
N051.09.35.446 E016.51.22.208
N051.09.03.488 E016.52.06.406
N051.09.22.406 E016.52.23.826
N051.10.13.206 E016.52.52.370
N051.10.07.140 E016.53.49.268
N051.10.46.949 E016.54.30.470
N051.10.30.925 E016.55.11.539
N051.09.45.040 E016.55.25.637
N051.09.42.973 E016.56.05.147
N051.09.23.929 E016.56.55.662
N051.09.02.992 E016.56.57.170
N051.08.18.010 E016.57.52.312
N051.08.17.930 E016.58.27.066
N051.07.59.880 E016.59.14.384
N051.08.08.822 E016.59.27.060
N051.08.38.767 E016.59.11.393
N051.08.50.568 E017.00.17.809
N051.09.17.485 E017.00.17.935
N051.10.07.435 E016.59.37.064
N051.09.56.700 E016.57.57.427
N051.10.10.711 E016.57.32.184
N051.10.45.408 E016.58.59.279
N051.11.58.308 E016.58.05.797
N051.12.06.235 E016.58.27.973
N051.10.21.328 E017.00.02.423
N051.10.47.125 E017.00.51.559
N051.10.35.065 E017.01.29.449
N051.10.13.080 E017.01.48.310
N051.09.53.993 E017.02.38.796
N051.09.40.914 E017.03.19.822
N051.08.55.727 E017.05.03.865
N051.08.30.887 E017.04.36.844
N051.08.32.698 E017.05.33.738
N051.09.24.232 E017.07.05.754
N051.09.34.247 E017.06.53.179
N051.09.40.406 E017.06.01.058
N051.10.11.345 E017.05.51.778
; - Zielona_Góra
URBAN region_URBAN N051.53.53.758 E015.30.33.188
N051.54.27.760 E015.30.16.146
N051.54.36.738 E015.30.14.699
N051.54.45.882 E015.29.50.773
N051.55.15.686 E015.30.02.552
N051.55.23.869 E015.29.33.785
N051.55.28.088 E015.29.01.730
N051.55.42.107 E015.28.52.338
N051.55.51.949 E015.29.08.574
N051.56.19.982 E015.28.49.786
N051.56.20.238 E015.28.14.437
N051.56.31.186 E015.28.16.234
N051.56.39.005 E015.28.37.261
N051.56.59.924 E015.28.37.628
N051.57.06.030 E015.28.20.053
N051.57.19.940 E015.28.25.115
N051.57.33.656 E015.28.57.508
N051.57.27.526 E015.29.18.298
N051.57.16.567 E015.29.18.107
N051.57.11.444 E015.29.37.309
N051.57.20.236 E015.30.01.580
N051.57.16.981 E015.30.36.886
N051.57.20.941 E015.30.40.176
N051.57.20.862 E015.30.51.426
N051.57.22.795 E015.30.59.501
N051.57.54.479 E015.31.25.806
N051.57.58.403 E015.31.33.920
N051.58.09.530 E015.31.11.611
N051.58.29.298 E015.31.32.884
N051.58.22.030 E015.32.11.346
N051.58.09.811 E015.32.44.891
N051.57.36.364 E015.31.49.591
N051.57.14.594 E015.31.29.896
N051.57.06.476 E015.31.49.033
N051.56.22.704 E015.31.40.181
N051.56.25.033 E015.33.05.404
N051.55.53.947 E015.33.30.521
N051.55.46.207 E015.33.01.447
N051.56.11.339 E015.32.33.004
N051.56.13.528 E015.32.07.328
N051.56.02.569 E015.32.07.127
N051.55.52.792 E015.31.42.841
N051.55.28.895 E015.31.40.789
N051.55.12.324 E015.30.52.290
N051.54.35.417 E015.30.58.036
N051.54.34.333 E015.31.09.257
; - Lódz
URBAN region_URBAN N051.49.46.690 E019.25.07.144
N051.49.48.097 E019.25.11.118
N051.49.51.924 E019.25.28.636
N051.49.52.241 E019.25.30.940
N051.49.52.586 E019.25.46.470
N051.49.55.686 E019.25.56.806
N051.49.55.535 E019.26.00.445
N051.49.56.521 E019.26.08.300
N051.49.57.457 E019.26.09.157
N051.49.38.917 E019.26.35.308
N051.49.30.835 E019.26.05.496
N051.49.10.272 E019.26.13.524
N051.48.55.850 E019.26.26.570
N051.48.59.926 E019.26.33.220
N051.49.12.248 E019.26.31.704
N051.49.34.608 E019.27.21.492
N051.48.58.579 E019.27.45.842
N051.48.46.174 E019.28.05.509
N051.49.17.497 E019.29.51.544
N051.50.12.127 E019.32.12.019
N051.50.03.037 E019.32.26.416
N051.49.04.411 E019.30.21.334
N051.48.23.695 E019.29.55.352
N051.48.17.950 E019.29.55.759
N051.48.05.684 E019.29.45.704
N051.47.51.266 E019.29.55.428
N051.48.11.246 E019.31.46.254
N051.48.04.972 E019.32.09.280
N051.47.55.979 E019.34.58.109
N051.48.37.116 E019.35.13.171
N051.48.36.976 E019.35.38.033
N051.48.04.748 E019.35.41.734
N051.48.26.327 E019.36.37.976
N051.48.18.504 E019.36.54.439
N051.47.46.586 E019.36.04.270
N051.47.41.172 E019.36.49.763
N051.47.28.266 E019.36.53.723
N051.46.38.564 E019.35.19.838
N051.47.27.924 E019.34.05.948
N051.47.34.159 E019.32.13.823
N051.46.35.710 E019.32.03.149
N051.46.25.867 E019.34.46.538
N051.46.11.665 E019.34.52.558
N051.46.18.214 E019.32.12.811
N051.45.58.730 E019.32.09.258
N051.45.25.063 E019.35.33.317
N051.46.00.689 E019.36.50.404
N051.45.55.476 E019.37.00.678
N051.45.48.589 E019.36.50.584
N051.45.40.403 E019.36.33.404
N051.45.39.096 E019.36.36.673
N051.44.54.157 E019.35.30.826
N051.44.57.966 E019.32.49.668
N051.44.46.939 E019.31.58.418
N051.43.56.600 E019.32.07.642
N051.44.37.252 E019.33.25.650
N051.44.20.393 E019.36.17.942
N051.44.41.132 E019.35.55.475
N051.44.52.609 E019.36.16.326
N051.44.36.974 E019.36.47.142
N051.44.53.534 E019.37.18.419
N051.44.48.311 E019.37.30.756
N051.44.06.166 E019.36.28.084
N051.44.21.822 E019.33.32.029
N051.43.36.008 E019.32.20.548
N051.42.53.953 E019.32.47.890
N051.43.05.084 E019.34.14.880
N051.42.42.757 E019.35.31.085
N051.42.26.093 E019.35.16.382
N051.42.42.163 E019.33.24.955
N051.42.28.465 E019.31.41.772
N051.42.38.747 E019.31.38.611
N051.42.46.789 E019.32.11.659
N051.43.03.209 E019.32.11.879
N051.43.25.882 E019.31.54.052
N051.43.35.177 E019.31.42.643
N051.43.22.008 E019.31.07.871
N051.43.32.459 E019.30.30.110
N051.43.26.342 E019.30.21.798
N051.42.54.479 E019.30.31.280
N051.42.41.170 E019.30.24.523
N051.42.34.855 E019.30.55.739
N051.42.26.615 E019.31.02.219
N051.42.16.423 E019.30.47.268
N051.42.26.849 E019.30.14.461
N051.42.26.960 E019.29.51.407
N051.42.18.749 E019.29.51.302
N051.42.15.818 E019.29.19.979
N051.41.54.413 E019.28.48.428
N051.41.52.379 E019.28.45.113
N051.41.52.339 E019.28.53.364
N051.41.46.468 E019.28.27.977
N051.41.46.385 E019.28.09.854
N051.41.45.092 E019.28.01.477
N051.41.20.195 E019.28.07.320
N051.41.20.533 E019.27.41.450
N051.41.16.148 E019.27.42.041
N051.41.15.270 E019.27.20.570
N051.41.22.168 E019.27.10.526
N051.41.17.243 E019.27.03.614
N051.41.09.654 E019.26.21.588
N051.41.10.633 E019.26.02.029
N051.41.09.974 E019.26.00.395
N051.41.10.007 E019.25.59.988
N051.41.09.438 E019.25.59.066
N051.41.06.317 E019.25.51.337
N051.41.13.038 E019.25.28.837
N051.41.11.357 E019.25.14.552
N051.41.24.781 E019.25.05.164
N051.41.27.406 E019.25.08.112
N051.41.28.097 E019.25.05.495
N051.41.31.434 E019.25.02.586
N051.41.33.770 E019.24.57.744
N051.41.35.934 E019.24.35.759
N051.41.43.321 E019.24.07.722
N051.41.40.020 E019.24.06.120
N051.41.40.063 E019.24.05.702
N051.41.35.488 E019.24.01.537
N051.41.36.416 E019.23.55.100
N051.41.53.596 E019.24.03.564
N051.41.47.346 E019.24.26.550
N051.42.16.945 E019.25.06.377
N051.42.23.656 E019.22.48.115
N051.42.39.035 E019.22.51.560
N051.42.33.318 E019.25.18.080
N051.42.37.393 E019.25.24.715
N051.42.51.844 E019.25.05.106
N051.43.08.238 E019.25.11.870
N051.43.06.269 E019.24.52.081
N051.43.28.913 E019.24.35.845
N051.43.35.958 E019.25.10.517
N051.43.51.323 E019.25.17.270
N051.43.58.418 E019.25.38.770
N051.44.07.670 E019.25.35.573
N051.43.59.574 E019.25.07.471
N051.44.20.170 E019.24.51.214
N051.44.20.310 E019.24.16.607
N051.44.06.191 E019.23.12.192
N051.44.52.494 E019.22.41.336
N051.45.13.709 E019.24.08.914
N051.45.22.957 E019.24.05.713
N051.45.26.096 E019.23.50.906
N051.45.35.345 E019.23.47.702
N051.45.59.918 E019.24.02.794
N051.46.24.600 E019.23.49.855
N051.46.12.479 E019.23.00.254
N051.46.20.752 E019.22.43.846
N051.46.41.383 E019.22.14.354
N051.46.57.760 E019.22.27.707
N051.47.00.686 E019.23.07.328
N051.47.15.011 E019.23.19.018
N051.47.18.089 E019.23.19.050
N051.47.30.721 E019.21.55.030
N051.47.59.395 E019.22.11.802
N051.48.12.935 E019.21.17.467
N051.48.21.164 E019.21.12.593
N051.48.53.860 E019.21.52.513
N051.48.42.386 E019.22.41.927
N051.48.51.534 E019.23.05.125
N051.48.56.480 E019.23.53.048
N051.49.05.588 E019.24.26.161



